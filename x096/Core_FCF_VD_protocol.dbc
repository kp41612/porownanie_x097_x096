VERSION "7"
// BundelVersion=v4.20.10_RC1

NS_ :

BS_:

BU_: EyeQ4 MCU

BO_ 118 Core_FCF_VD_protocol: 180 EyeQ4
 SG_ FCF_VD_Zero_byte : 0|8@1+ (1,0) [0|255] "NA" MCU
 SG_ FCF_VD_Protocol_Version : 8|8@1+ (1,0) [7|7] "counter" MCU
 SG_ FCF_VD_SyncID : 16|8@1+ (1,0) [0|255] "counter" MCU
 SG_ Reserved_1 : 24|8@1+ (1,0) [0|0] "NA" MCU
 SG_ FCF_Header_CRC : 32|32@1+ (1,0) [0|4294967295] "NA" MCU
 SG_ FCF_VD_AEB_Supp_FCV : 64|16@1+ (1,0) [0|65535] "BITWIZE" MCU
 SG_ FCF_VD_Alert_FCV : 80|16@1+ (1,0) [0|65535] "ENUM" MCU
 SG_ FCF_VD_ID_FCV : 96|8@1+ (1,0) [0|255] "counter" MCU
 SG_ FCF_VD_HeadWay_Alert : 104|1@1+ (1,0) [0|1] "ENUM" MCU
 SG_ FCF_VD_HeadWay_Distance : 105|11@1+ (0.01,0) [0|10] "m" MCU
 SG_ FCF_VD_Header_Buffer_C0 : 116|8@1+ (0.1,0) [0|13] "NA" MCU
 SG_ FCF_VD_Header_Buffer_C1 : 124|2@1+ (1,0) [0|3] "NA" MCU
 SG_ Reserved_2 : 126|2@1+ (1,0) [0|0] "NA" MCU
 SG_ FCF_VD_HW_Supp_Reason : 128|16@1+ (1,0) [0|65535] "BITWIZE" MCU
 SG_ FCF_VD_Header_Buffer_C2 : 144|8@1+ (0.1,0) [0|13] "NA" MCU
 SG_ FCF_Header_Buffer : 152|8@1+ (1,0) [0|0] "NA" MCU
 SG_ FCF_VD_CRC_A : 160|32@1+ (1,0) [0|4294967295] "NA" MCU
 SG_ FCF_VD_Alert_A : 192|16@1+ (1,0) [0|65535] "ENUM" MCU
 SG_ FCF_VD_ID_A : 208|8@1+ (1,0) [0|255] "counter" MCU
 SG_ FCF_VD_Buffer_C0_A : 216|8@1+ (0.1,0) [0|13] "NA" MCU
 SG_ FCF_VD_AEB_Supp_A : 224|16@1+ (1,0) [0|65535] "BITWIZE" MCU
 SG_ FCF_VD_Safety_Suppressed_A : 240|1@1+ (1,0) [0|1] "bool" MCU
 SG_ Reserved_3 : 241|15@1+ (1,0) [0|0] "NA" MCU
 SG_ FCF_VD_FCW_Supp_A : 256|32@1+ (1,0) [0|4294967295] "BITWIZE" MCU
 SG_ FCF_VD_Set_Type_A : 288|2@1+ (1,0) [0|3] "ENUM" MCU
 SG_ FCF_VD_TTC_Thresh_A : 290|10@1+ (0.01,0) [0|10] "s" MCU
 SG_ FCF_VD_TTC_A : 300|10@1+ (0.01,0) [0|10] "s" MCU
 SG_ FCF_VD_Buffer_A : 310|10@1+ (1,0) [0|0] "NA" MCU
 SG_ FCF_VD_CRC_B : 320|32@1+ (1,0) [0|4294967295] "NA" MCU
 SG_ FCF_VD_Alert_B : 352|16@1+ (1,0) [0|65535] "ENUM" MCU
 SG_ FCF_VD_ID_B : 368|8@1+ (1,0) [0|255] "counter" MCU
 SG_ FCF_VD_Buffer_C0_B : 376|8@1+ (0.1,0) [0|13] "NA" MCU
 SG_ FCF_VD_AEB_Supp_B : 384|16@1+ (1,0) [0|65535] "BITWIZE" MCU
 SG_ FCF_VD_Safety_Suppressed_B : 400|1@1+ (1,0) [0|1] "bool" MCU
 SG_ Reserved_4 : 401|15@1+ (1,0) [0|0] "NA" MCU
 SG_ FCF_VD_FCW_Supp_B : 416|32@1+ (1,0) [0|4294967295] "BITWIZE" MCU
 SG_ FCF_VD_Set_Type_B : 448|2@1+ (1,0) [0|3] "ENUM" MCU
 SG_ FCF_VD_TTC_Thresh_B : 450|10@1+ (0.01,0) [0|10] "s" MCU
 SG_ FCF_VD_TTC_B : 460|10@1+ (0.01,0) [0|10] "s" MCU
 SG_ FCF_VD_Buffer_B : 470|10@1+ (1,0) [0|0] "NA" MCU
 SG_ FCF_VD_CRC_C : 480|32@1+ (1,0) [0|4294967295] "NA" MCU
 SG_ FCF_VD_Alert_C : 512|16@1+ (1,0) [0|65535] "ENUM" MCU
 SG_ FCF_VD_ID_C : 528|8@1+ (1,0) [0|255] "counter" MCU
 SG_ FCF_VD_Buffer_C0_C : 536|8@1+ (0.1,0) [0|13] "NA" MCU
 SG_ FCF_VD_AEB_Supp_C : 544|16@1+ (1,0) [0|65535] "BITWIZE" MCU
 SG_ FCF_VD_Safety_Suppressed_C : 560|1@1+ (1,0) [0|1] "bool" MCU
 SG_ Reserved_5 : 561|15@1+ (1,0) [0|0] "NA" MCU
 SG_ FCF_VD_FCW_Supp_C : 576|32@1+ (1,0) [0|4294967295] "BITWIZE" MCU
 SG_ FCF_VD_Set_Type_C : 608|2@1+ (1,0) [0|3] "ENUM" MCU
 SG_ FCF_VD_TTC_Thresh_C : 610|10@1+ (0.01,0) [0|10] "s" MCU
 SG_ FCF_VD_TTC_C : 620|10@1+ (0.01,0) [0|10] "s" MCU
 SG_ FCF_VD_Buffer_C : 630|10@1+ (1,0) [0|0] "NA" MCU
 SG_ FCF_VD_CRC_D : 640|32@1+ (1,0) [0|4294967295] "NA" MCU
 SG_ FCF_VD_Alert_D : 672|16@1+ (1,0) [0|65535] "ENUM" MCU
 SG_ FCF_VD_ID_D : 688|8@1+ (1,0) [0|255] "counter" MCU
 SG_ FCF_VD_Buffer_C0_D : 696|8@1+ (0.1,0) [0|13] "NA" MCU
 SG_ FCF_VD_AEB_Supp_D : 704|16@1+ (1,0) [0|65535] "BITWIZE" MCU
 SG_ FCF_VD_Safety_Suppressed_D : 720|1@1+ (1,0) [0|1] "bool" MCU
 SG_ Reserved_6 : 721|15@1+ (1,0) [0|0] "NA" MCU
 SG_ FCF_VD_FCW_Supp_D : 736|32@1+ (1,0) [0|4294967295] "BITWIZE" MCU
 SG_ FCF_VD_Set_Type_D : 768|2@1+ (1,0) [0|3] "ENUM" MCU
 SG_ FCF_VD_TTC_Thresh_D : 770|10@1+ (0.01,0) [0|10] "s" MCU
 SG_ FCF_VD_TTC_D : 780|10@1+ (0.01,0) [0|10] "s" MCU
 SG_ FCF_VD_Buffer_D : 790|10@1+ (1,0) [0|0] "NA" MCU
 SG_ FCF_VD_CRC_E : 800|32@1+ (1,0) [0|4294967295] "NA" MCU
 SG_ FCF_VD_Alert_E : 832|16@1+ (1,0) [0|65535] "ENUM" MCU
 SG_ FCF_VD_ID_E : 848|8@1+ (1,0) [0|255] "counter" MCU
 SG_ FCF_VD_Buffer_C0_E : 856|8@1+ (0.1,0) [0|13] "NA" MCU
 SG_ FCF_VD_AEB_Supp_E : 864|16@1+ (1,0) [0|65535] "BITWIZE" MCU
 SG_ FCF_VD_Safety_Suppressed_E : 880|1@1+ (1,0) [0|1] "bool" MCU
 SG_ Reserved_7 : 881|15@1+ (1,0) [0|0] "NA" MCU
 SG_ FCF_VD_FCW_Supp_E : 896|32@1+ (1,0) [0|4294967295] "BITWIZE" MCU
 SG_ FCF_VD_Set_Type_E : 928|2@1+ (1,0) [0|3] "ENUM" MCU
 SG_ FCF_VD_TTC_Thresh_E : 930|10@1+ (0.01,0) [0|10] "s" MCU
 SG_ FCF_VD_TTC_E : 940|10@1+ (0.01,0) [0|10] "s" MCU
 SG_ FCF_VD_Buffer_E : 950|10@1+ (1,0) [0|0] "NA" MCU
 SG_ FCF_VD_CRC_F : 960|32@1+ (1,0) [0|4294967295] "NA" MCU
 SG_ FCF_VD_Alert_F : 992|16@1+ (1,0) [0|65535] "ENUM" MCU
 SG_ FCF_VD_ID_F : 1008|8@1+ (1,0) [0|255] "counter" MCU
 SG_ FCF_VD_Buffer_C0_F : 1016|8@1+ (0.1,0) [0|13] "NA" MCU
 SG_ FCF_VD_AEB_Supp_F : 1024|16@1+ (1,0) [0|65535] "BITWIZE" MCU
 SG_ FCF_VD_Safety_Suppressed_F : 1040|1@1+ (1,0) [0|1] "bool" MCU
 SG_ Reserved_8 : 1041|15@1+ (1,0) [0|0] "NA" MCU
 SG_ FCF_VD_FCW_Supp_F : 1056|32@1+ (1,0) [0|4294967295] "BITWIZE" MCU
 SG_ FCF_VD_Set_Type_F : 1088|2@1+ (1,0) [0|3] "ENUM" MCU
 SG_ FCF_VD_TTC_Thresh_F : 1090|10@1+ (0.01,0) [0|10] "s" MCU
 SG_ FCF_VD_TTC_F : 1100|10@1+ (0.01,0) [0|10] "s" MCU
 SG_ FCF_VD_Buffer_F : 1110|10@1+ (1,0) [0|0] "NA" MCU
 SG_ FCF_VD_CRC_G : 1120|32@1+ (1,0) [0|4294967295] "NA" MCU
 SG_ FCF_VD_Alert_G : 1152|16@1+ (1,0) [0|65535] "ENUM" MCU
 SG_ FCF_VD_ID_G : 1168|8@1+ (1,0) [0|255] "counter" MCU
 SG_ FCF_VD_Buffer_C0_G : 1176|8@1+ (0.1,0) [0|13] "NA" MCU
 SG_ FCF_VD_AEB_Supp_G : 1184|16@1+ (1,0) [0|65535] "BITWIZE" MCU
 SG_ FCF_VD_Safety_Suppressed_G : 1200|1@1+ (1,0) [0|1] "bool" MCU
 SG_ Reserved_9 : 1201|15@1+ (1,0) [0|0] "NA" MCU
 SG_ FCF_VD_FCW_Supp_G : 1216|32@1+ (1,0) [0|4294967295] "BITWIZE" MCU
 SG_ FCF_VD_Set_Type_G : 1248|2@1+ (1,0) [0|3] "ENUM" MCU
 SG_ FCF_VD_TTC_Thresh_G : 1250|10@1+ (0.01,0) [0|10] "s" MCU
 SG_ FCF_VD_TTC_G : 1260|10@1+ (0.01,0) [0|10] "s" MCU
 SG_ FCF_VD_Buffer_G : 1270|10@1+ (1,0) [0|0] "NA" MCU
 SG_ FCF_VD_CRC_H : 1280|32@1+ (1,0) [0|4294967295] "NA" MCU
 SG_ FCF_VD_Alert_H : 1312|16@1+ (1,0) [0|65535] "ENUM" MCU
 SG_ FCF_VD_ID_H : 1328|8@1+ (1,0) [0|255] "counter" MCU
 SG_ FCF_VD_Buffer_C0_H : 1336|8@1+ (0.1,0) [0|13] "NA" MCU
 SG_ FCF_VD_AEB_Supp_H : 1344|16@1+ (1,0) [0|65535] "BITWIZE" MCU
 SG_ FCF_VD_Safety_Suppressed_H : 1360|1@1+ (1,0) [0|1] "bool" MCU
 SG_ Reserved_10 : 1361|15@1+ (1,0) [0|0] "NA" MCU
 SG_ FCF_VD_FCW_Supp_H : 1376|32@1+ (1,0) [0|4294967295] "BITWIZE" MCU
 SG_ FCF_VD_Set_Type_H : 1408|2@1+ (1,0) [0|3] "ENUM" MCU
 SG_ FCF_VD_TTC_Thresh_H : 1410|10@1+ (0.01,0) [0|10] "s" MCU
 SG_ FCF_VD_TTC_H : 1420|10@1+ (0.01,0) [0|10] "s" MCU
 SG_ FCF_VD_Buffer_H : 1430|10@1+ (1,0) [0|0] "NA" MCU

CM_ SG_ 118 FCF_VD_Zero_byte "in case set to FF message is not available.";
CM_ SG_ 118 FCF_VD_Protocol_Version "Denotes the protocol version";
CM_ SG_ 118 FCF_VD_SyncID "Synchronizes between messages in same frame";
CM_ SG_ 118 FCF_Header_CRC "Calculated over all header signals. From the signal after the CRC until the first signal in the elements FCF_VD_CRC_A not including";
CM_ SG_ 118 FCF_VD_AEB_Supp_FCV "AEB suppression reason ";
CM_ SG_ 118 FCF_VD_Alert_FCV "Fusion suggestion. Based on configurable specific sets G, H for this purpose.";
CM_ SG_ 118 FCF_VD_ID_FCV "ID of vehicle on which activation was issued";
CM_ SG_ 118 FCF_VD_HeadWay_Alert "HeadWay Alert";
CM_ SG_ 118 FCF_VD_HeadWay_Distance "Headway distance in meters. Not Implemented";
CM_ SG_ 118 FCF_VD_HW_Supp_Reason "For suppression head way reasons please refer to documentations of the Frontal Collision Functionalities.";
CM_ SG_ 118 FCF_VD_CRC_A "CRC over FCF_VD_ID_X and the following signal (16 bit total) only";
CM_ SG_ 118 FCF_VD_Alert_A "Alert for this set";
CM_ SG_ 118 FCF_VD_ID_A "ID of vehicle on which activation was issued";
CM_ SG_ 118 FCF_VD_AEB_Supp_A "AEB suppression reason ";
CM_ SG_ 118 FCF_VD_Safety_Suppressed_A "The bit indicates allert suppresion as for safety event";
CM_ SG_ 118 FCF_VD_FCW_Supp_A "FCW suppression reason  ";
CM_ SG_ 118 FCF_VD_Set_Type_A "The type of the raised alert";
CM_ SG_ 118 FCF_VD_TTC_Thresh_A "TTC used threshold";
CM_ SG_ 118 FCF_VD_TTC_A "Estimated TTC for debug usage only";
CM_ SG_ 118 FCF_VD_CRC_B "CRC over FCF_VD_ID_X and the following signal (16 bit total) only";
CM_ SG_ 118 FCF_VD_Alert_B "Alert for this set";
CM_ SG_ 118 FCF_VD_ID_B "ID of vehicle on which activation was issued";
CM_ SG_ 118 FCF_VD_AEB_Supp_B "AEB suppression reason: ";
CM_ SG_ 118 FCF_VD_Safety_Suppressed_B "The bit indicates allert suppresion as for safety event";
CM_ SG_ 118 FCF_VD_FCW_Supp_B "FCW suppression reason  ";
CM_ SG_ 118 FCF_VD_Set_Type_B "The type of the raised alert";
CM_ SG_ 118 FCF_VD_TTC_Thresh_B "TTC used threshold";
CM_ SG_ 118 FCF_VD_TTC_B "Estimated TTC for debug usage only";
CM_ SG_ 118 FCF_VD_CRC_C "CRC over FCF_VD_ID_X and the following signal (16 bit total) only";
CM_ SG_ 118 FCF_VD_Alert_C "Alert for this set";
CM_ SG_ 118 FCF_VD_ID_C "ID of vehicle on which activation was issued";
CM_ SG_ 118 FCF_VD_AEB_Supp_C "AEB suppression reason: ";
CM_ SG_ 118 FCF_VD_Safety_Suppressed_C "The bit indicates allert suppresion as for safety event";
CM_ SG_ 118 FCF_VD_FCW_Supp_C "FCW suppression reason  ";
CM_ SG_ 118 FCF_VD_Set_Type_C "The type of the raised alert";
CM_ SG_ 118 FCF_VD_TTC_Thresh_C "TTC used threshold";
CM_ SG_ 118 FCF_VD_TTC_C "Estimated TTC for debug usage only";
CM_ SG_ 118 FCF_VD_CRC_D "CRC over FCF_VD_ID_X and the following signal (16 bit total) only";
CM_ SG_ 118 FCF_VD_Alert_D "Alert for this set";
CM_ SG_ 118 FCF_VD_ID_D "ID of vehicle on which activation was issued";
CM_ SG_ 118 FCF_VD_AEB_Supp_D "AEB suppression reason: ";
CM_ SG_ 118 FCF_VD_Safety_Suppressed_D "The bit indicates allert suppresion as for safety event";
CM_ SG_ 118 FCF_VD_FCW_Supp_D "FCW suppression reason  ";
CM_ SG_ 118 FCF_VD_Set_Type_D "The type of the raised alert";
CM_ SG_ 118 FCF_VD_TTC_Thresh_D "TTC used threshold";
CM_ SG_ 118 FCF_VD_TTC_D "Estimated TTC for debug usage only";
CM_ SG_ 118 FCF_VD_CRC_E "CRC over FCF_VD_ID_X and the following signal (16 bit total) only";
CM_ SG_ 118 FCF_VD_Alert_E "Alert for this set";
CM_ SG_ 118 FCF_VD_ID_E "ID of vehicle on which activation was issued";
CM_ SG_ 118 FCF_VD_AEB_Supp_E "AEB suppression reason: ";
CM_ SG_ 118 FCF_VD_Safety_Suppressed_E "The bit indicates allert suppresion as for safety event";
CM_ SG_ 118 FCF_VD_FCW_Supp_E "FCW suppression reason  ";
CM_ SG_ 118 FCF_VD_Set_Type_E "The type of the raised alert";
CM_ SG_ 118 FCF_VD_TTC_Thresh_E "TTC used threshold";
CM_ SG_ 118 FCF_VD_TTC_E "Estimated TTC for debug usage only";
CM_ SG_ 118 FCF_VD_CRC_F "CRC over FCF_VD_ID_X and the following signal (16 bit total) only";
CM_ SG_ 118 FCF_VD_Alert_F "Alert for this set";
CM_ SG_ 118 FCF_VD_ID_F "ID of vehicle on which activation was issued";
CM_ SG_ 118 FCF_VD_AEB_Supp_F "AEB suppression reason: ";
CM_ SG_ 118 FCF_VD_Safety_Suppressed_F "The bit indicates allert suppresion as for safety event";
CM_ SG_ 118 FCF_VD_FCW_Supp_F "FCW suppression reason  ";
CM_ SG_ 118 FCF_VD_Set_Type_F "The type of the raised alert";
CM_ SG_ 118 FCF_VD_TTC_Thresh_F "TTC used threshold";
CM_ SG_ 118 FCF_VD_TTC_F "Estimated TTC for debug usage only";
CM_ SG_ 118 FCF_VD_CRC_G "CRC over FCF_VD_ID_X and the following signal (16 bit total) only";
CM_ SG_ 118 FCF_VD_Alert_G "Alert for this set";
CM_ SG_ 118 FCF_VD_ID_G "ID of vehicle on which activation was issued";
CM_ SG_ 118 FCF_VD_AEB_Supp_G "AEB suppression reason: ";
CM_ SG_ 118 FCF_VD_Safety_Suppressed_G "The bit indicates allert suppresion as for safety event";
CM_ SG_ 118 FCF_VD_FCW_Supp_G "FCW suppression reason  ";
CM_ SG_ 118 FCF_VD_Set_Type_G "The type of the raised alert";
CM_ SG_ 118 FCF_VD_TTC_Thresh_G "TTC used threshold";
CM_ SG_ 118 FCF_VD_TTC_G "Estimated TTC for debug usage only";
CM_ SG_ 118 FCF_VD_CRC_H "CRC over FCF_VD_ID_X and the following signal (16 bit total) only";
CM_ SG_ 118 FCF_VD_Alert_H "Alert for this set";
CM_ SG_ 118 FCF_VD_ID_H "ID of vehicle on which activation was issued";
CM_ SG_ 118 FCF_VD_AEB_Supp_H "AEB suppression reason: ";
CM_ SG_ 118 FCF_VD_Safety_Suppressed_H "The bit indicates allert suppresion as for safety event";
CM_ SG_ 118 FCF_VD_FCW_Supp_H "FCW suppression reason  ";
CM_ SG_ 118 FCF_VD_Set_Type_H "The type of the raised alert";
CM_ SG_ 118 FCF_VD_TTC_Thresh_H "TTC used threshold";
CM_ SG_ 118 FCF_VD_TTC_H "Estimated TTC for debug usage only";

BA_DEF_  "BusType" STRING ;
BA_DEF_ SG_  "GenSigStartValue" INT 0 0;
BA_DEF_DEF_  "GenSigStartValue" 0;
BA_DEF_DEF_  "BusType" "Ethernet";

BA_ "GenSigStartValue" SG_ 118 FCF_VD_Protocol_Version 7;
BA_ "GenSigStartValue" SG_ 118 FCF_VD_Alert_A 39270;
BA_ "GenSigStartValue" SG_ 118 FCF_VD_TTC_A 1000;
BA_ "GenSigStartValue" SG_ 118 FCF_VD_Alert_B 39270;
BA_ "GenSigStartValue" SG_ 118 FCF_VD_TTC_B 1000;
BA_ "GenSigStartValue" SG_ 118 FCF_VD_Alert_C 39270;
BA_ "GenSigStartValue" SG_ 118 FCF_VD_TTC_C 1000;
BA_ "GenSigStartValue" SG_ 118 FCF_VD_Alert_D 39270;
BA_ "GenSigStartValue" SG_ 118 FCF_VD_TTC_D 1000;
BA_ "GenSigStartValue" SG_ 118 FCF_VD_Alert_E 39270;
BA_ "GenSigStartValue" SG_ 118 FCF_VD_TTC_E 1000;
BA_ "GenSigStartValue" SG_ 118 FCF_VD_Alert_F 39270;
BA_ "GenSigStartValue" SG_ 118 FCF_VD_TTC_F 1000;
BA_ "GenSigStartValue" SG_ 118 FCF_VD_Alert_G 39270;
BA_ "GenSigStartValue" SG_ 118 FCF_VD_TTC_G 1000;
BA_ "GenSigStartValue" SG_ 118 FCF_VD_Alert_H 39270;
BA_ "GenSigStartValue" SG_ 118 FCF_VD_TTC_H 1000;

VAL_ 118 FCF_VD_AEB_Supp_FCV 12 "(BIT_12)AEB_Safety_CRC" 11 "(BIT_11)AEB_MIN_REL_V" 10 "(BIT_10)AEB_MAX_REL_V" 9 "(BIT_9)AEB_MAX_SPEED_REDUCTION" 8 "(BIT_8)AEB_LATERAL_AVOIDANCE" 7 "(BIT_7)AEB_MIN_SPEED" 6 "(BIT_6)AEB_MAX_SPEED" 5 "(BIT_5)AEB_MAX_WARN_LENGTH" 4 "(BIT_4)AEB_MAX_DISTANCE" 3 "(BIT_3)AEB_MAX_STEERING_ANGLE" 2 "(BIT_2)AEB_MAX_YAW_RATE" 1 "(BIT_1)AEB_MIN_TIME_FOR_AEB_AFTER_AEB" 0 "(BIT_0)AEB_VALIDATION" ;
VAL_ 118 FCF_VD_Alert_FCV 26248 "START" 43588 "CONTINUE" 39287 "AVOID" 0 "NO_FUSION" ;
VAL_ 118 FCF_VD_HeadWay_Alert 1 "ALERT" 0 "NO_ALERT" ;
VAL_ 118 FCF_VD_Alert_A 43605 "ALERT" 39270 "NO_ALERT" ;
VAL_ 118 FCF_VD_AEB_Supp_A 12 "(BIT_12)AEB_Safety_CRC" 11 "(BIT_11)AEB_MIN_REL_V" 10 "(BIT_10)AEB_MAX_REL_V" 9 "(BIT_9)AEB_MAX_SPEED_REDUCTION" 8 "(BIT_8)AEB_LATERAL_AVOIDANCE" 7 "(BIT_7)AEB_MIN_SPEED" 6 "(BIT_6)AEB_MAX_SPEED" 5 "(BIT_5)AEB_MAX_WARN_LENGTH" 4 "(BIT_4)AEB_MAX_DISTANCE" 3 "(BIT_3)AEB_MAX_STEERING_ANGLE" 2 "(BIT_2)AEB_MAX_YAW_RATE" 1 "(BIT_1)AEB_MIN_TIME_FOR_AEB_AFTER_AEB" 0 "(BIT_0)AEB_VALIDATION" ;
VAL_ 118 FCF_VD_Safety_Suppressed_A 1 "TRUE" 0 "FALSE" ;
VAL_ 118 FCF_VD_FCW_Supp_A 19 "(BIT_19)FCW_ABOVE_MAX_STEERING" 18 "(BIT_18)FCW_ABOVE_MAX_DISTANCE" 17 "(BIT_17)FCW_NRTA_OVER_SPEED" 16 "(BIT_16)FCW_NRTA_UNDER_SPEED" 15 "(BIT_15)FCW_NOT_READY_TO_ASSIST" 14 "(BIT_14)FCW_MAXIMUM_TIME_FOR_WARNING" 13 "(BIT_13)NA_5" 12 "(BIT_12)FCW_MINIMUM_TIME_BETWEEN_WARNINGS" 11 "(BIT_11)FCW_CLUTCH_SUPPRESSION" 10 "(BIT_10)NA_4" 9 "(BIT_9)FCW_VEH_VEH_OPENING" 8 "(BIT_8)NA_3" 7 "(BIT_7)NA_2" 6 "(BIT_6)NA_1" 5 "(BIT_5)FCW_AY_AVOID" 4 "(BIT_4)FCW_LATERAL_AVIODANCE" 3 "(BIT_3)BRAKING_SUPPRESSION_LENGTH" 2 "(BIT_2)FCW_BRAKING_SUPPRESSION" 1 "(BIT_1)FCW_ACCELERATION_SUPPRESSION_LENGTH" 0 "(BIT_0)FCW_ACCELERATION_SUPPRESSION" ;
VAL_ 118 FCF_VD_Set_Type_A 3 "EGO_TAP" 2 "HEAD_ON" 1 "FCF" 0 "UNKNOWN" ;
VAL_ 118 FCF_VD_Alert_B 43605 "ALERT" 39270 "NO_ALERT" ;
VAL_ 118 FCF_VD_AEB_Supp_B 12 "(BIT_12)AEB_Safety_CRC" 11 "(BIT_11)AEB_MIN_REL_V" 10 "(BIT_10)AEB_MAX_REL_V" 9 "(BIT_9)AEB_MAX_SPEED_REDUCTION" 8 "(BIT_8)AEB_LATERAL_AVOIDANCE" 7 "(BIT_7)AEB_MIN_SPEED" 6 "(BIT_6)AEB_MAX_SPEED" 5 "(BIT_5)AEB_MAX_WARN_LENGTH" 4 "(BIT_4)AEB_MAX_DISTANCE" 3 "(BIT_3)AEB_MAX_STEERING_ANGLE" 2 "(BIT_2)AEB_MAX_YAW_RATE" 1 "(BIT_1)AEB_MIN_TIME_FOR_AEB_AFTER_AEB" 0 "(BIT_0)AEB_VALIDATION" ;
VAL_ 118 FCF_VD_Safety_Suppressed_B 1 "TRUE" 0 "FALSE" ;
VAL_ 118 FCF_VD_FCW_Supp_B 19 "(BIT_19)FCW_ABOVE_MAX_STEERING" 18 "(BIT_18)FCW_ABOVE_MAX_DISTANCE" 17 "(BIT_17)FCW_NRTA_OVER_SPEED" 16 "(BIT_16)FCW_NRTA_UNDER_SPEED" 15 "(BIT_15)FCW_NOT_READY_TO_ASSIST" 14 "(BIT_14)FCW_MAXIMUM_TIME_FOR_WARNING" 13 "(BIT_13)NA_5" 12 "(BIT_12)FCW_MINIMUM_TIME_BETWEEN_WARNINGS" 11 "(BIT_11)FCW_CLUTCH_SUPPRESSION" 10 "(BIT_10)NA_4" 9 "(BIT_9)FCW_VEH_VEH_OPENING" 8 "(BIT_8)NA_3" 7 "(BIT_7)NA_2" 6 "(BIT_6)NA_1" 5 "(BIT_5)FCW_AY_AVOID" 4 "(BIT_4)FCW_LATERAL_AVIODANCE" 3 "(BIT_3)BRAKING_SUPPRESSION_LENGTH" 2 "(BIT_2)FCW_BRAKING_SUPPRESSION" 1 "(BIT_1)FCW_ACCELERATION_SUPPRESSION_LENGTH" 0 "(BIT_0)FCW_ACCELERATION_SUPPRESSION" ;
VAL_ 118 FCF_VD_Set_Type_B 3 "EGO_TAP" 2 "HEAD_ON" 1 "FCF" 0 "UNKNOWN" ;
VAL_ 118 FCF_VD_Alert_C 43605 "ALERT" 39270 "NO_ALERT" ;
VAL_ 118 FCF_VD_AEB_Supp_C 12 "(BIT_12)AEB_Safety_CRC" 11 "(BIT_11)AEB_MIN_REL_V" 10 "(BIT_10)AEB_MAX_REL_V" 9 "(BIT_9)AEB_MAX_SPEED_REDUCTION" 8 "(BIT_8)AEB_LATERAL_AVOIDANCE" 7 "(BIT_7)AEB_MIN_SPEED" 6 "(BIT_6)AEB_MAX_SPEED" 5 "(BIT_5)AEB_MAX_WARN_LENGTH" 4 "(BIT_4)AEB_MAX_DISTANCE" 3 "(BIT_3)AEB_MAX_STEERING_ANGLE" 2 "(BIT_2)AEB_MAX_YAW_RATE" 1 "(BIT_1)AEB_MIN_TIME_FOR_AEB_AFTER_AEB" 0 "(BIT_0)AEB_VALIDATION" ;
VAL_ 118 FCF_VD_Safety_Suppressed_C 1 "TRUE" 0 "FALSE" ;
VAL_ 118 FCF_VD_FCW_Supp_C 19 "(BIT_19)FCW_ABOVE_MAX_STEERING" 18 "(BIT_18)FCW_ABOVE_MAX_DISTANCE" 17 "(BIT_17)FCW_NRTA_OVER_SPEED" 16 "(BIT_16)FCW_NRTA_UNDER_SPEED" 15 "(BIT_15)FCW_NOT_READY_TO_ASSIST" 14 "(BIT_14)FCW_MAXIMUM_TIME_FOR_WARNING" 13 "(BIT_13)NA_5" 12 "(BIT_12)FCW_MINIMUM_TIME_BETWEEN_WARNINGS" 11 "(BIT_11)FCW_CLUTCH_SUPPRESSION" 10 "(BIT_10)NA_4" 9 "(BIT_9)FCW_VEH_VEH_OPENING" 8 "(BIT_8)NA_3" 7 "(BIT_7)NA_2" 6 "(BIT_6)NA_1" 5 "(BIT_5)FCW_AY_AVOID" 4 "(BIT_4)FCW_LATERAL_AVIODANCE" 3 "(BIT_3)BRAKING_SUPPRESSION_LENGTH" 2 "(BIT_2)FCW_BRAKING_SUPPRESSION" 1 "(BIT_1)FCW_ACCELERATION_SUPPRESSION_LENGTH" 0 "(BIT_0)FCW_ACCELERATION_SUPPRESSION" ;
VAL_ 118 FCF_VD_Set_Type_C 3 "EGO_TAP" 2 "HEAD_ON" 1 "FCF" 0 "UNKNOWN" ;
VAL_ 118 FCF_VD_Alert_D 43605 "ALERT" 39270 "NO_ALERT" ;
VAL_ 118 FCF_VD_AEB_Supp_D 12 "(BIT_12)AEB_Safety_CRC" 11 "(BIT_11)AEB_MIN_REL_V" 10 "(BIT_10)AEB_MAX_REL_V" 9 "(BIT_9)AEB_MAX_SPEED_REDUCTION" 8 "(BIT_8)AEB_LATERAL_AVOIDANCE" 7 "(BIT_7)AEB_MIN_SPEED" 6 "(BIT_6)AEB_MAX_SPEED" 5 "(BIT_5)AEB_MAX_WARN_LENGTH" 4 "(BIT_4)AEB_MAX_DISTANCE" 3 "(BIT_3)AEB_MAX_STEERING_ANGLE" 2 "(BIT_2)AEB_MAX_YAW_RATE" 1 "(BIT_1)AEB_MIN_TIME_FOR_AEB_AFTER_AEB" 0 "(BIT_0)AEB_VALIDATION" ;
VAL_ 118 FCF_VD_Safety_Suppressed_D 1 "TRUE" 0 "FALSE" ;
VAL_ 118 FCF_VD_FCW_Supp_D 19 "(BIT_19)FCW_ABOVE_MAX_STEERING" 18 "(BIT_18)FCW_ABOVE_MAX_DISTANCE" 17 "(BIT_17)FCW_NRTA_OVER_SPEED" 16 "(BIT_16)FCW_NRTA_UNDER_SPEED" 15 "(BIT_15)FCW_NOT_READY_TO_ASSIST" 14 "(BIT_14)FCW_MAXIMUM_TIME_FOR_WARNING" 13 "(BIT_13)NA_5" 12 "(BIT_12)FCW_MINIMUM_TIME_BETWEEN_WARNINGS" 11 "(BIT_11)FCW_CLUTCH_SUPPRESSION" 10 "(BIT_10)NA_4" 9 "(BIT_9)FCW_VEH_VEH_OPENING" 8 "(BIT_8)NA_3" 7 "(BIT_7)NA_2" 6 "(BIT_6)NA_1" 5 "(BIT_5)FCW_AY_AVOID" 4 "(BIT_4)FCW_LATERAL_AVIODANCE" 3 "(BIT_3)BRAKING_SUPPRESSION_LENGTH" 2 "(BIT_2)FCW_BRAKING_SUPPRESSION" 1 "(BIT_1)FCW_ACCELERATION_SUPPRESSION_LENGTH" 0 "(BIT_0)FCW_ACCELERATION_SUPPRESSION" ;
VAL_ 118 FCF_VD_Set_Type_D 3 "EGO_TAP" 2 "HEAD_ON" 1 "FCF" 0 "UNKNOWN" ;
VAL_ 118 FCF_VD_Alert_E 43605 "ALERT" 39270 "NO_ALERT" ;
VAL_ 118 FCF_VD_AEB_Supp_E 12 "(BIT_12)AEB_Safety_CRC" 11 "(BIT_11)AEB_MIN_REL_V" 10 "(BIT_10)AEB_MAX_REL_V" 9 "(BIT_9)AEB_MAX_SPEED_REDUCTION" 8 "(BIT_8)AEB_LATERAL_AVOIDANCE" 7 "(BIT_7)AEB_MIN_SPEED" 6 "(BIT_6)AEB_MAX_SPEED" 5 "(BIT_5)AEB_MAX_WARN_LENGTH" 4 "(BIT_4)AEB_MAX_DISTANCE" 3 "(BIT_3)AEB_MAX_STEERING_ANGLE" 2 "(BIT_2)AEB_MAX_YAW_RATE" 1 "(BIT_1)AEB_MIN_TIME_FOR_AEB_AFTER_AEB" 0 "(BIT_0)AEB_VALIDATION" ;
VAL_ 118 FCF_VD_Safety_Suppressed_E 1 "TRUE" 0 "FALSE" ;
VAL_ 118 FCF_VD_FCW_Supp_E 19 "(BIT_19)FCW_ABOVE_MAX_STEERING" 18 "(BIT_18)FCW_ABOVE_MAX_DISTANCE" 17 "(BIT_17)FCW_NRTA_OVER_SPEED" 16 "(BIT_16)FCW_NRTA_UNDER_SPEED" 15 "(BIT_15)FCW_NOT_READY_TO_ASSIST" 14 "(BIT_14)FCW_MAXIMUM_TIME_FOR_WARNING" 13 "(BIT_13)NA_5" 12 "(BIT_12)FCW_MINIMUM_TIME_BETWEEN_WARNINGS" 11 "(BIT_11)FCW_CLUTCH_SUPPRESSION" 10 "(BIT_10)NA_4" 9 "(BIT_9)FCW_VEH_VEH_OPENING" 8 "(BIT_8)NA_3" 7 "(BIT_7)NA_2" 6 "(BIT_6)NA_1" 5 "(BIT_5)FCW_AY_AVOID" 4 "(BIT_4)FCW_LATERAL_AVIODANCE" 3 "(BIT_3)BRAKING_SUPPRESSION_LENGTH" 2 "(BIT_2)FCW_BRAKING_SUPPRESSION" 1 "(BIT_1)FCW_ACCELERATION_SUPPRESSION_LENGTH" 0 "(BIT_0)FCW_ACCELERATION_SUPPRESSION" ;
VAL_ 118 FCF_VD_Set_Type_E 3 "EGO_TAP" 2 "HEAD_ON" 1 "FCF" 0 "UNKNOWN" ;
VAL_ 118 FCF_VD_Alert_F 43605 "ALERT" 39270 "NO_ALERT" ;
VAL_ 118 FCF_VD_AEB_Supp_F 12 "(BIT_12)AEB_Safety_CRC" 11 "(BIT_11)AEB_MIN_REL_V" 10 "(BIT_10)AEB_MAX_REL_V" 9 "(BIT_9)AEB_MAX_SPEED_REDUCTION" 8 "(BIT_8)AEB_LATERAL_AVOIDANCE" 7 "(BIT_7)AEB_MIN_SPEED" 6 "(BIT_6)AEB_MAX_SPEED" 5 "(BIT_5)AEB_MAX_WARN_LENGTH" 4 "(BIT_4)AEB_MAX_DISTANCE" 3 "(BIT_3)AEB_MAX_STEERING_ANGLE" 2 "(BIT_2)AEB_MAX_YAW_RATE" 1 "(BIT_1)AEB_MIN_TIME_FOR_AEB_AFTER_AEB" 0 "(BIT_0)AEB_VALIDATION" ;
VAL_ 118 FCF_VD_Safety_Suppressed_F 1 "TRUE" 0 "FALSE" ;
VAL_ 118 FCF_VD_FCW_Supp_F 19 "(BIT_19)FCW_ABOVE_MAX_STEERING" 18 "(BIT_18)FCW_ABOVE_MAX_DISTANCE" 17 "(BIT_17)FCW_NRTA_OVER_SPEED" 16 "(BIT_16)FCW_NRTA_UNDER_SPEED" 15 "(BIT_15)FCW_NOT_READY_TO_ASSIST" 14 "(BIT_14)FCW_MAXIMUM_TIME_FOR_WARNING" 13 "(BIT_13)NA_5" 12 "(BIT_12)FCW_MINIMUM_TIME_BETWEEN_WARNINGS" 11 "(BIT_11)FCW_CLUTCH_SUPPRESSION" 10 "(BIT_10)NA_4" 9 "(BIT_9)FCW_VEH_VEH_OPENING" 8 "(BIT_8)NA_3" 7 "(BIT_7)NA_2" 6 "(BIT_6)NA_1" 5 "(BIT_5)FCW_AY_AVOID" 4 "(BIT_4)FCW_LATERAL_AVIODANCE" 3 "(BIT_3)BRAKING_SUPPRESSION_LENGTH" 2 "(BIT_2)FCW_BRAKING_SUPPRESSION" 1 "(BIT_1)FCW_ACCELERATION_SUPPRESSION_LENGTH" 0 "(BIT_0)FCW_ACCELERATION_SUPPRESSION" ;
VAL_ 118 FCF_VD_Set_Type_F 3 "EGO_TAP" 2 "HEAD_ON" 1 "FCF" 0 "UNKNOWN" ;
VAL_ 118 FCF_VD_Alert_G 43605 "ALERT" 39270 "NO_ALERT" ;
VAL_ 118 FCF_VD_AEB_Supp_G 12 "(BIT_12)AEB_Safety_CRC" 11 "(BIT_11)AEB_MIN_REL_V" 10 "(BIT_10)AEB_MAX_REL_V" 9 "(BIT_9)AEB_MAX_SPEED_REDUCTION" 8 "(BIT_8)AEB_LATERAL_AVOIDANCE" 7 "(BIT_7)AEB_MIN_SPEED" 6 "(BIT_6)AEB_MAX_SPEED" 5 "(BIT_5)AEB_MAX_WARN_LENGTH" 4 "(BIT_4)AEB_MAX_DISTANCE" 3 "(BIT_3)AEB_MAX_STEERING_ANGLE" 2 "(BIT_2)AEB_MAX_YAW_RATE" 1 "(BIT_1)AEB_MIN_TIME_FOR_AEB_AFTER_AEB" 0 "(BIT_0)AEB_VALIDATION" ;
VAL_ 118 FCF_VD_Safety_Suppressed_G 1 "TRUE" 0 "FALSE" ;
VAL_ 118 FCF_VD_FCW_Supp_G 19 "(BIT_19)FCW_ABOVE_MAX_STEERING" 18 "(BIT_18)FCW_ABOVE_MAX_DISTANCE" 17 "(BIT_17)FCW_NRTA_OVER_SPEED" 16 "(BIT_16)FCW_NRTA_UNDER_SPEED" 15 "(BIT_15)FCW_NOT_READY_TO_ASSIST" 14 "(BIT_14)FCW_MAXIMUM_TIME_FOR_WARNING" 13 "(BIT_13)NA_5" 12 "(BIT_12)FCW_MINIMUM_TIME_BETWEEN_WARNINGS" 11 "(BIT_11)FCW_CLUTCH_SUPPRESSION" 10 "(BIT_10)NA_4" 9 "(BIT_9)FCW_VEH_VEH_OPENING" 8 "(BIT_8)NA_3" 7 "(BIT_7)NA_2" 6 "(BIT_6)NA_1" 5 "(BIT_5)FCW_AY_AVOID" 4 "(BIT_4)FCW_LATERAL_AVIODANCE" 3 "(BIT_3)BRAKING_SUPPRESSION_LENGTH" 2 "(BIT_2)FCW_BRAKING_SUPPRESSION" 1 "(BIT_1)FCW_ACCELERATION_SUPPRESSION_LENGTH" 0 "(BIT_0)FCW_ACCELERATION_SUPPRESSION" ;
VAL_ 118 FCF_VD_Set_Type_G 3 "EGO_TAP" 2 "HEAD_ON" 1 "FCF" 0 "UNKNOWN" ;
VAL_ 118 FCF_VD_Alert_H 43605 "ALERT" 39270 "NO_ALERT" ;
VAL_ 118 FCF_VD_AEB_Supp_H 12 "(BIT_12)AEB_Safety_CRC" 11 "(BIT_11)AEB_MIN_REL_V" 10 "(BIT_10)AEB_MAX_REL_V" 9 "(BIT_9)AEB_MAX_SPEED_REDUCTION" 8 "(BIT_8)AEB_LATERAL_AVOIDANCE" 7 "(BIT_7)AEB_MIN_SPEED" 6 "(BIT_6)AEB_MAX_SPEED" 5 "(BIT_5)AEB_MAX_WARN_LENGTH" 4 "(BIT_4)AEB_MAX_DISTANCE" 3 "(BIT_3)AEB_MAX_STEERING_ANGLE" 2 "(BIT_2)AEB_MAX_YAW_RATE" 1 "(BIT_1)AEB_MIN_TIME_FOR_AEB_AFTER_AEB" 0 "(BIT_0)AEB_VALIDATION" ;
VAL_ 118 FCF_VD_Safety_Suppressed_H 1 "TRUE" 0 "FALSE" ;
VAL_ 118 FCF_VD_FCW_Supp_H 19 "(BIT_19)FCW_ABOVE_MAX_STEERING" 18 "(BIT_18)FCW_ABOVE_MAX_DISTANCE" 17 "(BIT_17)FCW_NRTA_OVER_SPEED" 16 "(BIT_16)FCW_NRTA_UNDER_SPEED" 15 "(BIT_15)FCW_NOT_READY_TO_ASSIST" 14 "(BIT_14)FCW_MAXIMUM_TIME_FOR_WARNING" 13 "(BIT_13)NA_5" 12 "(BIT_12)FCW_MINIMUM_TIME_BETWEEN_WARNINGS" 11 "(BIT_11)FCW_CLUTCH_SUPPRESSION" 10 "(BIT_10)NA_4" 9 "(BIT_9)FCW_VEH_VEH_OPENING" 8 "(BIT_8)NA_3" 7 "(BIT_7)NA_2" 6 "(BIT_6)NA_1" 5 "(BIT_5)FCW_AY_AVOID" 4 "(BIT_4)FCW_LATERAL_AVIODANCE" 3 "(BIT_3)BRAKING_SUPPRESSION_LENGTH" 2 "(BIT_2)FCW_BRAKING_SUPPRESSION" 1 "(BIT_1)FCW_ACCELERATION_SUPPRESSION_LENGTH" 0 "(BIT_0)FCW_ACCELERATION_SUPPRESSION" ;
VAL_ 118 FCF_VD_Set_Type_H 3 "EGO_TAP" 2 "HEAD_ON" 1 "FCF" 0 "UNKNOWN" ;
