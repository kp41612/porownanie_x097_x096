VERSION "2"
// BundelVersion=v4.20.10_RC1

NS_ :

BS_:

BU_: EyeQ4 MCU

BO_ 73 Core_Objects_Advanced_protocol: 972 EyeQ4
 SG_ OBJA_Zero_byte : 0|8@1+ (1,0) [0|255] "NA" MCU
 SG_ Reserved_1 : 8|24@1+ (1,0) [0|0] "NA" MCU
 SG_ OBJA_Header_CRC : 32|32@1+ (1,0) [0|4294967295] "NA" MCU
 SG_ OBJA_Protocol_Version : 64|8@1+ (1,0) [2|2] "counter" MCU
 SG_ OBJA_Sync_ID : 72|8@1+ (1,0) [0|255] "counter" MCU
 SG_ OBJA_Objects_Count : 80|11@1+ (1,0) [0|20] "counter" MCU
 SG_ Reserved_2 : 91|5@1+ (1,0) [0|0] "NA" MCU
 SG_ OBJA_CRC_0 : 96|32@1+ (1,0) [0|4294967295] "NA" MCU
 SG_ OBJA_ID_0 : 128|8@1+ (1,0) [0|255] "counter" MCU
 SG_ OBJA_Angle_Front_Right_0 : 136|15@1+ (0.0002,-3.14) [-3.14|3.14] "rad" MCU
 SG_ Reserved_3_0 : 151|8@1+ (1,0) [0|0] "NA" MCU
 SG_ OBJA_Angle_Front_Right_V_0 : 159|1@1+ (1,0) [0|1] "bool" MCU
 SG_ OBJA_Angle_Front_Right_STD_0 : 160|14@1+ (0.0001,0) [0|1.571] "rad" MCU
 SG_ OBJA_Angle_Front_Right_STD_V_0 : 174|1@1+ (1,0) [0|1] "bool" MCU
 SG_ OBJA_Angle_Front_Left_0 : 175|15@1+ (0.0002,-3.14) [-3.14|3.14] "rad" MCU
 SG_ Reserved_4_0 : 190|1@1+ (1,0) [0|0] "NA" MCU
 SG_ OBJA_Angle_Front_Left_V_0 : 191|1@1+ (1,0) [0|1] "bool" MCU
 SG_ OBJA_Angle_Front_Left_STD_0 : 192|14@1+ (0.0001,0) [0|1.571] "rad" MCU
 SG_ OBJA_Angle_Front_Left_STD_V_0 : 206|1@1+ (1,0) [0|1] "bool" MCU
 SG_ OBJA_Angle_Rear_Right_0 : 207|15@1+ (0.0002,-3.14) [-3.14|3.14] "rad" MCU
 SG_ Reserved_5_0 : 222|1@1+ (1,0) [0|0] "NA" MCU
 SG_ OBJA_Angle_Rear_Right_V_0 : 223|1@1+ (1,0) [0|1] "bool" MCU
 SG_ OBJA_Angle_Rear_Right_STD_0 : 224|14@1+ (0.0001,0) [0|1.571] "rad" MCU
 SG_ OBJA_Angle_Rear_Right_STD_V_0 : 238|1@1+ (1,0) [0|1] "bool" MCU
 SG_ OBJA_Angle_Rear_Left_0 : 239|15@1+ (0.0002,-3.14) [-3.14|3.14] "rad" MCU
 SG_ Reserved_6_0 : 254|1@1+ (1,0) [0|0] "NA" MCU
 SG_ OBJA_Angle_Rear_Left_V_0 : 255|1@1+ (1,0) [0|1] "bool" MCU
 SG_ OBJA_Angle_Rear_Left_STD_0 : 256|14@1+ (0.0001,0) [0|1.571] "rad" MCU
 SG_ OBJA_Angle_Rear_Left_STD_V_0 : 270|1@1+ (1,0) [0|1] "bool" MCU
 SG_ OBJA_Angle_Rear_Mid_0 : 271|15@1+ (0.0002,-3.14) [-3.14|3.14] "rad" MCU
 SG_ Reserved_7_0 : 286|1@1+ (1,0) [0|0] "NA" MCU
 SG_ OBJA_Angle_Rear_Mid_V_0 : 287|1@1+ (1,0) [0|1] "bool" MCU
 SG_ OBJA_Angle_Rear_Mid_STD_0 : 288|14@1+ (0.0001,0) [0|1.571] "rad" MCU
 SG_ OBJA_Angle_Rear_Mid_STD_V_0 : 302|1@1+ (1,0) [0|1] "bool" MCU
 SG_ OBJA_Angle_Rear_Mid_Rate_0 : 303|12@1+ (0.002,-2.234) [-2.234|2.2318] "RPS" MCU
 SG_ Reserved_8_0 : 315|4@1+ (1,0) [0|0] "NA" MCU
 SG_ OBJA_Angle_Rear_Mid_Rate_V_0 : 319|1@1+ (1,0) [0|1] "bool" MCU
 SG_ OBJA_Angle_Rear_Mid_Rate_STD_0 : 320|15@1+ (0.0001,0) [0|2.2318] "RPS" MCU
 SG_ OBJA_Angle_Rear_Mid_Rate_STD_V_0 : 335|1@1+ (1,0) [0|1] "bool" MCU
 SG_ OBJA_Angle_Front_Right_Rate_0 : 336|12@1+ (0.002,-2.234) [-2.234|2.2318] "RPS" MCU
 SG_ Reserved_9_0 : 348|3@1+ (1,0) [0|0] "NA" MCU
 SG_ OBJA_Angle_Front_Right_Rate_V_0 : 351|1@1+ (1,0) [0|1] "bool" MCU
 SG_ OBJA_Angle_Front_Right_Rate_STD_0 : 352|15@1+ (0.0001,0) [0|2.2318] "RPS" MCU
 SG_ OBJA_Angle_Front_Right_Rate_STD_V_0 : 367|1@1+ (1,0) [0|1] "bool" MCU
 SG_ OBJA_Angle_Front_Left_Rate_0 : 368|12@1+ (0.002,-2.234) [-2.234|2.2318] "RPS" MCU
 SG_ Reserved_10_0 : 380|3@1+ (1,0) [0|0] "NA" MCU
 SG_ OBJA_Angle_Front_Left_Rate_V_0 : 383|1@1+ (1,0) [0|1] "bool" MCU
 SG_ OBJA_Angle_Front_Left_Rate_STD_0 : 384|15@1+ (0.0001,0) [0|2.2318] "RPS" MCU
 SG_ OBJA_Angle_Front_Left_Rate_STD_V_0 : 399|1@1+ (1,0) [0|1] "bool" MCU
 SG_ OBJA_Angle_Rear_Right_Rate_0 : 400|12@1+ (0.002,-2.234) [-2.234|2.2318] "RPS" MCU
 SG_ Reserved_11_0 : 412|3@1+ (1,0) [0|0] "NA" MCU
 SG_ OBJA_Angle_Rear_Right_Rate_V_0 : 415|1@1+ (1,0) [0|1] "bool" MCU
 SG_ OBJA_Angle_Rear_Right_Rate_STD_0 : 416|15@1+ (0.0001,0) [0|2.2318] "RPS" MCU
 SG_ OBJA_Angle_Rear_Right_Rate_STD_V_0 : 431|1@1+ (1,0) [0|1] "bool" MCU
 SG_ OBJA_Angle_Rear_Left_Rate_0 : 432|12@1+ (0.002,-2.234) [-2.234|2.2318] "RPS" MCU
 SG_ Reserved_12_0 : 444|3@1+ (1,0) [0|0] "NA" MCU
 SG_ OBJA_Angle_Rear_Left_Rate_V_0 : 447|1@1+ (1,0) [0|1] "bool" MCU
 SG_ OBJA_Angle_Rear_Left_Rate_STD_0 : 448|15@1+ (0.0001,0) [0|2.2318] "RPS" MCU
 SG_ OBJA_Angle_Rear_Left_Rate_STD_V_0 : 463|1@1+ (1,0) [0|1] "bool" MCU
 SG_ Reserved_13_0 : 464|16@1+ (1,0) [0|0] "NA" MCU
 SG_ OBJA_CRC_1 : 480|32@1+ (1,0) [0|4294967295] "NA" MCU
 SG_ OBJA_ID_1 : 512|8@1+ (1,0) [0|255] "counter" MCU
 SG_ OBJA_Angle_Front_Right_1 : 520|15@1+ (0.0002,-3.14) [-3.14|3.14] "rad" MCU
 SG_ Reserved_3_1 : 535|8@1+ (1,0) [0|0] "NA" MCU
 SG_ OBJA_Angle_Front_Right_V_1 : 543|1@1+ (1,0) [0|1] "bool" MCU
 SG_ OBJA_Angle_Front_Right_STD_1 : 544|14@1+ (0.0001,0) [0|1.571] "rad" MCU
 SG_ OBJA_Angle_Front_Right_STD_V_1 : 558|1@1+ (1,0) [0|1] "bool" MCU
 SG_ OBJA_Angle_Front_Left_1 : 559|15@1+ (0.0002,-3.14) [-3.14|3.14] "rad" MCU
 SG_ Reserved_4_1 : 574|1@1+ (1,0) [0|0] "NA" MCU
 SG_ OBJA_Angle_Front_Left_V_1 : 575|1@1+ (1,0) [0|1] "bool" MCU
 SG_ OBJA_Angle_Front_Left_STD_1 : 576|14@1+ (0.0001,0) [0|1.571] "rad" MCU
 SG_ OBJA_Angle_Front_Left_STD_V_1 : 590|1@1+ (1,0) [0|1] "bool" MCU
 SG_ OBJA_Angle_Rear_Right_1 : 591|15@1+ (0.0002,-3.14) [-3.14|3.14] "rad" MCU
 SG_ Reserved_5_1 : 606|1@1+ (1,0) [0|0] "NA" MCU
 SG_ OBJA_Angle_Rear_Right_V_1 : 607|1@1+ (1,0) [0|1] "bool" MCU
 SG_ OBJA_Angle_Rear_Right_STD_1 : 608|14@1+ (0.0001,0) [0|1.571] "rad" MCU
 SG_ OBJA_Angle_Rear_Right_STD_V_1 : 622|1@1+ (1,0) [0|1] "bool" MCU
 SG_ OBJA_Angle_Rear_Left_1 : 623|15@1+ (0.0002,-3.14) [-3.14|3.14] "rad" MCU
 SG_ Reserved_6_1 : 638|1@1+ (1,0) [0|0] "NA" MCU
 SG_ OBJA_Angle_Rear_Left_V_1 : 639|1@1+ (1,0) [0|1] "bool" MCU
 SG_ OBJA_Angle_Rear_Left_STD_1 : 640|14@1+ (0.0001,0) [0|1.571] "rad" MCU
 SG_ OBJA_Angle_Rear_Left_STD_V_1 : 654|1@1+ (1,0) [0|1] "bool" MCU
 SG_ OBJA_Angle_Rear_Mid_1 : 655|15@1+ (0.0002,-3.14) [-3.14|3.14] "rad" MCU
 SG_ Reserved_7_1 : 670|1@1+ (1,0) [0|0] "NA" MCU
 SG_ OBJA_Angle_Rear_Mid_V_1 : 671|1@1+ (1,0) [0|1] "bool" MCU
 SG_ OBJA_Angle_Rear_Mid_STD_1 : 672|14@1+ (0.0001,0) [0|1.571] "rad" MCU
 SG_ OBJA_Angle_Rear_Mid_STD_V_1 : 686|1@1+ (1,0) [0|1] "bool" MCU
 SG_ OBJA_Angle_Rear_Mid_Rate_1 : 687|12@1+ (0.002,-2.234) [-2.234|2.2318] "RPS" MCU
 SG_ Reserved_8_1 : 699|4@1+ (1,0) [0|0] "NA" MCU
 SG_ OBJA_Angle_Rear_Mid_Rate_V_1 : 703|1@1+ (1,0) [0|1] "bool" MCU
 SG_ OBJA_Angle_Rear_Mid_Rate_STD_1 : 704|15@1+ (0.0001,0) [0|2.2318] "RPS" MCU
 SG_ OBJA_Angle_Rear_Mid_Rate_STD_V_1 : 719|1@1+ (1,0) [0|1] "bool" MCU
 SG_ OBJA_Angle_Front_Right_Rate_1 : 720|12@1+ (0.002,-2.234) [-2.234|2.2318] "RPS" MCU
 SG_ Reserved_9_1 : 732|3@1+ (1,0) [0|0] "NA" MCU
 SG_ OBJA_Angle_Front_Right_Rate_V_1 : 735|1@1+ (1,0) [0|1] "bool" MCU
 SG_ OBJA_Angle_Front_Right_Rate_STD_1 : 736|15@1+ (0.0001,0) [0|2.2318] "RPS" MCU
 SG_ OBJA_Angle_Front_Right_Rate_STD_V_1 : 751|1@1+ (1,0) [0|1] "bool" MCU
 SG_ OBJA_Angle_Front_Left_Rate_1 : 752|12@1+ (0.002,-2.234) [-2.234|2.2318] "RPS" MCU
 SG_ Reserved_10_1 : 764|3@1+ (1,0) [0|0] "NA" MCU
 SG_ OBJA_Angle_Front_Left_Rate_V_1 : 767|1@1+ (1,0) [0|1] "bool" MCU
 SG_ OBJA_Angle_Front_Left_Rate_STD_1 : 768|15@1+ (0.0001,0) [0|2.2318] "RPS" MCU
 SG_ OBJA_Angle_Front_Left_Rate_STD_V_1 : 783|1@1+ (1,0) [0|1] "bool" MCU
 SG_ OBJA_Angle_Rear_Right_Rate_1 : 784|12@1+ (0.002,-2.234) [-2.234|2.2318] "RPS" MCU
 SG_ Reserved_11_1 : 796|3@1+ (1,0) [0|0] "NA" MCU
 SG_ OBJA_Angle_Rear_Right_Rate_V_1 : 799|1@1+ (1,0) [0|1] "bool" MCU
 SG_ OBJA_Angle_Rear_Right_Rate_STD_1 : 800|15@1+ (0.0001,0) [0|2.2318] "RPS" MCU
 SG_ OBJA_Angle_Rear_Right_Rate_STD_V_1 : 815|1@1+ (1,0) [0|1] "bool" MCU
 SG_ OBJA_Angle_Rear_Left_Rate_1 : 816|12@1+ (0.002,-2.234) [-2.234|2.2318] "RPS" MCU
 SG_ Reserved_12_1 : 828|3@1+ (1,0) [0|0] "NA" MCU
 SG_ OBJA_Angle_Rear_Left_Rate_V_1 : 831|1@1+ (1,0) [0|1] "bool" MCU
 SG_ OBJA_Angle_Rear_Left_Rate_STD_1 : 832|15@1+ (0.0001,0) [0|2.2318] "RPS" MCU
 SG_ OBJA_Angle_Rear_Left_Rate_STD_V_1 : 847|1@1+ (1,0) [0|1] "bool" MCU
 SG_ Reserved_13_1 : 848|16@1+ (1,0) [0|0] "NA" MCU
 SG_ OBJA_CRC_2 : 864|32@1+ (1,0) [0|4294967295] "NA" MCU
 SG_ OBJA_ID_2 : 896|8@1+ (1,0) [0|255] "counter" MCU
 SG_ OBJA_Angle_Front_Right_2 : 904|15@1+ (0.0002,-3.14) [-3.14|3.14] "rad" MCU
 SG_ Reserved_3_2 : 919|8@1+ (1,0) [0|0] "NA" MCU
 SG_ OBJA_Angle_Front_Right_V_2 : 927|1@1+ (1,0) [0|1] "bool" MCU
 SG_ OBJA_Angle_Front_Right_STD_2 : 928|14@1+ (0.0001,0) [0|1.571] "rad" MCU
 SG_ OBJA_Angle_Front_Right_STD_V_2 : 942|1@1+ (1,0) [0|1] "bool" MCU
 SG_ OBJA_Angle_Front_Left_2 : 943|15@1+ (0.0002,-3.14) [-3.14|3.14] "rad" MCU
 SG_ Reserved_4_2 : 958|1@1+ (1,0) [0|0] "NA" MCU
 SG_ OBJA_Angle_Front_Left_V_2 : 959|1@1+ (1,0) [0|1] "bool" MCU
 SG_ OBJA_Angle_Front_Left_STD_2 : 960|14@1+ (0.0001,0) [0|1.571] "rad" MCU
 SG_ OBJA_Angle_Front_Left_STD_V_2 : 974|1@1+ (1,0) [0|1] "bool" MCU
 SG_ OBJA_Angle_Rear_Right_2 : 975|15@1+ (0.0002,-3.14) [-3.14|3.14] "rad" MCU
 SG_ Reserved_5_2 : 990|1@1+ (1,0) [0|0] "NA" MCU
 SG_ OBJA_Angle_Rear_Right_V_2 : 991|1@1+ (1,0) [0|1] "bool" MCU
 SG_ OBJA_Angle_Rear_Right_STD_2 : 992|14@1+ (0.0001,0) [0|1.571] "rad" MCU
 SG_ OBJA_Angle_Rear_Right_STD_V_2 : 1006|1@1+ (1,0) [0|1] "bool" MCU
 SG_ OBJA_Angle_Rear_Left_2 : 1007|15@1+ (0.0002,-3.14) [-3.14|3.14] "rad" MCU
 SG_ Reserved_6_2 : 1022|1@1+ (1,0) [0|0] "NA" MCU
 SG_ OBJA_Angle_Rear_Left_V_2 : 1023|1@1+ (1,0) [0|1] "bool" MCU
 SG_ OBJA_Angle_Rear_Left_STD_2 : 1024|14@1+ (0.0001,0) [0|1.571] "rad" MCU
 SG_ OBJA_Angle_Rear_Left_STD_V_2 : 1038|1@1+ (1,0) [0|1] "bool" MCU
 SG_ OBJA_Angle_Rear_Mid_2 : 1039|15@1+ (0.0002,-3.14) [-3.14|3.14] "rad" MCU
 SG_ Reserved_7_2 : 1054|1@1+ (1,0) [0|0] "NA" MCU
 SG_ OBJA_Angle_Rear_Mid_V_2 : 1055|1@1+ (1,0) [0|1] "bool" MCU
 SG_ OBJA_Angle_Rear_Mid_STD_2 : 1056|14@1+ (0.0001,0) [0|1.571] "rad" MCU
 SG_ OBJA_Angle_Rear_Mid_STD_V_2 : 1070|1@1+ (1,0) [0|1] "bool" MCU
 SG_ OBJA_Angle_Rear_Mid_Rate_2 : 1071|12@1+ (0.002,-2.234) [-2.234|2.2318] "RPS" MCU
 SG_ Reserved_8_2 : 1083|4@1+ (1,0) [0|0] "NA" MCU
 SG_ OBJA_Angle_Rear_Mid_Rate_V_2 : 1087|1@1+ (1,0) [0|1] "bool" MCU
 SG_ OBJA_Angle_Rear_Mid_Rate_STD_2 : 1088|15@1+ (0.0001,0) [0|2.2318] "RPS" MCU
 SG_ OBJA_Angle_Rear_Mid_Rate_STD_V_2 : 1103|1@1+ (1,0) [0|1] "bool" MCU
 SG_ OBJA_Angle_Front_Right_Rate_2 : 1104|12@1+ (0.002,-2.234) [-2.234|2.2318] "RPS" MCU
 SG_ Reserved_9_2 : 1116|3@1+ (1,0) [0|0] "NA" MCU
 SG_ OBJA_Angle_Front_Right_Rate_V_2 : 1119|1@1+ (1,0) [0|1] "bool" MCU
 SG_ OBJA_Angle_Front_Right_Rate_STD_2 : 1120|15@1+ (0.0001,0) [0|2.2318] "RPS" MCU
 SG_ OBJA_Angle_Front_Right_Rate_STD_V_2 : 1135|1@1+ (1,0) [0|1] "bool" MCU
 SG_ OBJA_Angle_Front_Left_Rate_2 : 1136|12@1+ (0.002,-2.234) [-2.234|2.2318] "RPS" MCU
 SG_ Reserved_10_2 : 1148|3@1+ (1,0) [0|0] "NA" MCU
 SG_ OBJA_Angle_Front_Left_Rate_V_2 : 1151|1@1+ (1,0) [0|1] "bool" MCU
 SG_ OBJA_Angle_Front_Left_Rate_STD_2 : 1152|15@1+ (0.0001,0) [0|2.2318] "RPS" MCU
 SG_ OBJA_Angle_Front_Left_Rate_STD_V_2 : 1167|1@1+ (1,0) [0|1] "bool" MCU
 SG_ OBJA_Angle_Rear_Right_Rate_2 : 1168|12@1+ (0.002,-2.234) [-2.234|2.2318] "RPS" MCU
 SG_ Reserved_11_2 : 1180|3@1+ (1,0) [0|0] "NA" MCU
 SG_ OBJA_Angle_Rear_Right_Rate_V_2 : 1183|1@1+ (1,0) [0|1] "bool" MCU
 SG_ OBJA_Angle_Rear_Right_Rate_STD_2 : 1184|15@1+ (0.0001,0) [0|2.2318] "RPS" MCU
 SG_ OBJA_Angle_Rear_Right_Rate_STD_V_2 : 1199|1@1+ (1,0) [0|1] "bool" MCU
 SG_ OBJA_Angle_Rear_Left_Rate_2 : 1200|12@1+ (0.002,-2.234) [-2.234|2.2318] "RPS" MCU
 SG_ Reserved_12_2 : 1212|3@1+ (1,0) [0|0] "NA" MCU
 SG_ OBJA_Angle_Rear_Left_Rate_V_2 : 1215|1@1+ (1,0) [0|1] "bool" MCU
 SG_ OBJA_Angle_Rear_Left_Rate_STD_2 : 1216|15@1+ (0.0001,0) [0|2.2318] "RPS" MCU
 SG_ OBJA_Angle_Rear_Left_Rate_STD_V_2 : 1231|1@1+ (1,0) [0|1] "bool" MCU
 SG_ Reserved_13_2 : 1232|16@1+ (1,0) [0|0] "NA" MCU
 SG_ OBJA_CRC_3 : 1248|32@1+ (1,0) [0|4294967295] "NA" MCU
 SG_ OBJA_ID_3 : 1280|8@1+ (1,0) [0|255] "counter" MCU
 SG_ OBJA_Angle_Front_Right_3 : 1288|15@1+ (0.0002,-3.14) [-3.14|3.14] "rad" MCU
 SG_ Reserved_3_3 : 1303|8@1+ (1,0) [0|0] "NA" MCU
 SG_ OBJA_Angle_Front_Right_V_3 : 1311|1@1+ (1,0) [0|1] "bool" MCU
 SG_ OBJA_Angle_Front_Right_STD_3 : 1312|14@1+ (0.0001,0) [0|1.571] "rad" MCU
 SG_ OBJA_Angle_Front_Right_STD_V_3 : 1326|1@1+ (1,0) [0|1] "bool" MCU
 SG_ OBJA_Angle_Front_Left_3 : 1327|15@1+ (0.0002,-3.14) [-3.14|3.14] "rad" MCU
 SG_ Reserved_4_3 : 1342|1@1+ (1,0) [0|0] "NA" MCU
 SG_ OBJA_Angle_Front_Left_V_3 : 1343|1@1+ (1,0) [0|1] "bool" MCU
 SG_ OBJA_Angle_Front_Left_STD_3 : 1344|14@1+ (0.0001,0) [0|1.571] "rad" MCU
 SG_ OBJA_Angle_Front_Left_STD_V_3 : 1358|1@1+ (1,0) [0|1] "bool" MCU
 SG_ OBJA_Angle_Rear_Right_3 : 1359|15@1+ (0.0002,-3.14) [-3.14|3.14] "rad" MCU
 SG_ Reserved_5_3 : 1374|1@1+ (1,0) [0|0] "NA" MCU
 SG_ OBJA_Angle_Rear_Right_V_3 : 1375|1@1+ (1,0) [0|1] "bool" MCU
 SG_ OBJA_Angle_Rear_Right_STD_3 : 1376|14@1+ (0.0001,0) [0|1.571] "rad" MCU
 SG_ OBJA_Angle_Rear_Right_STD_V_3 : 1390|1@1+ (1,0) [0|1] "bool" MCU
 SG_ OBJA_Angle_Rear_Left_3 : 1391|15@1+ (0.0002,-3.14) [-3.14|3.14] "rad" MCU
 SG_ Reserved_6_3 : 1406|1@1+ (1,0) [0|0] "NA" MCU
 SG_ OBJA_Angle_Rear_Left_V_3 : 1407|1@1+ (1,0) [0|1] "bool" MCU
 SG_ OBJA_Angle_Rear_Left_STD_3 : 1408|14@1+ (0.0001,0) [0|1.571] "rad" MCU
 SG_ OBJA_Angle_Rear_Left_STD_V_3 : 1422|1@1+ (1,0) [0|1] "bool" MCU
 SG_ OBJA_Angle_Rear_Mid_3 : 1423|15@1+ (0.0002,-3.14) [-3.14|3.14] "rad" MCU
 SG_ Reserved_7_3 : 1438|1@1+ (1,0) [0|0] "NA" MCU
 SG_ OBJA_Angle_Rear_Mid_V_3 : 1439|1@1+ (1,0) [0|1] "bool" MCU
 SG_ OBJA_Angle_Rear_Mid_STD_3 : 1440|14@1+ (0.0001,0) [0|1.571] "rad" MCU
 SG_ OBJA_Angle_Rear_Mid_STD_V_3 : 1454|1@1+ (1,0) [0|1] "bool" MCU
 SG_ OBJA_Angle_Rear_Mid_Rate_3 : 1455|12@1+ (0.002,-2.234) [-2.234|2.2318] "RPS" MCU
 SG_ Reserved_8_3 : 1467|4@1+ (1,0) [0|0] "NA" MCU
 SG_ OBJA_Angle_Rear_Mid_Rate_V_3 : 1471|1@1+ (1,0) [0|1] "bool" MCU
 SG_ OBJA_Angle_Rear_Mid_Rate_STD_3 : 1472|15@1+ (0.0001,0) [0|2.2318] "RPS" MCU
 SG_ OBJA_Angle_Rear_Mid_Rate_STD_V_3 : 1487|1@1+ (1,0) [0|1] "bool" MCU
 SG_ OBJA_Angle_Front_Right_Rate_3 : 1488|12@1+ (0.002,-2.234) [-2.234|2.2318] "RPS" MCU
 SG_ Reserved_9_3 : 1500|3@1+ (1,0) [0|0] "NA" MCU
 SG_ OBJA_Angle_Front_Right_Rate_V_3 : 1503|1@1+ (1,0) [0|1] "bool" MCU
 SG_ OBJA_Angle_Front_Right_Rate_STD_3 : 1504|15@1+ (0.0001,0) [0|2.2318] "RPS" MCU
 SG_ OBJA_Angle_Front_Right_Rate_STD_V_3 : 1519|1@1+ (1,0) [0|1] "bool" MCU
 SG_ OBJA_Angle_Front_Left_Rate_3 : 1520|12@1+ (0.002,-2.234) [-2.234|2.2318] "RPS" MCU
 SG_ Reserved_10_3 : 1532|3@1+ (1,0) [0|0] "NA" MCU
 SG_ OBJA_Angle_Front_Left_Rate_V_3 : 1535|1@1+ (1,0) [0|1] "bool" MCU
 SG_ OBJA_Angle_Front_Left_Rate_STD_3 : 1536|15@1+ (0.0001,0) [0|2.2318] "RPS" MCU
 SG_ OBJA_Angle_Front_Left_Rate_STD_V_3 : 1551|1@1+ (1,0) [0|1] "bool" MCU
 SG_ OBJA_Angle_Rear_Right_Rate_3 : 1552|12@1+ (0.002,-2.234) [-2.234|2.2318] "RPS" MCU
 SG_ Reserved_11_3 : 1564|3@1+ (1,0) [0|0] "NA" MCU
 SG_ OBJA_Angle_Rear_Right_Rate_V_3 : 1567|1@1+ (1,0) [0|1] "bool" MCU
 SG_ OBJA_Angle_Rear_Right_Rate_STD_3 : 1568|15@1+ (0.0001,0) [0|2.2318] "RPS" MCU
 SG_ OBJA_Angle_Rear_Right_Rate_STD_V_3 : 1583|1@1+ (1,0) [0|1] "bool" MCU
 SG_ OBJA_Angle_Rear_Left_Rate_3 : 1584|12@1+ (0.002,-2.234) [-2.234|2.2318] "RPS" MCU
 SG_ Reserved_12_3 : 1596|3@1+ (1,0) [0|0] "NA" MCU
 SG_ OBJA_Angle_Rear_Left_Rate_V_3 : 1599|1@1+ (1,0) [0|1] "bool" MCU
 SG_ OBJA_Angle_Rear_Left_Rate_STD_3 : 1600|15@1+ (0.0001,0) [0|2.2318] "RPS" MCU
 SG_ OBJA_Angle_Rear_Left_Rate_STD_V_3 : 1615|1@1+ (1,0) [0|1] "bool" MCU
 SG_ Reserved_13_3 : 1616|16@1+ (1,0) [0|0] "NA" MCU
 SG_ OBJA_CRC_4 : 1632|32@1+ (1,0) [0|4294967295] "NA" MCU
 SG_ OBJA_ID_4 : 1664|8@1+ (1,0) [0|255] "counter" MCU
 SG_ OBJA_Angle_Front_Right_4 : 1672|15@1+ (0.0002,-3.14) [-3.14|3.14] "rad" MCU
 SG_ Reserved_3_4 : 1687|8@1+ (1,0) [0|0] "NA" MCU
 SG_ OBJA_Angle_Front_Right_V_4 : 1695|1@1+ (1,0) [0|1] "bool" MCU
 SG_ OBJA_Angle_Front_Right_STD_4 : 1696|14@1+ (0.0001,0) [0|1.571] "rad" MCU
 SG_ OBJA_Angle_Front_Right_STD_V_4 : 1710|1@1+ (1,0) [0|1] "bool" MCU
 SG_ OBJA_Angle_Front_Left_4 : 1711|15@1+ (0.0002,-3.14) [-3.14|3.14] "rad" MCU
 SG_ Reserved_4_4 : 1726|1@1+ (1,0) [0|0] "NA" MCU
 SG_ OBJA_Angle_Front_Left_V_4 : 1727|1@1+ (1,0) [0|1] "bool" MCU
 SG_ OBJA_Angle_Front_Left_STD_4 : 1728|14@1+ (0.0001,0) [0|1.571] "rad" MCU
 SG_ OBJA_Angle_Front_Left_STD_V_4 : 1742|1@1+ (1,0) [0|1] "bool" MCU
 SG_ OBJA_Angle_Rear_Right_4 : 1743|15@1+ (0.0002,-3.14) [-3.14|3.14] "rad" MCU
 SG_ Reserved_5_4 : 1758|1@1+ (1,0) [0|0] "NA" MCU
 SG_ OBJA_Angle_Rear_Right_V_4 : 1759|1@1+ (1,0) [0|1] "bool" MCU
 SG_ OBJA_Angle_Rear_Right_STD_4 : 1760|14@1+ (0.0001,0) [0|1.571] "rad" MCU
 SG_ OBJA_Angle_Rear_Right_STD_V_4 : 1774|1@1+ (1,0) [0|1] "bool" MCU
 SG_ OBJA_Angle_Rear_Left_4 : 1775|15@1+ (0.0002,-3.14) [-3.14|3.14] "rad" MCU
 SG_ Reserved_6_4 : 1790|1@1+ (1,0) [0|0] "NA" MCU
 SG_ OBJA_Angle_Rear_Left_V_4 : 1791|1@1+ (1,0) [0|1] "bool" MCU
 SG_ OBJA_Angle_Rear_Left_STD_4 : 1792|14@1+ (0.0001,0) [0|1.571] "rad" MCU
 SG_ OBJA_Angle_Rear_Left_STD_V_4 : 1806|1@1+ (1,0) [0|1] "bool" MCU
 SG_ OBJA_Angle_Rear_Mid_4 : 1807|15@1+ (0.0002,-3.14) [-3.14|3.14] "rad" MCU
 SG_ Reserved_7_4 : 1822|1@1+ (1,0) [0|0] "NA" MCU
 SG_ OBJA_Angle_Rear_Mid_V_4 : 1823|1@1+ (1,0) [0|1] "bool" MCU
 SG_ OBJA_Angle_Rear_Mid_STD_4 : 1824|14@1+ (0.0001,0) [0|1.571] "rad" MCU
 SG_ OBJA_Angle_Rear_Mid_STD_V_4 : 1838|1@1+ (1,0) [0|1] "bool" MCU
 SG_ OBJA_Angle_Rear_Mid_Rate_4 : 1839|12@1+ (0.002,-2.234) [-2.234|2.2318] "RPS" MCU
 SG_ Reserved_8_4 : 1851|4@1+ (1,0) [0|0] "NA" MCU
 SG_ OBJA_Angle_Rear_Mid_Rate_V_4 : 1855|1@1+ (1,0) [0|1] "bool" MCU
 SG_ OBJA_Angle_Rear_Mid_Rate_STD_4 : 1856|15@1+ (0.0001,0) [0|2.2318] "RPS" MCU
 SG_ OBJA_Angle_Rear_Mid_Rate_STD_V_4 : 1871|1@1+ (1,0) [0|1] "bool" MCU
 SG_ OBJA_Angle_Front_Right_Rate_4 : 1872|12@1+ (0.002,-2.234) [-2.234|2.2318] "RPS" MCU
 SG_ Reserved_9_4 : 1884|3@1+ (1,0) [0|0] "NA" MCU
 SG_ OBJA_Angle_Front_Right_Rate_V_4 : 1887|1@1+ (1,0) [0|1] "bool" MCU
 SG_ OBJA_Angle_Front_Right_Rate_STD_4 : 1888|15@1+ (0.0001,0) [0|2.2318] "RPS" MCU
 SG_ OBJA_Angle_Front_Right_Rate_STD_V_4 : 1903|1@1+ (1,0) [0|1] "bool" MCU
 SG_ OBJA_Angle_Front_Left_Rate_4 : 1904|12@1+ (0.002,-2.234) [-2.234|2.2318] "RPS" MCU
 SG_ Reserved_10_4 : 1916|3@1+ (1,0) [0|0] "NA" MCU
 SG_ OBJA_Angle_Front_Left_Rate_V_4 : 1919|1@1+ (1,0) [0|1] "bool" MCU
 SG_ OBJA_Angle_Front_Left_Rate_STD_4 : 1920|15@1+ (0.0001,0) [0|2.2318] "RPS" MCU
 SG_ OBJA_Angle_Front_Left_Rate_STD_V_4 : 1935|1@1+ (1,0) [0|1] "bool" MCU
 SG_ OBJA_Angle_Rear_Right_Rate_4 : 1936|12@1+ (0.002,-2.234) [-2.234|2.2318] "RPS" MCU
 SG_ Reserved_11_4 : 1948|3@1+ (1,0) [0|0] "NA" MCU
 SG_ OBJA_Angle_Rear_Right_Rate_V_4 : 1951|1@1+ (1,0) [0|1] "bool" MCU
 SG_ OBJA_Angle_Rear_Right_Rate_STD_4 : 1952|15@1+ (0.0001,0) [0|2.2318] "RPS" MCU
 SG_ OBJA_Angle_Rear_Right_Rate_STD_V_4 : 1967|1@1+ (1,0) [0|1] "bool" MCU
 SG_ OBJA_Angle_Rear_Left_Rate_4 : 1968|12@1+ (0.002,-2.234) [-2.234|2.2318] "RPS" MCU
 SG_ Reserved_12_4 : 1980|3@1+ (1,0) [0|0] "NA" MCU
 SG_ OBJA_Angle_Rear_Left_Rate_V_4 : 1983|1@1+ (1,0) [0|1] "bool" MCU
 SG_ OBJA_Angle_Rear_Left_Rate_STD_4 : 1984|15@1+ (0.0001,0) [0|2.2318] "RPS" MCU
 SG_ OBJA_Angle_Rear_Left_Rate_STD_V_4 : 1999|1@1+ (1,0) [0|1] "bool" MCU
 SG_ Reserved_13_4 : 2000|16@1+ (1,0) [0|0] "NA" MCU
 SG_ OBJA_CRC_5 : 2016|32@1+ (1,0) [0|4294967295] "NA" MCU
 SG_ OBJA_ID_5 : 2048|8@1+ (1,0) [0|255] "counter" MCU
 SG_ OBJA_Angle_Front_Right_5 : 2056|15@1+ (0.0002,-3.14) [-3.14|3.14] "rad" MCU
 SG_ Reserved_3_5 : 2071|8@1+ (1,0) [0|0] "NA" MCU
 SG_ OBJA_Angle_Front_Right_V_5 : 2079|1@1+ (1,0) [0|1] "bool" MCU
 SG_ OBJA_Angle_Front_Right_STD_5 : 2080|14@1+ (0.0001,0) [0|1.571] "rad" MCU
 SG_ OBJA_Angle_Front_Right_STD_V_5 : 2094|1@1+ (1,0) [0|1] "bool" MCU
 SG_ OBJA_Angle_Front_Left_5 : 2095|15@1+ (0.0002,-3.14) [-3.14|3.14] "rad" MCU
 SG_ Reserved_4_5 : 2110|1@1+ (1,0) [0|0] "NA" MCU
 SG_ OBJA_Angle_Front_Left_V_5 : 2111|1@1+ (1,0) [0|1] "bool" MCU
 SG_ OBJA_Angle_Front_Left_STD_5 : 2112|14@1+ (0.0001,0) [0|1.571] "rad" MCU
 SG_ OBJA_Angle_Front_Left_STD_V_5 : 2126|1@1+ (1,0) [0|1] "bool" MCU
 SG_ OBJA_Angle_Rear_Right_5 : 2127|15@1+ (0.0002,-3.14) [-3.14|3.14] "rad" MCU
 SG_ Reserved_5_5 : 2142|1@1+ (1,0) [0|0] "NA" MCU
 SG_ OBJA_Angle_Rear_Right_V_5 : 2143|1@1+ (1,0) [0|1] "bool" MCU
 SG_ OBJA_Angle_Rear_Right_STD_5 : 2144|14@1+ (0.0001,0) [0|1.571] "rad" MCU
 SG_ OBJA_Angle_Rear_Right_STD_V_5 : 2158|1@1+ (1,0) [0|1] "bool" MCU
 SG_ OBJA_Angle_Rear_Left_5 : 2159|15@1+ (0.0002,-3.14) [-3.14|3.14] "rad" MCU
 SG_ Reserved_6_5 : 2174|1@1+ (1,0) [0|0] "NA" MCU
 SG_ OBJA_Angle_Rear_Left_V_5 : 2175|1@1+ (1,0) [0|1] "bool" MCU
 SG_ OBJA_Angle_Rear_Left_STD_5 : 2176|14@1+ (0.0001,0) [0|1.571] "rad" MCU
 SG_ OBJA_Angle_Rear_Left_STD_V_5 : 2190|1@1+ (1,0) [0|1] "bool" MCU
 SG_ OBJA_Angle_Rear_Mid_5 : 2191|15@1+ (0.0002,-3.14) [-3.14|3.14] "rad" MCU
 SG_ Reserved_7_5 : 2206|1@1+ (1,0) [0|0] "NA" MCU
 SG_ OBJA_Angle_Rear_Mid_V_5 : 2207|1@1+ (1,0) [0|1] "bool" MCU
 SG_ OBJA_Angle_Rear_Mid_STD_5 : 2208|14@1+ (0.0001,0) [0|1.571] "rad" MCU
 SG_ OBJA_Angle_Rear_Mid_STD_V_5 : 2222|1@1+ (1,0) [0|1] "bool" MCU
 SG_ OBJA_Angle_Rear_Mid_Rate_5 : 2223|12@1+ (0.002,-2.234) [-2.234|2.2318] "RPS" MCU
 SG_ Reserved_8_5 : 2235|4@1+ (1,0) [0|0] "NA" MCU
 SG_ OBJA_Angle_Rear_Mid_Rate_V_5 : 2239|1@1+ (1,0) [0|1] "bool" MCU
 SG_ OBJA_Angle_Rear_Mid_Rate_STD_5 : 2240|15@1+ (0.0001,0) [0|2.2318] "RPS" MCU
 SG_ OBJA_Angle_Rear_Mid_Rate_STD_V_5 : 2255|1@1+ (1,0) [0|1] "bool" MCU
 SG_ OBJA_Angle_Front_Right_Rate_5 : 2256|12@1+ (0.002,-2.234) [-2.234|2.2318] "RPS" MCU
 SG_ Reserved_9_5 : 2268|3@1+ (1,0) [0|0] "NA" MCU
 SG_ OBJA_Angle_Front_Right_Rate_V_5 : 2271|1@1+ (1,0) [0|1] "bool" MCU
 SG_ OBJA_Angle_Front_Right_Rate_STD_5 : 2272|15@1+ (0.0001,0) [0|2.2318] "RPS" MCU
 SG_ OBJA_Angle_Front_Right_Rate_STD_V_5 : 2287|1@1+ (1,0) [0|1] "bool" MCU
 SG_ OBJA_Angle_Front_Left_Rate_5 : 2288|12@1+ (0.002,-2.234) [-2.234|2.2318] "RPS" MCU
 SG_ Reserved_10_5 : 2300|3@1+ (1,0) [0|0] "NA" MCU
 SG_ OBJA_Angle_Front_Left_Rate_V_5 : 2303|1@1+ (1,0) [0|1] "bool" MCU
 SG_ OBJA_Angle_Front_Left_Rate_STD_5 : 2304|15@1+ (0.0001,0) [0|2.2318] "RPS" MCU
 SG_ OBJA_Angle_Front_Left_Rate_STD_V_5 : 2319|1@1+ (1,0) [0|1] "bool" MCU
 SG_ OBJA_Angle_Rear_Right_Rate_5 : 2320|12@1+ (0.002,-2.234) [-2.234|2.2318] "RPS" MCU
 SG_ Reserved_11_5 : 2332|3@1+ (1,0) [0|0] "NA" MCU
 SG_ OBJA_Angle_Rear_Right_Rate_V_5 : 2335|1@1+ (1,0) [0|1] "bool" MCU
 SG_ OBJA_Angle_Rear_Right_Rate_STD_5 : 2336|15@1+ (0.0001,0) [0|2.2318] "RPS" MCU
 SG_ OBJA_Angle_Rear_Right_Rate_STD_V_5 : 2351|1@1+ (1,0) [0|1] "bool" MCU
 SG_ OBJA_Angle_Rear_Left_Rate_5 : 2352|12@1+ (0.002,-2.234) [-2.234|2.2318] "RPS" MCU
 SG_ Reserved_12_5 : 2364|3@1+ (1,0) [0|0] "NA" MCU
 SG_ OBJA_Angle_Rear_Left_Rate_V_5 : 2367|1@1+ (1,0) [0|1] "bool" MCU
 SG_ OBJA_Angle_Rear_Left_Rate_STD_5 : 2368|15@1+ (0.0001,0) [0|2.2318] "RPS" MCU
 SG_ OBJA_Angle_Rear_Left_Rate_STD_V_5 : 2383|1@1+ (1,0) [0|1] "bool" MCU
 SG_ Reserved_13_5 : 2384|16@1+ (1,0) [0|0] "NA" MCU
 SG_ OBJA_CRC_6 : 2400|32@1+ (1,0) [0|4294967295] "NA" MCU
 SG_ OBJA_ID_6 : 2432|8@1+ (1,0) [0|255] "counter" MCU
 SG_ OBJA_Angle_Front_Right_6 : 2440|15@1+ (0.0002,-3.14) [-3.14|3.14] "rad" MCU
 SG_ Reserved_3_6 : 2455|8@1+ (1,0) [0|0] "NA" MCU
 SG_ OBJA_Angle_Front_Right_V_6 : 2463|1@1+ (1,0) [0|1] "bool" MCU
 SG_ OBJA_Angle_Front_Right_STD_6 : 2464|14@1+ (0.0001,0) [0|1.571] "rad" MCU
 SG_ OBJA_Angle_Front_Right_STD_V_6 : 2478|1@1+ (1,0) [0|1] "bool" MCU
 SG_ OBJA_Angle_Front_Left_6 : 2479|15@1+ (0.0002,-3.14) [-3.14|3.14] "rad" MCU
 SG_ Reserved_4_6 : 2494|1@1+ (1,0) [0|0] "NA" MCU
 SG_ OBJA_Angle_Front_Left_V_6 : 2495|1@1+ (1,0) [0|1] "bool" MCU
 SG_ OBJA_Angle_Front_Left_STD_6 : 2496|14@1+ (0.0001,0) [0|1.571] "rad" MCU
 SG_ OBJA_Angle_Front_Left_STD_V_6 : 2510|1@1+ (1,0) [0|1] "bool" MCU
 SG_ OBJA_Angle_Rear_Right_6 : 2511|15@1+ (0.0002,-3.14) [-3.14|3.14] "rad" MCU
 SG_ Reserved_5_6 : 2526|1@1+ (1,0) [0|0] "NA" MCU
 SG_ OBJA_Angle_Rear_Right_V_6 : 2527|1@1+ (1,0) [0|1] "bool" MCU
 SG_ OBJA_Angle_Rear_Right_STD_6 : 2528|14@1+ (0.0001,0) [0|1.571] "rad" MCU
 SG_ OBJA_Angle_Rear_Right_STD_V_6 : 2542|1@1+ (1,0) [0|1] "bool" MCU
 SG_ OBJA_Angle_Rear_Left_6 : 2543|15@1+ (0.0002,-3.14) [-3.14|3.14] "rad" MCU
 SG_ Reserved_6_6 : 2558|1@1+ (1,0) [0|0] "NA" MCU
 SG_ OBJA_Angle_Rear_Left_V_6 : 2559|1@1+ (1,0) [0|1] "bool" MCU
 SG_ OBJA_Angle_Rear_Left_STD_6 : 2560|14@1+ (0.0001,0) [0|1.571] "rad" MCU
 SG_ OBJA_Angle_Rear_Left_STD_V_6 : 2574|1@1+ (1,0) [0|1] "bool" MCU
 SG_ OBJA_Angle_Rear_Mid_6 : 2575|15@1+ (0.0002,-3.14) [-3.14|3.14] "rad" MCU
 SG_ Reserved_7_6 : 2590|1@1+ (1,0) [0|0] "NA" MCU
 SG_ OBJA_Angle_Rear_Mid_V_6 : 2591|1@1+ (1,0) [0|1] "bool" MCU
 SG_ OBJA_Angle_Rear_Mid_STD_6 : 2592|14@1+ (0.0001,0) [0|1.571] "rad" MCU
 SG_ OBJA_Angle_Rear_Mid_STD_V_6 : 2606|1@1+ (1,0) [0|1] "bool" MCU
 SG_ OBJA_Angle_Rear_Mid_Rate_6 : 2607|12@1+ (0.002,-2.234) [-2.234|2.2318] "RPS" MCU
 SG_ Reserved_8_6 : 2619|4@1+ (1,0) [0|0] "NA" MCU
 SG_ OBJA_Angle_Rear_Mid_Rate_V_6 : 2623|1@1+ (1,0) [0|1] "bool" MCU
 SG_ OBJA_Angle_Rear_Mid_Rate_STD_6 : 2624|15@1+ (0.0001,0) [0|2.2318] "RPS" MCU
 SG_ OBJA_Angle_Rear_Mid_Rate_STD_V_6 : 2639|1@1+ (1,0) [0|1] "bool" MCU
 SG_ OBJA_Angle_Front_Right_Rate_6 : 2640|12@1+ (0.002,-2.234) [-2.234|2.2318] "RPS" MCU
 SG_ Reserved_9_6 : 2652|3@1+ (1,0) [0|0] "NA" MCU
 SG_ OBJA_Angle_Front_Right_Rate_V_6 : 2655|1@1+ (1,0) [0|1] "bool" MCU
 SG_ OBJA_Angle_Front_Right_Rate_STD_6 : 2656|15@1+ (0.0001,0) [0|2.2318] "RPS" MCU
 SG_ OBJA_Angle_Front_Right_Rate_STD_V_6 : 2671|1@1+ (1,0) [0|1] "bool" MCU
 SG_ OBJA_Angle_Front_Left_Rate_6 : 2672|12@1+ (0.002,-2.234) [-2.234|2.2318] "RPS" MCU
 SG_ Reserved_10_6 : 2684|3@1+ (1,0) [0|0] "NA" MCU
 SG_ OBJA_Angle_Front_Left_Rate_V_6 : 2687|1@1+ (1,0) [0|1] "bool" MCU
 SG_ OBJA_Angle_Front_Left_Rate_STD_6 : 2688|15@1+ (0.0001,0) [0|2.2318] "RPS" MCU
 SG_ OBJA_Angle_Front_Left_Rate_STD_V_6 : 2703|1@1+ (1,0) [0|1] "bool" MCU
 SG_ OBJA_Angle_Rear_Right_Rate_6 : 2704|12@1+ (0.002,-2.234) [-2.234|2.2318] "RPS" MCU
 SG_ Reserved_11_6 : 2716|3@1+ (1,0) [0|0] "NA" MCU
 SG_ OBJA_Angle_Rear_Right_Rate_V_6 : 2719|1@1+ (1,0) [0|1] "bool" MCU
 SG_ OBJA_Angle_Rear_Right_Rate_STD_6 : 2720|15@1+ (0.0001,0) [0|2.2318] "RPS" MCU
 SG_ OBJA_Angle_Rear_Right_Rate_STD_V_6 : 2735|1@1+ (1,0) [0|1] "bool" MCU
 SG_ OBJA_Angle_Rear_Left_Rate_6 : 2736|12@1+ (0.002,-2.234) [-2.234|2.2318] "RPS" MCU
 SG_ Reserved_12_6 : 2748|3@1+ (1,0) [0|0] "NA" MCU
 SG_ OBJA_Angle_Rear_Left_Rate_V_6 : 2751|1@1+ (1,0) [0|1] "bool" MCU
 SG_ OBJA_Angle_Rear_Left_Rate_STD_6 : 2752|15@1+ (0.0001,0) [0|2.2318] "RPS" MCU
 SG_ OBJA_Angle_Rear_Left_Rate_STD_V_6 : 2767|1@1+ (1,0) [0|1] "bool" MCU
 SG_ Reserved_13_6 : 2768|16@1+ (1,0) [0|0] "NA" MCU
 SG_ OBJA_CRC_7 : 2784|32@1+ (1,0) [0|4294967295] "NA" MCU
 SG_ OBJA_ID_7 : 2816|8@1+ (1,0) [0|255] "counter" MCU
 SG_ OBJA_Angle_Front_Right_7 : 2824|15@1+ (0.0002,-3.14) [-3.14|3.14] "rad" MCU
 SG_ Reserved_3_7 : 2839|8@1+ (1,0) [0|0] "NA" MCU
 SG_ OBJA_Angle_Front_Right_V_7 : 2847|1@1+ (1,0) [0|1] "bool" MCU
 SG_ OBJA_Angle_Front_Right_STD_7 : 2848|14@1+ (0.0001,0) [0|1.571] "rad" MCU
 SG_ OBJA_Angle_Front_Right_STD_V_7 : 2862|1@1+ (1,0) [0|1] "bool" MCU
 SG_ OBJA_Angle_Front_Left_7 : 2863|15@1+ (0.0002,-3.14) [-3.14|3.14] "rad" MCU
 SG_ Reserved_4_7 : 2878|1@1+ (1,0) [0|0] "NA" MCU
 SG_ OBJA_Angle_Front_Left_V_7 : 2879|1@1+ (1,0) [0|1] "bool" MCU
 SG_ OBJA_Angle_Front_Left_STD_7 : 2880|14@1+ (0.0001,0) [0|1.571] "rad" MCU
 SG_ OBJA_Angle_Front_Left_STD_V_7 : 2894|1@1+ (1,0) [0|1] "bool" MCU
 SG_ OBJA_Angle_Rear_Right_7 : 2895|15@1+ (0.0002,-3.14) [-3.14|3.14] "rad" MCU
 SG_ Reserved_5_7 : 2910|1@1+ (1,0) [0|0] "NA" MCU
 SG_ OBJA_Angle_Rear_Right_V_7 : 2911|1@1+ (1,0) [0|1] "bool" MCU
 SG_ OBJA_Angle_Rear_Right_STD_7 : 2912|14@1+ (0.0001,0) [0|1.571] "rad" MCU
 SG_ OBJA_Angle_Rear_Right_STD_V_7 : 2926|1@1+ (1,0) [0|1] "bool" MCU
 SG_ OBJA_Angle_Rear_Left_7 : 2927|15@1+ (0.0002,-3.14) [-3.14|3.14] "rad" MCU
 SG_ Reserved_6_7 : 2942|1@1+ (1,0) [0|0] "NA" MCU
 SG_ OBJA_Angle_Rear_Left_V_7 : 2943|1@1+ (1,0) [0|1] "bool" MCU
 SG_ OBJA_Angle_Rear_Left_STD_7 : 2944|14@1+ (0.0001,0) [0|1.571] "rad" MCU
 SG_ OBJA_Angle_Rear_Left_STD_V_7 : 2958|1@1+ (1,0) [0|1] "bool" MCU
 SG_ OBJA_Angle_Rear_Mid_7 : 2959|15@1+ (0.0002,-3.14) [-3.14|3.14] "rad" MCU
 SG_ Reserved_7_7 : 2974|1@1+ (1,0) [0|0] "NA" MCU
 SG_ OBJA_Angle_Rear_Mid_V_7 : 2975|1@1+ (1,0) [0|1] "bool" MCU
 SG_ OBJA_Angle_Rear_Mid_STD_7 : 2976|14@1+ (0.0001,0) [0|1.571] "rad" MCU
 SG_ OBJA_Angle_Rear_Mid_STD_V_7 : 2990|1@1+ (1,0) [0|1] "bool" MCU
 SG_ OBJA_Angle_Rear_Mid_Rate_7 : 2991|12@1+ (0.002,-2.234) [-2.234|2.2318] "RPS" MCU
 SG_ Reserved_8_7 : 3003|4@1+ (1,0) [0|0] "NA" MCU
 SG_ OBJA_Angle_Rear_Mid_Rate_V_7 : 3007|1@1+ (1,0) [0|1] "bool" MCU
 SG_ OBJA_Angle_Rear_Mid_Rate_STD_7 : 3008|15@1+ (0.0001,0) [0|2.2318] "RPS" MCU
 SG_ OBJA_Angle_Rear_Mid_Rate_STD_V_7 : 3023|1@1+ (1,0) [0|1] "bool" MCU
 SG_ OBJA_Angle_Front_Right_Rate_7 : 3024|12@1+ (0.002,-2.234) [-2.234|2.2318] "RPS" MCU
 SG_ Reserved_9_7 : 3036|3@1+ (1,0) [0|0] "NA" MCU
 SG_ OBJA_Angle_Front_Right_Rate_V_7 : 3039|1@1+ (1,0) [0|1] "bool" MCU
 SG_ OBJA_Angle_Front_Right_Rate_STD_7 : 3040|15@1+ (0.0001,0) [0|2.2318] "RPS" MCU
 SG_ OBJA_Angle_Front_Right_Rate_STD_V_7 : 3055|1@1+ (1,0) [0|1] "bool" MCU
 SG_ OBJA_Angle_Front_Left_Rate_7 : 3056|12@1+ (0.002,-2.234) [-2.234|2.2318] "RPS" MCU
 SG_ Reserved_10_7 : 3068|3@1+ (1,0) [0|0] "NA" MCU
 SG_ OBJA_Angle_Front_Left_Rate_V_7 : 3071|1@1+ (1,0) [0|1] "bool" MCU
 SG_ OBJA_Angle_Front_Left_Rate_STD_7 : 3072|15@1+ (0.0001,0) [0|2.2318] "RPS" MCU
 SG_ OBJA_Angle_Front_Left_Rate_STD_V_7 : 3087|1@1+ (1,0) [0|1] "bool" MCU
 SG_ OBJA_Angle_Rear_Right_Rate_7 : 3088|12@1+ (0.002,-2.234) [-2.234|2.2318] "RPS" MCU
 SG_ Reserved_11_7 : 3100|3@1+ (1,0) [0|0] "NA" MCU
 SG_ OBJA_Angle_Rear_Right_Rate_V_7 : 3103|1@1+ (1,0) [0|1] "bool" MCU
 SG_ OBJA_Angle_Rear_Right_Rate_STD_7 : 3104|15@1+ (0.0001,0) [0|2.2318] "RPS" MCU
 SG_ OBJA_Angle_Rear_Right_Rate_STD_V_7 : 3119|1@1+ (1,0) [0|1] "bool" MCU
 SG_ OBJA_Angle_Rear_Left_Rate_7 : 3120|12@1+ (0.002,-2.234) [-2.234|2.2318] "RPS" MCU
 SG_ Reserved_12_7 : 3132|3@1+ (1,0) [0|0] "NA" MCU
 SG_ OBJA_Angle_Rear_Left_Rate_V_7 : 3135|1@1+ (1,0) [0|1] "bool" MCU
 SG_ OBJA_Angle_Rear_Left_Rate_STD_7 : 3136|15@1+ (0.0001,0) [0|2.2318] "RPS" MCU
 SG_ OBJA_Angle_Rear_Left_Rate_STD_V_7 : 3151|1@1+ (1,0) [0|1] "bool" MCU
 SG_ Reserved_13_7 : 3152|16@1+ (1,0) [0|0] "NA" MCU
 SG_ OBJA_CRC_8 : 3168|32@1+ (1,0) [0|4294967295] "NA" MCU
 SG_ OBJA_ID_8 : 3200|8@1+ (1,0) [0|255] "counter" MCU
 SG_ OBJA_Angle_Front_Right_8 : 3208|15@1+ (0.0002,-3.14) [-3.14|3.14] "rad" MCU
 SG_ Reserved_3_8 : 3223|8@1+ (1,0) [0|0] "NA" MCU
 SG_ OBJA_Angle_Front_Right_V_8 : 3231|1@1+ (1,0) [0|1] "bool" MCU
 SG_ OBJA_Angle_Front_Right_STD_8 : 3232|14@1+ (0.0001,0) [0|1.571] "rad" MCU
 SG_ OBJA_Angle_Front_Right_STD_V_8 : 3246|1@1+ (1,0) [0|1] "bool" MCU
 SG_ OBJA_Angle_Front_Left_8 : 3247|15@1+ (0.0002,-3.14) [-3.14|3.14] "rad" MCU
 SG_ Reserved_4_8 : 3262|1@1+ (1,0) [0|0] "NA" MCU
 SG_ OBJA_Angle_Front_Left_V_8 : 3263|1@1+ (1,0) [0|1] "bool" MCU
 SG_ OBJA_Angle_Front_Left_STD_8 : 3264|14@1+ (0.0001,0) [0|1.571] "rad" MCU
 SG_ OBJA_Angle_Front_Left_STD_V_8 : 3278|1@1+ (1,0) [0|1] "bool" MCU
 SG_ OBJA_Angle_Rear_Right_8 : 3279|15@1+ (0.0002,-3.14) [-3.14|3.14] "rad" MCU
 SG_ Reserved_5_8 : 3294|1@1+ (1,0) [0|0] "NA" MCU
 SG_ OBJA_Angle_Rear_Right_V_8 : 3295|1@1+ (1,0) [0|1] "bool" MCU
 SG_ OBJA_Angle_Rear_Right_STD_8 : 3296|14@1+ (0.0001,0) [0|1.571] "rad" MCU
 SG_ OBJA_Angle_Rear_Right_STD_V_8 : 3310|1@1+ (1,0) [0|1] "bool" MCU
 SG_ OBJA_Angle_Rear_Left_8 : 3311|15@1+ (0.0002,-3.14) [-3.14|3.14] "rad" MCU
 SG_ Reserved_6_8 : 3326|1@1+ (1,0) [0|0] "NA" MCU
 SG_ OBJA_Angle_Rear_Left_V_8 : 3327|1@1+ (1,0) [0|1] "bool" MCU
 SG_ OBJA_Angle_Rear_Left_STD_8 : 3328|14@1+ (0.0001,0) [0|1.571] "rad" MCU
 SG_ OBJA_Angle_Rear_Left_STD_V_8 : 3342|1@1+ (1,0) [0|1] "bool" MCU
 SG_ OBJA_Angle_Rear_Mid_8 : 3343|15@1+ (0.0002,-3.14) [-3.14|3.14] "rad" MCU
 SG_ Reserved_7_8 : 3358|1@1+ (1,0) [0|0] "NA" MCU
 SG_ OBJA_Angle_Rear_Mid_V_8 : 3359|1@1+ (1,0) [0|1] "bool" MCU
 SG_ OBJA_Angle_Rear_Mid_STD_8 : 3360|14@1+ (0.0001,0) [0|1.571] "rad" MCU
 SG_ OBJA_Angle_Rear_Mid_STD_V_8 : 3374|1@1+ (1,0) [0|1] "bool" MCU
 SG_ OBJA_Angle_Rear_Mid_Rate_8 : 3375|12@1+ (0.002,-2.234) [-2.234|2.2318] "RPS" MCU
 SG_ Reserved_8_8 : 3387|4@1+ (1,0) [0|0] "NA" MCU
 SG_ OBJA_Angle_Rear_Mid_Rate_V_8 : 3391|1@1+ (1,0) [0|1] "bool" MCU
 SG_ OBJA_Angle_Rear_Mid_Rate_STD_8 : 3392|15@1+ (0.0001,0) [0|2.2318] "RPS" MCU
 SG_ OBJA_Angle_Rear_Mid_Rate_STD_V_8 : 3407|1@1+ (1,0) [0|1] "bool" MCU
 SG_ OBJA_Angle_Front_Right_Rate_8 : 3408|12@1+ (0.002,-2.234) [-2.234|2.2318] "RPS" MCU
 SG_ Reserved_9_8 : 3420|3@1+ (1,0) [0|0] "NA" MCU
 SG_ OBJA_Angle_Front_Right_Rate_V_8 : 3423|1@1+ (1,0) [0|1] "bool" MCU
 SG_ OBJA_Angle_Front_Right_Rate_STD_8 : 3424|15@1+ (0.0001,0) [0|2.2318] "RPS" MCU
 SG_ OBJA_Angle_Front_Right_Rate_STD_V_8 : 3439|1@1+ (1,0) [0|1] "bool" MCU
 SG_ OBJA_Angle_Front_Left_Rate_8 : 3440|12@1+ (0.002,-2.234) [-2.234|2.2318] "RPS" MCU
 SG_ Reserved_10_8 : 3452|3@1+ (1,0) [0|0] "NA" MCU
 SG_ OBJA_Angle_Front_Left_Rate_V_8 : 3455|1@1+ (1,0) [0|1] "bool" MCU
 SG_ OBJA_Angle_Front_Left_Rate_STD_8 : 3456|15@1+ (0.0001,0) [0|2.2318] "RPS" MCU
 SG_ OBJA_Angle_Front_Left_Rate_STD_V_8 : 3471|1@1+ (1,0) [0|1] "bool" MCU
 SG_ OBJA_Angle_Rear_Right_Rate_8 : 3472|12@1+ (0.002,-2.234) [-2.234|2.2318] "RPS" MCU
 SG_ Reserved_11_8 : 3484|3@1+ (1,0) [0|0] "NA" MCU
 SG_ OBJA_Angle_Rear_Right_Rate_V_8 : 3487|1@1+ (1,0) [0|1] "bool" MCU
 SG_ OBJA_Angle_Rear_Right_Rate_STD_8 : 3488|15@1+ (0.0001,0) [0|2.2318] "RPS" MCU
 SG_ OBJA_Angle_Rear_Right_Rate_STD_V_8 : 3503|1@1+ (1,0) [0|1] "bool" MCU
 SG_ OBJA_Angle_Rear_Left_Rate_8 : 3504|12@1+ (0.002,-2.234) [-2.234|2.2318] "RPS" MCU
 SG_ Reserved_12_8 : 3516|3@1+ (1,0) [0|0] "NA" MCU
 SG_ OBJA_Angle_Rear_Left_Rate_V_8 : 3519|1@1+ (1,0) [0|1] "bool" MCU
 SG_ OBJA_Angle_Rear_Left_Rate_STD_8 : 3520|15@1+ (0.0001,0) [0|2.2318] "RPS" MCU
 SG_ OBJA_Angle_Rear_Left_Rate_STD_V_8 : 3535|1@1+ (1,0) [0|1] "bool" MCU
 SG_ Reserved_13_8 : 3536|16@1+ (1,0) [0|0] "NA" MCU
 SG_ OBJA_CRC_9 : 3552|32@1+ (1,0) [0|4294967295] "NA" MCU
 SG_ OBJA_ID_9 : 3584|8@1+ (1,0) [0|255] "counter" MCU
 SG_ OBJA_Angle_Front_Right_9 : 3592|15@1+ (0.0002,-3.14) [-3.14|3.14] "rad" MCU
 SG_ Reserved_3_9 : 3607|8@1+ (1,0) [0|0] "NA" MCU
 SG_ OBJA_Angle_Front_Right_V_9 : 3615|1@1+ (1,0) [0|1] "bool" MCU
 SG_ OBJA_Angle_Front_Right_STD_9 : 3616|14@1+ (0.0001,0) [0|1.571] "rad" MCU
 SG_ OBJA_Angle_Front_Right_STD_V_9 : 3630|1@1+ (1,0) [0|1] "bool" MCU
 SG_ OBJA_Angle_Front_Left_9 : 3631|15@1+ (0.0002,-3.14) [-3.14|3.14] "rad" MCU
 SG_ Reserved_4_9 : 3646|1@1+ (1,0) [0|0] "NA" MCU
 SG_ OBJA_Angle_Front_Left_V_9 : 3647|1@1+ (1,0) [0|1] "bool" MCU
 SG_ OBJA_Angle_Front_Left_STD_9 : 3648|14@1+ (0.0001,0) [0|1.571] "rad" MCU
 SG_ OBJA_Angle_Front_Left_STD_V_9 : 3662|1@1+ (1,0) [0|1] "bool" MCU
 SG_ OBJA_Angle_Rear_Right_9 : 3663|15@1+ (0.0002,-3.14) [-3.14|3.14] "rad" MCU
 SG_ Reserved_5_9 : 3678|1@1+ (1,0) [0|0] "NA" MCU
 SG_ OBJA_Angle_Rear_Right_V_9 : 3679|1@1+ (1,0) [0|1] "bool" MCU
 SG_ OBJA_Angle_Rear_Right_STD_9 : 3680|14@1+ (0.0001,0) [0|1.571] "rad" MCU
 SG_ OBJA_Angle_Rear_Right_STD_V_9 : 3694|1@1+ (1,0) [0|1] "bool" MCU
 SG_ OBJA_Angle_Rear_Left_9 : 3695|15@1+ (0.0002,-3.14) [-3.14|3.14] "rad" MCU
 SG_ Reserved_6_9 : 3710|1@1+ (1,0) [0|0] "NA" MCU
 SG_ OBJA_Angle_Rear_Left_V_9 : 3711|1@1+ (1,0) [0|1] "bool" MCU
 SG_ OBJA_Angle_Rear_Left_STD_9 : 3712|14@1+ (0.0001,0) [0|1.571] "rad" MCU
 SG_ OBJA_Angle_Rear_Left_STD_V_9 : 3726|1@1+ (1,0) [0|1] "bool" MCU
 SG_ OBJA_Angle_Rear_Mid_9 : 3727|15@1+ (0.0002,-3.14) [-3.14|3.14] "rad" MCU
 SG_ Reserved_7_9 : 3742|1@1+ (1,0) [0|0] "NA" MCU
 SG_ OBJA_Angle_Rear_Mid_V_9 : 3743|1@1+ (1,0) [0|1] "bool" MCU
 SG_ OBJA_Angle_Rear_Mid_STD_9 : 3744|14@1+ (0.0001,0) [0|1.571] "rad" MCU
 SG_ OBJA_Angle_Rear_Mid_STD_V_9 : 3758|1@1+ (1,0) [0|1] "bool" MCU
 SG_ OBJA_Angle_Rear_Mid_Rate_9 : 3759|12@1+ (0.002,-2.234) [-2.234|2.2318] "RPS" MCU
 SG_ Reserved_8_9 : 3771|4@1+ (1,0) [0|0] "NA" MCU
 SG_ OBJA_Angle_Rear_Mid_Rate_V_9 : 3775|1@1+ (1,0) [0|1] "bool" MCU
 SG_ OBJA_Angle_Rear_Mid_Rate_STD_9 : 3776|15@1+ (0.0001,0) [0|2.2318] "RPS" MCU
 SG_ OBJA_Angle_Rear_Mid_Rate_STD_V_9 : 3791|1@1+ (1,0) [0|1] "bool" MCU
 SG_ OBJA_Angle_Front_Right_Rate_9 : 3792|12@1+ (0.002,-2.234) [-2.234|2.2318] "RPS" MCU
 SG_ Reserved_9_9 : 3804|3@1+ (1,0) [0|0] "NA" MCU
 SG_ OBJA_Angle_Front_Right_Rate_V_9 : 3807|1@1+ (1,0) [0|1] "bool" MCU
 SG_ OBJA_Angle_Front_Right_Rate_STD_9 : 3808|15@1+ (0.0001,0) [0|2.2318] "RPS" MCU
 SG_ OBJA_Angle_Front_Right_Rate_STD_V_9 : 3823|1@1+ (1,0) [0|1] "bool" MCU
 SG_ OBJA_Angle_Front_Left_Rate_9 : 3824|12@1+ (0.002,-2.234) [-2.234|2.2318] "RPS" MCU
 SG_ Reserved_10_9 : 3836|3@1+ (1,0) [0|0] "NA" MCU
 SG_ OBJA_Angle_Front_Left_Rate_V_9 : 3839|1@1+ (1,0) [0|1] "bool" MCU
 SG_ OBJA_Angle_Front_Left_Rate_STD_9 : 3840|15@1+ (0.0001,0) [0|2.2318] "RPS" MCU
 SG_ OBJA_Angle_Front_Left_Rate_STD_V_9 : 3855|1@1+ (1,0) [0|1] "bool" MCU
 SG_ OBJA_Angle_Rear_Right_Rate_9 : 3856|12@1+ (0.002,-2.234) [-2.234|2.2318] "RPS" MCU
 SG_ Reserved_11_9 : 3868|3@1+ (1,0) [0|0] "NA" MCU
 SG_ OBJA_Angle_Rear_Right_Rate_V_9 : 3871|1@1+ (1,0) [0|1] "bool" MCU
 SG_ OBJA_Angle_Rear_Right_Rate_STD_9 : 3872|15@1+ (0.0001,0) [0|2.2318] "RPS" MCU
 SG_ OBJA_Angle_Rear_Right_Rate_STD_V_9 : 3887|1@1+ (1,0) [0|1] "bool" MCU
 SG_ OBJA_Angle_Rear_Left_Rate_9 : 3888|12@1+ (0.002,-2.234) [-2.234|2.2318] "RPS" MCU
 SG_ Reserved_12_9 : 3900|3@1+ (1,0) [0|0] "NA" MCU
 SG_ OBJA_Angle_Rear_Left_Rate_V_9 : 3903|1@1+ (1,0) [0|1] "bool" MCU
 SG_ OBJA_Angle_Rear_Left_Rate_STD_9 : 3904|15@1+ (0.0001,0) [0|2.2318] "RPS" MCU
 SG_ OBJA_Angle_Rear_Left_Rate_STD_V_9 : 3919|1@1+ (1,0) [0|1] "bool" MCU
 SG_ Reserved_13_9 : 3920|16@1+ (1,0) [0|0] "NA" MCU
 SG_ OBJA_CRC_10 : 3936|32@1+ (1,0) [0|4294967295] "NA" MCU
 SG_ OBJA_ID_10 : 3968|8@1+ (1,0) [0|255] "counter" MCU
 SG_ OBJA_Angle_Front_Right_10 : 3976|15@1+ (0.0002,-3.14) [-3.14|3.14] "rad" MCU
 SG_ Reserved_3_10 : 3991|8@1+ (1,0) [0|0] "NA" MCU
 SG_ OBJA_Angle_Front_Right_V_10 : 3999|1@1+ (1,0) [0|1] "bool" MCU
 SG_ OBJA_Angle_Front_Right_STD_10 : 4000|14@1+ (0.0001,0) [0|1.571] "rad" MCU
 SG_ OBJA_Angle_Front_Right_STD_V_10 : 4014|1@1+ (1,0) [0|1] "bool" MCU
 SG_ OBJA_Angle_Front_Left_10 : 4015|15@1+ (0.0002,-3.14) [-3.14|3.14] "rad" MCU
 SG_ Reserved_4_10 : 4030|1@1+ (1,0) [0|0] "NA" MCU
 SG_ OBJA_Angle_Front_Left_V_10 : 4031|1@1+ (1,0) [0|1] "bool" MCU
 SG_ OBJA_Angle_Front_Left_STD_10 : 4032|14@1+ (0.0001,0) [0|1.571] "rad" MCU
 SG_ OBJA_Angle_Front_Left_STD_V_10 : 4046|1@1+ (1,0) [0|1] "bool" MCU
 SG_ OBJA_Angle_Rear_Right_10 : 4047|15@1+ (0.0002,-3.14) [-3.14|3.14] "rad" MCU
 SG_ Reserved_5_10 : 4062|1@1+ (1,0) [0|0] "NA" MCU
 SG_ OBJA_Angle_Rear_Right_V_10 : 4063|1@1+ (1,0) [0|1] "bool" MCU
 SG_ OBJA_Angle_Rear_Right_STD_10 : 4064|14@1+ (0.0001,0) [0|1.571] "rad" MCU
 SG_ OBJA_Angle_Rear_Right_STD_V_10 : 4078|1@1+ (1,0) [0|1] "bool" MCU
 SG_ OBJA_Angle_Rear_Left_10 : 4079|15@1+ (0.0002,-3.14) [-3.14|3.14] "rad" MCU
 SG_ Reserved_6_10 : 4094|1@1+ (1,0) [0|0] "NA" MCU
 SG_ OBJA_Angle_Rear_Left_V_10 : 4095|1@1+ (1,0) [0|1] "bool" MCU
 SG_ OBJA_Angle_Rear_Left_STD_10 : 4096|14@1+ (0.0001,0) [0|1.571] "rad" MCU
 SG_ OBJA_Angle_Rear_Left_STD_V_10 : 4110|1@1+ (1,0) [0|1] "bool" MCU
 SG_ OBJA_Angle_Rear_Mid_10 : 4111|15@1+ (0.0002,-3.14) [-3.14|3.14] "rad" MCU
 SG_ Reserved_7_10 : 4126|1@1+ (1,0) [0|0] "NA" MCU
 SG_ OBJA_Angle_Rear_Mid_V_10 : 4127|1@1+ (1,0) [0|1] "bool" MCU
 SG_ OBJA_Angle_Rear_Mid_STD_10 : 4128|14@1+ (0.0001,0) [0|1.571] "rad" MCU
 SG_ OBJA_Angle_Rear_Mid_STD_V_10 : 4142|1@1+ (1,0) [0|1] "bool" MCU
 SG_ OBJA_Angle_Rear_Mid_Rate_10 : 4143|12@1+ (0.002,-2.234) [-2.234|2.2318] "RPS" MCU
 SG_ Reserved_8_10 : 4155|4@1+ (1,0) [0|0] "NA" MCU
 SG_ OBJA_Angle_Rear_Mid_Rate_V_10 : 4159|1@1+ (1,0) [0|1] "bool" MCU
 SG_ OBJA_Angle_Rear_Mid_Rate_STD_10 : 4160|15@1+ (0.0001,0) [0|2.2318] "RPS" MCU
 SG_ OBJA_Angle_Rear_Mid_Rate_STD_V_10 : 4175|1@1+ (1,0) [0|1] "bool" MCU
 SG_ OBJA_Angle_Front_Right_Rate_10 : 4176|12@1+ (0.002,-2.234) [-2.234|2.2318] "RPS" MCU
 SG_ Reserved_9_10 : 4188|3@1+ (1,0) [0|0] "NA" MCU
 SG_ OBJA_Angle_Front_Right_Rate_V_10 : 4191|1@1+ (1,0) [0|1] "bool" MCU
 SG_ OBJA_Angle_Front_Right_Rate_STD_10 : 4192|15@1+ (0.0001,0) [0|2.2318] "RPS" MCU
 SG_ OBJA_Angle_Front_Right_Rate_STD_V_10 : 4207|1@1+ (1,0) [0|1] "bool" MCU
 SG_ OBJA_Angle_Front_Left_Rate_10 : 4208|12@1+ (0.002,-2.234) [-2.234|2.2318] "RPS" MCU
 SG_ Reserved_10_10 : 4220|3@1+ (1,0) [0|0] "NA" MCU
 SG_ OBJA_Angle_Front_Left_Rate_V_10 : 4223|1@1+ (1,0) [0|1] "bool" MCU
 SG_ OBJA_Angle_Front_Left_Rate_STD_10 : 4224|15@1+ (0.0001,0) [0|2.2318] "RPS" MCU
 SG_ OBJA_Angle_Front_Left_Rate_STD_V_10 : 4239|1@1+ (1,0) [0|1] "bool" MCU
 SG_ OBJA_Angle_Rear_Right_Rate_10 : 4240|12@1+ (0.002,-2.234) [-2.234|2.2318] "RPS" MCU
 SG_ Reserved_11_10 : 4252|3@1+ (1,0) [0|0] "NA" MCU
 SG_ OBJA_Angle_Rear_Right_Rate_V_10 : 4255|1@1+ (1,0) [0|1] "bool" MCU
 SG_ OBJA_Angle_Rear_Right_Rate_STD_10 : 4256|15@1+ (0.0001,0) [0|2.2318] "RPS" MCU
 SG_ OBJA_Angle_Rear_Right_Rate_STD_V_10 : 4271|1@1+ (1,0) [0|1] "bool" MCU
 SG_ OBJA_Angle_Rear_Left_Rate_10 : 4272|12@1+ (0.002,-2.234) [-2.234|2.2318] "RPS" MCU
 SG_ Reserved_12_10 : 4284|3@1+ (1,0) [0|0] "NA" MCU
 SG_ OBJA_Angle_Rear_Left_Rate_V_10 : 4287|1@1+ (1,0) [0|1] "bool" MCU
 SG_ OBJA_Angle_Rear_Left_Rate_STD_10 : 4288|15@1+ (0.0001,0) [0|2.2318] "RPS" MCU
 SG_ OBJA_Angle_Rear_Left_Rate_STD_V_10 : 4303|1@1+ (1,0) [0|1] "bool" MCU
 SG_ Reserved_13_10 : 4304|16@1+ (1,0) [0|0] "NA" MCU
 SG_ OBJA_CRC_11 : 4320|32@1+ (1,0) [0|4294967295] "NA" MCU
 SG_ OBJA_ID_11 : 4352|8@1+ (1,0) [0|255] "counter" MCU
 SG_ OBJA_Angle_Front_Right_11 : 4360|15@1+ (0.0002,-3.14) [-3.14|3.14] "rad" MCU
 SG_ Reserved_3_11 : 4375|8@1+ (1,0) [0|0] "NA" MCU
 SG_ OBJA_Angle_Front_Right_V_11 : 4383|1@1+ (1,0) [0|1] "bool" MCU
 SG_ OBJA_Angle_Front_Right_STD_11 : 4384|14@1+ (0.0001,0) [0|1.571] "rad" MCU
 SG_ OBJA_Angle_Front_Right_STD_V_11 : 4398|1@1+ (1,0) [0|1] "bool" MCU
 SG_ OBJA_Angle_Front_Left_11 : 4399|15@1+ (0.0002,-3.14) [-3.14|3.14] "rad" MCU
 SG_ Reserved_4_11 : 4414|1@1+ (1,0) [0|0] "NA" MCU
 SG_ OBJA_Angle_Front_Left_V_11 : 4415|1@1+ (1,0) [0|1] "bool" MCU
 SG_ OBJA_Angle_Front_Left_STD_11 : 4416|14@1+ (0.0001,0) [0|1.571] "rad" MCU
 SG_ OBJA_Angle_Front_Left_STD_V_11 : 4430|1@1+ (1,0) [0|1] "bool" MCU
 SG_ OBJA_Angle_Rear_Right_11 : 4431|15@1+ (0.0002,-3.14) [-3.14|3.14] "rad" MCU
 SG_ Reserved_5_11 : 4446|1@1+ (1,0) [0|0] "NA" MCU
 SG_ OBJA_Angle_Rear_Right_V_11 : 4447|1@1+ (1,0) [0|1] "bool" MCU
 SG_ OBJA_Angle_Rear_Right_STD_11 : 4448|14@1+ (0.0001,0) [0|1.571] "rad" MCU
 SG_ OBJA_Angle_Rear_Right_STD_V_11 : 4462|1@1+ (1,0) [0|1] "bool" MCU
 SG_ OBJA_Angle_Rear_Left_11 : 4463|15@1+ (0.0002,-3.14) [-3.14|3.14] "rad" MCU
 SG_ Reserved_6_11 : 4478|1@1+ (1,0) [0|0] "NA" MCU
 SG_ OBJA_Angle_Rear_Left_V_11 : 4479|1@1+ (1,0) [0|1] "bool" MCU
 SG_ OBJA_Angle_Rear_Left_STD_11 : 4480|14@1+ (0.0001,0) [0|1.571] "rad" MCU
 SG_ OBJA_Angle_Rear_Left_STD_V_11 : 4494|1@1+ (1,0) [0|1] "bool" MCU
 SG_ OBJA_Angle_Rear_Mid_11 : 4495|15@1+ (0.0002,-3.14) [-3.14|3.14] "rad" MCU
 SG_ Reserved_7_11 : 4510|1@1+ (1,0) [0|0] "NA" MCU
 SG_ OBJA_Angle_Rear_Mid_V_11 : 4511|1@1+ (1,0) [0|1] "bool" MCU
 SG_ OBJA_Angle_Rear_Mid_STD_11 : 4512|14@1+ (0.0001,0) [0|1.571] "rad" MCU
 SG_ OBJA_Angle_Rear_Mid_STD_V_11 : 4526|1@1+ (1,0) [0|1] "bool" MCU
 SG_ OBJA_Angle_Rear_Mid_Rate_11 : 4527|12@1+ (0.002,-2.234) [-2.234|2.2318] "RPS" MCU
 SG_ Reserved_8_11 : 4539|4@1+ (1,0) [0|0] "NA" MCU
 SG_ OBJA_Angle_Rear_Mid_Rate_V_11 : 4543|1@1+ (1,0) [0|1] "bool" MCU
 SG_ OBJA_Angle_Rear_Mid_Rate_STD_11 : 4544|15@1+ (0.0001,0) [0|2.2318] "RPS" MCU
 SG_ OBJA_Angle_Rear_Mid_Rate_STD_V_11 : 4559|1@1+ (1,0) [0|1] "bool" MCU
 SG_ OBJA_Angle_Front_Right_Rate_11 : 4560|12@1+ (0.002,-2.234) [-2.234|2.2318] "RPS" MCU
 SG_ Reserved_9_11 : 4572|3@1+ (1,0) [0|0] "NA" MCU
 SG_ OBJA_Angle_Front_Right_Rate_V_11 : 4575|1@1+ (1,0) [0|1] "bool" MCU
 SG_ OBJA_Angle_Front_Right_Rate_STD_11 : 4576|15@1+ (0.0001,0) [0|2.2318] "RPS" MCU
 SG_ OBJA_Angle_Front_Right_Rate_STD_V_11 : 4591|1@1+ (1,0) [0|1] "bool" MCU
 SG_ OBJA_Angle_Front_Left_Rate_11 : 4592|12@1+ (0.002,-2.234) [-2.234|2.2318] "RPS" MCU
 SG_ Reserved_10_11 : 4604|3@1+ (1,0) [0|0] "NA" MCU
 SG_ OBJA_Angle_Front_Left_Rate_V_11 : 4607|1@1+ (1,0) [0|1] "bool" MCU
 SG_ OBJA_Angle_Front_Left_Rate_STD_11 : 4608|15@1+ (0.0001,0) [0|2.2318] "RPS" MCU
 SG_ OBJA_Angle_Front_Left_Rate_STD_V_11 : 4623|1@1+ (1,0) [0|1] "bool" MCU
 SG_ OBJA_Angle_Rear_Right_Rate_11 : 4624|12@1+ (0.002,-2.234) [-2.234|2.2318] "RPS" MCU
 SG_ Reserved_11_11 : 4636|3@1+ (1,0) [0|0] "NA" MCU
 SG_ OBJA_Angle_Rear_Right_Rate_V_11 : 4639|1@1+ (1,0) [0|1] "bool" MCU
 SG_ OBJA_Angle_Rear_Right_Rate_STD_11 : 4640|15@1+ (0.0001,0) [0|2.2318] "RPS" MCU
 SG_ OBJA_Angle_Rear_Right_Rate_STD_V_11 : 4655|1@1+ (1,0) [0|1] "bool" MCU
 SG_ OBJA_Angle_Rear_Left_Rate_11 : 4656|12@1+ (0.002,-2.234) [-2.234|2.2318] "RPS" MCU
 SG_ Reserved_12_11 : 4668|3@1+ (1,0) [0|0] "NA" MCU
 SG_ OBJA_Angle_Rear_Left_Rate_V_11 : 4671|1@1+ (1,0) [0|1] "bool" MCU
 SG_ OBJA_Angle_Rear_Left_Rate_STD_11 : 4672|15@1+ (0.0001,0) [0|2.2318] "RPS" MCU
 SG_ OBJA_Angle_Rear_Left_Rate_STD_V_11 : 4687|1@1+ (1,0) [0|1] "bool" MCU
 SG_ Reserved_13_11 : 4688|16@1+ (1,0) [0|0] "NA" MCU
 SG_ OBJA_CRC_12 : 4704|32@1+ (1,0) [0|4294967295] "NA" MCU
 SG_ OBJA_ID_12 : 4736|8@1+ (1,0) [0|255] "counter" MCU
 SG_ OBJA_Angle_Front_Right_12 : 4744|15@1+ (0.0002,-3.14) [-3.14|3.14] "rad" MCU
 SG_ Reserved_3_12 : 4759|8@1+ (1,0) [0|0] "NA" MCU
 SG_ OBJA_Angle_Front_Right_V_12 : 4767|1@1+ (1,0) [0|1] "bool" MCU
 SG_ OBJA_Angle_Front_Right_STD_12 : 4768|14@1+ (0.0001,0) [0|1.571] "rad" MCU
 SG_ OBJA_Angle_Front_Right_STD_V_12 : 4782|1@1+ (1,0) [0|1] "bool" MCU
 SG_ OBJA_Angle_Front_Left_12 : 4783|15@1+ (0.0002,-3.14) [-3.14|3.14] "rad" MCU
 SG_ Reserved_4_12 : 4798|1@1+ (1,0) [0|0] "NA" MCU
 SG_ OBJA_Angle_Front_Left_V_12 : 4799|1@1+ (1,0) [0|1] "bool" MCU
 SG_ OBJA_Angle_Front_Left_STD_12 : 4800|14@1+ (0.0001,0) [0|1.571] "rad" MCU
 SG_ OBJA_Angle_Front_Left_STD_V_12 : 4814|1@1+ (1,0) [0|1] "bool" MCU
 SG_ OBJA_Angle_Rear_Right_12 : 4815|15@1+ (0.0002,-3.14) [-3.14|3.14] "rad" MCU
 SG_ Reserved_5_12 : 4830|1@1+ (1,0) [0|0] "NA" MCU
 SG_ OBJA_Angle_Rear_Right_V_12 : 4831|1@1+ (1,0) [0|1] "bool" MCU
 SG_ OBJA_Angle_Rear_Right_STD_12 : 4832|14@1+ (0.0001,0) [0|1.571] "rad" MCU
 SG_ OBJA_Angle_Rear_Right_STD_V_12 : 4846|1@1+ (1,0) [0|1] "bool" MCU
 SG_ OBJA_Angle_Rear_Left_12 : 4847|15@1+ (0.0002,-3.14) [-3.14|3.14] "rad" MCU
 SG_ Reserved_6_12 : 4862|1@1+ (1,0) [0|0] "NA" MCU
 SG_ OBJA_Angle_Rear_Left_V_12 : 4863|1@1+ (1,0) [0|1] "bool" MCU
 SG_ OBJA_Angle_Rear_Left_STD_12 : 4864|14@1+ (0.0001,0) [0|1.571] "rad" MCU
 SG_ OBJA_Angle_Rear_Left_STD_V_12 : 4878|1@1+ (1,0) [0|1] "bool" MCU
 SG_ OBJA_Angle_Rear_Mid_12 : 4879|15@1+ (0.0002,-3.14) [-3.14|3.14] "rad" MCU
 SG_ Reserved_7_12 : 4894|1@1+ (1,0) [0|0] "NA" MCU
 SG_ OBJA_Angle_Rear_Mid_V_12 : 4895|1@1+ (1,0) [0|1] "bool" MCU
 SG_ OBJA_Angle_Rear_Mid_STD_12 : 4896|14@1+ (0.0001,0) [0|1.571] "rad" MCU
 SG_ OBJA_Angle_Rear_Mid_STD_V_12 : 4910|1@1+ (1,0) [0|1] "bool" MCU
 SG_ OBJA_Angle_Rear_Mid_Rate_12 : 4911|12@1+ (0.002,-2.234) [-2.234|2.2318] "RPS" MCU
 SG_ Reserved_8_12 : 4923|4@1+ (1,0) [0|0] "NA" MCU
 SG_ OBJA_Angle_Rear_Mid_Rate_V_12 : 4927|1@1+ (1,0) [0|1] "bool" MCU
 SG_ OBJA_Angle_Rear_Mid_Rate_STD_12 : 4928|15@1+ (0.0001,0) [0|2.2318] "RPS" MCU
 SG_ OBJA_Angle_Rear_Mid_Rate_STD_V_12 : 4943|1@1+ (1,0) [0|1] "bool" MCU
 SG_ OBJA_Angle_Front_Right_Rate_12 : 4944|12@1+ (0.002,-2.234) [-2.234|2.2318] "RPS" MCU
 SG_ Reserved_9_12 : 4956|3@1+ (1,0) [0|0] "NA" MCU
 SG_ OBJA_Angle_Front_Right_Rate_V_12 : 4959|1@1+ (1,0) [0|1] "bool" MCU
 SG_ OBJA_Angle_Front_Right_Rate_STD_12 : 4960|15@1+ (0.0001,0) [0|2.2318] "RPS" MCU
 SG_ OBJA_Angle_Front_Right_Rate_STD_V_12 : 4975|1@1+ (1,0) [0|1] "bool" MCU
 SG_ OBJA_Angle_Front_Left_Rate_12 : 4976|12@1+ (0.002,-2.234) [-2.234|2.2318] "RPS" MCU
 SG_ Reserved_10_12 : 4988|3@1+ (1,0) [0|0] "NA" MCU
 SG_ OBJA_Angle_Front_Left_Rate_V_12 : 4991|1@1+ (1,0) [0|1] "bool" MCU
 SG_ OBJA_Angle_Front_Left_Rate_STD_12 : 4992|15@1+ (0.0001,0) [0|2.2318] "RPS" MCU
 SG_ OBJA_Angle_Front_Left_Rate_STD_V_12 : 5007|1@1+ (1,0) [0|1] "bool" MCU
 SG_ OBJA_Angle_Rear_Right_Rate_12 : 5008|12@1+ (0.002,-2.234) [-2.234|2.2318] "RPS" MCU
 SG_ Reserved_11_12 : 5020|3@1+ (1,0) [0|0] "NA" MCU
 SG_ OBJA_Angle_Rear_Right_Rate_V_12 : 5023|1@1+ (1,0) [0|1] "bool" MCU
 SG_ OBJA_Angle_Rear_Right_Rate_STD_12 : 5024|15@1+ (0.0001,0) [0|2.2318] "RPS" MCU
 SG_ OBJA_Angle_Rear_Right_Rate_STD_V_12 : 5039|1@1+ (1,0) [0|1] "bool" MCU
 SG_ OBJA_Angle_Rear_Left_Rate_12 : 5040|12@1+ (0.002,-2.234) [-2.234|2.2318] "RPS" MCU
 SG_ Reserved_12_12 : 5052|3@1+ (1,0) [0|0] "NA" MCU
 SG_ OBJA_Angle_Rear_Left_Rate_V_12 : 5055|1@1+ (1,0) [0|1] "bool" MCU
 SG_ OBJA_Angle_Rear_Left_Rate_STD_12 : 5056|15@1+ (0.0001,0) [0|2.2318] "RPS" MCU
 SG_ OBJA_Angle_Rear_Left_Rate_STD_V_12 : 5071|1@1+ (1,0) [0|1] "bool" MCU
 SG_ Reserved_13_12 : 5072|16@1+ (1,0) [0|0] "NA" MCU
 SG_ OBJA_CRC_13 : 5088|32@1+ (1,0) [0|4294967295] "NA" MCU
 SG_ OBJA_ID_13 : 5120|8@1+ (1,0) [0|255] "counter" MCU
 SG_ OBJA_Angle_Front_Right_13 : 5128|15@1+ (0.0002,-3.14) [-3.14|3.14] "rad" MCU
 SG_ Reserved_3_13 : 5143|8@1+ (1,0) [0|0] "NA" MCU
 SG_ OBJA_Angle_Front_Right_V_13 : 5151|1@1+ (1,0) [0|1] "bool" MCU
 SG_ OBJA_Angle_Front_Right_STD_13 : 5152|14@1+ (0.0001,0) [0|1.571] "rad" MCU
 SG_ OBJA_Angle_Front_Right_STD_V_13 : 5166|1@1+ (1,0) [0|1] "bool" MCU
 SG_ OBJA_Angle_Front_Left_13 : 5167|15@1+ (0.0002,-3.14) [-3.14|3.14] "rad" MCU
 SG_ Reserved_4_13 : 5182|1@1+ (1,0) [0|0] "NA" MCU
 SG_ OBJA_Angle_Front_Left_V_13 : 5183|1@1+ (1,0) [0|1] "bool" MCU
 SG_ OBJA_Angle_Front_Left_STD_13 : 5184|14@1+ (0.0001,0) [0|1.571] "rad" MCU
 SG_ OBJA_Angle_Front_Left_STD_V_13 : 5198|1@1+ (1,0) [0|1] "bool" MCU
 SG_ OBJA_Angle_Rear_Right_13 : 5199|15@1+ (0.0002,-3.14) [-3.14|3.14] "rad" MCU
 SG_ Reserved_5_13 : 5214|1@1+ (1,0) [0|0] "NA" MCU
 SG_ OBJA_Angle_Rear_Right_V_13 : 5215|1@1+ (1,0) [0|1] "bool" MCU
 SG_ OBJA_Angle_Rear_Right_STD_13 : 5216|14@1+ (0.0001,0) [0|1.571] "rad" MCU
 SG_ OBJA_Angle_Rear_Right_STD_V_13 : 5230|1@1+ (1,0) [0|1] "bool" MCU
 SG_ OBJA_Angle_Rear_Left_13 : 5231|15@1+ (0.0002,-3.14) [-3.14|3.14] "rad" MCU
 SG_ Reserved_6_13 : 5246|1@1+ (1,0) [0|0] "NA" MCU
 SG_ OBJA_Angle_Rear_Left_V_13 : 5247|1@1+ (1,0) [0|1] "bool" MCU
 SG_ OBJA_Angle_Rear_Left_STD_13 : 5248|14@1+ (0.0001,0) [0|1.571] "rad" MCU
 SG_ OBJA_Angle_Rear_Left_STD_V_13 : 5262|1@1+ (1,0) [0|1] "bool" MCU
 SG_ OBJA_Angle_Rear_Mid_13 : 5263|15@1+ (0.0002,-3.14) [-3.14|3.14] "rad" MCU
 SG_ Reserved_7_13 : 5278|1@1+ (1,0) [0|0] "NA" MCU
 SG_ OBJA_Angle_Rear_Mid_V_13 : 5279|1@1+ (1,0) [0|1] "bool" MCU
 SG_ OBJA_Angle_Rear_Mid_STD_13 : 5280|14@1+ (0.0001,0) [0|1.571] "rad" MCU
 SG_ OBJA_Angle_Rear_Mid_STD_V_13 : 5294|1@1+ (1,0) [0|1] "bool" MCU
 SG_ OBJA_Angle_Rear_Mid_Rate_13 : 5295|12@1+ (0.002,-2.234) [-2.234|2.2318] "RPS" MCU
 SG_ Reserved_8_13 : 5307|4@1+ (1,0) [0|0] "NA" MCU
 SG_ OBJA_Angle_Rear_Mid_Rate_V_13 : 5311|1@1+ (1,0) [0|1] "bool" MCU
 SG_ OBJA_Angle_Rear_Mid_Rate_STD_13 : 5312|15@1+ (0.0001,0) [0|2.2318] "RPS" MCU
 SG_ OBJA_Angle_Rear_Mid_Rate_STD_V_13 : 5327|1@1+ (1,0) [0|1] "bool" MCU
 SG_ OBJA_Angle_Front_Right_Rate_13 : 5328|12@1+ (0.002,-2.234) [-2.234|2.2318] "RPS" MCU
 SG_ Reserved_9_13 : 5340|3@1+ (1,0) [0|0] "NA" MCU
 SG_ OBJA_Angle_Front_Right_Rate_V_13 : 5343|1@1+ (1,0) [0|1] "bool" MCU
 SG_ OBJA_Angle_Front_Right_Rate_STD_13 : 5344|15@1+ (0.0001,0) [0|2.2318] "RPS" MCU
 SG_ OBJA_Angle_Front_Right_Rate_STD_V_13 : 5359|1@1+ (1,0) [0|1] "bool" MCU
 SG_ OBJA_Angle_Front_Left_Rate_13 : 5360|12@1+ (0.002,-2.234) [-2.234|2.2318] "RPS" MCU
 SG_ Reserved_10_13 : 5372|3@1+ (1,0) [0|0] "NA" MCU
 SG_ OBJA_Angle_Front_Left_Rate_V_13 : 5375|1@1+ (1,0) [0|1] "bool" MCU
 SG_ OBJA_Angle_Front_Left_Rate_STD_13 : 5376|15@1+ (0.0001,0) [0|2.2318] "RPS" MCU
 SG_ OBJA_Angle_Front_Left_Rate_STD_V_13 : 5391|1@1+ (1,0) [0|1] "bool" MCU
 SG_ OBJA_Angle_Rear_Right_Rate_13 : 5392|12@1+ (0.002,-2.234) [-2.234|2.2318] "RPS" MCU
 SG_ Reserved_11_13 : 5404|3@1+ (1,0) [0|0] "NA" MCU
 SG_ OBJA_Angle_Rear_Right_Rate_V_13 : 5407|1@1+ (1,0) [0|1] "bool" MCU
 SG_ OBJA_Angle_Rear_Right_Rate_STD_13 : 5408|15@1+ (0.0001,0) [0|2.2318] "RPS" MCU
 SG_ OBJA_Angle_Rear_Right_Rate_STD_V_13 : 5423|1@1+ (1,0) [0|1] "bool" MCU
 SG_ OBJA_Angle_Rear_Left_Rate_13 : 5424|12@1+ (0.002,-2.234) [-2.234|2.2318] "RPS" MCU
 SG_ Reserved_12_13 : 5436|3@1+ (1,0) [0|0] "NA" MCU
 SG_ OBJA_Angle_Rear_Left_Rate_V_13 : 5439|1@1+ (1,0) [0|1] "bool" MCU
 SG_ OBJA_Angle_Rear_Left_Rate_STD_13 : 5440|15@1+ (0.0001,0) [0|2.2318] "RPS" MCU
 SG_ OBJA_Angle_Rear_Left_Rate_STD_V_13 : 5455|1@1+ (1,0) [0|1] "bool" MCU
 SG_ Reserved_13_13 : 5456|16@1+ (1,0) [0|0] "NA" MCU
 SG_ OBJA_CRC_14 : 5472|32@1+ (1,0) [0|4294967295] "NA" MCU
 SG_ OBJA_ID_14 : 5504|8@1+ (1,0) [0|255] "counter" MCU
 SG_ OBJA_Angle_Front_Right_14 : 5512|15@1+ (0.0002,-3.14) [-3.14|3.14] "rad" MCU
 SG_ Reserved_3_14 : 5527|8@1+ (1,0) [0|0] "NA" MCU
 SG_ OBJA_Angle_Front_Right_V_14 : 5535|1@1+ (1,0) [0|1] "bool" MCU
 SG_ OBJA_Angle_Front_Right_STD_14 : 5536|14@1+ (0.0001,0) [0|1.571] "rad" MCU
 SG_ OBJA_Angle_Front_Right_STD_V_14 : 5550|1@1+ (1,0) [0|1] "bool" MCU
 SG_ OBJA_Angle_Front_Left_14 : 5551|15@1+ (0.0002,-3.14) [-3.14|3.14] "rad" MCU
 SG_ Reserved_4_14 : 5566|1@1+ (1,0) [0|0] "NA" MCU
 SG_ OBJA_Angle_Front_Left_V_14 : 5567|1@1+ (1,0) [0|1] "bool" MCU
 SG_ OBJA_Angle_Front_Left_STD_14 : 5568|14@1+ (0.0001,0) [0|1.571] "rad" MCU
 SG_ OBJA_Angle_Front_Left_STD_V_14 : 5582|1@1+ (1,0) [0|1] "bool" MCU
 SG_ OBJA_Angle_Rear_Right_14 : 5583|15@1+ (0.0002,-3.14) [-3.14|3.14] "rad" MCU
 SG_ Reserved_5_14 : 5598|1@1+ (1,0) [0|0] "NA" MCU
 SG_ OBJA_Angle_Rear_Right_V_14 : 5599|1@1+ (1,0) [0|1] "bool" MCU
 SG_ OBJA_Angle_Rear_Right_STD_14 : 5600|14@1+ (0.0001,0) [0|1.571] "rad" MCU
 SG_ OBJA_Angle_Rear_Right_STD_V_14 : 5614|1@1+ (1,0) [0|1] "bool" MCU
 SG_ OBJA_Angle_Rear_Left_14 : 5615|15@1+ (0.0002,-3.14) [-3.14|3.14] "rad" MCU
 SG_ Reserved_6_14 : 5630|1@1+ (1,0) [0|0] "NA" MCU
 SG_ OBJA_Angle_Rear_Left_V_14 : 5631|1@1+ (1,0) [0|1] "bool" MCU
 SG_ OBJA_Angle_Rear_Left_STD_14 : 5632|14@1+ (0.0001,0) [0|1.571] "rad" MCU
 SG_ OBJA_Angle_Rear_Left_STD_V_14 : 5646|1@1+ (1,0) [0|1] "bool" MCU
 SG_ OBJA_Angle_Rear_Mid_14 : 5647|15@1+ (0.0002,-3.14) [-3.14|3.14] "rad" MCU
 SG_ Reserved_7_14 : 5662|1@1+ (1,0) [0|0] "NA" MCU
 SG_ OBJA_Angle_Rear_Mid_V_14 : 5663|1@1+ (1,0) [0|1] "bool" MCU
 SG_ OBJA_Angle_Rear_Mid_STD_14 : 5664|14@1+ (0.0001,0) [0|1.571] "rad" MCU
 SG_ OBJA_Angle_Rear_Mid_STD_V_14 : 5678|1@1+ (1,0) [0|1] "bool" MCU
 SG_ OBJA_Angle_Rear_Mid_Rate_14 : 5679|12@1+ (0.002,-2.234) [-2.234|2.2318] "RPS" MCU
 SG_ Reserved_8_14 : 5691|4@1+ (1,0) [0|0] "NA" MCU
 SG_ OBJA_Angle_Rear_Mid_Rate_V_14 : 5695|1@1+ (1,0) [0|1] "bool" MCU
 SG_ OBJA_Angle_Rear_Mid_Rate_STD_14 : 5696|15@1+ (0.0001,0) [0|2.2318] "RPS" MCU
 SG_ OBJA_Angle_Rear_Mid_Rate_STD_V_14 : 5711|1@1+ (1,0) [0|1] "bool" MCU
 SG_ OBJA_Angle_Front_Right_Rate_14 : 5712|12@1+ (0.002,-2.234) [-2.234|2.2318] "RPS" MCU
 SG_ Reserved_9_14 : 5724|3@1+ (1,0) [0|0] "NA" MCU
 SG_ OBJA_Angle_Front_Right_Rate_V_14 : 5727|1@1+ (1,0) [0|1] "bool" MCU
 SG_ OBJA_Angle_Front_Right_Rate_STD_14 : 5728|15@1+ (0.0001,0) [0|2.2318] "RPS" MCU
 SG_ OBJA_Angle_Front_Right_Rate_STD_V_14 : 5743|1@1+ (1,0) [0|1] "bool" MCU
 SG_ OBJA_Angle_Front_Left_Rate_14 : 5744|12@1+ (0.002,-2.234) [-2.234|2.2318] "RPS" MCU
 SG_ Reserved_10_14 : 5756|3@1+ (1,0) [0|0] "NA" MCU
 SG_ OBJA_Angle_Front_Left_Rate_V_14 : 5759|1@1+ (1,0) [0|1] "bool" MCU
 SG_ OBJA_Angle_Front_Left_Rate_STD_14 : 5760|15@1+ (0.0001,0) [0|2.2318] "RPS" MCU
 SG_ OBJA_Angle_Front_Left_Rate_STD_V_14 : 5775|1@1+ (1,0) [0|1] "bool" MCU
 SG_ OBJA_Angle_Rear_Right_Rate_14 : 5776|12@1+ (0.002,-2.234) [-2.234|2.2318] "RPS" MCU
 SG_ Reserved_11_14 : 5788|3@1+ (1,0) [0|0] "NA" MCU
 SG_ OBJA_Angle_Rear_Right_Rate_V_14 : 5791|1@1+ (1,0) [0|1] "bool" MCU
 SG_ OBJA_Angle_Rear_Right_Rate_STD_14 : 5792|15@1+ (0.0001,0) [0|2.2318] "RPS" MCU
 SG_ OBJA_Angle_Rear_Right_Rate_STD_V_14 : 5807|1@1+ (1,0) [0|1] "bool" MCU
 SG_ OBJA_Angle_Rear_Left_Rate_14 : 5808|12@1+ (0.002,-2.234) [-2.234|2.2318] "RPS" MCU
 SG_ Reserved_12_14 : 5820|3@1+ (1,0) [0|0] "NA" MCU
 SG_ OBJA_Angle_Rear_Left_Rate_V_14 : 5823|1@1+ (1,0) [0|1] "bool" MCU
 SG_ OBJA_Angle_Rear_Left_Rate_STD_14 : 5824|15@1+ (0.0001,0) [0|2.2318] "RPS" MCU
 SG_ OBJA_Angle_Rear_Left_Rate_STD_V_14 : 5839|1@1+ (1,0) [0|1] "bool" MCU
 SG_ Reserved_13_14 : 5840|16@1+ (1,0) [0|0] "NA" MCU
 SG_ OBJA_CRC_15 : 5856|32@1+ (1,0) [0|4294967295] "NA" MCU
 SG_ OBJA_ID_15 : 5888|8@1+ (1,0) [0|255] "counter" MCU
 SG_ OBJA_Angle_Front_Right_15 : 5896|15@1+ (0.0002,-3.14) [-3.14|3.14] "rad" MCU
 SG_ Reserved_3_15 : 5911|8@1+ (1,0) [0|0] "NA" MCU
 SG_ OBJA_Angle_Front_Right_V_15 : 5919|1@1+ (1,0) [0|1] "bool" MCU
 SG_ OBJA_Angle_Front_Right_STD_15 : 5920|14@1+ (0.0001,0) [0|1.571] "rad" MCU
 SG_ OBJA_Angle_Front_Right_STD_V_15 : 5934|1@1+ (1,0) [0|1] "bool" MCU
 SG_ OBJA_Angle_Front_Left_15 : 5935|15@1+ (0.0002,-3.14) [-3.14|3.14] "rad" MCU
 SG_ Reserved_4_15 : 5950|1@1+ (1,0) [0|0] "NA" MCU
 SG_ OBJA_Angle_Front_Left_V_15 : 5951|1@1+ (1,0) [0|1] "bool" MCU
 SG_ OBJA_Angle_Front_Left_STD_15 : 5952|14@1+ (0.0001,0) [0|1.571] "rad" MCU
 SG_ OBJA_Angle_Front_Left_STD_V_15 : 5966|1@1+ (1,0) [0|1] "bool" MCU
 SG_ OBJA_Angle_Rear_Right_15 : 5967|15@1+ (0.0002,-3.14) [-3.14|3.14] "rad" MCU
 SG_ Reserved_5_15 : 5982|1@1+ (1,0) [0|0] "NA" MCU
 SG_ OBJA_Angle_Rear_Right_V_15 : 5983|1@1+ (1,0) [0|1] "bool" MCU
 SG_ OBJA_Angle_Rear_Right_STD_15 : 5984|14@1+ (0.0001,0) [0|1.571] "rad" MCU
 SG_ OBJA_Angle_Rear_Right_STD_V_15 : 5998|1@1+ (1,0) [0|1] "bool" MCU
 SG_ OBJA_Angle_Rear_Left_15 : 5999|15@1+ (0.0002,-3.14) [-3.14|3.14] "rad" MCU
 SG_ Reserved_6_15 : 6014|1@1+ (1,0) [0|0] "NA" MCU
 SG_ OBJA_Angle_Rear_Left_V_15 : 6015|1@1+ (1,0) [0|1] "bool" MCU
 SG_ OBJA_Angle_Rear_Left_STD_15 : 6016|14@1+ (0.0001,0) [0|1.571] "rad" MCU
 SG_ OBJA_Angle_Rear_Left_STD_V_15 : 6030|1@1+ (1,0) [0|1] "bool" MCU
 SG_ OBJA_Angle_Rear_Mid_15 : 6031|15@1+ (0.0002,-3.14) [-3.14|3.14] "rad" MCU
 SG_ Reserved_7_15 : 6046|1@1+ (1,0) [0|0] "NA" MCU
 SG_ OBJA_Angle_Rear_Mid_V_15 : 6047|1@1+ (1,0) [0|1] "bool" MCU
 SG_ OBJA_Angle_Rear_Mid_STD_15 : 6048|14@1+ (0.0001,0) [0|1.571] "rad" MCU
 SG_ OBJA_Angle_Rear_Mid_STD_V_15 : 6062|1@1+ (1,0) [0|1] "bool" MCU
 SG_ OBJA_Angle_Rear_Mid_Rate_15 : 6063|12@1+ (0.002,-2.234) [-2.234|2.2318] "RPS" MCU
 SG_ Reserved_8_15 : 6075|4@1+ (1,0) [0|0] "NA" MCU
 SG_ OBJA_Angle_Rear_Mid_Rate_V_15 : 6079|1@1+ (1,0) [0|1] "bool" MCU
 SG_ OBJA_Angle_Rear_Mid_Rate_STD_15 : 6080|15@1+ (0.0001,0) [0|2.2318] "RPS" MCU
 SG_ OBJA_Angle_Rear_Mid_Rate_STD_V_15 : 6095|1@1+ (1,0) [0|1] "bool" MCU
 SG_ OBJA_Angle_Front_Right_Rate_15 : 6096|12@1+ (0.002,-2.234) [-2.234|2.2318] "RPS" MCU
 SG_ Reserved_9_15 : 6108|3@1+ (1,0) [0|0] "NA" MCU
 SG_ OBJA_Angle_Front_Right_Rate_V_15 : 6111|1@1+ (1,0) [0|1] "bool" MCU
 SG_ OBJA_Angle_Front_Right_Rate_STD_15 : 6112|15@1+ (0.0001,0) [0|2.2318] "RPS" MCU
 SG_ OBJA_Angle_Front_Right_Rate_STD_V_15 : 6127|1@1+ (1,0) [0|1] "bool" MCU
 SG_ OBJA_Angle_Front_Left_Rate_15 : 6128|12@1+ (0.002,-2.234) [-2.234|2.2318] "RPS" MCU
 SG_ Reserved_10_15 : 6140|3@1+ (1,0) [0|0] "NA" MCU
 SG_ OBJA_Angle_Front_Left_Rate_V_15 : 6143|1@1+ (1,0) [0|1] "bool" MCU
 SG_ OBJA_Angle_Front_Left_Rate_STD_15 : 6144|15@1+ (0.0001,0) [0|2.2318] "RPS" MCU
 SG_ OBJA_Angle_Front_Left_Rate_STD_V_15 : 6159|1@1+ (1,0) [0|1] "bool" MCU
 SG_ OBJA_Angle_Rear_Right_Rate_15 : 6160|12@1+ (0.002,-2.234) [-2.234|2.2318] "RPS" MCU
 SG_ Reserved_11_15 : 6172|3@1+ (1,0) [0|0] "NA" MCU
 SG_ OBJA_Angle_Rear_Right_Rate_V_15 : 6175|1@1+ (1,0) [0|1] "bool" MCU
 SG_ OBJA_Angle_Rear_Right_Rate_STD_15 : 6176|15@1+ (0.0001,0) [0|2.2318] "RPS" MCU
 SG_ OBJA_Angle_Rear_Right_Rate_STD_V_15 : 6191|1@1+ (1,0) [0|1] "bool" MCU
 SG_ OBJA_Angle_Rear_Left_Rate_15 : 6192|12@1+ (0.002,-2.234) [-2.234|2.2318] "RPS" MCU
 SG_ Reserved_12_15 : 6204|3@1+ (1,0) [0|0] "NA" MCU
 SG_ OBJA_Angle_Rear_Left_Rate_V_15 : 6207|1@1+ (1,0) [0|1] "bool" MCU
 SG_ OBJA_Angle_Rear_Left_Rate_STD_15 : 6208|15@1+ (0.0001,0) [0|2.2318] "RPS" MCU
 SG_ OBJA_Angle_Rear_Left_Rate_STD_V_15 : 6223|1@1+ (1,0) [0|1] "bool" MCU
 SG_ Reserved_13_15 : 6224|16@1+ (1,0) [0|0] "NA" MCU
 SG_ OBJA_CRC_16 : 6240|32@1+ (1,0) [0|4294967295] "NA" MCU
 SG_ OBJA_ID_16 : 6272|8@1+ (1,0) [0|255] "counter" MCU
 SG_ OBJA_Angle_Front_Right_16 : 6280|15@1+ (0.0002,-3.14) [-3.14|3.14] "rad" MCU
 SG_ Reserved_3_16 : 6295|8@1+ (1,0) [0|0] "NA" MCU
 SG_ OBJA_Angle_Front_Right_V_16 : 6303|1@1+ (1,0) [0|1] "bool" MCU
 SG_ OBJA_Angle_Front_Right_STD_16 : 6304|14@1+ (0.0001,0) [0|1.571] "rad" MCU
 SG_ OBJA_Angle_Front_Right_STD_V_16 : 6318|1@1+ (1,0) [0|1] "bool" MCU
 SG_ OBJA_Angle_Front_Left_16 : 6319|15@1+ (0.0002,-3.14) [-3.14|3.14] "rad" MCU
 SG_ Reserved_4_16 : 6334|1@1+ (1,0) [0|0] "NA" MCU
 SG_ OBJA_Angle_Front_Left_V_16 : 6335|1@1+ (1,0) [0|1] "bool" MCU
 SG_ OBJA_Angle_Front_Left_STD_16 : 6336|14@1+ (0.0001,0) [0|1.571] "rad" MCU
 SG_ OBJA_Angle_Front_Left_STD_V_16 : 6350|1@1+ (1,0) [0|1] "bool" MCU
 SG_ OBJA_Angle_Rear_Right_16 : 6351|15@1+ (0.0002,-3.14) [-3.14|3.14] "rad" MCU
 SG_ Reserved_5_16 : 6366|1@1+ (1,0) [0|0] "NA" MCU
 SG_ OBJA_Angle_Rear_Right_V_16 : 6367|1@1+ (1,0) [0|1] "bool" MCU
 SG_ OBJA_Angle_Rear_Right_STD_16 : 6368|14@1+ (0.0001,0) [0|1.571] "rad" MCU
 SG_ OBJA_Angle_Rear_Right_STD_V_16 : 6382|1@1+ (1,0) [0|1] "bool" MCU
 SG_ OBJA_Angle_Rear_Left_16 : 6383|15@1+ (0.0002,-3.14) [-3.14|3.14] "rad" MCU
 SG_ Reserved_6_16 : 6398|1@1+ (1,0) [0|0] "NA" MCU
 SG_ OBJA_Angle_Rear_Left_V_16 : 6399|1@1+ (1,0) [0|1] "bool" MCU
 SG_ OBJA_Angle_Rear_Left_STD_16 : 6400|14@1+ (0.0001,0) [0|1.571] "rad" MCU
 SG_ OBJA_Angle_Rear_Left_STD_V_16 : 6414|1@1+ (1,0) [0|1] "bool" MCU
 SG_ OBJA_Angle_Rear_Mid_16 : 6415|15@1+ (0.0002,-3.14) [-3.14|3.14] "rad" MCU
 SG_ Reserved_7_16 : 6430|1@1+ (1,0) [0|0] "NA" MCU
 SG_ OBJA_Angle_Rear_Mid_V_16 : 6431|1@1+ (1,0) [0|1] "bool" MCU
 SG_ OBJA_Angle_Rear_Mid_STD_16 : 6432|14@1+ (0.0001,0) [0|1.571] "rad" MCU
 SG_ OBJA_Angle_Rear_Mid_STD_V_16 : 6446|1@1+ (1,0) [0|1] "bool" MCU
 SG_ OBJA_Angle_Rear_Mid_Rate_16 : 6447|12@1+ (0.002,-2.234) [-2.234|2.2318] "RPS" MCU
 SG_ Reserved_8_16 : 6459|4@1+ (1,0) [0|0] "NA" MCU
 SG_ OBJA_Angle_Rear_Mid_Rate_V_16 : 6463|1@1+ (1,0) [0|1] "bool" MCU
 SG_ OBJA_Angle_Rear_Mid_Rate_STD_16 : 6464|15@1+ (0.0001,0) [0|2.2318] "RPS" MCU
 SG_ OBJA_Angle_Rear_Mid_Rate_STD_V_16 : 6479|1@1+ (1,0) [0|1] "bool" MCU
 SG_ OBJA_Angle_Front_Right_Rate_16 : 6480|12@1+ (0.002,-2.234) [-2.234|2.2318] "RPS" MCU
 SG_ Reserved_9_16 : 6492|3@1+ (1,0) [0|0] "NA" MCU
 SG_ OBJA_Angle_Front_Right_Rate_V_16 : 6495|1@1+ (1,0) [0|1] "bool" MCU
 SG_ OBJA_Angle_Front_Right_Rate_STD_16 : 6496|15@1+ (0.0001,0) [0|2.2318] "RPS" MCU
 SG_ OBJA_Angle_Front_Right_Rate_STD_V_16 : 6511|1@1+ (1,0) [0|1] "bool" MCU
 SG_ OBJA_Angle_Front_Left_Rate_16 : 6512|12@1+ (0.002,-2.234) [-2.234|2.2318] "RPS" MCU
 SG_ Reserved_10_16 : 6524|3@1+ (1,0) [0|0] "NA" MCU
 SG_ OBJA_Angle_Front_Left_Rate_V_16 : 6527|1@1+ (1,0) [0|1] "bool" MCU
 SG_ OBJA_Angle_Front_Left_Rate_STD_16 : 6528|15@1+ (0.0001,0) [0|2.2318] "RPS" MCU
 SG_ OBJA_Angle_Front_Left_Rate_STD_V_16 : 6543|1@1+ (1,0) [0|1] "bool" MCU
 SG_ OBJA_Angle_Rear_Right_Rate_16 : 6544|12@1+ (0.002,-2.234) [-2.234|2.2318] "RPS" MCU
 SG_ Reserved_11_16 : 6556|3@1+ (1,0) [0|0] "NA" MCU
 SG_ OBJA_Angle_Rear_Right_Rate_V_16 : 6559|1@1+ (1,0) [0|1] "bool" MCU
 SG_ OBJA_Angle_Rear_Right_Rate_STD_16 : 6560|15@1+ (0.0001,0) [0|2.2318] "RPS" MCU
 SG_ OBJA_Angle_Rear_Right_Rate_STD_V_16 : 6575|1@1+ (1,0) [0|1] "bool" MCU
 SG_ OBJA_Angle_Rear_Left_Rate_16 : 6576|12@1+ (0.002,-2.234) [-2.234|2.2318] "RPS" MCU
 SG_ Reserved_12_16 : 6588|3@1+ (1,0) [0|0] "NA" MCU
 SG_ OBJA_Angle_Rear_Left_Rate_V_16 : 6591|1@1+ (1,0) [0|1] "bool" MCU
 SG_ OBJA_Angle_Rear_Left_Rate_STD_16 : 6592|15@1+ (0.0001,0) [0|2.2318] "RPS" MCU
 SG_ OBJA_Angle_Rear_Left_Rate_STD_V_16 : 6607|1@1+ (1,0) [0|1] "bool" MCU
 SG_ Reserved_13_16 : 6608|16@1+ (1,0) [0|0] "NA" MCU
 SG_ OBJA_CRC_17 : 6624|32@1+ (1,0) [0|4294967295] "NA" MCU
 SG_ OBJA_ID_17 : 6656|8@1+ (1,0) [0|255] "counter" MCU
 SG_ OBJA_Angle_Front_Right_17 : 6664|15@1+ (0.0002,-3.14) [-3.14|3.14] "rad" MCU
 SG_ Reserved_3_17 : 6679|8@1+ (1,0) [0|0] "NA" MCU
 SG_ OBJA_Angle_Front_Right_V_17 : 6687|1@1+ (1,0) [0|1] "bool" MCU
 SG_ OBJA_Angle_Front_Right_STD_17 : 6688|14@1+ (0.0001,0) [0|1.571] "rad" MCU
 SG_ OBJA_Angle_Front_Right_STD_V_17 : 6702|1@1+ (1,0) [0|1] "bool" MCU
 SG_ OBJA_Angle_Front_Left_17 : 6703|15@1+ (0.0002,-3.14) [-3.14|3.14] "rad" MCU
 SG_ Reserved_4_17 : 6718|1@1+ (1,0) [0|0] "NA" MCU
 SG_ OBJA_Angle_Front_Left_V_17 : 6719|1@1+ (1,0) [0|1] "bool" MCU
 SG_ OBJA_Angle_Front_Left_STD_17 : 6720|14@1+ (0.0001,0) [0|1.571] "rad" MCU
 SG_ OBJA_Angle_Front_Left_STD_V_17 : 6734|1@1+ (1,0) [0|1] "bool" MCU
 SG_ OBJA_Angle_Rear_Right_17 : 6735|15@1+ (0.0002,-3.14) [-3.14|3.14] "rad" MCU
 SG_ Reserved_5_17 : 6750|1@1+ (1,0) [0|0] "NA" MCU
 SG_ OBJA_Angle_Rear_Right_V_17 : 6751|1@1+ (1,0) [0|1] "bool" MCU
 SG_ OBJA_Angle_Rear_Right_STD_17 : 6752|14@1+ (0.0001,0) [0|1.571] "rad" MCU
 SG_ OBJA_Angle_Rear_Right_STD_V_17 : 6766|1@1+ (1,0) [0|1] "bool" MCU
 SG_ OBJA_Angle_Rear_Left_17 : 6767|15@1+ (0.0002,-3.14) [-3.14|3.14] "rad" MCU
 SG_ Reserved_6_17 : 6782|1@1+ (1,0) [0|0] "NA" MCU
 SG_ OBJA_Angle_Rear_Left_V_17 : 6783|1@1+ (1,0) [0|1] "bool" MCU
 SG_ OBJA_Angle_Rear_Left_STD_17 : 6784|14@1+ (0.0001,0) [0|1.571] "rad" MCU
 SG_ OBJA_Angle_Rear_Left_STD_V_17 : 6798|1@1+ (1,0) [0|1] "bool" MCU
 SG_ OBJA_Angle_Rear_Mid_17 : 6799|15@1+ (0.0002,-3.14) [-3.14|3.14] "rad" MCU
 SG_ Reserved_7_17 : 6814|1@1+ (1,0) [0|0] "NA" MCU
 SG_ OBJA_Angle_Rear_Mid_V_17 : 6815|1@1+ (1,0) [0|1] "bool" MCU
 SG_ OBJA_Angle_Rear_Mid_STD_17 : 6816|14@1+ (0.0001,0) [0|1.571] "rad" MCU
 SG_ OBJA_Angle_Rear_Mid_STD_V_17 : 6830|1@1+ (1,0) [0|1] "bool" MCU
 SG_ OBJA_Angle_Rear_Mid_Rate_17 : 6831|12@1+ (0.002,-2.234) [-2.234|2.2318] "RPS" MCU
 SG_ Reserved_8_17 : 6843|4@1+ (1,0) [0|0] "NA" MCU
 SG_ OBJA_Angle_Rear_Mid_Rate_V_17 : 6847|1@1+ (1,0) [0|1] "bool" MCU
 SG_ OBJA_Angle_Rear_Mid_Rate_STD_17 : 6848|15@1+ (0.0001,0) [0|2.2318] "RPS" MCU
 SG_ OBJA_Angle_Rear_Mid_Rate_STD_V_17 : 6863|1@1+ (1,0) [0|1] "bool" MCU
 SG_ OBJA_Angle_Front_Right_Rate_17 : 6864|12@1+ (0.002,-2.234) [-2.234|2.2318] "RPS" MCU
 SG_ Reserved_9_17 : 6876|3@1+ (1,0) [0|0] "NA" MCU
 SG_ OBJA_Angle_Front_Right_Rate_V_17 : 6879|1@1+ (1,0) [0|1] "bool" MCU
 SG_ OBJA_Angle_Front_Right_Rate_STD_17 : 6880|15@1+ (0.0001,0) [0|2.2318] "RPS" MCU
 SG_ OBJA_Angle_Front_Right_Rate_STD_V_17 : 6895|1@1+ (1,0) [0|1] "bool" MCU
 SG_ OBJA_Angle_Front_Left_Rate_17 : 6896|12@1+ (0.002,-2.234) [-2.234|2.2318] "RPS" MCU
 SG_ Reserved_10_17 : 6908|3@1+ (1,0) [0|0] "NA" MCU
 SG_ OBJA_Angle_Front_Left_Rate_V_17 : 6911|1@1+ (1,0) [0|1] "bool" MCU
 SG_ OBJA_Angle_Front_Left_Rate_STD_17 : 6912|15@1+ (0.0001,0) [0|2.2318] "RPS" MCU
 SG_ OBJA_Angle_Front_Left_Rate_STD_V_17 : 6927|1@1+ (1,0) [0|1] "bool" MCU
 SG_ OBJA_Angle_Rear_Right_Rate_17 : 6928|12@1+ (0.002,-2.234) [-2.234|2.2318] "RPS" MCU
 SG_ Reserved_11_17 : 6940|3@1+ (1,0) [0|0] "NA" MCU
 SG_ OBJA_Angle_Rear_Right_Rate_V_17 : 6943|1@1+ (1,0) [0|1] "bool" MCU
 SG_ OBJA_Angle_Rear_Right_Rate_STD_17 : 6944|15@1+ (0.0001,0) [0|2.2318] "RPS" MCU
 SG_ OBJA_Angle_Rear_Right_Rate_STD_V_17 : 6959|1@1+ (1,0) [0|1] "bool" MCU
 SG_ OBJA_Angle_Rear_Left_Rate_17 : 6960|12@1+ (0.002,-2.234) [-2.234|2.2318] "RPS" MCU
 SG_ Reserved_12_17 : 6972|3@1+ (1,0) [0|0] "NA" MCU
 SG_ OBJA_Angle_Rear_Left_Rate_V_17 : 6975|1@1+ (1,0) [0|1] "bool" MCU
 SG_ OBJA_Angle_Rear_Left_Rate_STD_17 : 6976|15@1+ (0.0001,0) [0|2.2318] "RPS" MCU
 SG_ OBJA_Angle_Rear_Left_Rate_STD_V_17 : 6991|1@1+ (1,0) [0|1] "bool" MCU
 SG_ Reserved_13_17 : 6992|16@1+ (1,0) [0|0] "NA" MCU
 SG_ OBJA_CRC_18 : 7008|32@1+ (1,0) [0|4294967295] "NA" MCU
 SG_ OBJA_ID_18 : 7040|8@1+ (1,0) [0|255] "counter" MCU
 SG_ OBJA_Angle_Front_Right_18 : 7048|15@1+ (0.0002,-3.14) [-3.14|3.14] "rad" MCU
 SG_ Reserved_3_18 : 7063|8@1+ (1,0) [0|0] "NA" MCU
 SG_ OBJA_Angle_Front_Right_V_18 : 7071|1@1+ (1,0) [0|1] "bool" MCU
 SG_ OBJA_Angle_Front_Right_STD_18 : 7072|14@1+ (0.0001,0) [0|1.571] "rad" MCU
 SG_ OBJA_Angle_Front_Right_STD_V_18 : 7086|1@1+ (1,0) [0|1] "bool" MCU
 SG_ OBJA_Angle_Front_Left_18 : 7087|15@1+ (0.0002,-3.14) [-3.14|3.14] "rad" MCU
 SG_ Reserved_4_18 : 7102|1@1+ (1,0) [0|0] "NA" MCU
 SG_ OBJA_Angle_Front_Left_V_18 : 7103|1@1+ (1,0) [0|1] "bool" MCU
 SG_ OBJA_Angle_Front_Left_STD_18 : 7104|14@1+ (0.0001,0) [0|1.571] "rad" MCU
 SG_ OBJA_Angle_Front_Left_STD_V_18 : 7118|1@1+ (1,0) [0|1] "bool" MCU
 SG_ OBJA_Angle_Rear_Right_18 : 7119|15@1+ (0.0002,-3.14) [-3.14|3.14] "rad" MCU
 SG_ Reserved_5_18 : 7134|1@1+ (1,0) [0|0] "NA" MCU
 SG_ OBJA_Angle_Rear_Right_V_18 : 7135|1@1+ (1,0) [0|1] "bool" MCU
 SG_ OBJA_Angle_Rear_Right_STD_18 : 7136|14@1+ (0.0001,0) [0|1.571] "rad" MCU
 SG_ OBJA_Angle_Rear_Right_STD_V_18 : 7150|1@1+ (1,0) [0|1] "bool" MCU
 SG_ OBJA_Angle_Rear_Left_18 : 7151|15@1+ (0.0002,-3.14) [-3.14|3.14] "rad" MCU
 SG_ Reserved_6_18 : 7166|1@1+ (1,0) [0|0] "NA" MCU
 SG_ OBJA_Angle_Rear_Left_V_18 : 7167|1@1+ (1,0) [0|1] "bool" MCU
 SG_ OBJA_Angle_Rear_Left_STD_18 : 7168|14@1+ (0.0001,0) [0|1.571] "rad" MCU
 SG_ OBJA_Angle_Rear_Left_STD_V_18 : 7182|1@1+ (1,0) [0|1] "bool" MCU
 SG_ OBJA_Angle_Rear_Mid_18 : 7183|15@1+ (0.0002,-3.14) [-3.14|3.14] "rad" MCU
 SG_ Reserved_7_18 : 7198|1@1+ (1,0) [0|0] "NA" MCU
 SG_ OBJA_Angle_Rear_Mid_V_18 : 7199|1@1+ (1,0) [0|1] "bool" MCU
 SG_ OBJA_Angle_Rear_Mid_STD_18 : 7200|14@1+ (0.0001,0) [0|1.571] "rad" MCU
 SG_ OBJA_Angle_Rear_Mid_STD_V_18 : 7214|1@1+ (1,0) [0|1] "bool" MCU
 SG_ OBJA_Angle_Rear_Mid_Rate_18 : 7215|12@1+ (0.002,-2.234) [-2.234|2.2318] "RPS" MCU
 SG_ Reserved_8_18 : 7227|4@1+ (1,0) [0|0] "NA" MCU
 SG_ OBJA_Angle_Rear_Mid_Rate_V_18 : 7231|1@1+ (1,0) [0|1] "bool" MCU
 SG_ OBJA_Angle_Rear_Mid_Rate_STD_18 : 7232|15@1+ (0.0001,0) [0|2.2318] "RPS" MCU
 SG_ OBJA_Angle_Rear_Mid_Rate_STD_V_18 : 7247|1@1+ (1,0) [0|1] "bool" MCU
 SG_ OBJA_Angle_Front_Right_Rate_18 : 7248|12@1+ (0.002,-2.234) [-2.234|2.2318] "RPS" MCU
 SG_ Reserved_9_18 : 7260|3@1+ (1,0) [0|0] "NA" MCU
 SG_ OBJA_Angle_Front_Right_Rate_V_18 : 7263|1@1+ (1,0) [0|1] "bool" MCU
 SG_ OBJA_Angle_Front_Right_Rate_STD_18 : 7264|15@1+ (0.0001,0) [0|2.2318] "RPS" MCU
 SG_ OBJA_Angle_Front_Right_Rate_STD_V_18 : 7279|1@1+ (1,0) [0|1] "bool" MCU
 SG_ OBJA_Angle_Front_Left_Rate_18 : 7280|12@1+ (0.002,-2.234) [-2.234|2.2318] "RPS" MCU
 SG_ Reserved_10_18 : 7292|3@1+ (1,0) [0|0] "NA" MCU
 SG_ OBJA_Angle_Front_Left_Rate_V_18 : 7295|1@1+ (1,0) [0|1] "bool" MCU
 SG_ OBJA_Angle_Front_Left_Rate_STD_18 : 7296|15@1+ (0.0001,0) [0|2.2318] "RPS" MCU
 SG_ OBJA_Angle_Front_Left_Rate_STD_V_18 : 7311|1@1+ (1,0) [0|1] "bool" MCU
 SG_ OBJA_Angle_Rear_Right_Rate_18 : 7312|12@1+ (0.002,-2.234) [-2.234|2.2318] "RPS" MCU
 SG_ Reserved_11_18 : 7324|3@1+ (1,0) [0|0] "NA" MCU
 SG_ OBJA_Angle_Rear_Right_Rate_V_18 : 7327|1@1+ (1,0) [0|1] "bool" MCU
 SG_ OBJA_Angle_Rear_Right_Rate_STD_18 : 7328|15@1+ (0.0001,0) [0|2.2318] "RPS" MCU
 SG_ OBJA_Angle_Rear_Right_Rate_STD_V_18 : 7343|1@1+ (1,0) [0|1] "bool" MCU
 SG_ OBJA_Angle_Rear_Left_Rate_18 : 7344|12@1+ (0.002,-2.234) [-2.234|2.2318] "RPS" MCU
 SG_ Reserved_12_18 : 7356|3@1+ (1,0) [0|0] "NA" MCU
 SG_ OBJA_Angle_Rear_Left_Rate_V_18 : 7359|1@1+ (1,0) [0|1] "bool" MCU
 SG_ OBJA_Angle_Rear_Left_Rate_STD_18 : 7360|15@1+ (0.0001,0) [0|2.2318] "RPS" MCU
 SG_ OBJA_Angle_Rear_Left_Rate_STD_V_18 : 7375|1@1+ (1,0) [0|1] "bool" MCU
 SG_ Reserved_13_18 : 7376|16@1+ (1,0) [0|0] "NA" MCU
 SG_ OBJA_CRC_19 : 7392|32@1+ (1,0) [0|4294967295] "NA" MCU
 SG_ OBJA_ID_19 : 7424|8@1+ (1,0) [0|255] "counter" MCU
 SG_ OBJA_Angle_Front_Right_19 : 7432|15@1+ (0.0002,-3.14) [-3.14|3.14] "rad" MCU
 SG_ Reserved_3_19 : 7447|8@1+ (1,0) [0|0] "NA" MCU
 SG_ OBJA_Angle_Front_Right_V_19 : 7455|1@1+ (1,0) [0|1] "bool" MCU
 SG_ OBJA_Angle_Front_Right_STD_19 : 7456|14@1+ (0.0001,0) [0|1.571] "rad" MCU
 SG_ OBJA_Angle_Front_Right_STD_V_19 : 7470|1@1+ (1,0) [0|1] "bool" MCU
 SG_ OBJA_Angle_Front_Left_19 : 7471|15@1+ (0.0002,-3.14) [-3.14|3.14] "rad" MCU
 SG_ Reserved_4_19 : 7486|1@1+ (1,0) [0|0] "NA" MCU
 SG_ OBJA_Angle_Front_Left_V_19 : 7487|1@1+ (1,0) [0|1] "bool" MCU
 SG_ OBJA_Angle_Front_Left_STD_19 : 7488|14@1+ (0.0001,0) [0|1.571] "rad" MCU
 SG_ OBJA_Angle_Front_Left_STD_V_19 : 7502|1@1+ (1,0) [0|1] "bool" MCU
 SG_ OBJA_Angle_Rear_Right_19 : 7503|15@1+ (0.0002,-3.14) [-3.14|3.14] "rad" MCU
 SG_ Reserved_5_19 : 7518|1@1+ (1,0) [0|0] "NA" MCU
 SG_ OBJA_Angle_Rear_Right_V_19 : 7519|1@1+ (1,0) [0|1] "bool" MCU
 SG_ OBJA_Angle_Rear_Right_STD_19 : 7520|14@1+ (0.0001,0) [0|1.571] "rad" MCU
 SG_ OBJA_Angle_Rear_Right_STD_V_19 : 7534|1@1+ (1,0) [0|1] "bool" MCU
 SG_ OBJA_Angle_Rear_Left_19 : 7535|15@1+ (0.0002,-3.14) [-3.14|3.14] "rad" MCU
 SG_ Reserved_6_19 : 7550|1@1+ (1,0) [0|0] "NA" MCU
 SG_ OBJA_Angle_Rear_Left_V_19 : 7551|1@1+ (1,0) [0|1] "bool" MCU
 SG_ OBJA_Angle_Rear_Left_STD_19 : 7552|14@1+ (0.0001,0) [0|1.571] "rad" MCU
 SG_ OBJA_Angle_Rear_Left_STD_V_19 : 7566|1@1+ (1,0) [0|1] "bool" MCU
 SG_ OBJA_Angle_Rear_Mid_19 : 7567|15@1+ (0.0002,-3.14) [-3.14|3.14] "rad" MCU
 SG_ Reserved_7_19 : 7582|1@1+ (1,0) [0|0] "NA" MCU
 SG_ OBJA_Angle_Rear_Mid_V_19 : 7583|1@1+ (1,0) [0|1] "bool" MCU
 SG_ OBJA_Angle_Rear_Mid_STD_19 : 7584|14@1+ (0.0001,0) [0|1.571] "rad" MCU
 SG_ OBJA_Angle_Rear_Mid_STD_V_19 : 7598|1@1+ (1,0) [0|1] "bool" MCU
 SG_ OBJA_Angle_Rear_Mid_Rate_19 : 7599|12@1+ (0.002,-2.234) [-2.234|2.2318] "RPS" MCU
 SG_ Reserved_8_19 : 7611|4@1+ (1,0) [0|0] "NA" MCU
 SG_ OBJA_Angle_Rear_Mid_Rate_V_19 : 7615|1@1+ (1,0) [0|1] "bool" MCU
 SG_ OBJA_Angle_Rear_Mid_Rate_STD_19 : 7616|15@1+ (0.0001,0) [0|2.2318] "RPS" MCU
 SG_ OBJA_Angle_Rear_Mid_Rate_STD_V_19 : 7631|1@1+ (1,0) [0|1] "bool" MCU
 SG_ OBJA_Angle_Front_Right_Rate_19 : 7632|12@1+ (0.002,-2.234) [-2.234|2.2318] "RPS" MCU
 SG_ Reserved_9_19 : 7644|3@1+ (1,0) [0|0] "NA" MCU
 SG_ OBJA_Angle_Front_Right_Rate_V_19 : 7647|1@1+ (1,0) [0|1] "bool" MCU
 SG_ OBJA_Angle_Front_Right_Rate_STD_19 : 7648|15@1+ (0.0001,0) [0|2.2318] "RPS" MCU
 SG_ OBJA_Angle_Front_Right_Rate_STD_V_19 : 7663|1@1+ (1,0) [0|1] "bool" MCU
 SG_ OBJA_Angle_Front_Left_Rate_19 : 7664|12@1+ (0.002,-2.234) [-2.234|2.2318] "RPS" MCU
 SG_ Reserved_10_19 : 7676|3@1+ (1,0) [0|0] "NA" MCU
 SG_ OBJA_Angle_Front_Left_Rate_V_19 : 7679|1@1+ (1,0) [0|1] "bool" MCU
 SG_ OBJA_Angle_Front_Left_Rate_STD_19 : 7680|15@1+ (0.0001,0) [0|2.2318] "RPS" MCU
 SG_ OBJA_Angle_Front_Left_Rate_STD_V_19 : 7695|1@1+ (1,0) [0|1] "bool" MCU
 SG_ OBJA_Angle_Rear_Right_Rate_19 : 7696|12@1+ (0.002,-2.234) [-2.234|2.2318] "RPS" MCU
 SG_ Reserved_11_19 : 7708|3@1+ (1,0) [0|0] "NA" MCU
 SG_ OBJA_Angle_Rear_Right_Rate_V_19 : 7711|1@1+ (1,0) [0|1] "bool" MCU
 SG_ OBJA_Angle_Rear_Right_Rate_STD_19 : 7712|15@1+ (0.0001,0) [0|2.2318] "RPS" MCU
 SG_ OBJA_Angle_Rear_Right_Rate_STD_V_19 : 7727|1@1+ (1,0) [0|1] "bool" MCU
 SG_ OBJA_Angle_Rear_Left_Rate_19 : 7728|12@1+ (0.002,-2.234) [-2.234|2.2318] "RPS" MCU
 SG_ Reserved_12_19 : 7740|3@1+ (1,0) [0|0] "NA" MCU
 SG_ OBJA_Angle_Rear_Left_Rate_V_19 : 7743|1@1+ (1,0) [0|1] "bool" MCU
 SG_ OBJA_Angle_Rear_Left_Rate_STD_19 : 7744|15@1+ (0.0001,0) [0|2.2318] "RPS" MCU
 SG_ OBJA_Angle_Rear_Left_Rate_STD_V_19 : 7759|1@1+ (1,0) [0|1] "bool" MCU
 SG_ Reserved_13_19 : 7760|16@1+ (1,0) [0|0] "NA" MCU

CM_ SG_ 73 OBJA_Zero_byte "in case set to FF message is not available.";
CM_ SG_ 73 OBJA_Header_CRC "Calculated over all header signals. From the signal after the CRC until the first signal in the elements OBJA_CRC_0  not including";
CM_ SG_ 73 OBJA_Protocol_Version "Denotes the protocol version";
CM_ SG_ 73 OBJA_Sync_ID "The ID of the Sync message, used to synchronize between signals in the system. Every new frame promotes the sync ID by one.";
CM_ SG_ 73 OBJA_Objects_Count "Number of reported Elements";
CM_ SG_ 73 OBJA_CRC_0 "Calculated over all element signals. From the signal after the CRC until the first signal in the next elements OBJA_CRC_N+1  not including";
CM_ SG_ 73 OBJA_ID_0 "Unique id";
CM_ SG_ 73 OBJA_Angle_Front_Right_0 "The angle between the host longitudinal axis and the front right side of the target. The positive side is to the host's right.";
CM_ SG_ 73 OBJA_Angle_Front_Right_V_0 "Validator for Angle_Front_Right.";
CM_ SG_ 73 OBJA_Angle_Front_Right_STD_0 "Standard deviation of Angle_Front_Right.";
CM_ SG_ 73 OBJA_Angle_Front_Right_STD_V_0 "Validator for Angle_Front_Right_STD.";
CM_ SG_ 73 OBJA_Angle_Front_Left_0 "The angle between the host longitudinal axis and the front left side of the target. The positive side is to the host's right.";
CM_ SG_ 73 OBJA_Angle_Front_Left_V_0 "Validator for Angle_Front_Left.";
CM_ SG_ 73 OBJA_Angle_Front_Left_STD_0 "Standard deviation of Angle_Front_Left.";
CM_ SG_ 73 OBJA_Angle_Front_Left_STD_V_0 "Validator for Angle_Front_Left_STD.";
CM_ SG_ 73 OBJA_Angle_Rear_Right_0 "The angle between the host longitudinal axis and the rear right side of the target. The positive side is to the host's right.";
CM_ SG_ 73 OBJA_Angle_Rear_Right_V_0 "	 Validator for Angle_Rear_Right.";
CM_ SG_ 73 OBJA_Angle_Rear_Right_STD_0 "Standard deviation of Angle_Rear_Right.";
CM_ SG_ 73 OBJA_Angle_Rear_Right_STD_V_0 "Validator for Angle_Rear_Right_STD.";
CM_ SG_ 73 OBJA_Angle_Rear_Left_0 "The angle between the host longitudinal axis and the rear left side of the target. The positive side is to the host's right.";
CM_ SG_ 73 OBJA_Angle_Rear_Left_V_0 "Validator for Angle_Rear_Left.";
CM_ SG_ 73 OBJA_Angle_Rear_Left_STD_0 "Standard deviation of Angle_Rear_Left.";
CM_ SG_ 73 OBJA_Angle_Rear_Left_STD_V_0 "Validator for Angle_Rear_Left_STD.";
CM_ SG_ 73 OBJA_Angle_Rear_Mid_0 "The angle between the host longitudinal axis and the rear middle of the target. The positive side is to the host's right.";
CM_ SG_ 73 OBJA_Angle_Rear_Mid_V_0 "Validator for Angle_Rear_Mid.";
CM_ SG_ 73 OBJA_Angle_Rear_Mid_STD_0 "Standard deviation of Angle_Rear_Mid.";
CM_ SG_ 73 OBJA_Angle_Rear_Mid_STD_V_0 "Validator for Angle_Rear_Mid_STD.";
CM_ SG_ 73 OBJA_Angle_Rear_Mid_Rate_0 "The momentary angular speed of Angle_Rear_Mid. (radians)";
CM_ SG_ 73 OBJA_Angle_Rear_Mid_Rate_V_0 "Validator for the angular speed of Angle_Rear_Mid.";
CM_ SG_ 73 OBJA_Angle_Rear_Mid_Rate_STD_0 "Standard deviation of the angular speed of Angle_Rear_Mid. (radians)";
CM_ SG_ 73 OBJA_Angle_Rear_Mid_Rate_STD_V_0 "Validator for the STD of the angular speed of Angle_Rear_Mid.";
CM_ SG_ 73 OBJA_Angle_Front_Right_Rate_0 "The momentary angular speed of Angle_Front_Right. (radians)";
CM_ SG_ 73 OBJA_Angle_Front_Right_Rate_V_0 "Validator for the angular speed of Angle_Front_Right.";
CM_ SG_ 73 OBJA_Angle_Front_Right_Rate_STD_0 "Standard deviation of the angular speed of Angle_Front_Right. (radians)";
CM_ SG_ 73 OBJA_Angle_Front_Right_Rate_STD_V_0 "Validator for the STD of the angular speed of Angle_Front_Right.";
CM_ SG_ 73 OBJA_Angle_Front_Left_Rate_0 "The momentary angular speed of Angle_Front_Left. (radians)";
CM_ SG_ 73 OBJA_Angle_Front_Left_Rate_V_0 "Validator for the angular speed of Angle_Front_Left.";
CM_ SG_ 73 OBJA_Angle_Front_Left_Rate_STD_0 "Standard deviation of the angular speed of Angle_Front_Left. (radians)";
CM_ SG_ 73 OBJA_Angle_Front_Left_Rate_STD_V_0 "Validator for the STD of the angular speed of Angle_Front_Left.";
CM_ SG_ 73 OBJA_Angle_Rear_Right_Rate_0 "The momentary angular speed of Angle_Rear_Right. (radians)";
CM_ SG_ 73 OBJA_Angle_Rear_Right_Rate_V_0 "Validator for the angular speed of Angle_Rear_Right.";
CM_ SG_ 73 OBJA_Angle_Rear_Right_Rate_STD_0 "Standard deviation of the angular speed of Angle_Rear_Right. (radians)";
CM_ SG_ 73 OBJA_Angle_Rear_Right_Rate_STD_V_0 "Validator for the STD of the angular speed of Angle_Rear_Right.";
CM_ SG_ 73 OBJA_Angle_Rear_Left_Rate_0 "The momentary angular speed of Angle_Rear_Left. (radians)";
CM_ SG_ 73 OBJA_Angle_Rear_Left_Rate_V_0 "Validator for the angular speed of Angle_Rear_Left.";
CM_ SG_ 73 OBJA_Angle_Rear_Left_Rate_STD_0 "Standard deviation of the angular speed of Angle_Rear_Left. (radians)";
CM_ SG_ 73 OBJA_Angle_Rear_Left_Rate_STD_V_0 "Validator for the STD of the angular speed of Angle_Rear_Left.";
CM_ SG_ 73 OBJA_CRC_1 "Calculated over all element signals. From the signal after the CRC until the first signal in the next elements OBJA_CRC_N+1  not including";
CM_ SG_ 73 OBJA_ID_1 "Unique id";
CM_ SG_ 73 OBJA_Angle_Front_Right_1 "The angle between the host longitudinal axis and the front right side of the target. The positive side is to the host's right.";
CM_ SG_ 73 OBJA_Angle_Front_Right_V_1 "Validator for Angle_Front_Right.";
CM_ SG_ 73 OBJA_Angle_Front_Right_STD_1 "Standard deviation of Angle_Front_Right.";
CM_ SG_ 73 OBJA_Angle_Front_Right_STD_V_1 "Validator for Angle_Front_Right_STD.";
CM_ SG_ 73 OBJA_Angle_Front_Left_1 "The angle between the host longitudinal axis and the front left side of the target. The positive side is to the host's right.";
CM_ SG_ 73 OBJA_Angle_Front_Left_V_1 "Validator for Angle_Front_Left.";
CM_ SG_ 73 OBJA_Angle_Front_Left_STD_1 "Standard deviation of Angle_Front_Left.";
CM_ SG_ 73 OBJA_Angle_Front_Left_STD_V_1 "Validator for Angle_Front_Left_STD.";
CM_ SG_ 73 OBJA_Angle_Rear_Right_1 "The angle between the host longitudinal axis and the rear right side of the target. The positive side is to the host's right.";
CM_ SG_ 73 OBJA_Angle_Rear_Right_V_1 "	 Validator for Angle_Rear_Right.";
CM_ SG_ 73 OBJA_Angle_Rear_Right_STD_1 "Standard deviation of Angle_Rear_Right.";
CM_ SG_ 73 OBJA_Angle_Rear_Right_STD_V_1 "Validator for Angle_Rear_Right_STD.";
CM_ SG_ 73 OBJA_Angle_Rear_Left_1 "The angle between the host longitudinal axis and the rear left side of the target. The positive side is to the host's right.";
CM_ SG_ 73 OBJA_Angle_Rear_Left_V_1 "Validator for Angle_Rear_Left.";
CM_ SG_ 73 OBJA_Angle_Rear_Left_STD_1 "Standard deviation of Angle_Rear_Left.";
CM_ SG_ 73 OBJA_Angle_Rear_Left_STD_V_1 "Validator for Angle_Rear_Left_STD.";
CM_ SG_ 73 OBJA_Angle_Rear_Mid_1 "The angle between the host longitudinal axis and the rear middle of the target. The positive side is to the host's right.";
CM_ SG_ 73 OBJA_Angle_Rear_Mid_V_1 "Validator for Angle_Rear_Mid.";
CM_ SG_ 73 OBJA_Angle_Rear_Mid_STD_1 "Standard deviation of Angle_Rear_Mid.";
CM_ SG_ 73 OBJA_Angle_Rear_Mid_STD_V_1 "Validator for Angle_Rear_Mid_STD.";
CM_ SG_ 73 OBJA_Angle_Rear_Mid_Rate_1 "The momentary angular speed of Angle_Rear_Mid. (radians)";
CM_ SG_ 73 OBJA_Angle_Rear_Mid_Rate_V_1 "Validator for the angular speed of Angle_Rear_Mid.";
CM_ SG_ 73 OBJA_Angle_Rear_Mid_Rate_STD_1 "Standard deviation of the angular speed of Angle_Rear_Mid. (radians)";
CM_ SG_ 73 OBJA_Angle_Rear_Mid_Rate_STD_V_1 "Validator for the STD of the angular speed of Angle_Rear_Mid.";
CM_ SG_ 73 OBJA_Angle_Front_Right_Rate_1 "The momentary angular speed of Angle_Front_Right. (radians)";
CM_ SG_ 73 OBJA_Angle_Front_Right_Rate_V_1 "Validator for the angular speed of Angle_Front_Right.";
CM_ SG_ 73 OBJA_Angle_Front_Right_Rate_STD_1 "Standard deviation of the angular speed of Angle_Front_Right. (radians)";
CM_ SG_ 73 OBJA_Angle_Front_Right_Rate_STD_V_1 "Validator for the STD of the angular speed of Angle_Front_Right.";
CM_ SG_ 73 OBJA_Angle_Front_Left_Rate_1 "The momentary angular speed of Angle_Front_Left. (radians)";
CM_ SG_ 73 OBJA_Angle_Front_Left_Rate_V_1 "Validator for the angular speed of Angle_Front_Left.";
CM_ SG_ 73 OBJA_Angle_Front_Left_Rate_STD_1 "Standard deviation of the angular speed of Angle_Front_Left. (radians)";
CM_ SG_ 73 OBJA_Angle_Front_Left_Rate_STD_V_1 "Validator for the STD of the angular speed of Angle_Front_Left.";
CM_ SG_ 73 OBJA_Angle_Rear_Right_Rate_1 "The momentary angular speed of Angle_Rear_Right. (radians)";
CM_ SG_ 73 OBJA_Angle_Rear_Right_Rate_V_1 "Validator for the angular speed of Angle_Rear_Right.";
CM_ SG_ 73 OBJA_Angle_Rear_Right_Rate_STD_1 "Standard deviation of the angular speed of Angle_Rear_Right. (radians)";
CM_ SG_ 73 OBJA_Angle_Rear_Right_Rate_STD_V_1 "Validator for the STD of the angular speed of Angle_Rear_Right.";
CM_ SG_ 73 OBJA_Angle_Rear_Left_Rate_1 "The momentary angular speed of Angle_Rear_Left. (radians)";
CM_ SG_ 73 OBJA_Angle_Rear_Left_Rate_V_1 "Validator for the angular speed of Angle_Rear_Left.";
CM_ SG_ 73 OBJA_Angle_Rear_Left_Rate_STD_1 "Standard deviation of the angular speed of Angle_Rear_Left. (radians)";
CM_ SG_ 73 OBJA_Angle_Rear_Left_Rate_STD_V_1 "Validator for the STD of the angular speed of Angle_Rear_Left.";
CM_ SG_ 73 OBJA_CRC_2 "Calculated over all element signals. From the signal after the CRC until the first signal in the next elements OBJA_CRC_N+1  not including";
CM_ SG_ 73 OBJA_ID_2 "Unique id";
CM_ SG_ 73 OBJA_Angle_Front_Right_2 "The angle between the host longitudinal axis and the front right side of the target. The positive side is to the host's right.";
CM_ SG_ 73 OBJA_Angle_Front_Right_V_2 "Validator for Angle_Front_Right.";
CM_ SG_ 73 OBJA_Angle_Front_Right_STD_2 "Standard deviation of Angle_Front_Right.";
CM_ SG_ 73 OBJA_Angle_Front_Right_STD_V_2 "Validator for Angle_Front_Right_STD.";
CM_ SG_ 73 OBJA_Angle_Front_Left_2 "The angle between the host longitudinal axis and the front left side of the target. The positive side is to the host's right.";
CM_ SG_ 73 OBJA_Angle_Front_Left_V_2 "Validator for Angle_Front_Left.";
CM_ SG_ 73 OBJA_Angle_Front_Left_STD_2 "Standard deviation of Angle_Front_Left.";
CM_ SG_ 73 OBJA_Angle_Front_Left_STD_V_2 "Validator for Angle_Front_Left_STD.";
CM_ SG_ 73 OBJA_Angle_Rear_Right_2 "The angle between the host longitudinal axis and the rear right side of the target. The positive side is to the host's right.";
CM_ SG_ 73 OBJA_Angle_Rear_Right_V_2 "	 Validator for Angle_Rear_Right.";
CM_ SG_ 73 OBJA_Angle_Rear_Right_STD_2 "Standard deviation of Angle_Rear_Right.";
CM_ SG_ 73 OBJA_Angle_Rear_Right_STD_V_2 "Validator for Angle_Rear_Right_STD.";
CM_ SG_ 73 OBJA_Angle_Rear_Left_2 "The angle between the host longitudinal axis and the rear left side of the target. The positive side is to the host's right.";
CM_ SG_ 73 OBJA_Angle_Rear_Left_V_2 "Validator for Angle_Rear_Left.";
CM_ SG_ 73 OBJA_Angle_Rear_Left_STD_2 "Standard deviation of Angle_Rear_Left.";
CM_ SG_ 73 OBJA_Angle_Rear_Left_STD_V_2 "Validator for Angle_Rear_Left_STD.";
CM_ SG_ 73 OBJA_Angle_Rear_Mid_2 "The angle between the host longitudinal axis and the rear middle of the target. The positive side is to the host's right.";
CM_ SG_ 73 OBJA_Angle_Rear_Mid_V_2 "Validator for Angle_Rear_Mid.";
CM_ SG_ 73 OBJA_Angle_Rear_Mid_STD_2 "Standard deviation of Angle_Rear_Mid.";
CM_ SG_ 73 OBJA_Angle_Rear_Mid_STD_V_2 "Validator for Angle_Rear_Mid_STD.";
CM_ SG_ 73 OBJA_Angle_Rear_Mid_Rate_2 "The momentary angular speed of Angle_Rear_Mid. (radians)";
CM_ SG_ 73 OBJA_Angle_Rear_Mid_Rate_V_2 "Validator for the angular speed of Angle_Rear_Mid.";
CM_ SG_ 73 OBJA_Angle_Rear_Mid_Rate_STD_2 "Standard deviation of the angular speed of Angle_Rear_Mid. (radians)";
CM_ SG_ 73 OBJA_Angle_Rear_Mid_Rate_STD_V_2 "Validator for the STD of the angular speed of Angle_Rear_Mid.";
CM_ SG_ 73 OBJA_Angle_Front_Right_Rate_2 "The momentary angular speed of Angle_Front_Right. (radians)";
CM_ SG_ 73 OBJA_Angle_Front_Right_Rate_V_2 "Validator for the angular speed of Angle_Front_Right.";
CM_ SG_ 73 OBJA_Angle_Front_Right_Rate_STD_2 "Standard deviation of the angular speed of Angle_Front_Right. (radians)";
CM_ SG_ 73 OBJA_Angle_Front_Right_Rate_STD_V_2 "Validator for the STD of the angular speed of Angle_Front_Right.";
CM_ SG_ 73 OBJA_Angle_Front_Left_Rate_2 "The momentary angular speed of Angle_Front_Left. (radians)";
CM_ SG_ 73 OBJA_Angle_Front_Left_Rate_V_2 "Validator for the angular speed of Angle_Front_Left.";
CM_ SG_ 73 OBJA_Angle_Front_Left_Rate_STD_2 "Standard deviation of the angular speed of Angle_Front_Left. (radians)";
CM_ SG_ 73 OBJA_Angle_Front_Left_Rate_STD_V_2 "Validator for the STD of the angular speed of Angle_Front_Left.";
CM_ SG_ 73 OBJA_Angle_Rear_Right_Rate_2 "The momentary angular speed of Angle_Rear_Right. (radians)";
CM_ SG_ 73 OBJA_Angle_Rear_Right_Rate_V_2 "Validator for the angular speed of Angle_Rear_Right.";
CM_ SG_ 73 OBJA_Angle_Rear_Right_Rate_STD_2 "Standard deviation of the angular speed of Angle_Rear_Right. (radians)";
CM_ SG_ 73 OBJA_Angle_Rear_Right_Rate_STD_V_2 "Validator for the STD of the angular speed of Angle_Rear_Right.";
CM_ SG_ 73 OBJA_Angle_Rear_Left_Rate_2 "The momentary angular speed of Angle_Rear_Left. (radians)";
CM_ SG_ 73 OBJA_Angle_Rear_Left_Rate_V_2 "Validator for the angular speed of Angle_Rear_Left.";
CM_ SG_ 73 OBJA_Angle_Rear_Left_Rate_STD_2 "Standard deviation of the angular speed of Angle_Rear_Left. (radians)";
CM_ SG_ 73 OBJA_Angle_Rear_Left_Rate_STD_V_2 "Validator for the STD of the angular speed of Angle_Rear_Left.";
CM_ SG_ 73 OBJA_CRC_3 "Calculated over all element signals. From the signal after the CRC until the first signal in the next elements OBJA_CRC_N+1  not including";
CM_ SG_ 73 OBJA_ID_3 "Unique id";
CM_ SG_ 73 OBJA_Angle_Front_Right_3 "The angle between the host longitudinal axis and the front right side of the target. The positive side is to the host's right.";
CM_ SG_ 73 OBJA_Angle_Front_Right_V_3 "Validator for Angle_Front_Right.";
CM_ SG_ 73 OBJA_Angle_Front_Right_STD_3 "Standard deviation of Angle_Front_Right.";
CM_ SG_ 73 OBJA_Angle_Front_Right_STD_V_3 "Validator for Angle_Front_Right_STD.";
CM_ SG_ 73 OBJA_Angle_Front_Left_3 "The angle between the host longitudinal axis and the front left side of the target. The positive side is to the host's right.";
CM_ SG_ 73 OBJA_Angle_Front_Left_V_3 "Validator for Angle_Front_Left.";
CM_ SG_ 73 OBJA_Angle_Front_Left_STD_3 "Standard deviation of Angle_Front_Left.";
CM_ SG_ 73 OBJA_Angle_Front_Left_STD_V_3 "Validator for Angle_Front_Left_STD.";
CM_ SG_ 73 OBJA_Angle_Rear_Right_3 "The angle between the host longitudinal axis and the rear right side of the target. The positive side is to the host's right.";
CM_ SG_ 73 OBJA_Angle_Rear_Right_V_3 "	 Validator for Angle_Rear_Right.";
CM_ SG_ 73 OBJA_Angle_Rear_Right_STD_3 "Standard deviation of Angle_Rear_Right.";
CM_ SG_ 73 OBJA_Angle_Rear_Right_STD_V_3 "Validator for Angle_Rear_Right_STD.";
CM_ SG_ 73 OBJA_Angle_Rear_Left_3 "The angle between the host longitudinal axis and the rear left side of the target. The positive side is to the host's right.";
CM_ SG_ 73 OBJA_Angle_Rear_Left_V_3 "Validator for Angle_Rear_Left.";
CM_ SG_ 73 OBJA_Angle_Rear_Left_STD_3 "Standard deviation of Angle_Rear_Left.";
CM_ SG_ 73 OBJA_Angle_Rear_Left_STD_V_3 "Validator for Angle_Rear_Left_STD.";
CM_ SG_ 73 OBJA_Angle_Rear_Mid_3 "The angle between the host longitudinal axis and the rear middle of the target. The positive side is to the host's right.";
CM_ SG_ 73 OBJA_Angle_Rear_Mid_V_3 "Validator for Angle_Rear_Mid.";
CM_ SG_ 73 OBJA_Angle_Rear_Mid_STD_3 "Standard deviation of Angle_Rear_Mid.";
CM_ SG_ 73 OBJA_Angle_Rear_Mid_STD_V_3 "Validator for Angle_Rear_Mid_STD.";
CM_ SG_ 73 OBJA_Angle_Rear_Mid_Rate_3 "The momentary angular speed of Angle_Rear_Mid. (radians)";
CM_ SG_ 73 OBJA_Angle_Rear_Mid_Rate_V_3 "Validator for the angular speed of Angle_Rear_Mid.";
CM_ SG_ 73 OBJA_Angle_Rear_Mid_Rate_STD_3 "Standard deviation of the angular speed of Angle_Rear_Mid. (radians)";
CM_ SG_ 73 OBJA_Angle_Rear_Mid_Rate_STD_V_3 "Validator for the STD of the angular speed of Angle_Rear_Mid.";
CM_ SG_ 73 OBJA_Angle_Front_Right_Rate_3 "The momentary angular speed of Angle_Front_Right. (radians)";
CM_ SG_ 73 OBJA_Angle_Front_Right_Rate_V_3 "Validator for the angular speed of Angle_Front_Right.";
CM_ SG_ 73 OBJA_Angle_Front_Right_Rate_STD_3 "Standard deviation of the angular speed of Angle_Front_Right. (radians)";
CM_ SG_ 73 OBJA_Angle_Front_Right_Rate_STD_V_3 "Validator for the STD of the angular speed of Angle_Front_Right.";
CM_ SG_ 73 OBJA_Angle_Front_Left_Rate_3 "The momentary angular speed of Angle_Front_Left. (radians)";
CM_ SG_ 73 OBJA_Angle_Front_Left_Rate_V_3 "Validator for the angular speed of Angle_Front_Left.";
CM_ SG_ 73 OBJA_Angle_Front_Left_Rate_STD_3 "Standard deviation of the angular speed of Angle_Front_Left. (radians)";
CM_ SG_ 73 OBJA_Angle_Front_Left_Rate_STD_V_3 "Validator for the STD of the angular speed of Angle_Front_Left.";
CM_ SG_ 73 OBJA_Angle_Rear_Right_Rate_3 "The momentary angular speed of Angle_Rear_Right. (radians)";
CM_ SG_ 73 OBJA_Angle_Rear_Right_Rate_V_3 "Validator for the angular speed of Angle_Rear_Right.";
CM_ SG_ 73 OBJA_Angle_Rear_Right_Rate_STD_3 "Standard deviation of the angular speed of Angle_Rear_Right. (radians)";
CM_ SG_ 73 OBJA_Angle_Rear_Right_Rate_STD_V_3 "Validator for the STD of the angular speed of Angle_Rear_Right.";
CM_ SG_ 73 OBJA_Angle_Rear_Left_Rate_3 "The momentary angular speed of Angle_Rear_Left. (radians)";
CM_ SG_ 73 OBJA_Angle_Rear_Left_Rate_V_3 "Validator for the angular speed of Angle_Rear_Left.";
CM_ SG_ 73 OBJA_Angle_Rear_Left_Rate_STD_3 "Standard deviation of the angular speed of Angle_Rear_Left. (radians)";
CM_ SG_ 73 OBJA_Angle_Rear_Left_Rate_STD_V_3 "Validator for the STD of the angular speed of Angle_Rear_Left.";
CM_ SG_ 73 OBJA_CRC_4 "Calculated over all element signals. From the signal after the CRC until the first signal in the next elements OBJA_CRC_N+1  not including";
CM_ SG_ 73 OBJA_ID_4 "Unique id";
CM_ SG_ 73 OBJA_Angle_Front_Right_4 "The angle between the host longitudinal axis and the front right side of the target. The positive side is to the host's right.";
CM_ SG_ 73 OBJA_Angle_Front_Right_V_4 "Validator for Angle_Front_Right.";
CM_ SG_ 73 OBJA_Angle_Front_Right_STD_4 "Standard deviation of Angle_Front_Right.";
CM_ SG_ 73 OBJA_Angle_Front_Right_STD_V_4 "Validator for Angle_Front_Right_STD.";
CM_ SG_ 73 OBJA_Angle_Front_Left_4 "The angle between the host longitudinal axis and the front left side of the target. The positive side is to the host's right.";
CM_ SG_ 73 OBJA_Angle_Front_Left_V_4 "Validator for Angle_Front_Left.";
CM_ SG_ 73 OBJA_Angle_Front_Left_STD_4 "Standard deviation of Angle_Front_Left.";
CM_ SG_ 73 OBJA_Angle_Front_Left_STD_V_4 "Validator for Angle_Front_Left_STD.";
CM_ SG_ 73 OBJA_Angle_Rear_Right_4 "The angle between the host longitudinal axis and the rear right side of the target. The positive side is to the host's right.";
CM_ SG_ 73 OBJA_Angle_Rear_Right_V_4 "	 Validator for Angle_Rear_Right.";
CM_ SG_ 73 OBJA_Angle_Rear_Right_STD_4 "Standard deviation of Angle_Rear_Right.";
CM_ SG_ 73 OBJA_Angle_Rear_Right_STD_V_4 "Validator for Angle_Rear_Right_STD.";
CM_ SG_ 73 OBJA_Angle_Rear_Left_4 "The angle between the host longitudinal axis and the rear left side of the target. The positive side is to the host's right.";
CM_ SG_ 73 OBJA_Angle_Rear_Left_V_4 "Validator for Angle_Rear_Left.";
CM_ SG_ 73 OBJA_Angle_Rear_Left_STD_4 "Standard deviation of Angle_Rear_Left.";
CM_ SG_ 73 OBJA_Angle_Rear_Left_STD_V_4 "Validator for Angle_Rear_Left_STD.";
CM_ SG_ 73 OBJA_Angle_Rear_Mid_4 "The angle between the host longitudinal axis and the rear middle of the target. The positive side is to the host's right.";
CM_ SG_ 73 OBJA_Angle_Rear_Mid_V_4 "Validator for Angle_Rear_Mid.";
CM_ SG_ 73 OBJA_Angle_Rear_Mid_STD_4 "Standard deviation of Angle_Rear_Mid.";
CM_ SG_ 73 OBJA_Angle_Rear_Mid_STD_V_4 "Validator for Angle_Rear_Mid_STD.";
CM_ SG_ 73 OBJA_Angle_Rear_Mid_Rate_4 "The momentary angular speed of Angle_Rear_Mid. (radians)";
CM_ SG_ 73 OBJA_Angle_Rear_Mid_Rate_V_4 "Validator for the angular speed of Angle_Rear_Mid.";
CM_ SG_ 73 OBJA_Angle_Rear_Mid_Rate_STD_4 "Standard deviation of the angular speed of Angle_Rear_Mid. (radians)";
CM_ SG_ 73 OBJA_Angle_Rear_Mid_Rate_STD_V_4 "Validator for the STD of the angular speed of Angle_Rear_Mid.";
CM_ SG_ 73 OBJA_Angle_Front_Right_Rate_4 "The momentary angular speed of Angle_Front_Right. (radians)";
CM_ SG_ 73 OBJA_Angle_Front_Right_Rate_V_4 "Validator for the angular speed of Angle_Front_Right.";
CM_ SG_ 73 OBJA_Angle_Front_Right_Rate_STD_4 "Standard deviation of the angular speed of Angle_Front_Right. (radians)";
CM_ SG_ 73 OBJA_Angle_Front_Right_Rate_STD_V_4 "Validator for the STD of the angular speed of Angle_Front_Right.";
CM_ SG_ 73 OBJA_Angle_Front_Left_Rate_4 "The momentary angular speed of Angle_Front_Left. (radians)";
CM_ SG_ 73 OBJA_Angle_Front_Left_Rate_V_4 "Validator for the angular speed of Angle_Front_Left.";
CM_ SG_ 73 OBJA_Angle_Front_Left_Rate_STD_4 "Standard deviation of the angular speed of Angle_Front_Left. (radians)";
CM_ SG_ 73 OBJA_Angle_Front_Left_Rate_STD_V_4 "Validator for the STD of the angular speed of Angle_Front_Left.";
CM_ SG_ 73 OBJA_Angle_Rear_Right_Rate_4 "The momentary angular speed of Angle_Rear_Right. (radians)";
CM_ SG_ 73 OBJA_Angle_Rear_Right_Rate_V_4 "Validator for the angular speed of Angle_Rear_Right.";
CM_ SG_ 73 OBJA_Angle_Rear_Right_Rate_STD_4 "Standard deviation of the angular speed of Angle_Rear_Right. (radians)";
CM_ SG_ 73 OBJA_Angle_Rear_Right_Rate_STD_V_4 "Validator for the STD of the angular speed of Angle_Rear_Right.";
CM_ SG_ 73 OBJA_Angle_Rear_Left_Rate_4 "The momentary angular speed of Angle_Rear_Left. (radians)";
CM_ SG_ 73 OBJA_Angle_Rear_Left_Rate_V_4 "Validator for the angular speed of Angle_Rear_Left.";
CM_ SG_ 73 OBJA_Angle_Rear_Left_Rate_STD_4 "Standard deviation of the angular speed of Angle_Rear_Left. (radians)";
CM_ SG_ 73 OBJA_Angle_Rear_Left_Rate_STD_V_4 "Validator for the STD of the angular speed of Angle_Rear_Left.";
CM_ SG_ 73 OBJA_CRC_5 "Calculated over all element signals. From the signal after the CRC until the first signal in the next elements OBJA_CRC_N+1  not including";
CM_ SG_ 73 OBJA_ID_5 "Unique id";
CM_ SG_ 73 OBJA_Angle_Front_Right_5 "The angle between the host longitudinal axis and the front right side of the target. The positive side is to the host's right.";
CM_ SG_ 73 OBJA_Angle_Front_Right_V_5 "Validator for Angle_Front_Right.";
CM_ SG_ 73 OBJA_Angle_Front_Right_STD_5 "Standard deviation of Angle_Front_Right.";
CM_ SG_ 73 OBJA_Angle_Front_Right_STD_V_5 "Validator for Angle_Front_Right_STD.";
CM_ SG_ 73 OBJA_Angle_Front_Left_5 "The angle between the host longitudinal axis and the front left side of the target. The positive side is to the host's right.";
CM_ SG_ 73 OBJA_Angle_Front_Left_V_5 "Validator for Angle_Front_Left.";
CM_ SG_ 73 OBJA_Angle_Front_Left_STD_5 "Standard deviation of Angle_Front_Left.";
CM_ SG_ 73 OBJA_Angle_Front_Left_STD_V_5 "Validator for Angle_Front_Left_STD.";
CM_ SG_ 73 OBJA_Angle_Rear_Right_5 "The angle between the host longitudinal axis and the rear right side of the target. The positive side is to the host's right.";
CM_ SG_ 73 OBJA_Angle_Rear_Right_V_5 "	 Validator for Angle_Rear_Right.";
CM_ SG_ 73 OBJA_Angle_Rear_Right_STD_5 "Standard deviation of Angle_Rear_Right.";
CM_ SG_ 73 OBJA_Angle_Rear_Right_STD_V_5 "Validator for Angle_Rear_Right_STD.";
CM_ SG_ 73 OBJA_Angle_Rear_Left_5 "The angle between the host longitudinal axis and the rear left side of the target. The positive side is to the host's right.";
CM_ SG_ 73 OBJA_Angle_Rear_Left_V_5 "Validator for Angle_Rear_Left.";
CM_ SG_ 73 OBJA_Angle_Rear_Left_STD_5 "Standard deviation of Angle_Rear_Left.";
CM_ SG_ 73 OBJA_Angle_Rear_Left_STD_V_5 "Validator for Angle_Rear_Left_STD.";
CM_ SG_ 73 OBJA_Angle_Rear_Mid_5 "The angle between the host longitudinal axis and the rear middle of the target. The positive side is to the host's right.";
CM_ SG_ 73 OBJA_Angle_Rear_Mid_V_5 "Validator for Angle_Rear_Mid.";
CM_ SG_ 73 OBJA_Angle_Rear_Mid_STD_5 "Standard deviation of Angle_Rear_Mid.";
CM_ SG_ 73 OBJA_Angle_Rear_Mid_STD_V_5 "Validator for Angle_Rear_Mid_STD.";
CM_ SG_ 73 OBJA_Angle_Rear_Mid_Rate_5 "The momentary angular speed of Angle_Rear_Mid. (radians)";
CM_ SG_ 73 OBJA_Angle_Rear_Mid_Rate_V_5 "Validator for the angular speed of Angle_Rear_Mid.";
CM_ SG_ 73 OBJA_Angle_Rear_Mid_Rate_STD_5 "Standard deviation of the angular speed of Angle_Rear_Mid. (radians)";
CM_ SG_ 73 OBJA_Angle_Rear_Mid_Rate_STD_V_5 "Validator for the STD of the angular speed of Angle_Rear_Mid.";
CM_ SG_ 73 OBJA_Angle_Front_Right_Rate_5 "The momentary angular speed of Angle_Front_Right. (radians)";
CM_ SG_ 73 OBJA_Angle_Front_Right_Rate_V_5 "Validator for the angular speed of Angle_Front_Right.";
CM_ SG_ 73 OBJA_Angle_Front_Right_Rate_STD_5 "Standard deviation of the angular speed of Angle_Front_Right. (radians)";
CM_ SG_ 73 OBJA_Angle_Front_Right_Rate_STD_V_5 "Validator for the STD of the angular speed of Angle_Front_Right.";
CM_ SG_ 73 OBJA_Angle_Front_Left_Rate_5 "The momentary angular speed of Angle_Front_Left. (radians)";
CM_ SG_ 73 OBJA_Angle_Front_Left_Rate_V_5 "Validator for the angular speed of Angle_Front_Left.";
CM_ SG_ 73 OBJA_Angle_Front_Left_Rate_STD_5 "Standard deviation of the angular speed of Angle_Front_Left. (radians)";
CM_ SG_ 73 OBJA_Angle_Front_Left_Rate_STD_V_5 "Validator for the STD of the angular speed of Angle_Front_Left.";
CM_ SG_ 73 OBJA_Angle_Rear_Right_Rate_5 "The momentary angular speed of Angle_Rear_Right. (radians)";
CM_ SG_ 73 OBJA_Angle_Rear_Right_Rate_V_5 "Validator for the angular speed of Angle_Rear_Right.";
CM_ SG_ 73 OBJA_Angle_Rear_Right_Rate_STD_5 "Standard deviation of the angular speed of Angle_Rear_Right. (radians)";
CM_ SG_ 73 OBJA_Angle_Rear_Right_Rate_STD_V_5 "Validator for the STD of the angular speed of Angle_Rear_Right.";
CM_ SG_ 73 OBJA_Angle_Rear_Left_Rate_5 "The momentary angular speed of Angle_Rear_Left. (radians)";
CM_ SG_ 73 OBJA_Angle_Rear_Left_Rate_V_5 "Validator for the angular speed of Angle_Rear_Left.";
CM_ SG_ 73 OBJA_Angle_Rear_Left_Rate_STD_5 "Standard deviation of the angular speed of Angle_Rear_Left. (radians)";
CM_ SG_ 73 OBJA_Angle_Rear_Left_Rate_STD_V_5 "Validator for the STD of the angular speed of Angle_Rear_Left.";
CM_ SG_ 73 OBJA_CRC_6 "Calculated over all element signals. From the signal after the CRC until the first signal in the next elements OBJA_CRC_N+1  not including";
CM_ SG_ 73 OBJA_ID_6 "Unique id";
CM_ SG_ 73 OBJA_Angle_Front_Right_6 "The angle between the host longitudinal axis and the front right side of the target. The positive side is to the host's right.";
CM_ SG_ 73 OBJA_Angle_Front_Right_V_6 "Validator for Angle_Front_Right.";
CM_ SG_ 73 OBJA_Angle_Front_Right_STD_6 "Standard deviation of Angle_Front_Right.";
CM_ SG_ 73 OBJA_Angle_Front_Right_STD_V_6 "Validator for Angle_Front_Right_STD.";
CM_ SG_ 73 OBJA_Angle_Front_Left_6 "The angle between the host longitudinal axis and the front left side of the target. The positive side is to the host's right.";
CM_ SG_ 73 OBJA_Angle_Front_Left_V_6 "Validator for Angle_Front_Left.";
CM_ SG_ 73 OBJA_Angle_Front_Left_STD_6 "Standard deviation of Angle_Front_Left.";
CM_ SG_ 73 OBJA_Angle_Front_Left_STD_V_6 "Validator for Angle_Front_Left_STD.";
CM_ SG_ 73 OBJA_Angle_Rear_Right_6 "The angle between the host longitudinal axis and the rear right side of the target. The positive side is to the host's right.";
CM_ SG_ 73 OBJA_Angle_Rear_Right_V_6 "	 Validator for Angle_Rear_Right.";
CM_ SG_ 73 OBJA_Angle_Rear_Right_STD_6 "Standard deviation of Angle_Rear_Right.";
CM_ SG_ 73 OBJA_Angle_Rear_Right_STD_V_6 "Validator for Angle_Rear_Right_STD.";
CM_ SG_ 73 OBJA_Angle_Rear_Left_6 "The angle between the host longitudinal axis and the rear left side of the target. The positive side is to the host's right.";
CM_ SG_ 73 OBJA_Angle_Rear_Left_V_6 "Validator for Angle_Rear_Left.";
CM_ SG_ 73 OBJA_Angle_Rear_Left_STD_6 "Standard deviation of Angle_Rear_Left.";
CM_ SG_ 73 OBJA_Angle_Rear_Left_STD_V_6 "Validator for Angle_Rear_Left_STD.";
CM_ SG_ 73 OBJA_Angle_Rear_Mid_6 "The angle between the host longitudinal axis and the rear middle of the target. The positive side is to the host's right.";
CM_ SG_ 73 OBJA_Angle_Rear_Mid_V_6 "Validator for Angle_Rear_Mid.";
CM_ SG_ 73 OBJA_Angle_Rear_Mid_STD_6 "Standard deviation of Angle_Rear_Mid.";
CM_ SG_ 73 OBJA_Angle_Rear_Mid_STD_V_6 "Validator for Angle_Rear_Mid_STD.";
CM_ SG_ 73 OBJA_Angle_Rear_Mid_Rate_6 "The momentary angular speed of Angle_Rear_Mid. (radians)";
CM_ SG_ 73 OBJA_Angle_Rear_Mid_Rate_V_6 "Validator for the angular speed of Angle_Rear_Mid.";
CM_ SG_ 73 OBJA_Angle_Rear_Mid_Rate_STD_6 "Standard deviation of the angular speed of Angle_Rear_Mid. (radians)";
CM_ SG_ 73 OBJA_Angle_Rear_Mid_Rate_STD_V_6 "Validator for the STD of the angular speed of Angle_Rear_Mid.";
CM_ SG_ 73 OBJA_Angle_Front_Right_Rate_6 "The momentary angular speed of Angle_Front_Right. (radians)";
CM_ SG_ 73 OBJA_Angle_Front_Right_Rate_V_6 "Validator for the angular speed of Angle_Front_Right.";
CM_ SG_ 73 OBJA_Angle_Front_Right_Rate_STD_6 "Standard deviation of the angular speed of Angle_Front_Right. (radians)";
CM_ SG_ 73 OBJA_Angle_Front_Right_Rate_STD_V_6 "Validator for the STD of the angular speed of Angle_Front_Right.";
CM_ SG_ 73 OBJA_Angle_Front_Left_Rate_6 "The momentary angular speed of Angle_Front_Left. (radians)";
CM_ SG_ 73 OBJA_Angle_Front_Left_Rate_V_6 "Validator for the angular speed of Angle_Front_Left.";
CM_ SG_ 73 OBJA_Angle_Front_Left_Rate_STD_6 "Standard deviation of the angular speed of Angle_Front_Left. (radians)";
CM_ SG_ 73 OBJA_Angle_Front_Left_Rate_STD_V_6 "Validator for the STD of the angular speed of Angle_Front_Left.";
CM_ SG_ 73 OBJA_Angle_Rear_Right_Rate_6 "The momentary angular speed of Angle_Rear_Right. (radians)";
CM_ SG_ 73 OBJA_Angle_Rear_Right_Rate_V_6 "Validator for the angular speed of Angle_Rear_Right.";
CM_ SG_ 73 OBJA_Angle_Rear_Right_Rate_STD_6 "Standard deviation of the angular speed of Angle_Rear_Right. (radians)";
CM_ SG_ 73 OBJA_Angle_Rear_Right_Rate_STD_V_6 "Validator for the STD of the angular speed of Angle_Rear_Right.";
CM_ SG_ 73 OBJA_Angle_Rear_Left_Rate_6 "The momentary angular speed of Angle_Rear_Left. (radians)";
CM_ SG_ 73 OBJA_Angle_Rear_Left_Rate_V_6 "Validator for the angular speed of Angle_Rear_Left.";
CM_ SG_ 73 OBJA_Angle_Rear_Left_Rate_STD_6 "Standard deviation of the angular speed of Angle_Rear_Left. (radians)";
CM_ SG_ 73 OBJA_Angle_Rear_Left_Rate_STD_V_6 "Validator for the STD of the angular speed of Angle_Rear_Left.";
CM_ SG_ 73 OBJA_CRC_7 "Calculated over all element signals. From the signal after the CRC until the first signal in the next elements OBJA_CRC_N+1  not including";
CM_ SG_ 73 OBJA_ID_7 "Unique id";
CM_ SG_ 73 OBJA_Angle_Front_Right_7 "The angle between the host longitudinal axis and the front right side of the target. The positive side is to the host's right.";
CM_ SG_ 73 OBJA_Angle_Front_Right_V_7 "Validator for Angle_Front_Right.";
CM_ SG_ 73 OBJA_Angle_Front_Right_STD_7 "Standard deviation of Angle_Front_Right.";
CM_ SG_ 73 OBJA_Angle_Front_Right_STD_V_7 "Validator for Angle_Front_Right_STD.";
CM_ SG_ 73 OBJA_Angle_Front_Left_7 "The angle between the host longitudinal axis and the front left side of the target. The positive side is to the host's right.";
CM_ SG_ 73 OBJA_Angle_Front_Left_V_7 "Validator for Angle_Front_Left.";
CM_ SG_ 73 OBJA_Angle_Front_Left_STD_7 "Standard deviation of Angle_Front_Left.";
CM_ SG_ 73 OBJA_Angle_Front_Left_STD_V_7 "Validator for Angle_Front_Left_STD.";
CM_ SG_ 73 OBJA_Angle_Rear_Right_7 "The angle between the host longitudinal axis and the rear right side of the target. The positive side is to the host's right.";
CM_ SG_ 73 OBJA_Angle_Rear_Right_V_7 "	 Validator for Angle_Rear_Right.";
CM_ SG_ 73 OBJA_Angle_Rear_Right_STD_7 "Standard deviation of Angle_Rear_Right.";
CM_ SG_ 73 OBJA_Angle_Rear_Right_STD_V_7 "Validator for Angle_Rear_Right_STD.";
CM_ SG_ 73 OBJA_Angle_Rear_Left_7 "The angle between the host longitudinal axis and the rear left side of the target. The positive side is to the host's right.";
CM_ SG_ 73 OBJA_Angle_Rear_Left_V_7 "Validator for Angle_Rear_Left.";
CM_ SG_ 73 OBJA_Angle_Rear_Left_STD_7 "Standard deviation of Angle_Rear_Left.";
CM_ SG_ 73 OBJA_Angle_Rear_Left_STD_V_7 "Validator for Angle_Rear_Left_STD.";
CM_ SG_ 73 OBJA_Angle_Rear_Mid_7 "The angle between the host longitudinal axis and the rear middle of the target. The positive side is to the host's right.";
CM_ SG_ 73 OBJA_Angle_Rear_Mid_V_7 "Validator for Angle_Rear_Mid.";
CM_ SG_ 73 OBJA_Angle_Rear_Mid_STD_7 "Standard deviation of Angle_Rear_Mid.";
CM_ SG_ 73 OBJA_Angle_Rear_Mid_STD_V_7 "Validator for Angle_Rear_Mid_STD.";
CM_ SG_ 73 OBJA_Angle_Rear_Mid_Rate_7 "The momentary angular speed of Angle_Rear_Mid. (radians)";
CM_ SG_ 73 OBJA_Angle_Rear_Mid_Rate_V_7 "Validator for the angular speed of Angle_Rear_Mid.";
CM_ SG_ 73 OBJA_Angle_Rear_Mid_Rate_STD_7 "Standard deviation of the angular speed of Angle_Rear_Mid. (radians)";
CM_ SG_ 73 OBJA_Angle_Rear_Mid_Rate_STD_V_7 "Validator for the STD of the angular speed of Angle_Rear_Mid.";
CM_ SG_ 73 OBJA_Angle_Front_Right_Rate_7 "The momentary angular speed of Angle_Front_Right. (radians)";
CM_ SG_ 73 OBJA_Angle_Front_Right_Rate_V_7 "Validator for the angular speed of Angle_Front_Right.";
CM_ SG_ 73 OBJA_Angle_Front_Right_Rate_STD_7 "Standard deviation of the angular speed of Angle_Front_Right. (radians)";
CM_ SG_ 73 OBJA_Angle_Front_Right_Rate_STD_V_7 "Validator for the STD of the angular speed of Angle_Front_Right.";
CM_ SG_ 73 OBJA_Angle_Front_Left_Rate_7 "The momentary angular speed of Angle_Front_Left. (radians)";
CM_ SG_ 73 OBJA_Angle_Front_Left_Rate_V_7 "Validator for the angular speed of Angle_Front_Left.";
CM_ SG_ 73 OBJA_Angle_Front_Left_Rate_STD_7 "Standard deviation of the angular speed of Angle_Front_Left. (radians)";
CM_ SG_ 73 OBJA_Angle_Front_Left_Rate_STD_V_7 "Validator for the STD of the angular speed of Angle_Front_Left.";
CM_ SG_ 73 OBJA_Angle_Rear_Right_Rate_7 "The momentary angular speed of Angle_Rear_Right. (radians)";
CM_ SG_ 73 OBJA_Angle_Rear_Right_Rate_V_7 "Validator for the angular speed of Angle_Rear_Right.";
CM_ SG_ 73 OBJA_Angle_Rear_Right_Rate_STD_7 "Standard deviation of the angular speed of Angle_Rear_Right. (radians)";
CM_ SG_ 73 OBJA_Angle_Rear_Right_Rate_STD_V_7 "Validator for the STD of the angular speed of Angle_Rear_Right.";
CM_ SG_ 73 OBJA_Angle_Rear_Left_Rate_7 "The momentary angular speed of Angle_Rear_Left. (radians)";
CM_ SG_ 73 OBJA_Angle_Rear_Left_Rate_V_7 "Validator for the angular speed of Angle_Rear_Left.";
CM_ SG_ 73 OBJA_Angle_Rear_Left_Rate_STD_7 "Standard deviation of the angular speed of Angle_Rear_Left. (radians)";
CM_ SG_ 73 OBJA_Angle_Rear_Left_Rate_STD_V_7 "Validator for the STD of the angular speed of Angle_Rear_Left.";
CM_ SG_ 73 OBJA_CRC_8 "Calculated over all element signals. From the signal after the CRC until the first signal in the next elements OBJA_CRC_N+1  not including";
CM_ SG_ 73 OBJA_ID_8 "Unique id";
CM_ SG_ 73 OBJA_Angle_Front_Right_8 "The angle between the host longitudinal axis and the front right side of the target. The positive side is to the host's right.";
CM_ SG_ 73 OBJA_Angle_Front_Right_V_8 "Validator for Angle_Front_Right.";
CM_ SG_ 73 OBJA_Angle_Front_Right_STD_8 "Standard deviation of Angle_Front_Right.";
CM_ SG_ 73 OBJA_Angle_Front_Right_STD_V_8 "Validator for Angle_Front_Right_STD.";
CM_ SG_ 73 OBJA_Angle_Front_Left_8 "The angle between the host longitudinal axis and the front left side of the target. The positive side is to the host's right.";
CM_ SG_ 73 OBJA_Angle_Front_Left_V_8 "Validator for Angle_Front_Left.";
CM_ SG_ 73 OBJA_Angle_Front_Left_STD_8 "Standard deviation of Angle_Front_Left.";
CM_ SG_ 73 OBJA_Angle_Front_Left_STD_V_8 "Validator for Angle_Front_Left_STD.";
CM_ SG_ 73 OBJA_Angle_Rear_Right_8 "The angle between the host longitudinal axis and the rear right side of the target. The positive side is to the host's right.";
CM_ SG_ 73 OBJA_Angle_Rear_Right_V_8 "	 Validator for Angle_Rear_Right.";
CM_ SG_ 73 OBJA_Angle_Rear_Right_STD_8 "Standard deviation of Angle_Rear_Right.";
CM_ SG_ 73 OBJA_Angle_Rear_Right_STD_V_8 "Validator for Angle_Rear_Right_STD.";
CM_ SG_ 73 OBJA_Angle_Rear_Left_8 "The angle between the host longitudinal axis and the rear left side of the target. The positive side is to the host's right.";
CM_ SG_ 73 OBJA_Angle_Rear_Left_V_8 "Validator for Angle_Rear_Left.";
CM_ SG_ 73 OBJA_Angle_Rear_Left_STD_8 "Standard deviation of Angle_Rear_Left.";
CM_ SG_ 73 OBJA_Angle_Rear_Left_STD_V_8 "Validator for Angle_Rear_Left_STD.";
CM_ SG_ 73 OBJA_Angle_Rear_Mid_8 "The angle between the host longitudinal axis and the rear middle of the target. The positive side is to the host's right.";
CM_ SG_ 73 OBJA_Angle_Rear_Mid_V_8 "Validator for Angle_Rear_Mid.";
CM_ SG_ 73 OBJA_Angle_Rear_Mid_STD_8 "Standard deviation of Angle_Rear_Mid.";
CM_ SG_ 73 OBJA_Angle_Rear_Mid_STD_V_8 "Validator for Angle_Rear_Mid_STD.";
CM_ SG_ 73 OBJA_Angle_Rear_Mid_Rate_8 "The momentary angular speed of Angle_Rear_Mid. (radians)";
CM_ SG_ 73 OBJA_Angle_Rear_Mid_Rate_V_8 "Validator for the angular speed of Angle_Rear_Mid.";
CM_ SG_ 73 OBJA_Angle_Rear_Mid_Rate_STD_8 "Standard deviation of the angular speed of Angle_Rear_Mid. (radians)";
CM_ SG_ 73 OBJA_Angle_Rear_Mid_Rate_STD_V_8 "Validator for the STD of the angular speed of Angle_Rear_Mid.";
CM_ SG_ 73 OBJA_Angle_Front_Right_Rate_8 "The momentary angular speed of Angle_Front_Right. (radians)";
CM_ SG_ 73 OBJA_Angle_Front_Right_Rate_V_8 "Validator for the angular speed of Angle_Front_Right.";
CM_ SG_ 73 OBJA_Angle_Front_Right_Rate_STD_8 "Standard deviation of the angular speed of Angle_Front_Right. (radians)";
CM_ SG_ 73 OBJA_Angle_Front_Right_Rate_STD_V_8 "Validator for the STD of the angular speed of Angle_Front_Right.";
CM_ SG_ 73 OBJA_Angle_Front_Left_Rate_8 "The momentary angular speed of Angle_Front_Left. (radians)";
CM_ SG_ 73 OBJA_Angle_Front_Left_Rate_V_8 "Validator for the angular speed of Angle_Front_Left.";
CM_ SG_ 73 OBJA_Angle_Front_Left_Rate_STD_8 "Standard deviation of the angular speed of Angle_Front_Left. (radians)";
CM_ SG_ 73 OBJA_Angle_Front_Left_Rate_STD_V_8 "Validator for the STD of the angular speed of Angle_Front_Left.";
CM_ SG_ 73 OBJA_Angle_Rear_Right_Rate_8 "The momentary angular speed of Angle_Rear_Right. (radians)";
CM_ SG_ 73 OBJA_Angle_Rear_Right_Rate_V_8 "Validator for the angular speed of Angle_Rear_Right.";
CM_ SG_ 73 OBJA_Angle_Rear_Right_Rate_STD_8 "Standard deviation of the angular speed of Angle_Rear_Right. (radians)";
CM_ SG_ 73 OBJA_Angle_Rear_Right_Rate_STD_V_8 "Validator for the STD of the angular speed of Angle_Rear_Right.";
CM_ SG_ 73 OBJA_Angle_Rear_Left_Rate_8 "The momentary angular speed of Angle_Rear_Left. (radians)";
CM_ SG_ 73 OBJA_Angle_Rear_Left_Rate_V_8 "Validator for the angular speed of Angle_Rear_Left.";
CM_ SG_ 73 OBJA_Angle_Rear_Left_Rate_STD_8 "Standard deviation of the angular speed of Angle_Rear_Left. (radians)";
CM_ SG_ 73 OBJA_Angle_Rear_Left_Rate_STD_V_8 "Validator for the STD of the angular speed of Angle_Rear_Left.";
CM_ SG_ 73 OBJA_CRC_9 "Calculated over all element signals. From the signal after the CRC until the first signal in the next elements OBJA_CRC_N+1  not including";
CM_ SG_ 73 OBJA_ID_9 "Unique id";
CM_ SG_ 73 OBJA_Angle_Front_Right_9 "The angle between the host longitudinal axis and the front right side of the target. The positive side is to the host's right.";
CM_ SG_ 73 OBJA_Angle_Front_Right_V_9 "Validator for Angle_Front_Right.";
CM_ SG_ 73 OBJA_Angle_Front_Right_STD_9 "Standard deviation of Angle_Front_Right.";
CM_ SG_ 73 OBJA_Angle_Front_Right_STD_V_9 "Validator for Angle_Front_Right_STD.";
CM_ SG_ 73 OBJA_Angle_Front_Left_9 "The angle between the host longitudinal axis and the front left side of the target. The positive side is to the host's right.";
CM_ SG_ 73 OBJA_Angle_Front_Left_V_9 "Validator for Angle_Front_Left.";
CM_ SG_ 73 OBJA_Angle_Front_Left_STD_9 "Standard deviation of Angle_Front_Left.";
CM_ SG_ 73 OBJA_Angle_Front_Left_STD_V_9 "Validator for Angle_Front_Left_STD.";
CM_ SG_ 73 OBJA_Angle_Rear_Right_9 "The angle between the host longitudinal axis and the rear right side of the target. The positive side is to the host's right.";
CM_ SG_ 73 OBJA_Angle_Rear_Right_V_9 "	 Validator for Angle_Rear_Right.";
CM_ SG_ 73 OBJA_Angle_Rear_Right_STD_9 "Standard deviation of Angle_Rear_Right.";
CM_ SG_ 73 OBJA_Angle_Rear_Right_STD_V_9 "Validator for Angle_Rear_Right_STD.";
CM_ SG_ 73 OBJA_Angle_Rear_Left_9 "The angle between the host longitudinal axis and the rear left side of the target. The positive side is to the host's right.";
CM_ SG_ 73 OBJA_Angle_Rear_Left_V_9 "Validator for Angle_Rear_Left.";
CM_ SG_ 73 OBJA_Angle_Rear_Left_STD_9 "Standard deviation of Angle_Rear_Left.";
CM_ SG_ 73 OBJA_Angle_Rear_Left_STD_V_9 "Validator for Angle_Rear_Left_STD.";
CM_ SG_ 73 OBJA_Angle_Rear_Mid_9 "The angle between the host longitudinal axis and the rear middle of the target. The positive side is to the host's right.";
CM_ SG_ 73 OBJA_Angle_Rear_Mid_V_9 "Validator for Angle_Rear_Mid.";
CM_ SG_ 73 OBJA_Angle_Rear_Mid_STD_9 "Standard deviation of Angle_Rear_Mid.";
CM_ SG_ 73 OBJA_Angle_Rear_Mid_STD_V_9 "Validator for Angle_Rear_Mid_STD.";
CM_ SG_ 73 OBJA_Angle_Rear_Mid_Rate_9 "The momentary angular speed of Angle_Rear_Mid. (radians)";
CM_ SG_ 73 OBJA_Angle_Rear_Mid_Rate_V_9 "Validator for the angular speed of Angle_Rear_Mid.";
CM_ SG_ 73 OBJA_Angle_Rear_Mid_Rate_STD_9 "Standard deviation of the angular speed of Angle_Rear_Mid. (radians)";
CM_ SG_ 73 OBJA_Angle_Rear_Mid_Rate_STD_V_9 "Validator for the STD of the angular speed of Angle_Rear_Mid.";
CM_ SG_ 73 OBJA_Angle_Front_Right_Rate_9 "The momentary angular speed of Angle_Front_Right. (radians)";
CM_ SG_ 73 OBJA_Angle_Front_Right_Rate_V_9 "Validator for the angular speed of Angle_Front_Right.";
CM_ SG_ 73 OBJA_Angle_Front_Right_Rate_STD_9 "Standard deviation of the angular speed of Angle_Front_Right. (radians)";
CM_ SG_ 73 OBJA_Angle_Front_Right_Rate_STD_V_9 "Validator for the STD of the angular speed of Angle_Front_Right.";
CM_ SG_ 73 OBJA_Angle_Front_Left_Rate_9 "The momentary angular speed of Angle_Front_Left. (radians)";
CM_ SG_ 73 OBJA_Angle_Front_Left_Rate_V_9 "Validator for the angular speed of Angle_Front_Left.";
CM_ SG_ 73 OBJA_Angle_Front_Left_Rate_STD_9 "Standard deviation of the angular speed of Angle_Front_Left. (radians)";
CM_ SG_ 73 OBJA_Angle_Front_Left_Rate_STD_V_9 "Validator for the STD of the angular speed of Angle_Front_Left.";
CM_ SG_ 73 OBJA_Angle_Rear_Right_Rate_9 "The momentary angular speed of Angle_Rear_Right. (radians)";
CM_ SG_ 73 OBJA_Angle_Rear_Right_Rate_V_9 "Validator for the angular speed of Angle_Rear_Right.";
CM_ SG_ 73 OBJA_Angle_Rear_Right_Rate_STD_9 "Standard deviation of the angular speed of Angle_Rear_Right. (radians)";
CM_ SG_ 73 OBJA_Angle_Rear_Right_Rate_STD_V_9 "Validator for the STD of the angular speed of Angle_Rear_Right.";
CM_ SG_ 73 OBJA_Angle_Rear_Left_Rate_9 "The momentary angular speed of Angle_Rear_Left. (radians)";
CM_ SG_ 73 OBJA_Angle_Rear_Left_Rate_V_9 "Validator for the angular speed of Angle_Rear_Left.";
CM_ SG_ 73 OBJA_Angle_Rear_Left_Rate_STD_9 "Standard deviation of the angular speed of Angle_Rear_Left. (radians)";
CM_ SG_ 73 OBJA_Angle_Rear_Left_Rate_STD_V_9 "Validator for the STD of the angular speed of Angle_Rear_Left.";
CM_ SG_ 73 OBJA_CRC_10 "Calculated over all element signals. From the signal after the CRC until the first signal in the next elements OBJA_CRC_N+1  not including";
CM_ SG_ 73 OBJA_ID_10 "Unique id";
CM_ SG_ 73 OBJA_Angle_Front_Right_10 "The angle between the host longitudinal axis and the front right side of the target. The positive side is to the host's right.";
CM_ SG_ 73 OBJA_Angle_Front_Right_V_10 "Validator for Angle_Front_Right.";
CM_ SG_ 73 OBJA_Angle_Front_Right_STD_10 "Standard deviation of Angle_Front_Right.";
CM_ SG_ 73 OBJA_Angle_Front_Right_STD_V_10 "Validator for Angle_Front_Right_STD.";
CM_ SG_ 73 OBJA_Angle_Front_Left_10 "The angle between the host longitudinal axis and the front left side of the target. The positive side is to the host's right.";
CM_ SG_ 73 OBJA_Angle_Front_Left_V_10 "Validator for Angle_Front_Left.";
CM_ SG_ 73 OBJA_Angle_Front_Left_STD_10 "Standard deviation of Angle_Front_Left.";
CM_ SG_ 73 OBJA_Angle_Front_Left_STD_V_10 "Validator for Angle_Front_Left_STD.";
CM_ SG_ 73 OBJA_Angle_Rear_Right_10 "The angle between the host longitudinal axis and the rear right side of the target. The positive side is to the host's right.";
CM_ SG_ 73 OBJA_Angle_Rear_Right_V_10 "	 Validator for Angle_Rear_Right.";
CM_ SG_ 73 OBJA_Angle_Rear_Right_STD_10 "Standard deviation of Angle_Rear_Right.";
CM_ SG_ 73 OBJA_Angle_Rear_Right_STD_V_10 "Validator for Angle_Rear_Right_STD.";
CM_ SG_ 73 OBJA_Angle_Rear_Left_10 "The angle between the host longitudinal axis and the rear left side of the target. The positive side is to the host's right.";
CM_ SG_ 73 OBJA_Angle_Rear_Left_V_10 "Validator for Angle_Rear_Left.";
CM_ SG_ 73 OBJA_Angle_Rear_Left_STD_10 "Standard deviation of Angle_Rear_Left.";
CM_ SG_ 73 OBJA_Angle_Rear_Left_STD_V_10 "Validator for Angle_Rear_Left_STD.";
CM_ SG_ 73 OBJA_Angle_Rear_Mid_10 "The angle between the host longitudinal axis and the rear middle of the target. The positive side is to the host's right.";
CM_ SG_ 73 OBJA_Angle_Rear_Mid_V_10 "Validator for Angle_Rear_Mid.";
CM_ SG_ 73 OBJA_Angle_Rear_Mid_STD_10 "Standard deviation of Angle_Rear_Mid.";
CM_ SG_ 73 OBJA_Angle_Rear_Mid_STD_V_10 "Validator for Angle_Rear_Mid_STD.";
CM_ SG_ 73 OBJA_Angle_Rear_Mid_Rate_10 "The momentary angular speed of Angle_Rear_Mid. (radians)";
CM_ SG_ 73 OBJA_Angle_Rear_Mid_Rate_V_10 "Validator for the angular speed of Angle_Rear_Mid.";
CM_ SG_ 73 OBJA_Angle_Rear_Mid_Rate_STD_10 "Standard deviation of the angular speed of Angle_Rear_Mid. (radians)";
CM_ SG_ 73 OBJA_Angle_Rear_Mid_Rate_STD_V_10 "Validator for the STD of the angular speed of Angle_Rear_Mid.";
CM_ SG_ 73 OBJA_Angle_Front_Right_Rate_10 "The momentary angular speed of Angle_Front_Right. (radians)";
CM_ SG_ 73 OBJA_Angle_Front_Right_Rate_V_10 "Validator for the angular speed of Angle_Front_Right.";
CM_ SG_ 73 OBJA_Angle_Front_Right_Rate_STD_10 "Standard deviation of the angular speed of Angle_Front_Right. (radians)";
CM_ SG_ 73 OBJA_Angle_Front_Right_Rate_STD_V_10 "Validator for the STD of the angular speed of Angle_Front_Right.";
CM_ SG_ 73 OBJA_Angle_Front_Left_Rate_10 "The momentary angular speed of Angle_Front_Left. (radians)";
CM_ SG_ 73 OBJA_Angle_Front_Left_Rate_V_10 "Validator for the angular speed of Angle_Front_Left.";
CM_ SG_ 73 OBJA_Angle_Front_Left_Rate_STD_10 "Standard deviation of the angular speed of Angle_Front_Left. (radians)";
CM_ SG_ 73 OBJA_Angle_Front_Left_Rate_STD_V_10 "Validator for the STD of the angular speed of Angle_Front_Left.";
CM_ SG_ 73 OBJA_Angle_Rear_Right_Rate_10 "The momentary angular speed of Angle_Rear_Right. (radians)";
CM_ SG_ 73 OBJA_Angle_Rear_Right_Rate_V_10 "Validator for the angular speed of Angle_Rear_Right.";
CM_ SG_ 73 OBJA_Angle_Rear_Right_Rate_STD_10 "Standard deviation of the angular speed of Angle_Rear_Right. (radians)";
CM_ SG_ 73 OBJA_Angle_Rear_Right_Rate_STD_V_10 "Validator for the STD of the angular speed of Angle_Rear_Right.";
CM_ SG_ 73 OBJA_Angle_Rear_Left_Rate_10 "The momentary angular speed of Angle_Rear_Left. (radians)";
CM_ SG_ 73 OBJA_Angle_Rear_Left_Rate_V_10 "Validator for the angular speed of Angle_Rear_Left.";
CM_ SG_ 73 OBJA_Angle_Rear_Left_Rate_STD_10 "Standard deviation of the angular speed of Angle_Rear_Left. (radians)";
CM_ SG_ 73 OBJA_Angle_Rear_Left_Rate_STD_V_10 "Validator for the STD of the angular speed of Angle_Rear_Left.";
CM_ SG_ 73 OBJA_CRC_11 "Calculated over all element signals. From the signal after the CRC until the first signal in the next elements OBJA_CRC_N+1  not including";
CM_ SG_ 73 OBJA_ID_11 "Unique id";
CM_ SG_ 73 OBJA_Angle_Front_Right_11 "The angle between the host longitudinal axis and the front right side of the target. The positive side is to the host's right.";
CM_ SG_ 73 OBJA_Angle_Front_Right_V_11 "Validator for Angle_Front_Right.";
CM_ SG_ 73 OBJA_Angle_Front_Right_STD_11 "Standard deviation of Angle_Front_Right.";
CM_ SG_ 73 OBJA_Angle_Front_Right_STD_V_11 "Validator for Angle_Front_Right_STD.";
CM_ SG_ 73 OBJA_Angle_Front_Left_11 "The angle between the host longitudinal axis and the front left side of the target. The positive side is to the host's right.";
CM_ SG_ 73 OBJA_Angle_Front_Left_V_11 "Validator for Angle_Front_Left.";
CM_ SG_ 73 OBJA_Angle_Front_Left_STD_11 "Standard deviation of Angle_Front_Left.";
CM_ SG_ 73 OBJA_Angle_Front_Left_STD_V_11 "Validator for Angle_Front_Left_STD.";
CM_ SG_ 73 OBJA_Angle_Rear_Right_11 "The angle between the host longitudinal axis and the rear right side of the target. The positive side is to the host's right.";
CM_ SG_ 73 OBJA_Angle_Rear_Right_V_11 "	 Validator for Angle_Rear_Right.";
CM_ SG_ 73 OBJA_Angle_Rear_Right_STD_11 "Standard deviation of Angle_Rear_Right.";
CM_ SG_ 73 OBJA_Angle_Rear_Right_STD_V_11 "Validator for Angle_Rear_Right_STD.";
CM_ SG_ 73 OBJA_Angle_Rear_Left_11 "The angle between the host longitudinal axis and the rear left side of the target. The positive side is to the host's right.";
CM_ SG_ 73 OBJA_Angle_Rear_Left_V_11 "Validator for Angle_Rear_Left.";
CM_ SG_ 73 OBJA_Angle_Rear_Left_STD_11 "Standard deviation of Angle_Rear_Left.";
CM_ SG_ 73 OBJA_Angle_Rear_Left_STD_V_11 "Validator for Angle_Rear_Left_STD.";
CM_ SG_ 73 OBJA_Angle_Rear_Mid_11 "The angle between the host longitudinal axis and the rear middle of the target. The positive side is to the host's right.";
CM_ SG_ 73 OBJA_Angle_Rear_Mid_V_11 "Validator for Angle_Rear_Mid.";
CM_ SG_ 73 OBJA_Angle_Rear_Mid_STD_11 "Standard deviation of Angle_Rear_Mid.";
CM_ SG_ 73 OBJA_Angle_Rear_Mid_STD_V_11 "Validator for Angle_Rear_Mid_STD.";
CM_ SG_ 73 OBJA_Angle_Rear_Mid_Rate_11 "The momentary angular speed of Angle_Rear_Mid. (radians)";
CM_ SG_ 73 OBJA_Angle_Rear_Mid_Rate_V_11 "Validator for the angular speed of Angle_Rear_Mid.";
CM_ SG_ 73 OBJA_Angle_Rear_Mid_Rate_STD_11 "Standard deviation of the angular speed of Angle_Rear_Mid. (radians)";
CM_ SG_ 73 OBJA_Angle_Rear_Mid_Rate_STD_V_11 "Validator for the STD of the angular speed of Angle_Rear_Mid.";
CM_ SG_ 73 OBJA_Angle_Front_Right_Rate_11 "The momentary angular speed of Angle_Front_Right. (radians)";
CM_ SG_ 73 OBJA_Angle_Front_Right_Rate_V_11 "Validator for the angular speed of Angle_Front_Right.";
CM_ SG_ 73 OBJA_Angle_Front_Right_Rate_STD_11 "Standard deviation of the angular speed of Angle_Front_Right. (radians)";
CM_ SG_ 73 OBJA_Angle_Front_Right_Rate_STD_V_11 "Validator for the STD of the angular speed of Angle_Front_Right.";
CM_ SG_ 73 OBJA_Angle_Front_Left_Rate_11 "The momentary angular speed of Angle_Front_Left. (radians)";
CM_ SG_ 73 OBJA_Angle_Front_Left_Rate_V_11 "Validator for the angular speed of Angle_Front_Left.";
CM_ SG_ 73 OBJA_Angle_Front_Left_Rate_STD_11 "Standard deviation of the angular speed of Angle_Front_Left. (radians)";
CM_ SG_ 73 OBJA_Angle_Front_Left_Rate_STD_V_11 "Validator for the STD of the angular speed of Angle_Front_Left.";
CM_ SG_ 73 OBJA_Angle_Rear_Right_Rate_11 "The momentary angular speed of Angle_Rear_Right. (radians)";
CM_ SG_ 73 OBJA_Angle_Rear_Right_Rate_V_11 "Validator for the angular speed of Angle_Rear_Right.";
CM_ SG_ 73 OBJA_Angle_Rear_Right_Rate_STD_11 "Standard deviation of the angular speed of Angle_Rear_Right. (radians)";
CM_ SG_ 73 OBJA_Angle_Rear_Right_Rate_STD_V_11 "Validator for the STD of the angular speed of Angle_Rear_Right.";
CM_ SG_ 73 OBJA_Angle_Rear_Left_Rate_11 "The momentary angular speed of Angle_Rear_Left. (radians)";
CM_ SG_ 73 OBJA_Angle_Rear_Left_Rate_V_11 "Validator for the angular speed of Angle_Rear_Left.";
CM_ SG_ 73 OBJA_Angle_Rear_Left_Rate_STD_11 "Standard deviation of the angular speed of Angle_Rear_Left. (radians)";
CM_ SG_ 73 OBJA_Angle_Rear_Left_Rate_STD_V_11 "Validator for the STD of the angular speed of Angle_Rear_Left.";
CM_ SG_ 73 OBJA_CRC_12 "Calculated over all element signals. From the signal after the CRC until the first signal in the next elements OBJA_CRC_N+1  not including";
CM_ SG_ 73 OBJA_ID_12 "Unique id";
CM_ SG_ 73 OBJA_Angle_Front_Right_12 "The angle between the host longitudinal axis and the front right side of the target. The positive side is to the host's right.";
CM_ SG_ 73 OBJA_Angle_Front_Right_V_12 "Validator for Angle_Front_Right.";
CM_ SG_ 73 OBJA_Angle_Front_Right_STD_12 "Standard deviation of Angle_Front_Right.";
CM_ SG_ 73 OBJA_Angle_Front_Right_STD_V_12 "Validator for Angle_Front_Right_STD.";
CM_ SG_ 73 OBJA_Angle_Front_Left_12 "The angle between the host longitudinal axis and the front left side of the target. The positive side is to the host's right.";
CM_ SG_ 73 OBJA_Angle_Front_Left_V_12 "Validator for Angle_Front_Left.";
CM_ SG_ 73 OBJA_Angle_Front_Left_STD_12 "Standard deviation of Angle_Front_Left.";
CM_ SG_ 73 OBJA_Angle_Front_Left_STD_V_12 "Validator for Angle_Front_Left_STD.";
CM_ SG_ 73 OBJA_Angle_Rear_Right_12 "The angle between the host longitudinal axis and the rear right side of the target. The positive side is to the host's right.";
CM_ SG_ 73 OBJA_Angle_Rear_Right_V_12 "	 Validator for Angle_Rear_Right.";
CM_ SG_ 73 OBJA_Angle_Rear_Right_STD_12 "Standard deviation of Angle_Rear_Right.";
CM_ SG_ 73 OBJA_Angle_Rear_Right_STD_V_12 "Validator for Angle_Rear_Right_STD.";
CM_ SG_ 73 OBJA_Angle_Rear_Left_12 "The angle between the host longitudinal axis and the rear left side of the target. The positive side is to the host's right.";
CM_ SG_ 73 OBJA_Angle_Rear_Left_V_12 "Validator for Angle_Rear_Left.";
CM_ SG_ 73 OBJA_Angle_Rear_Left_STD_12 "Standard deviation of Angle_Rear_Left.";
CM_ SG_ 73 OBJA_Angle_Rear_Left_STD_V_12 "Validator for Angle_Rear_Left_STD.";
CM_ SG_ 73 OBJA_Angle_Rear_Mid_12 "The angle between the host longitudinal axis and the rear middle of the target. The positive side is to the host's right.";
CM_ SG_ 73 OBJA_Angle_Rear_Mid_V_12 "Validator for Angle_Rear_Mid.";
CM_ SG_ 73 OBJA_Angle_Rear_Mid_STD_12 "Standard deviation of Angle_Rear_Mid.";
CM_ SG_ 73 OBJA_Angle_Rear_Mid_STD_V_12 "Validator for Angle_Rear_Mid_STD.";
CM_ SG_ 73 OBJA_Angle_Rear_Mid_Rate_12 "The momentary angular speed of Angle_Rear_Mid. (radians)";
CM_ SG_ 73 OBJA_Angle_Rear_Mid_Rate_V_12 "Validator for the angular speed of Angle_Rear_Mid.";
CM_ SG_ 73 OBJA_Angle_Rear_Mid_Rate_STD_12 "Standard deviation of the angular speed of Angle_Rear_Mid. (radians)";
CM_ SG_ 73 OBJA_Angle_Rear_Mid_Rate_STD_V_12 "Validator for the STD of the angular speed of Angle_Rear_Mid.";
CM_ SG_ 73 OBJA_Angle_Front_Right_Rate_12 "The momentary angular speed of Angle_Front_Right. (radians)";
CM_ SG_ 73 OBJA_Angle_Front_Right_Rate_V_12 "Validator for the angular speed of Angle_Front_Right.";
CM_ SG_ 73 OBJA_Angle_Front_Right_Rate_STD_12 "Standard deviation of the angular speed of Angle_Front_Right. (radians)";
CM_ SG_ 73 OBJA_Angle_Front_Right_Rate_STD_V_12 "Validator for the STD of the angular speed of Angle_Front_Right.";
CM_ SG_ 73 OBJA_Angle_Front_Left_Rate_12 "The momentary angular speed of Angle_Front_Left. (radians)";
CM_ SG_ 73 OBJA_Angle_Front_Left_Rate_V_12 "Validator for the angular speed of Angle_Front_Left.";
CM_ SG_ 73 OBJA_Angle_Front_Left_Rate_STD_12 "Standard deviation of the angular speed of Angle_Front_Left. (radians)";
CM_ SG_ 73 OBJA_Angle_Front_Left_Rate_STD_V_12 "Validator for the STD of the angular speed of Angle_Front_Left.";
CM_ SG_ 73 OBJA_Angle_Rear_Right_Rate_12 "The momentary angular speed of Angle_Rear_Right. (radians)";
CM_ SG_ 73 OBJA_Angle_Rear_Right_Rate_V_12 "Validator for the angular speed of Angle_Rear_Right.";
CM_ SG_ 73 OBJA_Angle_Rear_Right_Rate_STD_12 "Standard deviation of the angular speed of Angle_Rear_Right. (radians)";
CM_ SG_ 73 OBJA_Angle_Rear_Right_Rate_STD_V_12 "Validator for the STD of the angular speed of Angle_Rear_Right.";
CM_ SG_ 73 OBJA_Angle_Rear_Left_Rate_12 "The momentary angular speed of Angle_Rear_Left. (radians)";
CM_ SG_ 73 OBJA_Angle_Rear_Left_Rate_V_12 "Validator for the angular speed of Angle_Rear_Left.";
CM_ SG_ 73 OBJA_Angle_Rear_Left_Rate_STD_12 "Standard deviation of the angular speed of Angle_Rear_Left. (radians)";
CM_ SG_ 73 OBJA_Angle_Rear_Left_Rate_STD_V_12 "Validator for the STD of the angular speed of Angle_Rear_Left.";
CM_ SG_ 73 OBJA_CRC_13 "Calculated over all element signals. From the signal after the CRC until the first signal in the next elements OBJA_CRC_N+1  not including";
CM_ SG_ 73 OBJA_ID_13 "Unique id";
CM_ SG_ 73 OBJA_Angle_Front_Right_13 "The angle between the host longitudinal axis and the front right side of the target. The positive side is to the host's right.";
CM_ SG_ 73 OBJA_Angle_Front_Right_V_13 "Validator for Angle_Front_Right.";
CM_ SG_ 73 OBJA_Angle_Front_Right_STD_13 "Standard deviation of Angle_Front_Right.";
CM_ SG_ 73 OBJA_Angle_Front_Right_STD_V_13 "Validator for Angle_Front_Right_STD.";
CM_ SG_ 73 OBJA_Angle_Front_Left_13 "The angle between the host longitudinal axis and the front left side of the target. The positive side is to the host's right.";
CM_ SG_ 73 OBJA_Angle_Front_Left_V_13 "Validator for Angle_Front_Left.";
CM_ SG_ 73 OBJA_Angle_Front_Left_STD_13 "Standard deviation of Angle_Front_Left.";
CM_ SG_ 73 OBJA_Angle_Front_Left_STD_V_13 "Validator for Angle_Front_Left_STD.";
CM_ SG_ 73 OBJA_Angle_Rear_Right_13 "The angle between the host longitudinal axis and the rear right side of the target. The positive side is to the host's right.";
CM_ SG_ 73 OBJA_Angle_Rear_Right_V_13 "	 Validator for Angle_Rear_Right.";
CM_ SG_ 73 OBJA_Angle_Rear_Right_STD_13 "Standard deviation of Angle_Rear_Right.";
CM_ SG_ 73 OBJA_Angle_Rear_Right_STD_V_13 "Validator for Angle_Rear_Right_STD.";
CM_ SG_ 73 OBJA_Angle_Rear_Left_13 "The angle between the host longitudinal axis and the rear left side of the target. The positive side is to the host's right.";
CM_ SG_ 73 OBJA_Angle_Rear_Left_V_13 "Validator for Angle_Rear_Left.";
CM_ SG_ 73 OBJA_Angle_Rear_Left_STD_13 "Standard deviation of Angle_Rear_Left.";
CM_ SG_ 73 OBJA_Angle_Rear_Left_STD_V_13 "Validator for Angle_Rear_Left_STD.";
CM_ SG_ 73 OBJA_Angle_Rear_Mid_13 "The angle between the host longitudinal axis and the rear middle of the target. The positive side is to the host's right.";
CM_ SG_ 73 OBJA_Angle_Rear_Mid_V_13 "Validator for Angle_Rear_Mid.";
CM_ SG_ 73 OBJA_Angle_Rear_Mid_STD_13 "Standard deviation of Angle_Rear_Mid.";
CM_ SG_ 73 OBJA_Angle_Rear_Mid_STD_V_13 "Validator for Angle_Rear_Mid_STD.";
CM_ SG_ 73 OBJA_Angle_Rear_Mid_Rate_13 "The momentary angular speed of Angle_Rear_Mid. (radians)";
CM_ SG_ 73 OBJA_Angle_Rear_Mid_Rate_V_13 "Validator for the angular speed of Angle_Rear_Mid.";
CM_ SG_ 73 OBJA_Angle_Rear_Mid_Rate_STD_13 "Standard deviation of the angular speed of Angle_Rear_Mid. (radians)";
CM_ SG_ 73 OBJA_Angle_Rear_Mid_Rate_STD_V_13 "Validator for the STD of the angular speed of Angle_Rear_Mid.";
CM_ SG_ 73 OBJA_Angle_Front_Right_Rate_13 "The momentary angular speed of Angle_Front_Right. (radians)";
CM_ SG_ 73 OBJA_Angle_Front_Right_Rate_V_13 "Validator for the angular speed of Angle_Front_Right.";
CM_ SG_ 73 OBJA_Angle_Front_Right_Rate_STD_13 "Standard deviation of the angular speed of Angle_Front_Right. (radians)";
CM_ SG_ 73 OBJA_Angle_Front_Right_Rate_STD_V_13 "Validator for the STD of the angular speed of Angle_Front_Right.";
CM_ SG_ 73 OBJA_Angle_Front_Left_Rate_13 "The momentary angular speed of Angle_Front_Left. (radians)";
CM_ SG_ 73 OBJA_Angle_Front_Left_Rate_V_13 "Validator for the angular speed of Angle_Front_Left.";
CM_ SG_ 73 OBJA_Angle_Front_Left_Rate_STD_13 "Standard deviation of the angular speed of Angle_Front_Left. (radians)";
CM_ SG_ 73 OBJA_Angle_Front_Left_Rate_STD_V_13 "Validator for the STD of the angular speed of Angle_Front_Left.";
CM_ SG_ 73 OBJA_Angle_Rear_Right_Rate_13 "The momentary angular speed of Angle_Rear_Right. (radians)";
CM_ SG_ 73 OBJA_Angle_Rear_Right_Rate_V_13 "Validator for the angular speed of Angle_Rear_Right.";
CM_ SG_ 73 OBJA_Angle_Rear_Right_Rate_STD_13 "Standard deviation of the angular speed of Angle_Rear_Right. (radians)";
CM_ SG_ 73 OBJA_Angle_Rear_Right_Rate_STD_V_13 "Validator for the STD of the angular speed of Angle_Rear_Right.";
CM_ SG_ 73 OBJA_Angle_Rear_Left_Rate_13 "The momentary angular speed of Angle_Rear_Left. (radians)";
CM_ SG_ 73 OBJA_Angle_Rear_Left_Rate_V_13 "Validator for the angular speed of Angle_Rear_Left.";
CM_ SG_ 73 OBJA_Angle_Rear_Left_Rate_STD_13 "Standard deviation of the angular speed of Angle_Rear_Left. (radians)";
CM_ SG_ 73 OBJA_Angle_Rear_Left_Rate_STD_V_13 "Validator for the STD of the angular speed of Angle_Rear_Left.";
CM_ SG_ 73 OBJA_CRC_14 "Calculated over all element signals. From the signal after the CRC until the first signal in the next elements OBJA_CRC_N+1  not including";
CM_ SG_ 73 OBJA_ID_14 "Unique id";
CM_ SG_ 73 OBJA_Angle_Front_Right_14 "The angle between the host longitudinal axis and the front right side of the target. The positive side is to the host's right.";
CM_ SG_ 73 OBJA_Angle_Front_Right_V_14 "Validator for Angle_Front_Right.";
CM_ SG_ 73 OBJA_Angle_Front_Right_STD_14 "Standard deviation of Angle_Front_Right.";
CM_ SG_ 73 OBJA_Angle_Front_Right_STD_V_14 "Validator for Angle_Front_Right_STD.";
CM_ SG_ 73 OBJA_Angle_Front_Left_14 "The angle between the host longitudinal axis and the front left side of the target. The positive side is to the host's right.";
CM_ SG_ 73 OBJA_Angle_Front_Left_V_14 "Validator for Angle_Front_Left.";
CM_ SG_ 73 OBJA_Angle_Front_Left_STD_14 "Standard deviation of Angle_Front_Left.";
CM_ SG_ 73 OBJA_Angle_Front_Left_STD_V_14 "Validator for Angle_Front_Left_STD.";
CM_ SG_ 73 OBJA_Angle_Rear_Right_14 "The angle between the host longitudinal axis and the rear right side of the target. The positive side is to the host's right.";
CM_ SG_ 73 OBJA_Angle_Rear_Right_V_14 "	 Validator for Angle_Rear_Right.";
CM_ SG_ 73 OBJA_Angle_Rear_Right_STD_14 "Standard deviation of Angle_Rear_Right.";
CM_ SG_ 73 OBJA_Angle_Rear_Right_STD_V_14 "Validator for Angle_Rear_Right_STD.";
CM_ SG_ 73 OBJA_Angle_Rear_Left_14 "The angle between the host longitudinal axis and the rear left side of the target. The positive side is to the host's right.";
CM_ SG_ 73 OBJA_Angle_Rear_Left_V_14 "Validator for Angle_Rear_Left.";
CM_ SG_ 73 OBJA_Angle_Rear_Left_STD_14 "Standard deviation of Angle_Rear_Left.";
CM_ SG_ 73 OBJA_Angle_Rear_Left_STD_V_14 "Validator for Angle_Rear_Left_STD.";
CM_ SG_ 73 OBJA_Angle_Rear_Mid_14 "The angle between the host longitudinal axis and the rear middle of the target. The positive side is to the host's right.";
CM_ SG_ 73 OBJA_Angle_Rear_Mid_V_14 "Validator for Angle_Rear_Mid.";
CM_ SG_ 73 OBJA_Angle_Rear_Mid_STD_14 "Standard deviation of Angle_Rear_Mid.";
CM_ SG_ 73 OBJA_Angle_Rear_Mid_STD_V_14 "Validator for Angle_Rear_Mid_STD.";
CM_ SG_ 73 OBJA_Angle_Rear_Mid_Rate_14 "The momentary angular speed of Angle_Rear_Mid. (radians)";
CM_ SG_ 73 OBJA_Angle_Rear_Mid_Rate_V_14 "Validator for the angular speed of Angle_Rear_Mid.";
CM_ SG_ 73 OBJA_Angle_Rear_Mid_Rate_STD_14 "Standard deviation of the angular speed of Angle_Rear_Mid. (radians)";
CM_ SG_ 73 OBJA_Angle_Rear_Mid_Rate_STD_V_14 "Validator for the STD of the angular speed of Angle_Rear_Mid.";
CM_ SG_ 73 OBJA_Angle_Front_Right_Rate_14 "The momentary angular speed of Angle_Front_Right. (radians)";
CM_ SG_ 73 OBJA_Angle_Front_Right_Rate_V_14 "Validator for the angular speed of Angle_Front_Right.";
CM_ SG_ 73 OBJA_Angle_Front_Right_Rate_STD_14 "Standard deviation of the angular speed of Angle_Front_Right. (radians)";
CM_ SG_ 73 OBJA_Angle_Front_Right_Rate_STD_V_14 "Validator for the STD of the angular speed of Angle_Front_Right.";
CM_ SG_ 73 OBJA_Angle_Front_Left_Rate_14 "The momentary angular speed of Angle_Front_Left. (radians)";
CM_ SG_ 73 OBJA_Angle_Front_Left_Rate_V_14 "Validator for the angular speed of Angle_Front_Left.";
CM_ SG_ 73 OBJA_Angle_Front_Left_Rate_STD_14 "Standard deviation of the angular speed of Angle_Front_Left. (radians)";
CM_ SG_ 73 OBJA_Angle_Front_Left_Rate_STD_V_14 "Validator for the STD of the angular speed of Angle_Front_Left.";
CM_ SG_ 73 OBJA_Angle_Rear_Right_Rate_14 "The momentary angular speed of Angle_Rear_Right. (radians)";
CM_ SG_ 73 OBJA_Angle_Rear_Right_Rate_V_14 "Validator for the angular speed of Angle_Rear_Right.";
CM_ SG_ 73 OBJA_Angle_Rear_Right_Rate_STD_14 "Standard deviation of the angular speed of Angle_Rear_Right. (radians)";
CM_ SG_ 73 OBJA_Angle_Rear_Right_Rate_STD_V_14 "Validator for the STD of the angular speed of Angle_Rear_Right.";
CM_ SG_ 73 OBJA_Angle_Rear_Left_Rate_14 "The momentary angular speed of Angle_Rear_Left. (radians)";
CM_ SG_ 73 OBJA_Angle_Rear_Left_Rate_V_14 "Validator for the angular speed of Angle_Rear_Left.";
CM_ SG_ 73 OBJA_Angle_Rear_Left_Rate_STD_14 "Standard deviation of the angular speed of Angle_Rear_Left. (radians)";
CM_ SG_ 73 OBJA_Angle_Rear_Left_Rate_STD_V_14 "Validator for the STD of the angular speed of Angle_Rear_Left.";
CM_ SG_ 73 OBJA_CRC_15 "Calculated over all element signals. From the signal after the CRC until the first signal in the next elements OBJA_CRC_N+1  not including";
CM_ SG_ 73 OBJA_ID_15 "Unique id";
CM_ SG_ 73 OBJA_Angle_Front_Right_15 "The angle between the host longitudinal axis and the front right side of the target. The positive side is to the host's right.";
CM_ SG_ 73 OBJA_Angle_Front_Right_V_15 "Validator for Angle_Front_Right.";
CM_ SG_ 73 OBJA_Angle_Front_Right_STD_15 "Standard deviation of Angle_Front_Right.";
CM_ SG_ 73 OBJA_Angle_Front_Right_STD_V_15 "Validator for Angle_Front_Right_STD.";
CM_ SG_ 73 OBJA_Angle_Front_Left_15 "The angle between the host longitudinal axis and the front left side of the target. The positive side is to the host's right.";
CM_ SG_ 73 OBJA_Angle_Front_Left_V_15 "Validator for Angle_Front_Left.";
CM_ SG_ 73 OBJA_Angle_Front_Left_STD_15 "Standard deviation of Angle_Front_Left.";
CM_ SG_ 73 OBJA_Angle_Front_Left_STD_V_15 "Validator for Angle_Front_Left_STD.";
CM_ SG_ 73 OBJA_Angle_Rear_Right_15 "The angle between the host longitudinal axis and the rear right side of the target. The positive side is to the host's right.";
CM_ SG_ 73 OBJA_Angle_Rear_Right_V_15 "	 Validator for Angle_Rear_Right.";
CM_ SG_ 73 OBJA_Angle_Rear_Right_STD_15 "Standard deviation of Angle_Rear_Right.";
CM_ SG_ 73 OBJA_Angle_Rear_Right_STD_V_15 "Validator for Angle_Rear_Right_STD.";
CM_ SG_ 73 OBJA_Angle_Rear_Left_15 "The angle between the host longitudinal axis and the rear left side of the target. The positive side is to the host's right.";
CM_ SG_ 73 OBJA_Angle_Rear_Left_V_15 "Validator for Angle_Rear_Left.";
CM_ SG_ 73 OBJA_Angle_Rear_Left_STD_15 "Standard deviation of Angle_Rear_Left.";
CM_ SG_ 73 OBJA_Angle_Rear_Left_STD_V_15 "Validator for Angle_Rear_Left_STD.";
CM_ SG_ 73 OBJA_Angle_Rear_Mid_15 "The angle between the host longitudinal axis and the rear middle of the target. The positive side is to the host's right.";
CM_ SG_ 73 OBJA_Angle_Rear_Mid_V_15 "Validator for Angle_Rear_Mid.";
CM_ SG_ 73 OBJA_Angle_Rear_Mid_STD_15 "Standard deviation of Angle_Rear_Mid.";
CM_ SG_ 73 OBJA_Angle_Rear_Mid_STD_V_15 "Validator for Angle_Rear_Mid_STD.";
CM_ SG_ 73 OBJA_Angle_Rear_Mid_Rate_15 "The momentary angular speed of Angle_Rear_Mid. (radians)";
CM_ SG_ 73 OBJA_Angle_Rear_Mid_Rate_V_15 "Validator for the angular speed of Angle_Rear_Mid.";
CM_ SG_ 73 OBJA_Angle_Rear_Mid_Rate_STD_15 "Standard deviation of the angular speed of Angle_Rear_Mid. (radians)";
CM_ SG_ 73 OBJA_Angle_Rear_Mid_Rate_STD_V_15 "Validator for the STD of the angular speed of Angle_Rear_Mid.";
CM_ SG_ 73 OBJA_Angle_Front_Right_Rate_15 "The momentary angular speed of Angle_Front_Right. (radians)";
CM_ SG_ 73 OBJA_Angle_Front_Right_Rate_V_15 "Validator for the angular speed of Angle_Front_Right.";
CM_ SG_ 73 OBJA_Angle_Front_Right_Rate_STD_15 "Standard deviation of the angular speed of Angle_Front_Right. (radians)";
CM_ SG_ 73 OBJA_Angle_Front_Right_Rate_STD_V_15 "Validator for the STD of the angular speed of Angle_Front_Right.";
CM_ SG_ 73 OBJA_Angle_Front_Left_Rate_15 "The momentary angular speed of Angle_Front_Left. (radians)";
CM_ SG_ 73 OBJA_Angle_Front_Left_Rate_V_15 "Validator for the angular speed of Angle_Front_Left.";
CM_ SG_ 73 OBJA_Angle_Front_Left_Rate_STD_15 "Standard deviation of the angular speed of Angle_Front_Left. (radians)";
CM_ SG_ 73 OBJA_Angle_Front_Left_Rate_STD_V_15 "Validator for the STD of the angular speed of Angle_Front_Left.";
CM_ SG_ 73 OBJA_Angle_Rear_Right_Rate_15 "The momentary angular speed of Angle_Rear_Right. (radians)";
CM_ SG_ 73 OBJA_Angle_Rear_Right_Rate_V_15 "Validator for the angular speed of Angle_Rear_Right.";
CM_ SG_ 73 OBJA_Angle_Rear_Right_Rate_STD_15 "Standard deviation of the angular speed of Angle_Rear_Right. (radians)";
CM_ SG_ 73 OBJA_Angle_Rear_Right_Rate_STD_V_15 "Validator for the STD of the angular speed of Angle_Rear_Right.";
CM_ SG_ 73 OBJA_Angle_Rear_Left_Rate_15 "The momentary angular speed of Angle_Rear_Left. (radians)";
CM_ SG_ 73 OBJA_Angle_Rear_Left_Rate_V_15 "Validator for the angular speed of Angle_Rear_Left.";
CM_ SG_ 73 OBJA_Angle_Rear_Left_Rate_STD_15 "Standard deviation of the angular speed of Angle_Rear_Left. (radians)";
CM_ SG_ 73 OBJA_Angle_Rear_Left_Rate_STD_V_15 "Validator for the STD of the angular speed of Angle_Rear_Left.";
CM_ SG_ 73 OBJA_CRC_16 "Calculated over all element signals. From the signal after the CRC until the first signal in the next elements OBJA_CRC_N+1  not including";
CM_ SG_ 73 OBJA_ID_16 "Unique id";
CM_ SG_ 73 OBJA_Angle_Front_Right_16 "The angle between the host longitudinal axis and the front right side of the target. The positive side is to the host's right.";
CM_ SG_ 73 OBJA_Angle_Front_Right_V_16 "Validator for Angle_Front_Right.";
CM_ SG_ 73 OBJA_Angle_Front_Right_STD_16 "Standard deviation of Angle_Front_Right.";
CM_ SG_ 73 OBJA_Angle_Front_Right_STD_V_16 "Validator for Angle_Front_Right_STD.";
CM_ SG_ 73 OBJA_Angle_Front_Left_16 "The angle between the host longitudinal axis and the front left side of the target. The positive side is to the host's right.";
CM_ SG_ 73 OBJA_Angle_Front_Left_V_16 "Validator for Angle_Front_Left.";
CM_ SG_ 73 OBJA_Angle_Front_Left_STD_16 "Standard deviation of Angle_Front_Left.";
CM_ SG_ 73 OBJA_Angle_Front_Left_STD_V_16 "Validator for Angle_Front_Left_STD.";
CM_ SG_ 73 OBJA_Angle_Rear_Right_16 "The angle between the host longitudinal axis and the rear right side of the target. The positive side is to the host's right.";
CM_ SG_ 73 OBJA_Angle_Rear_Right_V_16 "	 Validator for Angle_Rear_Right.";
CM_ SG_ 73 OBJA_Angle_Rear_Right_STD_16 "Standard deviation of Angle_Rear_Right.";
CM_ SG_ 73 OBJA_Angle_Rear_Right_STD_V_16 "Validator for Angle_Rear_Right_STD.";
CM_ SG_ 73 OBJA_Angle_Rear_Left_16 "The angle between the host longitudinal axis and the rear left side of the target. The positive side is to the host's right.";
CM_ SG_ 73 OBJA_Angle_Rear_Left_V_16 "Validator for Angle_Rear_Left.";
CM_ SG_ 73 OBJA_Angle_Rear_Left_STD_16 "Standard deviation of Angle_Rear_Left.";
CM_ SG_ 73 OBJA_Angle_Rear_Left_STD_V_16 "Validator for Angle_Rear_Left_STD.";
CM_ SG_ 73 OBJA_Angle_Rear_Mid_16 "The angle between the host longitudinal axis and the rear middle of the target. The positive side is to the host's right.";
CM_ SG_ 73 OBJA_Angle_Rear_Mid_V_16 "Validator for Angle_Rear_Mid.";
CM_ SG_ 73 OBJA_Angle_Rear_Mid_STD_16 "Standard deviation of Angle_Rear_Mid.";
CM_ SG_ 73 OBJA_Angle_Rear_Mid_STD_V_16 "Validator for Angle_Rear_Mid_STD.";
CM_ SG_ 73 OBJA_Angle_Rear_Mid_Rate_16 "The momentary angular speed of Angle_Rear_Mid. (radians)";
CM_ SG_ 73 OBJA_Angle_Rear_Mid_Rate_V_16 "Validator for the angular speed of Angle_Rear_Mid.";
CM_ SG_ 73 OBJA_Angle_Rear_Mid_Rate_STD_16 "Standard deviation of the angular speed of Angle_Rear_Mid. (radians)";
CM_ SG_ 73 OBJA_Angle_Rear_Mid_Rate_STD_V_16 "Validator for the STD of the angular speed of Angle_Rear_Mid.";
CM_ SG_ 73 OBJA_Angle_Front_Right_Rate_16 "The momentary angular speed of Angle_Front_Right. (radians)";
CM_ SG_ 73 OBJA_Angle_Front_Right_Rate_V_16 "Validator for the angular speed of Angle_Front_Right.";
CM_ SG_ 73 OBJA_Angle_Front_Right_Rate_STD_16 "Standard deviation of the angular speed of Angle_Front_Right. (radians)";
CM_ SG_ 73 OBJA_Angle_Front_Right_Rate_STD_V_16 "Validator for the STD of the angular speed of Angle_Front_Right.";
CM_ SG_ 73 OBJA_Angle_Front_Left_Rate_16 "The momentary angular speed of Angle_Front_Left. (radians)";
CM_ SG_ 73 OBJA_Angle_Front_Left_Rate_V_16 "Validator for the angular speed of Angle_Front_Left.";
CM_ SG_ 73 OBJA_Angle_Front_Left_Rate_STD_16 "Standard deviation of the angular speed of Angle_Front_Left. (radians)";
CM_ SG_ 73 OBJA_Angle_Front_Left_Rate_STD_V_16 "Validator for the STD of the angular speed of Angle_Front_Left.";
CM_ SG_ 73 OBJA_Angle_Rear_Right_Rate_16 "The momentary angular speed of Angle_Rear_Right. (radians)";
CM_ SG_ 73 OBJA_Angle_Rear_Right_Rate_V_16 "Validator for the angular speed of Angle_Rear_Right.";
CM_ SG_ 73 OBJA_Angle_Rear_Right_Rate_STD_16 "Standard deviation of the angular speed of Angle_Rear_Right. (radians)";
CM_ SG_ 73 OBJA_Angle_Rear_Right_Rate_STD_V_16 "Validator for the STD of the angular speed of Angle_Rear_Right.";
CM_ SG_ 73 OBJA_Angle_Rear_Left_Rate_16 "The momentary angular speed of Angle_Rear_Left. (radians)";
CM_ SG_ 73 OBJA_Angle_Rear_Left_Rate_V_16 "Validator for the angular speed of Angle_Rear_Left.";
CM_ SG_ 73 OBJA_Angle_Rear_Left_Rate_STD_16 "Standard deviation of the angular speed of Angle_Rear_Left. (radians)";
CM_ SG_ 73 OBJA_Angle_Rear_Left_Rate_STD_V_16 "Validator for the STD of the angular speed of Angle_Rear_Left.";
CM_ SG_ 73 OBJA_CRC_17 "Calculated over all element signals. From the signal after the CRC until the first signal in the next elements OBJA_CRC_N+1  not including";
CM_ SG_ 73 OBJA_ID_17 "Unique id";
CM_ SG_ 73 OBJA_Angle_Front_Right_17 "The angle between the host longitudinal axis and the front right side of the target. The positive side is to the host's right.";
CM_ SG_ 73 OBJA_Angle_Front_Right_V_17 "Validator for Angle_Front_Right.";
CM_ SG_ 73 OBJA_Angle_Front_Right_STD_17 "Standard deviation of Angle_Front_Right.";
CM_ SG_ 73 OBJA_Angle_Front_Right_STD_V_17 "Validator for Angle_Front_Right_STD.";
CM_ SG_ 73 OBJA_Angle_Front_Left_17 "The angle between the host longitudinal axis and the front left side of the target. The positive side is to the host's right.";
CM_ SG_ 73 OBJA_Angle_Front_Left_V_17 "Validator for Angle_Front_Left.";
CM_ SG_ 73 OBJA_Angle_Front_Left_STD_17 "Standard deviation of Angle_Front_Left.";
CM_ SG_ 73 OBJA_Angle_Front_Left_STD_V_17 "Validator for Angle_Front_Left_STD.";
CM_ SG_ 73 OBJA_Angle_Rear_Right_17 "The angle between the host longitudinal axis and the rear right side of the target. The positive side is to the host's right.";
CM_ SG_ 73 OBJA_Angle_Rear_Right_V_17 "	 Validator for Angle_Rear_Right.";
CM_ SG_ 73 OBJA_Angle_Rear_Right_STD_17 "Standard deviation of Angle_Rear_Right.";
CM_ SG_ 73 OBJA_Angle_Rear_Right_STD_V_17 "Validator for Angle_Rear_Right_STD.";
CM_ SG_ 73 OBJA_Angle_Rear_Left_17 "The angle between the host longitudinal axis and the rear left side of the target. The positive side is to the host's right.";
CM_ SG_ 73 OBJA_Angle_Rear_Left_V_17 "Validator for Angle_Rear_Left.";
CM_ SG_ 73 OBJA_Angle_Rear_Left_STD_17 "Standard deviation of Angle_Rear_Left.";
CM_ SG_ 73 OBJA_Angle_Rear_Left_STD_V_17 "Validator for Angle_Rear_Left_STD.";
CM_ SG_ 73 OBJA_Angle_Rear_Mid_17 "The angle between the host longitudinal axis and the rear middle of the target. The positive side is to the host's right.";
CM_ SG_ 73 OBJA_Angle_Rear_Mid_V_17 "Validator for Angle_Rear_Mid.";
CM_ SG_ 73 OBJA_Angle_Rear_Mid_STD_17 "Standard deviation of Angle_Rear_Mid.";
CM_ SG_ 73 OBJA_Angle_Rear_Mid_STD_V_17 "Validator for Angle_Rear_Mid_STD.";
CM_ SG_ 73 OBJA_Angle_Rear_Mid_Rate_17 "The momentary angular speed of Angle_Rear_Mid. (radians)";
CM_ SG_ 73 OBJA_Angle_Rear_Mid_Rate_V_17 "Validator for the angular speed of Angle_Rear_Mid.";
CM_ SG_ 73 OBJA_Angle_Rear_Mid_Rate_STD_17 "Standard deviation of the angular speed of Angle_Rear_Mid. (radians)";
CM_ SG_ 73 OBJA_Angle_Rear_Mid_Rate_STD_V_17 "Validator for the STD of the angular speed of Angle_Rear_Mid.";
CM_ SG_ 73 OBJA_Angle_Front_Right_Rate_17 "The momentary angular speed of Angle_Front_Right. (radians)";
CM_ SG_ 73 OBJA_Angle_Front_Right_Rate_V_17 "Validator for the angular speed of Angle_Front_Right.";
CM_ SG_ 73 OBJA_Angle_Front_Right_Rate_STD_17 "Standard deviation of the angular speed of Angle_Front_Right. (radians)";
CM_ SG_ 73 OBJA_Angle_Front_Right_Rate_STD_V_17 "Validator for the STD of the angular speed of Angle_Front_Right.";
CM_ SG_ 73 OBJA_Angle_Front_Left_Rate_17 "The momentary angular speed of Angle_Front_Left. (radians)";
CM_ SG_ 73 OBJA_Angle_Front_Left_Rate_V_17 "Validator for the angular speed of Angle_Front_Left.";
CM_ SG_ 73 OBJA_Angle_Front_Left_Rate_STD_17 "Standard deviation of the angular speed of Angle_Front_Left. (radians)";
CM_ SG_ 73 OBJA_Angle_Front_Left_Rate_STD_V_17 "Validator for the STD of the angular speed of Angle_Front_Left.";
CM_ SG_ 73 OBJA_Angle_Rear_Right_Rate_17 "The momentary angular speed of Angle_Rear_Right. (radians)";
CM_ SG_ 73 OBJA_Angle_Rear_Right_Rate_V_17 "Validator for the angular speed of Angle_Rear_Right.";
CM_ SG_ 73 OBJA_Angle_Rear_Right_Rate_STD_17 "Standard deviation of the angular speed of Angle_Rear_Right. (radians)";
CM_ SG_ 73 OBJA_Angle_Rear_Right_Rate_STD_V_17 "Validator for the STD of the angular speed of Angle_Rear_Right.";
CM_ SG_ 73 OBJA_Angle_Rear_Left_Rate_17 "The momentary angular speed of Angle_Rear_Left. (radians)";
CM_ SG_ 73 OBJA_Angle_Rear_Left_Rate_V_17 "Validator for the angular speed of Angle_Rear_Left.";
CM_ SG_ 73 OBJA_Angle_Rear_Left_Rate_STD_17 "Standard deviation of the angular speed of Angle_Rear_Left. (radians)";
CM_ SG_ 73 OBJA_Angle_Rear_Left_Rate_STD_V_17 "Validator for the STD of the angular speed of Angle_Rear_Left.";
CM_ SG_ 73 OBJA_CRC_18 "Calculated over all element signals. From the signal after the CRC until the first signal in the next elements OBJA_CRC_N+1  not including";
CM_ SG_ 73 OBJA_ID_18 "Unique id";
CM_ SG_ 73 OBJA_Angle_Front_Right_18 "The angle between the host longitudinal axis and the front right side of the target. The positive side is to the host's right.";
CM_ SG_ 73 OBJA_Angle_Front_Right_V_18 "Validator for Angle_Front_Right.";
CM_ SG_ 73 OBJA_Angle_Front_Right_STD_18 "Standard deviation of Angle_Front_Right.";
CM_ SG_ 73 OBJA_Angle_Front_Right_STD_V_18 "Validator for Angle_Front_Right_STD.";
CM_ SG_ 73 OBJA_Angle_Front_Left_18 "The angle between the host longitudinal axis and the front left side of the target. The positive side is to the host's right.";
CM_ SG_ 73 OBJA_Angle_Front_Left_V_18 "Validator for Angle_Front_Left.";
CM_ SG_ 73 OBJA_Angle_Front_Left_STD_18 "Standard deviation of Angle_Front_Left.";
CM_ SG_ 73 OBJA_Angle_Front_Left_STD_V_18 "Validator for Angle_Front_Left_STD.";
CM_ SG_ 73 OBJA_Angle_Rear_Right_18 "The angle between the host longitudinal axis and the rear right side of the target. The positive side is to the host's right.";
CM_ SG_ 73 OBJA_Angle_Rear_Right_V_18 "	 Validator for Angle_Rear_Right.";
CM_ SG_ 73 OBJA_Angle_Rear_Right_STD_18 "Standard deviation of Angle_Rear_Right.";
CM_ SG_ 73 OBJA_Angle_Rear_Right_STD_V_18 "Validator for Angle_Rear_Right_STD.";
CM_ SG_ 73 OBJA_Angle_Rear_Left_18 "The angle between the host longitudinal axis and the rear left side of the target. The positive side is to the host's right.";
CM_ SG_ 73 OBJA_Angle_Rear_Left_V_18 "Validator for Angle_Rear_Left.";
CM_ SG_ 73 OBJA_Angle_Rear_Left_STD_18 "Standard deviation of Angle_Rear_Left.";
CM_ SG_ 73 OBJA_Angle_Rear_Left_STD_V_18 "Validator for Angle_Rear_Left_STD.";
CM_ SG_ 73 OBJA_Angle_Rear_Mid_18 "The angle between the host longitudinal axis and the rear middle of the target. The positive side is to the host's right.";
CM_ SG_ 73 OBJA_Angle_Rear_Mid_V_18 "Validator for Angle_Rear_Mid.";
CM_ SG_ 73 OBJA_Angle_Rear_Mid_STD_18 "Standard deviation of Angle_Rear_Mid.";
CM_ SG_ 73 OBJA_Angle_Rear_Mid_STD_V_18 "Validator for Angle_Rear_Mid_STD.";
CM_ SG_ 73 OBJA_Angle_Rear_Mid_Rate_18 "The momentary angular speed of Angle_Rear_Mid. (radians)";
CM_ SG_ 73 OBJA_Angle_Rear_Mid_Rate_V_18 "Validator for the angular speed of Angle_Rear_Mid.";
CM_ SG_ 73 OBJA_Angle_Rear_Mid_Rate_STD_18 "Standard deviation of the angular speed of Angle_Rear_Mid. (radians)";
CM_ SG_ 73 OBJA_Angle_Rear_Mid_Rate_STD_V_18 "Validator for the STD of the angular speed of Angle_Rear_Mid.";
CM_ SG_ 73 OBJA_Angle_Front_Right_Rate_18 "The momentary angular speed of Angle_Front_Right. (radians)";
CM_ SG_ 73 OBJA_Angle_Front_Right_Rate_V_18 "Validator for the angular speed of Angle_Front_Right.";
CM_ SG_ 73 OBJA_Angle_Front_Right_Rate_STD_18 "Standard deviation of the angular speed of Angle_Front_Right. (radians)";
CM_ SG_ 73 OBJA_Angle_Front_Right_Rate_STD_V_18 "Validator for the STD of the angular speed of Angle_Front_Right.";
CM_ SG_ 73 OBJA_Angle_Front_Left_Rate_18 "The momentary angular speed of Angle_Front_Left. (radians)";
CM_ SG_ 73 OBJA_Angle_Front_Left_Rate_V_18 "Validator for the angular speed of Angle_Front_Left.";
CM_ SG_ 73 OBJA_Angle_Front_Left_Rate_STD_18 "Standard deviation of the angular speed of Angle_Front_Left. (radians)";
CM_ SG_ 73 OBJA_Angle_Front_Left_Rate_STD_V_18 "Validator for the STD of the angular speed of Angle_Front_Left.";
CM_ SG_ 73 OBJA_Angle_Rear_Right_Rate_18 "The momentary angular speed of Angle_Rear_Right. (radians)";
CM_ SG_ 73 OBJA_Angle_Rear_Right_Rate_V_18 "Validator for the angular speed of Angle_Rear_Right.";
CM_ SG_ 73 OBJA_Angle_Rear_Right_Rate_STD_18 "Standard deviation of the angular speed of Angle_Rear_Right. (radians)";
CM_ SG_ 73 OBJA_Angle_Rear_Right_Rate_STD_V_18 "Validator for the STD of the angular speed of Angle_Rear_Right.";
CM_ SG_ 73 OBJA_Angle_Rear_Left_Rate_18 "The momentary angular speed of Angle_Rear_Left. (radians)";
CM_ SG_ 73 OBJA_Angle_Rear_Left_Rate_V_18 "Validator for the angular speed of Angle_Rear_Left.";
CM_ SG_ 73 OBJA_Angle_Rear_Left_Rate_STD_18 "Standard deviation of the angular speed of Angle_Rear_Left. (radians)";
CM_ SG_ 73 OBJA_Angle_Rear_Left_Rate_STD_V_18 "Validator for the STD of the angular speed of Angle_Rear_Left.";
CM_ SG_ 73 OBJA_CRC_19 "Calculated over all element signals. From the signal after the CRC until the first signal in the next elements OBJA_CRC_N+1  not including";
CM_ SG_ 73 OBJA_ID_19 "Unique id";
CM_ SG_ 73 OBJA_Angle_Front_Right_19 "The angle between the host longitudinal axis and the front right side of the target. The positive side is to the host's right.";
CM_ SG_ 73 OBJA_Angle_Front_Right_V_19 "Validator for Angle_Front_Right.";
CM_ SG_ 73 OBJA_Angle_Front_Right_STD_19 "Standard deviation of Angle_Front_Right.";
CM_ SG_ 73 OBJA_Angle_Front_Right_STD_V_19 "Validator for Angle_Front_Right_STD.";
CM_ SG_ 73 OBJA_Angle_Front_Left_19 "The angle between the host longitudinal axis and the front left side of the target. The positive side is to the host's right.";
CM_ SG_ 73 OBJA_Angle_Front_Left_V_19 "Validator for Angle_Front_Left.";
CM_ SG_ 73 OBJA_Angle_Front_Left_STD_19 "Standard deviation of Angle_Front_Left.";
CM_ SG_ 73 OBJA_Angle_Front_Left_STD_V_19 "Validator for Angle_Front_Left_STD.";
CM_ SG_ 73 OBJA_Angle_Rear_Right_19 "The angle between the host longitudinal axis and the rear right side of the target. The positive side is to the host's right.";
CM_ SG_ 73 OBJA_Angle_Rear_Right_V_19 "	 Validator for Angle_Rear_Right.";
CM_ SG_ 73 OBJA_Angle_Rear_Right_STD_19 "Standard deviation of Angle_Rear_Right.";
CM_ SG_ 73 OBJA_Angle_Rear_Right_STD_V_19 "Validator for Angle_Rear_Right_STD.";
CM_ SG_ 73 OBJA_Angle_Rear_Left_19 "The angle between the host longitudinal axis and the rear left side of the target. The positive side is to the host's right.";
CM_ SG_ 73 OBJA_Angle_Rear_Left_V_19 "Validator for Angle_Rear_Left.";
CM_ SG_ 73 OBJA_Angle_Rear_Left_STD_19 "Standard deviation of Angle_Rear_Left.";
CM_ SG_ 73 OBJA_Angle_Rear_Left_STD_V_19 "Validator for Angle_Rear_Left_STD.";
CM_ SG_ 73 OBJA_Angle_Rear_Mid_19 "The angle between the host longitudinal axis and the rear middle of the target. The positive side is to the host's right.";
CM_ SG_ 73 OBJA_Angle_Rear_Mid_V_19 "Validator for Angle_Rear_Mid.";
CM_ SG_ 73 OBJA_Angle_Rear_Mid_STD_19 "Standard deviation of Angle_Rear_Mid.";
CM_ SG_ 73 OBJA_Angle_Rear_Mid_STD_V_19 "Validator for Angle_Rear_Mid_STD.";
CM_ SG_ 73 OBJA_Angle_Rear_Mid_Rate_19 "The momentary angular speed of Angle_Rear_Mid. (radians)";
CM_ SG_ 73 OBJA_Angle_Rear_Mid_Rate_V_19 "Validator for the angular speed of Angle_Rear_Mid.";
CM_ SG_ 73 OBJA_Angle_Rear_Mid_Rate_STD_19 "Standard deviation of the angular speed of Angle_Rear_Mid. (radians)";
CM_ SG_ 73 OBJA_Angle_Rear_Mid_Rate_STD_V_19 "Validator for the STD of the angular speed of Angle_Rear_Mid.";
CM_ SG_ 73 OBJA_Angle_Front_Right_Rate_19 "The momentary angular speed of Angle_Front_Right. (radians)";
CM_ SG_ 73 OBJA_Angle_Front_Right_Rate_V_19 "Validator for the angular speed of Angle_Front_Right.";
CM_ SG_ 73 OBJA_Angle_Front_Right_Rate_STD_19 "Standard deviation of the angular speed of Angle_Front_Right. (radians)";
CM_ SG_ 73 OBJA_Angle_Front_Right_Rate_STD_V_19 "Validator for the STD of the angular speed of Angle_Front_Right.";
CM_ SG_ 73 OBJA_Angle_Front_Left_Rate_19 "The momentary angular speed of Angle_Front_Left. (radians)";
CM_ SG_ 73 OBJA_Angle_Front_Left_Rate_V_19 "Validator for the angular speed of Angle_Front_Left.";
CM_ SG_ 73 OBJA_Angle_Front_Left_Rate_STD_19 "Standard deviation of the angular speed of Angle_Front_Left. (radians)";
CM_ SG_ 73 OBJA_Angle_Front_Left_Rate_STD_V_19 "Validator for the STD of the angular speed of Angle_Front_Left.";
CM_ SG_ 73 OBJA_Angle_Rear_Right_Rate_19 "The momentary angular speed of Angle_Rear_Right. (radians)";
CM_ SG_ 73 OBJA_Angle_Rear_Right_Rate_V_19 "Validator for the angular speed of Angle_Rear_Right.";
CM_ SG_ 73 OBJA_Angle_Rear_Right_Rate_STD_19 "Standard deviation of the angular speed of Angle_Rear_Right. (radians)";
CM_ SG_ 73 OBJA_Angle_Rear_Right_Rate_STD_V_19 "Validator for the STD of the angular speed of Angle_Rear_Right.";
CM_ SG_ 73 OBJA_Angle_Rear_Left_Rate_19 "The momentary angular speed of Angle_Rear_Left. (radians)";
CM_ SG_ 73 OBJA_Angle_Rear_Left_Rate_V_19 "Validator for the angular speed of Angle_Rear_Left.";
CM_ SG_ 73 OBJA_Angle_Rear_Left_Rate_STD_19 "Standard deviation of the angular speed of Angle_Rear_Left. (radians)";
CM_ SG_ 73 OBJA_Angle_Rear_Left_Rate_STD_V_19 "Validator for the STD of the angular speed of Angle_Rear_Left.";

BA_DEF_  "BusType" STRING ;
BA_DEF_ SG_  "GenSigStartValue" INT 0 0;
BA_DEF_DEF_  "GenSigStartValue" 0;
BA_DEF_DEF_  "BusType" "Ethernet";

BA_ "GenSigStartValue" SG_ 73 OBJA_Protocol_Version 2;

VAL_ 73 OBJA_Angle_Front_Right_V_0 1 "VALID" 0 "INVALID" ;
VAL_ 73 OBJA_Angle_Front_Right_STD_V_0 1 "VALID" 0 "INVALID" ;
VAL_ 73 OBJA_Angle_Front_Left_V_0 1 "VALID" 0 "INVALID" ;
VAL_ 73 OBJA_Angle_Front_Left_STD_V_0 1 "VALID" 0 "INVALID" ;
VAL_ 73 OBJA_Angle_Rear_Right_V_0 1 "VALID" 0 "INVALID" ;
VAL_ 73 OBJA_Angle_Rear_Right_STD_V_0 1 "VALID" 0 "INVALID" ;
VAL_ 73 OBJA_Angle_Rear_Left_V_0 1 "VALID" 0 "INVALID" ;
VAL_ 73 OBJA_Angle_Rear_Left_STD_V_0 1 "VALID" 0 "INVALID" ;
VAL_ 73 OBJA_Angle_Rear_Mid_V_0 1 "VALID" 0 "INVALID" ;
VAL_ 73 OBJA_Angle_Rear_Mid_STD_V_0 1 "VALID" 0 "INVALID" ;
VAL_ 73 OBJA_Angle_Rear_Mid_Rate_V_0 1 "VALID" 0 "INVALID" ;
VAL_ 73 OBJA_Angle_Rear_Mid_Rate_STD_V_0 1 "VALID" 0 "INVALID" ;
VAL_ 73 OBJA_Angle_Front_Right_Rate_V_0 1 "VALID" 0 "INVALID" ;
VAL_ 73 OBJA_Angle_Front_Right_Rate_STD_V_0 1 "VALID" 0 "INVALID" ;
VAL_ 73 OBJA_Angle_Front_Left_Rate_V_0 1 "VALID" 0 "INVALID" ;
VAL_ 73 OBJA_Angle_Front_Left_Rate_STD_V_0 1 "VALID" 0 "INVALID" ;
VAL_ 73 OBJA_Angle_Rear_Right_Rate_V_0 1 "VALID" 0 "INVALID" ;
VAL_ 73 OBJA_Angle_Rear_Right_Rate_STD_V_0 1 "VALID" 0 "INVALID" ;
VAL_ 73 OBJA_Angle_Rear_Left_Rate_V_0 1 "VALID" 0 "INVALID" ;
VAL_ 73 OBJA_Angle_Rear_Left_Rate_STD_V_0 1 "VALID" 0 "INVALID" ;
VAL_ 73 OBJA_Angle_Front_Right_V_1 1 "VALID" 0 "INVALID" ;
VAL_ 73 OBJA_Angle_Front_Right_STD_V_1 1 "VALID" 0 "INVALID" ;
VAL_ 73 OBJA_Angle_Front_Left_V_1 1 "VALID" 0 "INVALID" ;
VAL_ 73 OBJA_Angle_Front_Left_STD_V_1 1 "VALID" 0 "INVALID" ;
VAL_ 73 OBJA_Angle_Rear_Right_V_1 1 "VALID" 0 "INVALID" ;
VAL_ 73 OBJA_Angle_Rear_Right_STD_V_1 1 "VALID" 0 "INVALID" ;
VAL_ 73 OBJA_Angle_Rear_Left_V_1 1 "VALID" 0 "INVALID" ;
VAL_ 73 OBJA_Angle_Rear_Left_STD_V_1 1 "VALID" 0 "INVALID" ;
VAL_ 73 OBJA_Angle_Rear_Mid_V_1 1 "VALID" 0 "INVALID" ;
VAL_ 73 OBJA_Angle_Rear_Mid_STD_V_1 1 "VALID" 0 "INVALID" ;
VAL_ 73 OBJA_Angle_Rear_Mid_Rate_V_1 1 "VALID" 0 "INVALID" ;
VAL_ 73 OBJA_Angle_Rear_Mid_Rate_STD_V_1 1 "VALID" 0 "INVALID" ;
VAL_ 73 OBJA_Angle_Front_Right_Rate_V_1 1 "VALID" 0 "INVALID" ;
VAL_ 73 OBJA_Angle_Front_Right_Rate_STD_V_1 1 "VALID" 0 "INVALID" ;
VAL_ 73 OBJA_Angle_Front_Left_Rate_V_1 1 "VALID" 0 "INVALID" ;
VAL_ 73 OBJA_Angle_Front_Left_Rate_STD_V_1 1 "VALID" 0 "INVALID" ;
VAL_ 73 OBJA_Angle_Rear_Right_Rate_V_1 1 "VALID" 0 "INVALID" ;
VAL_ 73 OBJA_Angle_Rear_Right_Rate_STD_V_1 1 "VALID" 0 "INVALID" ;
VAL_ 73 OBJA_Angle_Rear_Left_Rate_V_1 1 "VALID" 0 "INVALID" ;
VAL_ 73 OBJA_Angle_Rear_Left_Rate_STD_V_1 1 "VALID" 0 "INVALID" ;
VAL_ 73 OBJA_Angle_Front_Right_V_2 1 "VALID" 0 "INVALID" ;
VAL_ 73 OBJA_Angle_Front_Right_STD_V_2 1 "VALID" 0 "INVALID" ;
VAL_ 73 OBJA_Angle_Front_Left_V_2 1 "VALID" 0 "INVALID" ;
VAL_ 73 OBJA_Angle_Front_Left_STD_V_2 1 "VALID" 0 "INVALID" ;
VAL_ 73 OBJA_Angle_Rear_Right_V_2 1 "VALID" 0 "INVALID" ;
VAL_ 73 OBJA_Angle_Rear_Right_STD_V_2 1 "VALID" 0 "INVALID" ;
VAL_ 73 OBJA_Angle_Rear_Left_V_2 1 "VALID" 0 "INVALID" ;
VAL_ 73 OBJA_Angle_Rear_Left_STD_V_2 1 "VALID" 0 "INVALID" ;
VAL_ 73 OBJA_Angle_Rear_Mid_V_2 1 "VALID" 0 "INVALID" ;
VAL_ 73 OBJA_Angle_Rear_Mid_STD_V_2 1 "VALID" 0 "INVALID" ;
VAL_ 73 OBJA_Angle_Rear_Mid_Rate_V_2 1 "VALID" 0 "INVALID" ;
VAL_ 73 OBJA_Angle_Rear_Mid_Rate_STD_V_2 1 "VALID" 0 "INVALID" ;
VAL_ 73 OBJA_Angle_Front_Right_Rate_V_2 1 "VALID" 0 "INVALID" ;
VAL_ 73 OBJA_Angle_Front_Right_Rate_STD_V_2 1 "VALID" 0 "INVALID" ;
VAL_ 73 OBJA_Angle_Front_Left_Rate_V_2 1 "VALID" 0 "INVALID" ;
VAL_ 73 OBJA_Angle_Front_Left_Rate_STD_V_2 1 "VALID" 0 "INVALID" ;
VAL_ 73 OBJA_Angle_Rear_Right_Rate_V_2 1 "VALID" 0 "INVALID" ;
VAL_ 73 OBJA_Angle_Rear_Right_Rate_STD_V_2 1 "VALID" 0 "INVALID" ;
VAL_ 73 OBJA_Angle_Rear_Left_Rate_V_2 1 "VALID" 0 "INVALID" ;
VAL_ 73 OBJA_Angle_Rear_Left_Rate_STD_V_2 1 "VALID" 0 "INVALID" ;
VAL_ 73 OBJA_Angle_Front_Right_V_3 1 "VALID" 0 "INVALID" ;
VAL_ 73 OBJA_Angle_Front_Right_STD_V_3 1 "VALID" 0 "INVALID" ;
VAL_ 73 OBJA_Angle_Front_Left_V_3 1 "VALID" 0 "INVALID" ;
VAL_ 73 OBJA_Angle_Front_Left_STD_V_3 1 "VALID" 0 "INVALID" ;
VAL_ 73 OBJA_Angle_Rear_Right_V_3 1 "VALID" 0 "INVALID" ;
VAL_ 73 OBJA_Angle_Rear_Right_STD_V_3 1 "VALID" 0 "INVALID" ;
VAL_ 73 OBJA_Angle_Rear_Left_V_3 1 "VALID" 0 "INVALID" ;
VAL_ 73 OBJA_Angle_Rear_Left_STD_V_3 1 "VALID" 0 "INVALID" ;
VAL_ 73 OBJA_Angle_Rear_Mid_V_3 1 "VALID" 0 "INVALID" ;
VAL_ 73 OBJA_Angle_Rear_Mid_STD_V_3 1 "VALID" 0 "INVALID" ;
VAL_ 73 OBJA_Angle_Rear_Mid_Rate_V_3 1 "VALID" 0 "INVALID" ;
VAL_ 73 OBJA_Angle_Rear_Mid_Rate_STD_V_3 1 "VALID" 0 "INVALID" ;
VAL_ 73 OBJA_Angle_Front_Right_Rate_V_3 1 "VALID" 0 "INVALID" ;
VAL_ 73 OBJA_Angle_Front_Right_Rate_STD_V_3 1 "VALID" 0 "INVALID" ;
VAL_ 73 OBJA_Angle_Front_Left_Rate_V_3 1 "VALID" 0 "INVALID" ;
VAL_ 73 OBJA_Angle_Front_Left_Rate_STD_V_3 1 "VALID" 0 "INVALID" ;
VAL_ 73 OBJA_Angle_Rear_Right_Rate_V_3 1 "VALID" 0 "INVALID" ;
VAL_ 73 OBJA_Angle_Rear_Right_Rate_STD_V_3 1 "VALID" 0 "INVALID" ;
VAL_ 73 OBJA_Angle_Rear_Left_Rate_V_3 1 "VALID" 0 "INVALID" ;
VAL_ 73 OBJA_Angle_Rear_Left_Rate_STD_V_3 1 "VALID" 0 "INVALID" ;
VAL_ 73 OBJA_Angle_Front_Right_V_4 1 "VALID" 0 "INVALID" ;
VAL_ 73 OBJA_Angle_Front_Right_STD_V_4 1 "VALID" 0 "INVALID" ;
VAL_ 73 OBJA_Angle_Front_Left_V_4 1 "VALID" 0 "INVALID" ;
VAL_ 73 OBJA_Angle_Front_Left_STD_V_4 1 "VALID" 0 "INVALID" ;
VAL_ 73 OBJA_Angle_Rear_Right_V_4 1 "VALID" 0 "INVALID" ;
VAL_ 73 OBJA_Angle_Rear_Right_STD_V_4 1 "VALID" 0 "INVALID" ;
VAL_ 73 OBJA_Angle_Rear_Left_V_4 1 "VALID" 0 "INVALID" ;
VAL_ 73 OBJA_Angle_Rear_Left_STD_V_4 1 "VALID" 0 "INVALID" ;
VAL_ 73 OBJA_Angle_Rear_Mid_V_4 1 "VALID" 0 "INVALID" ;
VAL_ 73 OBJA_Angle_Rear_Mid_STD_V_4 1 "VALID" 0 "INVALID" ;
VAL_ 73 OBJA_Angle_Rear_Mid_Rate_V_4 1 "VALID" 0 "INVALID" ;
VAL_ 73 OBJA_Angle_Rear_Mid_Rate_STD_V_4 1 "VALID" 0 "INVALID" ;
VAL_ 73 OBJA_Angle_Front_Right_Rate_V_4 1 "VALID" 0 "INVALID" ;
VAL_ 73 OBJA_Angle_Front_Right_Rate_STD_V_4 1 "VALID" 0 "INVALID" ;
VAL_ 73 OBJA_Angle_Front_Left_Rate_V_4 1 "VALID" 0 "INVALID" ;
VAL_ 73 OBJA_Angle_Front_Left_Rate_STD_V_4 1 "VALID" 0 "INVALID" ;
VAL_ 73 OBJA_Angle_Rear_Right_Rate_V_4 1 "VALID" 0 "INVALID" ;
VAL_ 73 OBJA_Angle_Rear_Right_Rate_STD_V_4 1 "VALID" 0 "INVALID" ;
VAL_ 73 OBJA_Angle_Rear_Left_Rate_V_4 1 "VALID" 0 "INVALID" ;
VAL_ 73 OBJA_Angle_Rear_Left_Rate_STD_V_4 1 "VALID" 0 "INVALID" ;
VAL_ 73 OBJA_Angle_Front_Right_V_5 1 "VALID" 0 "INVALID" ;
VAL_ 73 OBJA_Angle_Front_Right_STD_V_5 1 "VALID" 0 "INVALID" ;
VAL_ 73 OBJA_Angle_Front_Left_V_5 1 "VALID" 0 "INVALID" ;
VAL_ 73 OBJA_Angle_Front_Left_STD_V_5 1 "VALID" 0 "INVALID" ;
VAL_ 73 OBJA_Angle_Rear_Right_V_5 1 "VALID" 0 "INVALID" ;
VAL_ 73 OBJA_Angle_Rear_Right_STD_V_5 1 "VALID" 0 "INVALID" ;
VAL_ 73 OBJA_Angle_Rear_Left_V_5 1 "VALID" 0 "INVALID" ;
VAL_ 73 OBJA_Angle_Rear_Left_STD_V_5 1 "VALID" 0 "INVALID" ;
VAL_ 73 OBJA_Angle_Rear_Mid_V_5 1 "VALID" 0 "INVALID" ;
VAL_ 73 OBJA_Angle_Rear_Mid_STD_V_5 1 "VALID" 0 "INVALID" ;
VAL_ 73 OBJA_Angle_Rear_Mid_Rate_V_5 1 "VALID" 0 "INVALID" ;
VAL_ 73 OBJA_Angle_Rear_Mid_Rate_STD_V_5 1 "VALID" 0 "INVALID" ;
VAL_ 73 OBJA_Angle_Front_Right_Rate_V_5 1 "VALID" 0 "INVALID" ;
VAL_ 73 OBJA_Angle_Front_Right_Rate_STD_V_5 1 "VALID" 0 "INVALID" ;
VAL_ 73 OBJA_Angle_Front_Left_Rate_V_5 1 "VALID" 0 "INVALID" ;
VAL_ 73 OBJA_Angle_Front_Left_Rate_STD_V_5 1 "VALID" 0 "INVALID" ;
VAL_ 73 OBJA_Angle_Rear_Right_Rate_V_5 1 "VALID" 0 "INVALID" ;
VAL_ 73 OBJA_Angle_Rear_Right_Rate_STD_V_5 1 "VALID" 0 "INVALID" ;
VAL_ 73 OBJA_Angle_Rear_Left_Rate_V_5 1 "VALID" 0 "INVALID" ;
VAL_ 73 OBJA_Angle_Rear_Left_Rate_STD_V_5 1 "VALID" 0 "INVALID" ;
VAL_ 73 OBJA_Angle_Front_Right_V_6 1 "VALID" 0 "INVALID" ;
VAL_ 73 OBJA_Angle_Front_Right_STD_V_6 1 "VALID" 0 "INVALID" ;
VAL_ 73 OBJA_Angle_Front_Left_V_6 1 "VALID" 0 "INVALID" ;
VAL_ 73 OBJA_Angle_Front_Left_STD_V_6 1 "VALID" 0 "INVALID" ;
VAL_ 73 OBJA_Angle_Rear_Right_V_6 1 "VALID" 0 "INVALID" ;
VAL_ 73 OBJA_Angle_Rear_Right_STD_V_6 1 "VALID" 0 "INVALID" ;
VAL_ 73 OBJA_Angle_Rear_Left_V_6 1 "VALID" 0 "INVALID" ;
VAL_ 73 OBJA_Angle_Rear_Left_STD_V_6 1 "VALID" 0 "INVALID" ;
VAL_ 73 OBJA_Angle_Rear_Mid_V_6 1 "VALID" 0 "INVALID" ;
VAL_ 73 OBJA_Angle_Rear_Mid_STD_V_6 1 "VALID" 0 "INVALID" ;
VAL_ 73 OBJA_Angle_Rear_Mid_Rate_V_6 1 "VALID" 0 "INVALID" ;
VAL_ 73 OBJA_Angle_Rear_Mid_Rate_STD_V_6 1 "VALID" 0 "INVALID" ;
VAL_ 73 OBJA_Angle_Front_Right_Rate_V_6 1 "VALID" 0 "INVALID" ;
VAL_ 73 OBJA_Angle_Front_Right_Rate_STD_V_6 1 "VALID" 0 "INVALID" ;
VAL_ 73 OBJA_Angle_Front_Left_Rate_V_6 1 "VALID" 0 "INVALID" ;
VAL_ 73 OBJA_Angle_Front_Left_Rate_STD_V_6 1 "VALID" 0 "INVALID" ;
VAL_ 73 OBJA_Angle_Rear_Right_Rate_V_6 1 "VALID" 0 "INVALID" ;
VAL_ 73 OBJA_Angle_Rear_Right_Rate_STD_V_6 1 "VALID" 0 "INVALID" ;
VAL_ 73 OBJA_Angle_Rear_Left_Rate_V_6 1 "VALID" 0 "INVALID" ;
VAL_ 73 OBJA_Angle_Rear_Left_Rate_STD_V_6 1 "VALID" 0 "INVALID" ;
VAL_ 73 OBJA_Angle_Front_Right_V_7 1 "VALID" 0 "INVALID" ;
VAL_ 73 OBJA_Angle_Front_Right_STD_V_7 1 "VALID" 0 "INVALID" ;
VAL_ 73 OBJA_Angle_Front_Left_V_7 1 "VALID" 0 "INVALID" ;
VAL_ 73 OBJA_Angle_Front_Left_STD_V_7 1 "VALID" 0 "INVALID" ;
VAL_ 73 OBJA_Angle_Rear_Right_V_7 1 "VALID" 0 "INVALID" ;
VAL_ 73 OBJA_Angle_Rear_Right_STD_V_7 1 "VALID" 0 "INVALID" ;
VAL_ 73 OBJA_Angle_Rear_Left_V_7 1 "VALID" 0 "INVALID" ;
VAL_ 73 OBJA_Angle_Rear_Left_STD_V_7 1 "VALID" 0 "INVALID" ;
VAL_ 73 OBJA_Angle_Rear_Mid_V_7 1 "VALID" 0 "INVALID" ;
VAL_ 73 OBJA_Angle_Rear_Mid_STD_V_7 1 "VALID" 0 "INVALID" ;
VAL_ 73 OBJA_Angle_Rear_Mid_Rate_V_7 1 "VALID" 0 "INVALID" ;
VAL_ 73 OBJA_Angle_Rear_Mid_Rate_STD_V_7 1 "VALID" 0 "INVALID" ;
VAL_ 73 OBJA_Angle_Front_Right_Rate_V_7 1 "VALID" 0 "INVALID" ;
VAL_ 73 OBJA_Angle_Front_Right_Rate_STD_V_7 1 "VALID" 0 "INVALID" ;
VAL_ 73 OBJA_Angle_Front_Left_Rate_V_7 1 "VALID" 0 "INVALID" ;
VAL_ 73 OBJA_Angle_Front_Left_Rate_STD_V_7 1 "VALID" 0 "INVALID" ;
VAL_ 73 OBJA_Angle_Rear_Right_Rate_V_7 1 "VALID" 0 "INVALID" ;
VAL_ 73 OBJA_Angle_Rear_Right_Rate_STD_V_7 1 "VALID" 0 "INVALID" ;
VAL_ 73 OBJA_Angle_Rear_Left_Rate_V_7 1 "VALID" 0 "INVALID" ;
VAL_ 73 OBJA_Angle_Rear_Left_Rate_STD_V_7 1 "VALID" 0 "INVALID" ;
VAL_ 73 OBJA_Angle_Front_Right_V_8 1 "VALID" 0 "INVALID" ;
VAL_ 73 OBJA_Angle_Front_Right_STD_V_8 1 "VALID" 0 "INVALID" ;
VAL_ 73 OBJA_Angle_Front_Left_V_8 1 "VALID" 0 "INVALID" ;
VAL_ 73 OBJA_Angle_Front_Left_STD_V_8 1 "VALID" 0 "INVALID" ;
VAL_ 73 OBJA_Angle_Rear_Right_V_8 1 "VALID" 0 "INVALID" ;
VAL_ 73 OBJA_Angle_Rear_Right_STD_V_8 1 "VALID" 0 "INVALID" ;
VAL_ 73 OBJA_Angle_Rear_Left_V_8 1 "VALID" 0 "INVALID" ;
VAL_ 73 OBJA_Angle_Rear_Left_STD_V_8 1 "VALID" 0 "INVALID" ;
VAL_ 73 OBJA_Angle_Rear_Mid_V_8 1 "VALID" 0 "INVALID" ;
VAL_ 73 OBJA_Angle_Rear_Mid_STD_V_8 1 "VALID" 0 "INVALID" ;
VAL_ 73 OBJA_Angle_Rear_Mid_Rate_V_8 1 "VALID" 0 "INVALID" ;
VAL_ 73 OBJA_Angle_Rear_Mid_Rate_STD_V_8 1 "VALID" 0 "INVALID" ;
VAL_ 73 OBJA_Angle_Front_Right_Rate_V_8 1 "VALID" 0 "INVALID" ;
VAL_ 73 OBJA_Angle_Front_Right_Rate_STD_V_8 1 "VALID" 0 "INVALID" ;
VAL_ 73 OBJA_Angle_Front_Left_Rate_V_8 1 "VALID" 0 "INVALID" ;
VAL_ 73 OBJA_Angle_Front_Left_Rate_STD_V_8 1 "VALID" 0 "INVALID" ;
VAL_ 73 OBJA_Angle_Rear_Right_Rate_V_8 1 "VALID" 0 "INVALID" ;
VAL_ 73 OBJA_Angle_Rear_Right_Rate_STD_V_8 1 "VALID" 0 "INVALID" ;
VAL_ 73 OBJA_Angle_Rear_Left_Rate_V_8 1 "VALID" 0 "INVALID" ;
VAL_ 73 OBJA_Angle_Rear_Left_Rate_STD_V_8 1 "VALID" 0 "INVALID" ;
VAL_ 73 OBJA_Angle_Front_Right_V_9 1 "VALID" 0 "INVALID" ;
VAL_ 73 OBJA_Angle_Front_Right_STD_V_9 1 "VALID" 0 "INVALID" ;
VAL_ 73 OBJA_Angle_Front_Left_V_9 1 "VALID" 0 "INVALID" ;
VAL_ 73 OBJA_Angle_Front_Left_STD_V_9 1 "VALID" 0 "INVALID" ;
VAL_ 73 OBJA_Angle_Rear_Right_V_9 1 "VALID" 0 "INVALID" ;
VAL_ 73 OBJA_Angle_Rear_Right_STD_V_9 1 "VALID" 0 "INVALID" ;
VAL_ 73 OBJA_Angle_Rear_Left_V_9 1 "VALID" 0 "INVALID" ;
VAL_ 73 OBJA_Angle_Rear_Left_STD_V_9 1 "VALID" 0 "INVALID" ;
VAL_ 73 OBJA_Angle_Rear_Mid_V_9 1 "VALID" 0 "INVALID" ;
VAL_ 73 OBJA_Angle_Rear_Mid_STD_V_9 1 "VALID" 0 "INVALID" ;
VAL_ 73 OBJA_Angle_Rear_Mid_Rate_V_9 1 "VALID" 0 "INVALID" ;
VAL_ 73 OBJA_Angle_Rear_Mid_Rate_STD_V_9 1 "VALID" 0 "INVALID" ;
VAL_ 73 OBJA_Angle_Front_Right_Rate_V_9 1 "VALID" 0 "INVALID" ;
VAL_ 73 OBJA_Angle_Front_Right_Rate_STD_V_9 1 "VALID" 0 "INVALID" ;
VAL_ 73 OBJA_Angle_Front_Left_Rate_V_9 1 "VALID" 0 "INVALID" ;
VAL_ 73 OBJA_Angle_Front_Left_Rate_STD_V_9 1 "VALID" 0 "INVALID" ;
VAL_ 73 OBJA_Angle_Rear_Right_Rate_V_9 1 "VALID" 0 "INVALID" ;
VAL_ 73 OBJA_Angle_Rear_Right_Rate_STD_V_9 1 "VALID" 0 "INVALID" ;
VAL_ 73 OBJA_Angle_Rear_Left_Rate_V_9 1 "VALID" 0 "INVALID" ;
VAL_ 73 OBJA_Angle_Rear_Left_Rate_STD_V_9 1 "VALID" 0 "INVALID" ;
VAL_ 73 OBJA_Angle_Front_Right_V_10 1 "VALID" 0 "INVALID" ;
VAL_ 73 OBJA_Angle_Front_Right_STD_V_10 1 "VALID" 0 "INVALID" ;
VAL_ 73 OBJA_Angle_Front_Left_V_10 1 "VALID" 0 "INVALID" ;
VAL_ 73 OBJA_Angle_Front_Left_STD_V_10 1 "VALID" 0 "INVALID" ;
VAL_ 73 OBJA_Angle_Rear_Right_V_10 1 "VALID" 0 "INVALID" ;
VAL_ 73 OBJA_Angle_Rear_Right_STD_V_10 1 "VALID" 0 "INVALID" ;
VAL_ 73 OBJA_Angle_Rear_Left_V_10 1 "VALID" 0 "INVALID" ;
VAL_ 73 OBJA_Angle_Rear_Left_STD_V_10 1 "VALID" 0 "INVALID" ;
VAL_ 73 OBJA_Angle_Rear_Mid_V_10 1 "VALID" 0 "INVALID" ;
VAL_ 73 OBJA_Angle_Rear_Mid_STD_V_10 1 "VALID" 0 "INVALID" ;
VAL_ 73 OBJA_Angle_Rear_Mid_Rate_V_10 1 "VALID" 0 "INVALID" ;
VAL_ 73 OBJA_Angle_Rear_Mid_Rate_STD_V_10 1 "VALID" 0 "INVALID" ;
VAL_ 73 OBJA_Angle_Front_Right_Rate_V_10 1 "VALID" 0 "INVALID" ;
VAL_ 73 OBJA_Angle_Front_Right_Rate_STD_V_10 1 "VALID" 0 "INVALID" ;
VAL_ 73 OBJA_Angle_Front_Left_Rate_V_10 1 "VALID" 0 "INVALID" ;
VAL_ 73 OBJA_Angle_Front_Left_Rate_STD_V_10 1 "VALID" 0 "INVALID" ;
VAL_ 73 OBJA_Angle_Rear_Right_Rate_V_10 1 "VALID" 0 "INVALID" ;
VAL_ 73 OBJA_Angle_Rear_Right_Rate_STD_V_10 1 "VALID" 0 "INVALID" ;
VAL_ 73 OBJA_Angle_Rear_Left_Rate_V_10 1 "VALID" 0 "INVALID" ;
VAL_ 73 OBJA_Angle_Rear_Left_Rate_STD_V_10 1 "VALID" 0 "INVALID" ;
VAL_ 73 OBJA_Angle_Front_Right_V_11 1 "VALID" 0 "INVALID" ;
VAL_ 73 OBJA_Angle_Front_Right_STD_V_11 1 "VALID" 0 "INVALID" ;
VAL_ 73 OBJA_Angle_Front_Left_V_11 1 "VALID" 0 "INVALID" ;
VAL_ 73 OBJA_Angle_Front_Left_STD_V_11 1 "VALID" 0 "INVALID" ;
VAL_ 73 OBJA_Angle_Rear_Right_V_11 1 "VALID" 0 "INVALID" ;
VAL_ 73 OBJA_Angle_Rear_Right_STD_V_11 1 "VALID" 0 "INVALID" ;
VAL_ 73 OBJA_Angle_Rear_Left_V_11 1 "VALID" 0 "INVALID" ;
VAL_ 73 OBJA_Angle_Rear_Left_STD_V_11 1 "VALID" 0 "INVALID" ;
VAL_ 73 OBJA_Angle_Rear_Mid_V_11 1 "VALID" 0 "INVALID" ;
VAL_ 73 OBJA_Angle_Rear_Mid_STD_V_11 1 "VALID" 0 "INVALID" ;
VAL_ 73 OBJA_Angle_Rear_Mid_Rate_V_11 1 "VALID" 0 "INVALID" ;
VAL_ 73 OBJA_Angle_Rear_Mid_Rate_STD_V_11 1 "VALID" 0 "INVALID" ;
VAL_ 73 OBJA_Angle_Front_Right_Rate_V_11 1 "VALID" 0 "INVALID" ;
VAL_ 73 OBJA_Angle_Front_Right_Rate_STD_V_11 1 "VALID" 0 "INVALID" ;
VAL_ 73 OBJA_Angle_Front_Left_Rate_V_11 1 "VALID" 0 "INVALID" ;
VAL_ 73 OBJA_Angle_Front_Left_Rate_STD_V_11 1 "VALID" 0 "INVALID" ;
VAL_ 73 OBJA_Angle_Rear_Right_Rate_V_11 1 "VALID" 0 "INVALID" ;
VAL_ 73 OBJA_Angle_Rear_Right_Rate_STD_V_11 1 "VALID" 0 "INVALID" ;
VAL_ 73 OBJA_Angle_Rear_Left_Rate_V_11 1 "VALID" 0 "INVALID" ;
VAL_ 73 OBJA_Angle_Rear_Left_Rate_STD_V_11 1 "VALID" 0 "INVALID" ;
VAL_ 73 OBJA_Angle_Front_Right_V_12 1 "VALID" 0 "INVALID" ;
VAL_ 73 OBJA_Angle_Front_Right_STD_V_12 1 "VALID" 0 "INVALID" ;
VAL_ 73 OBJA_Angle_Front_Left_V_12 1 "VALID" 0 "INVALID" ;
VAL_ 73 OBJA_Angle_Front_Left_STD_V_12 1 "VALID" 0 "INVALID" ;
VAL_ 73 OBJA_Angle_Rear_Right_V_12 1 "VALID" 0 "INVALID" ;
VAL_ 73 OBJA_Angle_Rear_Right_STD_V_12 1 "VALID" 0 "INVALID" ;
VAL_ 73 OBJA_Angle_Rear_Left_V_12 1 "VALID" 0 "INVALID" ;
VAL_ 73 OBJA_Angle_Rear_Left_STD_V_12 1 "VALID" 0 "INVALID" ;
VAL_ 73 OBJA_Angle_Rear_Mid_V_12 1 "VALID" 0 "INVALID" ;
VAL_ 73 OBJA_Angle_Rear_Mid_STD_V_12 1 "VALID" 0 "INVALID" ;
VAL_ 73 OBJA_Angle_Rear_Mid_Rate_V_12 1 "VALID" 0 "INVALID" ;
VAL_ 73 OBJA_Angle_Rear_Mid_Rate_STD_V_12 1 "VALID" 0 "INVALID" ;
VAL_ 73 OBJA_Angle_Front_Right_Rate_V_12 1 "VALID" 0 "INVALID" ;
VAL_ 73 OBJA_Angle_Front_Right_Rate_STD_V_12 1 "VALID" 0 "INVALID" ;
VAL_ 73 OBJA_Angle_Front_Left_Rate_V_12 1 "VALID" 0 "INVALID" ;
VAL_ 73 OBJA_Angle_Front_Left_Rate_STD_V_12 1 "VALID" 0 "INVALID" ;
VAL_ 73 OBJA_Angle_Rear_Right_Rate_V_12 1 "VALID" 0 "INVALID" ;
VAL_ 73 OBJA_Angle_Rear_Right_Rate_STD_V_12 1 "VALID" 0 "INVALID" ;
VAL_ 73 OBJA_Angle_Rear_Left_Rate_V_12 1 "VALID" 0 "INVALID" ;
VAL_ 73 OBJA_Angle_Rear_Left_Rate_STD_V_12 1 "VALID" 0 "INVALID" ;
VAL_ 73 OBJA_Angle_Front_Right_V_13 1 "VALID" 0 "INVALID" ;
VAL_ 73 OBJA_Angle_Front_Right_STD_V_13 1 "VALID" 0 "INVALID" ;
VAL_ 73 OBJA_Angle_Front_Left_V_13 1 "VALID" 0 "INVALID" ;
VAL_ 73 OBJA_Angle_Front_Left_STD_V_13 1 "VALID" 0 "INVALID" ;
VAL_ 73 OBJA_Angle_Rear_Right_V_13 1 "VALID" 0 "INVALID" ;
VAL_ 73 OBJA_Angle_Rear_Right_STD_V_13 1 "VALID" 0 "INVALID" ;
VAL_ 73 OBJA_Angle_Rear_Left_V_13 1 "VALID" 0 "INVALID" ;
VAL_ 73 OBJA_Angle_Rear_Left_STD_V_13 1 "VALID" 0 "INVALID" ;
VAL_ 73 OBJA_Angle_Rear_Mid_V_13 1 "VALID" 0 "INVALID" ;
VAL_ 73 OBJA_Angle_Rear_Mid_STD_V_13 1 "VALID" 0 "INVALID" ;
VAL_ 73 OBJA_Angle_Rear_Mid_Rate_V_13 1 "VALID" 0 "INVALID" ;
VAL_ 73 OBJA_Angle_Rear_Mid_Rate_STD_V_13 1 "VALID" 0 "INVALID" ;
VAL_ 73 OBJA_Angle_Front_Right_Rate_V_13 1 "VALID" 0 "INVALID" ;
VAL_ 73 OBJA_Angle_Front_Right_Rate_STD_V_13 1 "VALID" 0 "INVALID" ;
VAL_ 73 OBJA_Angle_Front_Left_Rate_V_13 1 "VALID" 0 "INVALID" ;
VAL_ 73 OBJA_Angle_Front_Left_Rate_STD_V_13 1 "VALID" 0 "INVALID" ;
VAL_ 73 OBJA_Angle_Rear_Right_Rate_V_13 1 "VALID" 0 "INVALID" ;
VAL_ 73 OBJA_Angle_Rear_Right_Rate_STD_V_13 1 "VALID" 0 "INVALID" ;
VAL_ 73 OBJA_Angle_Rear_Left_Rate_V_13 1 "VALID" 0 "INVALID" ;
VAL_ 73 OBJA_Angle_Rear_Left_Rate_STD_V_13 1 "VALID" 0 "INVALID" ;
VAL_ 73 OBJA_Angle_Front_Right_V_14 1 "VALID" 0 "INVALID" ;
VAL_ 73 OBJA_Angle_Front_Right_STD_V_14 1 "VALID" 0 "INVALID" ;
VAL_ 73 OBJA_Angle_Front_Left_V_14 1 "VALID" 0 "INVALID" ;
VAL_ 73 OBJA_Angle_Front_Left_STD_V_14 1 "VALID" 0 "INVALID" ;
VAL_ 73 OBJA_Angle_Rear_Right_V_14 1 "VALID" 0 "INVALID" ;
VAL_ 73 OBJA_Angle_Rear_Right_STD_V_14 1 "VALID" 0 "INVALID" ;
VAL_ 73 OBJA_Angle_Rear_Left_V_14 1 "VALID" 0 "INVALID" ;
VAL_ 73 OBJA_Angle_Rear_Left_STD_V_14 1 "VALID" 0 "INVALID" ;
VAL_ 73 OBJA_Angle_Rear_Mid_V_14 1 "VALID" 0 "INVALID" ;
VAL_ 73 OBJA_Angle_Rear_Mid_STD_V_14 1 "VALID" 0 "INVALID" ;
VAL_ 73 OBJA_Angle_Rear_Mid_Rate_V_14 1 "VALID" 0 "INVALID" ;
VAL_ 73 OBJA_Angle_Rear_Mid_Rate_STD_V_14 1 "VALID" 0 "INVALID" ;
VAL_ 73 OBJA_Angle_Front_Right_Rate_V_14 1 "VALID" 0 "INVALID" ;
VAL_ 73 OBJA_Angle_Front_Right_Rate_STD_V_14 1 "VALID" 0 "INVALID" ;
VAL_ 73 OBJA_Angle_Front_Left_Rate_V_14 1 "VALID" 0 "INVALID" ;
VAL_ 73 OBJA_Angle_Front_Left_Rate_STD_V_14 1 "VALID" 0 "INVALID" ;
VAL_ 73 OBJA_Angle_Rear_Right_Rate_V_14 1 "VALID" 0 "INVALID" ;
VAL_ 73 OBJA_Angle_Rear_Right_Rate_STD_V_14 1 "VALID" 0 "INVALID" ;
VAL_ 73 OBJA_Angle_Rear_Left_Rate_V_14 1 "VALID" 0 "INVALID" ;
VAL_ 73 OBJA_Angle_Rear_Left_Rate_STD_V_14 1 "VALID" 0 "INVALID" ;
VAL_ 73 OBJA_Angle_Front_Right_V_15 1 "VALID" 0 "INVALID" ;
VAL_ 73 OBJA_Angle_Front_Right_STD_V_15 1 "VALID" 0 "INVALID" ;
VAL_ 73 OBJA_Angle_Front_Left_V_15 1 "VALID" 0 "INVALID" ;
VAL_ 73 OBJA_Angle_Front_Left_STD_V_15 1 "VALID" 0 "INVALID" ;
VAL_ 73 OBJA_Angle_Rear_Right_V_15 1 "VALID" 0 "INVALID" ;
VAL_ 73 OBJA_Angle_Rear_Right_STD_V_15 1 "VALID" 0 "INVALID" ;
VAL_ 73 OBJA_Angle_Rear_Left_V_15 1 "VALID" 0 "INVALID" ;
VAL_ 73 OBJA_Angle_Rear_Left_STD_V_15 1 "VALID" 0 "INVALID" ;
VAL_ 73 OBJA_Angle_Rear_Mid_V_15 1 "VALID" 0 "INVALID" ;
VAL_ 73 OBJA_Angle_Rear_Mid_STD_V_15 1 "VALID" 0 "INVALID" ;
VAL_ 73 OBJA_Angle_Rear_Mid_Rate_V_15 1 "VALID" 0 "INVALID" ;
VAL_ 73 OBJA_Angle_Rear_Mid_Rate_STD_V_15 1 "VALID" 0 "INVALID" ;
VAL_ 73 OBJA_Angle_Front_Right_Rate_V_15 1 "VALID" 0 "INVALID" ;
VAL_ 73 OBJA_Angle_Front_Right_Rate_STD_V_15 1 "VALID" 0 "INVALID" ;
VAL_ 73 OBJA_Angle_Front_Left_Rate_V_15 1 "VALID" 0 "INVALID" ;
VAL_ 73 OBJA_Angle_Front_Left_Rate_STD_V_15 1 "VALID" 0 "INVALID" ;
VAL_ 73 OBJA_Angle_Rear_Right_Rate_V_15 1 "VALID" 0 "INVALID" ;
VAL_ 73 OBJA_Angle_Rear_Right_Rate_STD_V_15 1 "VALID" 0 "INVALID" ;
VAL_ 73 OBJA_Angle_Rear_Left_Rate_V_15 1 "VALID" 0 "INVALID" ;
VAL_ 73 OBJA_Angle_Rear_Left_Rate_STD_V_15 1 "VALID" 0 "INVALID" ;
VAL_ 73 OBJA_Angle_Front_Right_V_16 1 "VALID" 0 "INVALID" ;
VAL_ 73 OBJA_Angle_Front_Right_STD_V_16 1 "VALID" 0 "INVALID" ;
VAL_ 73 OBJA_Angle_Front_Left_V_16 1 "VALID" 0 "INVALID" ;
VAL_ 73 OBJA_Angle_Front_Left_STD_V_16 1 "VALID" 0 "INVALID" ;
VAL_ 73 OBJA_Angle_Rear_Right_V_16 1 "VALID" 0 "INVALID" ;
VAL_ 73 OBJA_Angle_Rear_Right_STD_V_16 1 "VALID" 0 "INVALID" ;
VAL_ 73 OBJA_Angle_Rear_Left_V_16 1 "VALID" 0 "INVALID" ;
VAL_ 73 OBJA_Angle_Rear_Left_STD_V_16 1 "VALID" 0 "INVALID" ;
VAL_ 73 OBJA_Angle_Rear_Mid_V_16 1 "VALID" 0 "INVALID" ;
VAL_ 73 OBJA_Angle_Rear_Mid_STD_V_16 1 "VALID" 0 "INVALID" ;
VAL_ 73 OBJA_Angle_Rear_Mid_Rate_V_16 1 "VALID" 0 "INVALID" ;
VAL_ 73 OBJA_Angle_Rear_Mid_Rate_STD_V_16 1 "VALID" 0 "INVALID" ;
VAL_ 73 OBJA_Angle_Front_Right_Rate_V_16 1 "VALID" 0 "INVALID" ;
VAL_ 73 OBJA_Angle_Front_Right_Rate_STD_V_16 1 "VALID" 0 "INVALID" ;
VAL_ 73 OBJA_Angle_Front_Left_Rate_V_16 1 "VALID" 0 "INVALID" ;
VAL_ 73 OBJA_Angle_Front_Left_Rate_STD_V_16 1 "VALID" 0 "INVALID" ;
VAL_ 73 OBJA_Angle_Rear_Right_Rate_V_16 1 "VALID" 0 "INVALID" ;
VAL_ 73 OBJA_Angle_Rear_Right_Rate_STD_V_16 1 "VALID" 0 "INVALID" ;
VAL_ 73 OBJA_Angle_Rear_Left_Rate_V_16 1 "VALID" 0 "INVALID" ;
VAL_ 73 OBJA_Angle_Rear_Left_Rate_STD_V_16 1 "VALID" 0 "INVALID" ;
VAL_ 73 OBJA_Angle_Front_Right_V_17 1 "VALID" 0 "INVALID" ;
VAL_ 73 OBJA_Angle_Front_Right_STD_V_17 1 "VALID" 0 "INVALID" ;
VAL_ 73 OBJA_Angle_Front_Left_V_17 1 "VALID" 0 "INVALID" ;
VAL_ 73 OBJA_Angle_Front_Left_STD_V_17 1 "VALID" 0 "INVALID" ;
VAL_ 73 OBJA_Angle_Rear_Right_V_17 1 "VALID" 0 "INVALID" ;
VAL_ 73 OBJA_Angle_Rear_Right_STD_V_17 1 "VALID" 0 "INVALID" ;
VAL_ 73 OBJA_Angle_Rear_Left_V_17 1 "VALID" 0 "INVALID" ;
VAL_ 73 OBJA_Angle_Rear_Left_STD_V_17 1 "VALID" 0 "INVALID" ;
VAL_ 73 OBJA_Angle_Rear_Mid_V_17 1 "VALID" 0 "INVALID" ;
VAL_ 73 OBJA_Angle_Rear_Mid_STD_V_17 1 "VALID" 0 "INVALID" ;
VAL_ 73 OBJA_Angle_Rear_Mid_Rate_V_17 1 "VALID" 0 "INVALID" ;
VAL_ 73 OBJA_Angle_Rear_Mid_Rate_STD_V_17 1 "VALID" 0 "INVALID" ;
VAL_ 73 OBJA_Angle_Front_Right_Rate_V_17 1 "VALID" 0 "INVALID" ;
VAL_ 73 OBJA_Angle_Front_Right_Rate_STD_V_17 1 "VALID" 0 "INVALID" ;
VAL_ 73 OBJA_Angle_Front_Left_Rate_V_17 1 "VALID" 0 "INVALID" ;
VAL_ 73 OBJA_Angle_Front_Left_Rate_STD_V_17 1 "VALID" 0 "INVALID" ;
VAL_ 73 OBJA_Angle_Rear_Right_Rate_V_17 1 "VALID" 0 "INVALID" ;
VAL_ 73 OBJA_Angle_Rear_Right_Rate_STD_V_17 1 "VALID" 0 "INVALID" ;
VAL_ 73 OBJA_Angle_Rear_Left_Rate_V_17 1 "VALID" 0 "INVALID" ;
VAL_ 73 OBJA_Angle_Rear_Left_Rate_STD_V_17 1 "VALID" 0 "INVALID" ;
VAL_ 73 OBJA_Angle_Front_Right_V_18 1 "VALID" 0 "INVALID" ;
VAL_ 73 OBJA_Angle_Front_Right_STD_V_18 1 "VALID" 0 "INVALID" ;
VAL_ 73 OBJA_Angle_Front_Left_V_18 1 "VALID" 0 "INVALID" ;
VAL_ 73 OBJA_Angle_Front_Left_STD_V_18 1 "VALID" 0 "INVALID" ;
VAL_ 73 OBJA_Angle_Rear_Right_V_18 1 "VALID" 0 "INVALID" ;
VAL_ 73 OBJA_Angle_Rear_Right_STD_V_18 1 "VALID" 0 "INVALID" ;
VAL_ 73 OBJA_Angle_Rear_Left_V_18 1 "VALID" 0 "INVALID" ;
VAL_ 73 OBJA_Angle_Rear_Left_STD_V_18 1 "VALID" 0 "INVALID" ;
VAL_ 73 OBJA_Angle_Rear_Mid_V_18 1 "VALID" 0 "INVALID" ;
VAL_ 73 OBJA_Angle_Rear_Mid_STD_V_18 1 "VALID" 0 "INVALID" ;
VAL_ 73 OBJA_Angle_Rear_Mid_Rate_V_18 1 "VALID" 0 "INVALID" ;
VAL_ 73 OBJA_Angle_Rear_Mid_Rate_STD_V_18 1 "VALID" 0 "INVALID" ;
VAL_ 73 OBJA_Angle_Front_Right_Rate_V_18 1 "VALID" 0 "INVALID" ;
VAL_ 73 OBJA_Angle_Front_Right_Rate_STD_V_18 1 "VALID" 0 "INVALID" ;
VAL_ 73 OBJA_Angle_Front_Left_Rate_V_18 1 "VALID" 0 "INVALID" ;
VAL_ 73 OBJA_Angle_Front_Left_Rate_STD_V_18 1 "VALID" 0 "INVALID" ;
VAL_ 73 OBJA_Angle_Rear_Right_Rate_V_18 1 "VALID" 0 "INVALID" ;
VAL_ 73 OBJA_Angle_Rear_Right_Rate_STD_V_18 1 "VALID" 0 "INVALID" ;
VAL_ 73 OBJA_Angle_Rear_Left_Rate_V_18 1 "VALID" 0 "INVALID" ;
VAL_ 73 OBJA_Angle_Rear_Left_Rate_STD_V_18 1 "VALID" 0 "INVALID" ;
VAL_ 73 OBJA_Angle_Front_Right_V_19 1 "VALID" 0 "INVALID" ;
VAL_ 73 OBJA_Angle_Front_Right_STD_V_19 1 "VALID" 0 "INVALID" ;
VAL_ 73 OBJA_Angle_Front_Left_V_19 1 "VALID" 0 "INVALID" ;
VAL_ 73 OBJA_Angle_Front_Left_STD_V_19 1 "VALID" 0 "INVALID" ;
VAL_ 73 OBJA_Angle_Rear_Right_V_19 1 "VALID" 0 "INVALID" ;
VAL_ 73 OBJA_Angle_Rear_Right_STD_V_19 1 "VALID" 0 "INVALID" ;
VAL_ 73 OBJA_Angle_Rear_Left_V_19 1 "VALID" 0 "INVALID" ;
VAL_ 73 OBJA_Angle_Rear_Left_STD_V_19 1 "VALID" 0 "INVALID" ;
VAL_ 73 OBJA_Angle_Rear_Mid_V_19 1 "VALID" 0 "INVALID" ;
VAL_ 73 OBJA_Angle_Rear_Mid_STD_V_19 1 "VALID" 0 "INVALID" ;
VAL_ 73 OBJA_Angle_Rear_Mid_Rate_V_19 1 "VALID" 0 "INVALID" ;
VAL_ 73 OBJA_Angle_Rear_Mid_Rate_STD_V_19 1 "VALID" 0 "INVALID" ;
VAL_ 73 OBJA_Angle_Front_Right_Rate_V_19 1 "VALID" 0 "INVALID" ;
VAL_ 73 OBJA_Angle_Front_Right_Rate_STD_V_19 1 "VALID" 0 "INVALID" ;
VAL_ 73 OBJA_Angle_Front_Left_Rate_V_19 1 "VALID" 0 "INVALID" ;
VAL_ 73 OBJA_Angle_Front_Left_Rate_STD_V_19 1 "VALID" 0 "INVALID" ;
VAL_ 73 OBJA_Angle_Rear_Right_Rate_V_19 1 "VALID" 0 "INVALID" ;
VAL_ 73 OBJA_Angle_Rear_Right_Rate_STD_V_19 1 "VALID" 0 "INVALID" ;
VAL_ 73 OBJA_Angle_Rear_Left_Rate_V_19 1 "VALID" 0 "INVALID" ;
VAL_ 73 OBJA_Angle_Rear_Left_Rate_STD_V_19 1 "VALID" 0 "INVALID" ;
