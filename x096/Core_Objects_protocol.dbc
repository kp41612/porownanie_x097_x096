VERSION "14"
// BundelVersion=v4.20.10_RC1
NS_ :

BS_:

BU_: EyeQ4 MCU

BO_ 154 Core_Objects_protocol: 4660 EyeQ4
 SG_ OBJ_Is_VeryClose_28 : 26965|1@1+ (1,0) [0|1] "bool" MCU
 SG_ OBJ_Buffer_C4_28 : 26966|2@1+ (1,0) [0|2] "NA" MCU
 SG_ OBJ_Buffer_C5_28 : 26968|2@1+ (1,0) [0|2] "NA" MCU
 SG_ OBJ_Buffer_C6_28 : 26970|2@1+ (1,0) [0|2] "NA" MCU
 SG_ OBJ_Buffer_C7_28 : 26972|2@1+ (1,0) [0|2] "NA" MCU
 SG_ Reserved_21_28 : 26974|2@1+ (1,0) [0|0] "NA" MCU
 SG_ OBJ_OverlapAngleEgoLaneR_28 : 26976|10@1+ (0.01,-3.14) [-3.14|3.14] "rad" MCU
 SG_ OBJ_OverlapAngleEgoLaneR_V_28 : 26986|1@1+ (1,0) [0|1] "bool" MCU
 SG_ OBJ_OverlapAngleEgoLaneL_28 : 26987|10@1+ (0.01,-3.14) [-3.14|3.14] "rad" MCU
 SG_ OBJ_OverlapAngleEgoLaneL_V_28 : 26997|1@1+ (1,0) [0|1] "bool" MCU
 SG_ OBJ_Is_EMERGENCY_VCL_28 : 26998|1@1+ (1,0) [0|1] "bool" MCU
 SG_ OBJ_EMERGENCY_LIGHT_COLOR_28 : 26999|4@1+ (1,0) [0|15] "BITWIZE" MCU
 SG_ OBJ_EMERGENCY_V_28 : 27003|1@1+ (1,0) [0|1] "bool" MCU
 SG_ Reserved_22_28 : 27004|4@1+ (1,0) [0|0] "NA" MCU
 SG_ OBJ_Angle_Top_28 : 27008|14@1+ (0.0002,0) [0|3.1415] "rad" MCU
 SG_ OBJ_Angle_Top_V_28 : 27022|1@1+ (1,0) [0|1] "bool" MCU
 SG_ OBJ_Angle_Top_STD_28 : 27023|15@1+ (0.0001,0) [0|3.1415] "rad" MCU
 SG_ OBJ_Angle_Top_STD_V_28 : 27038|1@1+ (1,0) [0|1] "bool" MCU
 SG_ OBJ_Buffer_C14_28 : 27039|1@1+ (1,0) [0|1] "NA" MCU
 SG_ OBJ_Buffer_C15_28 : 27040|1@1+ (1,0) [0|1] "NA" MCU
 SG_ OBJ_Buffer_C18_28 : 27041|2@1+ (1,0) [0|2] "NA" MCU
 SG_ OBJ_Buffer_C19_28 : 27043|1@1+ (1,0) [0|1] "NA" MCU
 SG_ Reserved_23_28 : 27044|28@1+ (1,0) [0|0] "NA" MCU
 SG_ OBJ_CRC_29 : 27072|32@1+ (1,0) [0|4294967295] "NA" MCU
 SG_ OBJ_ID_29 : 27104|8@1+ (1,0) [0|255] "counter" MCU
 SG_ OBJ_Existence_Probability_29 : 27112|8@1+ (0.01,0) [0|1] "NA" MCU
 SG_ OBJ_Fusion_Source_29 : 27120|16@1+ (1,0) [0|65535] "BITWIZE" MCU
 SG_ OBJ_Triggered_SDM_29 : 27136|2@1+ (1,0) [0|2] "ENUM" MCU
 SG_ OBJ_Motion_Category_29 : 27138|4@1+ (1,0) [0|13] "ENUM" MCU
 SG_ OBJ_Buffer_C0_29 : 27142|7@1+ (0.01,0) [0|1] "NA" MCU
 SG_ OBJ_Object_Age_29 : 27149|11@1+ (1,0) [0|2047] "frames" MCU
 SG_ OBJ_Measuring_Status_29 : 27160|3@1+ (1,0) [0|7] "BITWIZE" MCU
 SG_ OBJ_Object_Class_29 : 27163|4@1+ (1,0) [0|8] "ENUM" MCU
 SG_ Reserved_4_29 : 27167|1@1+ (1,0) [0|0] "NA" MCU
 SG_ OBJ_Class_Probability_29 : 27168|7@1+ (0.01,0) [0|1] "NA" MCU
 SG_ OBJ_Car_Probability_29 : 27175|7@1+ (0.01,0) [0|1] "NA" MCU
 SG_ OBJ_Truck_Probability_29 : 27182|7@1+ (0.01,0) [0|1] "NA" MCU
 SG_ OBJ_Bike_Probability_29 : 27189|7@1+ (0.01,0) [0|1] "NA" MCU
 SG_ OBJ_Camera_Source_29 : 27196|4@1+ (1,0) [0|15] "ENUM" MCU
 SG_ OBJ_Motion_Status_29 : 27200|3@1+ (1,0) [0|5] "ENUM" MCU
 SG_ OBJ_Motion_Orientation_29 : 27203|4@1+ (1,0) [0|13] "ENUM" MCU
 SG_ OBJ_Has_Cut_Lane_29 : 27207|1@1+ (1,0) [0|1] "bool" MCU
 SG_ OBJ_Has_Cut_Path_29 : 27208|1@1+ (1,0) [0|1] "bool" MCU
 SG_ OBJ_Brake_Light_29 : 27209|1@1+ (1,0) [0|1] "bool" MCU
 SG_ OBJ_Turn_Indicator_Right_29 : 27210|1@1+ (1,0) [0|1] "bool" MCU
 SG_ OBJ_Turn_Indicator_Left_29 : 27211|1@1+ (1,0) [0|1] "bool" MCU
 SG_ OBJ_Light_Indicator_Validity_29 : 27212|1@1+ (1,0) [0|1] "bool" MCU
 SG_ OBJ_Right_Out_Of_Image_29 : 27213|1@1+ (1,0) [0|1] "bool" MCU
 SG_ OBJ_Left_Out_Of_Image_29 : 27214|1@1+ (1,0) [0|1] "bool" MCU
 SG_ OBJ_Right_Out_Of_Image_V_29 : 27215|1@1+ (1,0) [0|1] "bool" MCU
 SG_ OBJ_Left_Out_Of_Image_V_29 : 27216|1@1+ (1,0) [0|1] "bool" MCU
 SG_ OBJ_Top_Out_Of_Image_29 : 27217|1@1+ (1,0) [0|1] "bool" MCU
 SG_ OBJ_Bottom_Out_Of_Image_29 : 27218|1@1+ (1,0) [0|1] "bool" MCU
 SG_ OBJ_Top_Out_Of_Image_V_29 : 27219|1@1+ (1,0) [0|1] "bool" MCU
 SG_ OBJ_Bottom_Out_Of_Image_V_29 : 27220|1@1+ (1,0) [0|1] "bool" MCU
 SG_ OBJ_Lane_Assignment_29 : 27221|3@1+ (1,0) [0|5] "ENUM" MCU
 SG_ OBJ_Lane_Assignment_V_29 : 27224|1@1+ (1,0) [0|1] "bool" MCU
 SG_ OBJ_Age_Seconds_29 : 27225|7@1+ (1,0) [0|100] "s" MCU
 SG_ OBJ_Age_Seconds_V_29 : 27232|1@1+ (1,0) [0|1] "bool" MCU
 SG_ OBJ_Width_29 : 27233|9@1+ (0.01,0) [0.4|2.95] "m" MCU
 SG_ OBJ_Width_V_29 : 27242|1@1+ (1,0) [0|1] "bool" MCU
 SG_ OBJ_Width_STD_29 : 27243|11@1+ (0.001,0) [0|2] "m" MCU
 SG_ OBJ_Width_STD_V_29 : 27254|1@1+ (1,0) [0|1] "bool" MCU
 SG_ OBJ_Length_29 : 27255|9@1+ (0.05,0) [1.2|21] "m" MCU
 SG_ OBJ_Length_V_29 : 27264|1@1+ (1,0) [0|1] "bool" MCU
 SG_ OBJ_Length_STD_29 : 27265|10@1+ (0.01,0) [0|10] "m" MCU
 SG_ OBJ_Length_STD_V_29 : 27275|1@1+ (1,0) [0|1] "bool" MCU
 SG_ OBJ_Radar_ID_29 : 27276|8@1+ (1,0) [0|255] "counter" MCU
 SG_ OBJ_Height_29 : 27284|9@1+ (0.01,0) [0|2.95] "m" MCU
 SG_ OBJ_Height_V_29 : 27293|1@1+ (1,0) [0|1] "bool" MCU
 SG_ Reserved_5_29 : 27294|2@1+ (1,0) [0|0] "NA" MCU
 SG_ OBJ_Height_STD_29 : 27296|11@1+ (0.001,0) [0|2] "m" MCU
 SG_ OBJ_Height_STD_V_29 : 27307|1@1+ (1,0) [0|1] "bool" MCU
 SG_ OBJ_Abs_Long_Velocity_29 : 27308|12@1+ (0.05,-100) [-100|100] "m_per_s" MCU
 SG_ OBJ_Abs_Long_Velocity_V_29 : 27320|1@1+ (1,0) [0|1] "bool" MCU
 SG_ Reserved_6_29 : 27321|7@1+ (1,0) [0|0] "NA" MCU
 SG_ OBJ_Abs_Long_Velocity_STD_29 : 27328|13@1+ (0.01,0) [0|65] "m_per_s" MCU
 SG_ OBJ_Abs_Long_Vel_STD_V_29 : 27341|1@1+ (1,0) [0|1] "bool" MCU
 SG_ OBJ_Abs_Lat_Velocity_29 : 27342|11@1+ (0.05,-50) [-50|50] "m_per_s" MCU
 SG_ OBJ_Abs_Lat_Velocity_V_29 : 27353|1@1+ (1,0) [0|1] "bool" MCU
 SG_ Reserved_7_29 : 27354|6@1+ (1,0) [0|0] "NA" MCU
 SG_ OBJ_Abs_Lat_Velocity_STD_29 : 27360|13@1+ (0.01,0) [0|50] "m_per_s" MCU
 SG_ OBJ_Abs_Lat_Vel_STD_V_29 : 27373|1@1+ (1,0) [0|1] "bool" MCU
 SG_ OBJ_Abs_Long_Acc_29 : 27374|9@1+ (0.05,-10) [-10|10] "m_per_s2" MCU
 SG_ OBJ_Abs_Long_Acc_V_29 : 27383|1@1+ (1,0) [0|1] "bool" MCU
 SG_ Reserved_8_29 : 27384|8@1+ (1,0) [0|0] "NA" MCU
 SG_ OBJ_Abs_Long_Acc_STD_29 : 27392|10@1+ (0.01,0) [0|7.3] "m_per_s2" MCU
 SG_ OBJ_Abs_Long_Acc_STD_V_29 : 27402|1@1+ (1,0) [0|1] "bool" MCU
 SG_ OBJ_Abs_Lat_Acc_29 : 27403|9@1+ (0.05,-10) [-10|10] "m_per_s2" MCU
 SG_ OBJ_Abs_Lat_Acc_V_29 : 27412|1@1+ (1,0) [0|1] "bool" MCU
 SG_ OBJ_Abs_Lat_Acc_STD_29 : 27413|10@1+ (0.01,0) [0|7.3] "m_per_s2" MCU
 SG_ OBJ_Abs_Lat_Acc_STD_V_29 : 27423|1@1+ (1,0) [0|1] "bool" MCU
 SG_ OBJ_Abs_Acceleration_29 : 27424|9@1+ (0.05,-12.7) [-12.7|12.7] "m_per_s2" MCU
 SG_ OBJ_Abs_Acceleration_V_29 : 27433|1@1+ (1,0) [0|1] "bool" MCU
 SG_ OBJ_Abs_Acc_STD_29 : 27434|10@1+ (0.01,0) [0|7.3] "m_per_s2" MCU
 SG_ OBJ_Abs_Acc_STD_V_29 : 27444|1@1+ (1,0) [0|1] "bool" MCU
 SG_ OBJ_Inv_TTC_29 : 27445|11@1+ (0.01,-8) [-8|8] "INV(s)" MCU
 SG_ OBJ_Inv_TTC_V_29 : 27456|1@1+ (1,0) [0|1] "bool" MCU
 SG_ OBJ_Inv_TTC_STD_29 : 27457|12@1+ (0.001,0) [0|4] "INV(s)" MCU
 SG_ OBJ_Inv_TTC_STD_V_29 : 27469|1@1+ (1,0) [0|1] "bool" MCU
 SG_ OBJ_Relative_Long_Acc_29 : 27470|10@1+ (0.05,-20) [-20|20] "m_per_s2" MCU
 SG_ OBJ_Relative_Long_Acc_V_29 : 27480|1@1+ (1,0) [0|1] "bool" MCU
 SG_ Reserved_9_29 : 27481|7@1+ (1,0) [0|0] "NA" MCU
 SG_ OBJ_Relative_Long_Acc_STD_29 : 27488|10@1+ (0.01,0) [0|7.3] "m_per_s2" MCU
 SG_ OBJ_Rel_Long_Acc_STD_V_29 : 27498|1@1+ (1,0) [0|1] "bool" MCU
 SG_ OBJ_Relative_Long_Velocity_29 : 27499|13@1+ (0.05,-120) [-120|130] "m_per_s" MCU
 SG_ OBJ_Relative_Long_Velocity_V_29 : 27512|1@1+ (1,0) [0|1] "bool" MCU
 SG_ Reserved_10_29 : 27513|7@1+ (1,0) [0|0] "NA" MCU
 SG_ OBJ_Relative_Long_Vel_STD_29 : 27520|14@1+ (0.01,0) [0|130] "m_per_s" MCU
 SG_ OBJ_Rel_Long_Vel_STD_V_29 : 27534|1@1+ (1,0) [0|1] "bool" MCU
 SG_ OBJ_Relative_Lat_Velocity_29 : 27535|11@1+ (0.05,-50) [-50|50] "m_per_s" MCU
 SG_ OBJ_Relative_Lat_Velocity_V_29 : 27546|1@1+ (1,0) [0|1] "bool" MCU
 SG_ Reserved_11_29 : 27547|5@1+ (1,0) [0|0] "NA" MCU
 SG_ OBJ_Relative_Lat_Velocity_STD_29 : 27552|13@1+ (0.01,0) [0|50] "m_per_s" MCU
 SG_ OBJ_Rel_Lat_Vel_STD_V_29 : 27565|1@1+ (1,0) [0|1] "bool" MCU
 SG_ OBJ_Long_Distance_29 : 27566|14@1+ (0.05,-200) [-200|500] "m" MCU
 SG_ OBJ_Long_Distance_V_29 : 27580|1@1+ (1,0) [0|1] "bool" MCU
 SG_ Reserved_12_29 : 27581|3@1+ (1,0) [0|0] "NA" MCU
 SG_ OBJ_Long_Distance_STD_29 : 27584|15@1+ (0.01,0) [0|250] "m" MCU
 SG_ OBJ_Long_Distance_STD_V_29 : 27599|1@1+ (1,0) [0|1] "bool" MCU
 SG_ OBJ_Lat_Distance_29 : 27600|12@1+ (0.05,-100) [-100|100] "m" MCU
 SG_ OBJ_Lat_Distance_V_29 : 27612|1@1+ (1,0) [0|1] "bool" MCU
 SG_ Reserved_13_29 : 27613|3@1+ (1,0) [0|0] "NA" MCU
 SG_ OBJ_Lat_Distance_STD_29 : 27616|14@1+ (0.01,0) [0|100] "m" MCU
 SG_ OBJ_Lat_Distance_STD_V_29 : 27630|1@1+ (1,0) [0|1] "bool" MCU
 SG_ OBJ_Absolute_Speed_29 : 27631|12@1+ (0.05,-65) [-65|65] "m_per_s" MCU
 SG_ OBJ_Absolute_Speed_V_29 : 27643|1@1+ (1,0) [0|1] "bool" MCU
 SG_ Reserved_14_29 : 27644|4@1+ (1,0) [0|0] "NA" MCU
 SG_ OBJ_Absolute_Speed_STD_29 : 27648|13@1+ (0.01,0) [0|65] "m_per_s" MCU
 SG_ OBJ_Absolute_Speed_STD_V_29 : 27661|1@1+ (1,0) [0|1] "bool" MCU
 SG_ OBJ_Heading_29 : 27662|10@1+ (0.01,-3.14) [-3.14|3.14] "rad" MCU
 SG_ OBJ_Heading_V_29 : 27672|1@1+ (1,0) [0|1] "bool" MCU
 SG_ Reserved_15_29 : 27673|7@1+ (1,0) [0|0] "NA" MCU
 SG_ OBJ_Heading_STD_29 : 27680|15@1+ (0.0001,0) [0|3.14] "rad" MCU
 SG_ OBJ_Heading_STD_V_29 : 27695|1@1+ (1,0) [0|1] "bool" MCU
 SG_ OBJ_Angle_Rate_STD_29 : 27696|15@1+ (0.0001,0) [0|2.2318] "RPS" MCU
 SG_ OBJ_Angle_Rate_STD_V_29 : 27711|1@1+ (1,0) [0|1] "bool" MCU
 SG_ OBJ_Angle_Rate_29 : 27712|12@1+ (0.002,-2.234) [-2.234|2.2318] "RPS" MCU
 SG_ OBJ_Angle_Rate_V_29 : 27724|1@1+ (1,0) [0|1] "bool" MCU
 SG_ OBJ_Angle_Right_29 : 27725|14@1+ (0.0002,-1.571) [-1.571|1.571] "rad" MCU
 SG_ OBJ_Angle_Right_V_29 : 27739|1@1+ (1,0) [0|1] "bool" MCU
 SG_ Reserved_16_29 : 27740|4@1+ (1,0) [0|0] "NA" MCU
 SG_ OBJ_Angle_Right_STD_29 : 27744|14@1+ (0.0001,0) [0|1.571] "rad" MCU
 SG_ OBJ_Angle_Right_STD_V_29 : 27758|1@1+ (1,0) [0|1] "bool" MCU
 SG_ OBJ_Angle_Left_29 : 27759|14@1+ (0.0002,-1.571) [-1.571|1.571] "rad" MCU
 SG_ OBJ_Angle_Left_V_29 : 27773|1@1+ (1,0) [0|1] "bool" MCU
 SG_ Reserved_17_29 : 27774|2@1+ (1,0) [0|0] "NA" MCU
 SG_ OBJ_Angle_Left_STD_29 : 27776|14@1+ (0.0001,0) [0|1.571] "rad" MCU
 SG_ OBJ_Angle_Left_STD_V_29 : 27790|1@1+ (1,0) [0|1] "bool" MCU
 SG_ OBJ_Angle_Side_29 : 27791|14@1+ (0.0002,-1.571) [-1.571|1.571] "rad" MCU
 SG_ OBJ_Angle_Side_V_29 : 27805|1@1+ (1,0) [0|1] "bool" MCU
 SG_ Reserved_18_29 : 27806|2@1+ (1,0) [0|0] "NA" MCU
 SG_ OBJ_Angle_Side_STD_29 : 27808|14@1+ (0.0001,0) [0|1.571] "rad" MCU
 SG_ OBJ_Angle_Side_STD_V_29 : 27822|1@1+ (1,0) [0|1] "bool" MCU
 SG_ OBJ_Angle_Mid_V_29 : 27823|1@1+ (1,0) [0|1] "bool" MCU
 SG_ OBJ_Angle_Mid_29 : 27824|14@1+ (0.0002,-1.571) [-1.571|1.571] "rad" MCU
 SG_ Reserved_19_29 : 27838|2@1+ (1,0) [0|0] "NA" MCU
 SG_ OBJ_Angle_Mid_STD_29 : 27840|14@1+ (0.0001,0) [0|1.571] "rad" MCU
 SG_ OBJ_Angle_Mid_STD_V_29 : 27854|1@1+ (1,0) [0|1] "bool" MCU
 SG_ OBJ_Angle_Bottom_V_29 : 27855|1@1+ (1,0) [0|1] "bool" MCU
 SG_ OBJ_Angle_Bottom_29 : 27856|14@1+ (0.0002,-1.571) [-1.571|1.571] "rad" MCU
 SG_ Reserved_20_29 : 27870|2@1+ (1,0) [0|0] "NA" MCU
 SG_ OBJ_Angle_Bottom_STD_29 : 27872|14@1+ (0.0001,0) [0|1.571] "rad" MCU
 SG_ OBJ_Angle_Bottom_STD_V_29 : 27886|1@1+ (1,0) [0|1] "bool" MCU
 SG_ OBJ_Visibility_Side_V_29 : 27887|1@1+ (1,0) [0|1] "bool" MCU
 SG_ OBJ_Visibility_Side_29 : 27888|2@1+ (1,0) [0|2] "ENUM" MCU
 SG_ OBJ_Is_In_Drivable_Area_29 : 27890|1@1+ (1,0) [0|1] "bool" MCU
 SG_ OBJ_Is_In_Drivable_Area_V_29 : 27891|1@1+ (1,0) [0|1] "bool" MCU
 SG_ OBJ_Is_VeryClose_V_29 : 27892|1@1+ (1,0) [0|1] "bool" MCU
 SG_ OBJ_Is_VeryClose_29 : 27893|1@1+ (1,0) [0|1] "bool" MCU
 SG_ OBJ_Buffer_C4_29 : 27894|2@1+ (1,0) [0|2] "NA" MCU
 SG_ OBJ_Buffer_C5_29 : 27896|2@1+ (1,0) [0|2] "NA" MCU
 SG_ OBJ_Buffer_C6_29 : 27898|2@1+ (1,0) [0|2] "NA" MCU
 SG_ OBJ_Buffer_C7_29 : 27900|2@1+ (1,0) [0|2] "NA" MCU
 SG_ Reserved_21_29 : 27902|2@1+ (1,0) [0|0] "NA" MCU
 SG_ OBJ_OverlapAngleEgoLaneR_29 : 27904|10@1+ (0.01,-3.14) [-3.14|3.14] "rad" MCU
 SG_ OBJ_OverlapAngleEgoLaneR_V_29 : 27914|1@1+ (1,0) [0|1] "bool" MCU
 SG_ OBJ_OverlapAngleEgoLaneL_29 : 27915|10@1+ (0.01,-3.14) [-3.14|3.14] "rad" MCU
 SG_ OBJ_OverlapAngleEgoLaneL_V_29 : 27925|1@1+ (1,0) [0|1] "bool" MCU
 SG_ OBJ_Is_EMERGENCY_VCL_29 : 27926|1@1+ (1,0) [0|1] "bool" MCU
 SG_ OBJ_EMERGENCY_LIGHT_COLOR_29 : 27927|4@1+ (1,0) [0|15] "BITWIZE" MCU
 SG_ OBJ_EMERGENCY_V_29 : 27931|1@1+ (1,0) [0|1] "bool" MCU
 SG_ Reserved_22_29 : 27932|4@1+ (1,0) [0|0] "NA" MCU
 SG_ OBJ_Angle_Top_29 : 27936|14@1+ (0.0002,0) [0|3.1415] "rad" MCU
 SG_ OBJ_Angle_Top_V_29 : 27950|1@1+ (1,0) [0|1] "bool" MCU
 SG_ OBJ_Angle_Top_STD_29 : 27951|15@1+ (0.0001,0) [0|3.1415] "rad" MCU
 SG_ OBJ_Angle_Top_STD_V_29 : 27966|1@1+ (1,0) [0|1] "bool" MCU
 SG_ OBJ_Buffer_C14_29 : 27967|1@1+ (1,0) [0|1] "NA" MCU
 SG_ OBJ_Buffer_C15_29 : 27968|1@1+ (1,0) [0|1] "NA" MCU
 SG_ OBJ_Buffer_C18_29 : 27969|2@1+ (1,0) [0|2] "NA" MCU
 SG_ OBJ_Buffer_C19_29 : 27971|1@1+ (1,0) [0|1] "NA" MCU
 SG_ Reserved_23_29 : 27972|28@1+ (1,0) [0|0] "NA" MCU
 SG_ OBJ_CRC_30 : 28000|32@1+ (1,0) [0|4294967295] "NA" MCU
 SG_ OBJ_ID_30 : 28032|8@1+ (1,0) [0|255] "counter" MCU
 SG_ OBJ_Existence_Probability_30 : 28040|8@1+ (0.01,0) [0|1] "NA" MCU
 SG_ OBJ_Fusion_Source_30 : 28048|16@1+ (1,0) [0|65535] "BITWIZE" MCU
 SG_ OBJ_Triggered_SDM_30 : 28064|2@1+ (1,0) [0|2] "ENUM" MCU
 SG_ OBJ_Motion_Category_30 : 28066|4@1+ (1,0) [0|13] "ENUM" MCU
 SG_ OBJ_Buffer_C0_30 : 28070|7@1+ (0.01,0) [0|1] "NA" MCU
 SG_ OBJ_Object_Age_30 : 28077|11@1+ (1,0) [0|2047] "frames" MCU
 SG_ OBJ_Measuring_Status_30 : 28088|3@1+ (1,0) [0|7] "BITWIZE" MCU
 SG_ OBJ_Object_Class_30 : 28091|4@1+ (1,0) [0|8] "ENUM" MCU
 SG_ Reserved_4_30 : 28095|1@1+ (1,0) [0|0] "NA" MCU
 SG_ OBJ_Class_Probability_30 : 28096|7@1+ (0.01,0) [0|1] "NA" MCU
 SG_ OBJ_Car_Probability_30 : 28103|7@1+ (0.01,0) [0|1] "NA" MCU
 SG_ OBJ_Truck_Probability_30 : 28110|7@1+ (0.01,0) [0|1] "NA" MCU
 SG_ OBJ_Bike_Probability_30 : 28117|7@1+ (0.01,0) [0|1] "NA" MCU
 SG_ OBJ_Camera_Source_30 : 28124|4@1+ (1,0) [0|15] "ENUM" MCU
 SG_ OBJ_Motion_Status_30 : 28128|3@1+ (1,0) [0|5] "ENUM" MCU
 SG_ OBJ_Motion_Orientation_30 : 28131|4@1+ (1,0) [0|13] "ENUM" MCU
 SG_ OBJ_Has_Cut_Lane_30 : 28135|1@1+ (1,0) [0|1] "bool" MCU
 SG_ OBJ_Has_Cut_Path_30 : 28136|1@1+ (1,0) [0|1] "bool" MCU
 SG_ OBJ_Brake_Light_30 : 28137|1@1+ (1,0) [0|1] "bool" MCU
 SG_ OBJ_Turn_Indicator_Right_30 : 28138|1@1+ (1,0) [0|1] "bool" MCU
 SG_ OBJ_Turn_Indicator_Left_30 : 28139|1@1+ (1,0) [0|1] "bool" MCU
 SG_ OBJ_Light_Indicator_Validity_30 : 28140|1@1+ (1,0) [0|1] "bool" MCU
 SG_ OBJ_Right_Out_Of_Image_30 : 28141|1@1+ (1,0) [0|1] "bool" MCU
 SG_ OBJ_Left_Out_Of_Image_30 : 28142|1@1+ (1,0) [0|1] "bool" MCU
 SG_ OBJ_Right_Out_Of_Image_V_30 : 28143|1@1+ (1,0) [0|1] "bool" MCU
 SG_ OBJ_Left_Out_Of_Image_V_30 : 28144|1@1+ (1,0) [0|1] "bool" MCU
 SG_ OBJ_Top_Out_Of_Image_30 : 28145|1@1+ (1,0) [0|1] "bool" MCU
 SG_ OBJ_Bottom_Out_Of_Image_30 : 28146|1@1+ (1,0) [0|1] "bool" MCU
 SG_ OBJ_Top_Out_Of_Image_V_30 : 28147|1@1+ (1,0) [0|1] "bool" MCU
 SG_ OBJ_Bottom_Out_Of_Image_V_30 : 28148|1@1+ (1,0) [0|1] "bool" MCU
 SG_ OBJ_Lane_Assignment_30 : 28149|3@1+ (1,0) [0|5] "ENUM" MCU
 SG_ OBJ_Lane_Assignment_V_30 : 28152|1@1+ (1,0) [0|1] "bool" MCU
 SG_ OBJ_Age_Seconds_30 : 28153|7@1+ (1,0) [0|100] "s" MCU
 SG_ OBJ_Age_Seconds_V_30 : 28160|1@1+ (1,0) [0|1] "bool" MCU
 SG_ OBJ_Width_30 : 28161|9@1+ (0.01,0) [0.4|2.95] "m" MCU
 SG_ OBJ_Width_V_30 : 28170|1@1+ (1,0) [0|1] "bool" MCU
 SG_ OBJ_Width_STD_30 : 28171|11@1+ (0.001,0) [0|2] "m" MCU
 SG_ OBJ_Width_STD_V_30 : 28182|1@1+ (1,0) [0|1] "bool" MCU
 SG_ OBJ_Length_30 : 28183|9@1+ (0.05,0) [1.2|21] "m" MCU
 SG_ OBJ_Length_V_30 : 28192|1@1+ (1,0) [0|1] "bool" MCU
 SG_ OBJ_Length_STD_30 : 28193|10@1+ (0.01,0) [0|10] "m" MCU
 SG_ OBJ_Length_STD_V_30 : 28203|1@1+ (1,0) [0|1] "bool" MCU
 SG_ OBJ_Radar_ID_30 : 28204|8@1+ (1,0) [0|255] "counter" MCU
 SG_ OBJ_Height_30 : 28212|9@1+ (0.01,0) [0|2.95] "m" MCU
 SG_ OBJ_Height_V_30 : 28221|1@1+ (1,0) [0|1] "bool" MCU
 SG_ Reserved_5_30 : 28222|2@1+ (1,0) [0|0] "NA" MCU
 SG_ OBJ_Height_STD_30 : 28224|11@1+ (0.001,0) [0|2] "m" MCU
 SG_ OBJ_Height_STD_V_30 : 28235|1@1+ (1,0) [0|1] "bool" MCU
 SG_ OBJ_Abs_Long_Velocity_30 : 28236|12@1+ (0.05,-100) [-100|100] "m_per_s" MCU
 SG_ OBJ_Abs_Long_Velocity_V_30 : 28248|1@1+ (1,0) [0|1] "bool" MCU
 SG_ Reserved_6_30 : 28249|7@1+ (1,0) [0|0] "NA" MCU
 SG_ OBJ_Abs_Long_Velocity_STD_30 : 28256|13@1+ (0.01,0) [0|65] "m_per_s" MCU
 SG_ OBJ_Abs_Long_Vel_STD_V_30 : 28269|1@1+ (1,0) [0|1] "bool" MCU
 SG_ OBJ_Abs_Lat_Velocity_30 : 28270|11@1+ (0.05,-50) [-50|50] "m_per_s" MCU
 SG_ OBJ_Abs_Lat_Velocity_V_30 : 28281|1@1+ (1,0) [0|1] "bool" MCU
 SG_ Reserved_7_30 : 28282|6@1+ (1,0) [0|0] "NA" MCU
 SG_ OBJ_Abs_Lat_Velocity_STD_30 : 28288|13@1+ (0.01,0) [0|50] "m_per_s" MCU
 SG_ OBJ_Abs_Lat_Vel_STD_V_30 : 28301|1@1+ (1,0) [0|1] "bool" MCU
 SG_ OBJ_Abs_Long_Acc_30 : 28302|9@1+ (0.05,-10) [-10|10] "m_per_s2" MCU
 SG_ OBJ_Abs_Long_Acc_V_30 : 28311|1@1+ (1,0) [0|1] "bool" MCU
 SG_ Reserved_8_30 : 28312|8@1+ (1,0) [0|0] "NA" MCU
 SG_ OBJ_Abs_Long_Acc_STD_30 : 28320|10@1+ (0.01,0) [0|7.3] "m_per_s2" MCU
 SG_ OBJ_Abs_Long_Acc_STD_V_30 : 28330|1@1+ (1,0) [0|1] "bool" MCU
 SG_ OBJ_Abs_Lat_Acc_30 : 28331|9@1+ (0.05,-10) [-10|10] "m_per_s2" MCU
 SG_ OBJ_Abs_Lat_Acc_V_30 : 28340|1@1+ (1,0) [0|1] "bool" MCU
 SG_ OBJ_Abs_Lat_Acc_STD_30 : 28341|10@1+ (0.01,0) [0|7.3] "m_per_s2" MCU
 SG_ OBJ_Abs_Lat_Acc_STD_V_30 : 28351|1@1+ (1,0) [0|1] "bool" MCU
 SG_ OBJ_Abs_Acceleration_30 : 28352|9@1+ (0.05,-12.7) [-12.7|12.7] "m_per_s2" MCU
 SG_ OBJ_Abs_Acceleration_V_30 : 28361|1@1+ (1,0) [0|1] "bool" MCU
 SG_ OBJ_Abs_Acc_STD_30 : 28362|10@1+ (0.01,0) [0|7.3] "m_per_s2" MCU
 SG_ OBJ_Abs_Acc_STD_V_30 : 28372|1@1+ (1,0) [0|1] "bool" MCU
 SG_ OBJ_Inv_TTC_30 : 28373|11@1+ (0.01,-8) [-8|8] "INV(s)" MCU
 SG_ OBJ_Inv_TTC_V_30 : 28384|1@1+ (1,0) [0|1] "bool" MCU
 SG_ OBJ_Inv_TTC_STD_30 : 28385|12@1+ (0.001,0) [0|4] "INV(s)" MCU
 SG_ OBJ_Inv_TTC_STD_V_30 : 28397|1@1+ (1,0) [0|1] "bool" MCU
 SG_ OBJ_Relative_Long_Acc_30 : 28398|10@1+ (0.05,-20) [-20|20] "m_per_s2" MCU
 SG_ OBJ_Relative_Long_Acc_V_30 : 28408|1@1+ (1,0) [0|1] "bool" MCU
 SG_ Reserved_9_30 : 28409|7@1+ (1,0) [0|0] "NA" MCU
 SG_ OBJ_Relative_Long_Acc_STD_30 : 28416|10@1+ (0.01,0) [0|7.3] "m_per_s2" MCU
 SG_ OBJ_Rel_Long_Acc_STD_V_30 : 28426|1@1+ (1,0) [0|1] "bool" MCU
 SG_ OBJ_Relative_Long_Velocity_30 : 28427|13@1+ (0.05,-120) [-120|130] "m_per_s" MCU
 SG_ OBJ_Relative_Long_Velocity_V_30 : 28440|1@1+ (1,0) [0|1] "bool" MCU
 SG_ Reserved_10_30 : 28441|7@1+ (1,0) [0|0] "NA" MCU
 SG_ OBJ_Relative_Long_Vel_STD_30 : 28448|14@1+ (0.01,0) [0|130] "m_per_s" MCU
 SG_ OBJ_Rel_Long_Vel_STD_V_30 : 28462|1@1+ (1,0) [0|1] "bool" MCU
 SG_ OBJ_Relative_Lat_Velocity_30 : 28463|11@1+ (0.05,-50) [-50|50] "m_per_s" MCU
 SG_ OBJ_Relative_Lat_Velocity_V_30 : 28474|1@1+ (1,0) [0|1] "bool" MCU
 SG_ Reserved_11_30 : 28475|5@1+ (1,0) [0|0] "NA" MCU
 SG_ OBJ_Relative_Lat_Velocity_STD_30 : 28480|13@1+ (0.01,0) [0|50] "m_per_s" MCU
 SG_ OBJ_Rel_Lat_Vel_STD_V_30 : 28493|1@1+ (1,0) [0|1] "bool" MCU
 SG_ OBJ_Long_Distance_30 : 28494|14@1+ (0.05,-200) [-200|500] "m" MCU
 SG_ OBJ_Long_Distance_V_30 : 28508|1@1+ (1,0) [0|1] "bool" MCU
 SG_ Reserved_12_30 : 28509|3@1+ (1,0) [0|0] "NA" MCU
 SG_ OBJ_Long_Distance_STD_30 : 28512|15@1+ (0.01,0) [0|250] "m" MCU
 SG_ OBJ_Long_Distance_STD_V_30 : 28527|1@1+ (1,0) [0|1] "bool" MCU
 SG_ OBJ_Lat_Distance_30 : 28528|12@1+ (0.05,-100) [-100|100] "m" MCU
 SG_ OBJ_Lat_Distance_V_30 : 28540|1@1+ (1,0) [0|1] "bool" MCU
 SG_ Reserved_13_30 : 28541|3@1+ (1,0) [0|0] "NA" MCU
 SG_ OBJ_Lat_Distance_STD_30 : 28544|14@1+ (0.01,0) [0|100] "m" MCU
 SG_ OBJ_Lat_Distance_STD_V_30 : 28558|1@1+ (1,0) [0|1] "bool" MCU
 SG_ OBJ_Absolute_Speed_30 : 28559|12@1+ (0.05,-65) [-65|65] "m_per_s" MCU
 SG_ OBJ_Absolute_Speed_V_30 : 28571|1@1+ (1,0) [0|1] "bool" MCU
 SG_ Reserved_14_30 : 28572|4@1+ (1,0) [0|0] "NA" MCU
 SG_ OBJ_Absolute_Speed_STD_30 : 28576|13@1+ (0.01,0) [0|65] "m_per_s" MCU
 SG_ OBJ_Absolute_Speed_STD_V_30 : 28589|1@1+ (1,0) [0|1] "bool" MCU
 SG_ OBJ_Heading_30 : 28590|10@1+ (0.01,-3.14) [-3.14|3.14] "rad" MCU
 SG_ OBJ_Heading_V_30 : 28600|1@1+ (1,0) [0|1] "bool" MCU
 SG_ Reserved_15_30 : 28601|7@1+ (1,0) [0|0] "NA" MCU
 SG_ OBJ_Heading_STD_30 : 28608|15@1+ (0.0001,0) [0|3.14] "rad" MCU
 SG_ OBJ_Heading_STD_V_30 : 28623|1@1+ (1,0) [0|1] "bool" MCU
 SG_ OBJ_Angle_Rate_STD_30 : 28624|15@1+ (0.0001,0) [0|2.2318] "RPS" MCU
 SG_ OBJ_Angle_Rate_STD_V_30 : 28639|1@1+ (1,0) [0|1] "bool" MCU
 SG_ OBJ_Angle_Rate_30 : 28640|12@1+ (0.002,-2.234) [-2.234|2.2318] "RPS" MCU
 SG_ OBJ_Angle_Rate_V_30 : 28652|1@1+ (1,0) [0|1] "bool" MCU
 SG_ OBJ_Angle_Right_30 : 28653|14@1+ (0.0002,-1.571) [-1.571|1.571] "rad" MCU
 SG_ OBJ_Angle_Right_V_30 : 28667|1@1+ (1,0) [0|1] "bool" MCU
 SG_ Reserved_16_30 : 28668|4@1+ (1,0) [0|0] "NA" MCU
 SG_ OBJ_Angle_Right_STD_30 : 28672|14@1+ (0.0001,0) [0|1.571] "rad" MCU
 SG_ OBJ_Angle_Right_STD_V_30 : 28686|1@1+ (1,0) [0|1] "bool" MCU
 SG_ OBJ_Angle_Left_30 : 28687|14@1+ (0.0002,-1.571) [-1.571|1.571] "rad" MCU
 SG_ OBJ_Angle_Left_V_30 : 28701|1@1+ (1,0) [0|1] "bool" MCU
 SG_ Reserved_17_30 : 28702|2@1+ (1,0) [0|0] "NA" MCU
 SG_ OBJ_Angle_Left_STD_30 : 28704|14@1+ (0.0001,0) [0|1.571] "rad" MCU
 SG_ OBJ_Angle_Left_STD_V_30 : 28718|1@1+ (1,0) [0|1] "bool" MCU
 SG_ OBJ_Angle_Side_30 : 28719|14@1+ (0.0002,-1.571) [-1.571|1.571] "rad" MCU
 SG_ OBJ_Angle_Side_V_30 : 28733|1@1+ (1,0) [0|1] "bool" MCU
 SG_ Reserved_18_30 : 28734|2@1+ (1,0) [0|0] "NA" MCU
 SG_ OBJ_Angle_Side_STD_30 : 28736|14@1+ (0.0001,0) [0|1.571] "rad" MCU
 SG_ OBJ_Angle_Side_STD_V_30 : 28750|1@1+ (1,0) [0|1] "bool" MCU
 SG_ OBJ_Angle_Mid_V_30 : 28751|1@1+ (1,0) [0|1] "bool" MCU
 SG_ OBJ_Angle_Mid_30 : 28752|14@1+ (0.0002,-1.571) [-1.571|1.571] "rad" MCU
 SG_ Reserved_19_30 : 28766|2@1+ (1,0) [0|0] "NA" MCU
 SG_ OBJ_Angle_Mid_STD_30 : 28768|14@1+ (0.0001,0) [0|1.571] "rad" MCU
 SG_ OBJ_Angle_Mid_STD_V_30 : 28782|1@1+ (1,0) [0|1] "bool" MCU
 SG_ OBJ_Angle_Bottom_V_30 : 28783|1@1+ (1,0) [0|1] "bool" MCU
 SG_ OBJ_Angle_Bottom_30 : 28784|14@1+ (0.0002,-1.571) [-1.571|1.571] "rad" MCU
 SG_ Reserved_20_30 : 28798|2@1+ (1,0) [0|0] "NA" MCU
 SG_ OBJ_Angle_Bottom_STD_30 : 28800|14@1+ (0.0001,0) [0|1.571] "rad" MCU
 SG_ OBJ_Angle_Bottom_STD_V_30 : 28814|1@1+ (1,0) [0|1] "bool" MCU
 SG_ OBJ_Visibility_Side_V_30 : 28815|1@1+ (1,0) [0|1] "bool" MCU
 SG_ OBJ_Visibility_Side_30 : 28816|2@1+ (1,0) [0|2] "ENUM" MCU
 SG_ OBJ_Is_In_Drivable_Area_30 : 28818|1@1+ (1,0) [0|1] "bool" MCU
 SG_ OBJ_Is_In_Drivable_Area_V_30 : 28819|1@1+ (1,0) [0|1] "bool" MCU
 SG_ OBJ_Is_VeryClose_V_30 : 28820|1@1+ (1,0) [0|1] "bool" MCU
 SG_ OBJ_Is_VeryClose_30 : 28821|1@1+ (1,0) [0|1] "bool" MCU
 SG_ OBJ_Buffer_C4_30 : 28822|2@1+ (1,0) [0|2] "NA" MCU
 SG_ OBJ_Buffer_C5_30 : 28824|2@1+ (1,0) [0|2] "NA" MCU
 SG_ OBJ_Buffer_C6_30 : 28826|2@1+ (1,0) [0|2] "NA" MCU
 SG_ OBJ_Buffer_C7_30 : 28828|2@1+ (1,0) [0|2] "NA" MCU
 SG_ Reserved_21_30 : 28830|2@1+ (1,0) [0|0] "NA" MCU
 SG_ OBJ_OverlapAngleEgoLaneR_30 : 28832|10@1+ (0.01,-3.14) [-3.14|3.14] "rad" MCU
 SG_ OBJ_OverlapAngleEgoLaneR_V_30 : 28842|1@1+ (1,0) [0|1] "bool" MCU
 SG_ OBJ_OverlapAngleEgoLaneL_30 : 28843|10@1+ (0.01,-3.14) [-3.14|3.14] "rad" MCU
 SG_ OBJ_OverlapAngleEgoLaneL_V_30 : 28853|1@1+ (1,0) [0|1] "bool" MCU
 SG_ OBJ_Is_EMERGENCY_VCL_30 : 28854|1@1+ (1,0) [0|1] "bool" MCU
 SG_ OBJ_EMERGENCY_LIGHT_COLOR_30 : 28855|4@1+ (1,0) [0|15] "BITWIZE" MCU
 SG_ OBJ_EMERGENCY_V_30 : 28859|1@1+ (1,0) [0|1] "bool" MCU
 SG_ Reserved_22_30 : 28860|4@1+ (1,0) [0|0] "NA" MCU
 SG_ OBJ_Angle_Top_30 : 28864|14@1+ (0.0002,0) [0|3.1415] "rad" MCU
 SG_ OBJ_Angle_Top_V_30 : 28878|1@1+ (1,0) [0|1] "bool" MCU
 SG_ OBJ_Angle_Top_STD_30 : 28879|15@1+ (0.0001,0) [0|3.1415] "rad" MCU
 SG_ OBJ_Angle_Top_STD_V_30 : 28894|1@1+ (1,0) [0|1] "bool" MCU
 SG_ OBJ_Buffer_C14_30 : 28895|1@1+ (1,0) [0|1] "NA" MCU
 SG_ OBJ_Buffer_C15_30 : 28896|1@1+ (1,0) [0|1] "NA" MCU
 SG_ OBJ_Buffer_C18_30 : 28897|2@1+ (1,0) [0|2] "NA" MCU
 SG_ OBJ_Buffer_C19_30 : 28899|1@1+ (1,0) [0|1] "NA" MCU
 SG_ Reserved_23_30 : 28900|28@1+ (1,0) [0|0] "NA" MCU
 SG_ OBJ_CRC_31 : 28928|32@1+ (1,0) [0|4294967295] "NA" MCU
 SG_ OBJ_ID_31 : 28960|8@1+ (1,0) [0|255] "counter" MCU
 SG_ OBJ_Existence_Probability_31 : 28968|8@1+ (0.01,0) [0|1] "NA" MCU
 SG_ OBJ_Fusion_Source_31 : 28976|16@1+ (1,0) [0|65535] "BITWIZE" MCU
 SG_ OBJ_Triggered_SDM_31 : 28992|2@1+ (1,0) [0|2] "ENUM" MCU
 SG_ OBJ_Motion_Category_31 : 28994|4@1+ (1,0) [0|13] "ENUM" MCU
 SG_ OBJ_Buffer_C0_31 : 28998|7@1+ (0.01,0) [0|1] "NA" MCU
 SG_ OBJ_Object_Age_31 : 29005|11@1+ (1,0) [0|2047] "frames" MCU
 SG_ OBJ_Measuring_Status_31 : 29016|3@1+ (1,0) [0|7] "BITWIZE" MCU
 SG_ OBJ_Object_Class_31 : 29019|4@1+ (1,0) [0|8] "ENUM" MCU
 SG_ Reserved_4_31 : 29023|1@1+ (1,0) [0|0] "NA" MCU
 SG_ OBJ_Class_Probability_31 : 29024|7@1+ (0.01,0) [0|1] "NA" MCU
 SG_ OBJ_Car_Probability_31 : 29031|7@1+ (0.01,0) [0|1] "NA" MCU
 SG_ OBJ_Truck_Probability_31 : 29038|7@1+ (0.01,0) [0|1] "NA" MCU
 SG_ OBJ_Bike_Probability_31 : 29045|7@1+ (0.01,0) [0|1] "NA" MCU
 SG_ OBJ_Camera_Source_31 : 29052|4@1+ (1,0) [0|15] "ENUM" MCU
 SG_ OBJ_Motion_Status_31 : 29056|3@1+ (1,0) [0|5] "ENUM" MCU
 SG_ OBJ_Motion_Orientation_31 : 29059|4@1+ (1,0) [0|13] "ENUM" MCU
 SG_ OBJ_Has_Cut_Lane_31 : 29063|1@1+ (1,0) [0|1] "bool" MCU
 SG_ OBJ_Has_Cut_Path_31 : 29064|1@1+ (1,0) [0|1] "bool" MCU
 SG_ OBJ_Brake_Light_31 : 29065|1@1+ (1,0) [0|1] "bool" MCU
 SG_ OBJ_Turn_Indicator_Right_31 : 29066|1@1+ (1,0) [0|1] "bool" MCU
 SG_ OBJ_Turn_Indicator_Left_31 : 29067|1@1+ (1,0) [0|1] "bool" MCU
 SG_ OBJ_Light_Indicator_Validity_31 : 29068|1@1+ (1,0) [0|1] "bool" MCU
 SG_ OBJ_Right_Out_Of_Image_31 : 29069|1@1+ (1,0) [0|1] "bool" MCU
 SG_ OBJ_Left_Out_Of_Image_31 : 29070|1@1+ (1,0) [0|1] "bool" MCU
 SG_ OBJ_Right_Out_Of_Image_V_31 : 29071|1@1+ (1,0) [0|1] "bool" MCU
 SG_ OBJ_Left_Out_Of_Image_V_31 : 29072|1@1+ (1,0) [0|1] "bool" MCU
 SG_ OBJ_Top_Out_Of_Image_31 : 29073|1@1+ (1,0) [0|1] "bool" MCU
 SG_ OBJ_Bottom_Out_Of_Image_31 : 29074|1@1+ (1,0) [0|1] "bool" MCU
 SG_ OBJ_Top_Out_Of_Image_V_31 : 29075|1@1+ (1,0) [0|1] "bool" MCU
 SG_ OBJ_Bottom_Out_Of_Image_V_31 : 29076|1@1+ (1,0) [0|1] "bool" MCU
 SG_ OBJ_Lane_Assignment_31 : 29077|3@1+ (1,0) [0|5] "ENUM" MCU
 SG_ OBJ_Lane_Assignment_V_31 : 29080|1@1+ (1,0) [0|1] "bool" MCU
 SG_ OBJ_Age_Seconds_31 : 29081|7@1+ (1,0) [0|100] "s" MCU
 SG_ OBJ_Age_Seconds_V_31 : 29088|1@1+ (1,0) [0|1] "bool" MCU
 SG_ OBJ_Width_31 : 29089|9@1+ (0.01,0) [0.4|2.95] "m" MCU
 SG_ OBJ_Width_V_31 : 29098|1@1+ (1,0) [0|1] "bool" MCU
 SG_ OBJ_Width_STD_31 : 29099|11@1+ (0.001,0) [0|2] "m" MCU
 SG_ OBJ_Width_STD_V_31 : 29110|1@1+ (1,0) [0|1] "bool" MCU
 SG_ OBJ_Length_31 : 29111|9@1+ (0.05,0) [1.2|21] "m" MCU
 SG_ OBJ_Length_V_31 : 29120|1@1+ (1,0) [0|1] "bool" MCU
 SG_ OBJ_Length_STD_31 : 29121|10@1+ (0.01,0) [0|10] "m" MCU
 SG_ OBJ_Length_STD_V_31 : 29131|1@1+ (1,0) [0|1] "bool" MCU
 SG_ OBJ_Radar_ID_31 : 29132|8@1+ (1,0) [0|255] "counter" MCU
 SG_ OBJ_Height_31 : 29140|9@1+ (0.01,0) [0|2.95] "m" MCU
 SG_ OBJ_Height_V_31 : 29149|1@1+ (1,0) [0|1] "bool" MCU
 SG_ Reserved_5_31 : 29150|2@1+ (1,0) [0|0] "NA" MCU
 SG_ OBJ_Height_STD_31 : 29152|11@1+ (0.001,0) [0|2] "m" MCU
 SG_ OBJ_Height_STD_V_31 : 29163|1@1+ (1,0) [0|1] "bool" MCU
 SG_ OBJ_Abs_Long_Velocity_31 : 29164|12@1+ (0.05,-100) [-100|100] "m_per_s" MCU
 SG_ OBJ_Abs_Long_Velocity_V_31 : 29176|1@1+ (1,0) [0|1] "bool" MCU
 SG_ Reserved_6_31 : 29177|7@1+ (1,0) [0|0] "NA" MCU
 SG_ OBJ_Abs_Long_Velocity_STD_31 : 29184|13@1+ (0.01,0) [0|65] "m_per_s" MCU
 SG_ OBJ_Abs_Long_Vel_STD_V_31 : 29197|1@1+ (1,0) [0|1] "bool" MCU
 SG_ OBJ_Abs_Lat_Velocity_31 : 29198|11@1+ (0.05,-50) [-50|50] "m_per_s" MCU
 SG_ OBJ_Abs_Lat_Velocity_V_31 : 29209|1@1+ (1,0) [0|1] "bool" MCU
 SG_ Reserved_7_31 : 29210|6@1+ (1,0) [0|0] "NA" MCU
 SG_ OBJ_Abs_Lat_Velocity_STD_31 : 29216|13@1+ (0.01,0) [0|50] "m_per_s" MCU
 SG_ OBJ_Abs_Lat_Vel_STD_V_31 : 29229|1@1+ (1,0) [0|1] "bool" MCU
 SG_ OBJ_Abs_Long_Acc_31 : 29230|9@1+ (0.05,-10) [-10|10] "m_per_s2" MCU
 SG_ OBJ_Abs_Long_Acc_V_31 : 29239|1@1+ (1,0) [0|1] "bool" MCU
 SG_ Reserved_8_31 : 29240|8@1+ (1,0) [0|0] "NA" MCU
 SG_ OBJ_Abs_Long_Acc_STD_31 : 29248|10@1+ (0.01,0) [0|7.3] "m_per_s2" MCU
 SG_ OBJ_Abs_Long_Acc_STD_V_31 : 29258|1@1+ (1,0) [0|1] "bool" MCU
 SG_ OBJ_Abs_Lat_Acc_31 : 29259|9@1+ (0.05,-10) [-10|10] "m_per_s2" MCU
 SG_ OBJ_Abs_Lat_Acc_V_31 : 29268|1@1+ (1,0) [0|1] "bool" MCU
 SG_ OBJ_Abs_Lat_Acc_STD_31 : 29269|10@1+ (0.01,0) [0|7.3] "m_per_s2" MCU
 SG_ OBJ_Abs_Lat_Acc_STD_V_31 : 29279|1@1+ (1,0) [0|1] "bool" MCU
 SG_ OBJ_Abs_Acceleration_31 : 29280|9@1+ (0.05,-12.7) [-12.7|12.7] "m_per_s2" MCU
 SG_ OBJ_Abs_Acceleration_V_31 : 29289|1@1+ (1,0) [0|1] "bool" MCU
 SG_ OBJ_Abs_Acc_STD_31 : 29290|10@1+ (0.01,0) [0|7.3] "m_per_s2" MCU
 SG_ OBJ_Abs_Acc_STD_V_31 : 29300|1@1+ (1,0) [0|1] "bool" MCU
 SG_ OBJ_Inv_TTC_31 : 29301|11@1+ (0.01,-8) [-8|8] "INV(s)" MCU
 SG_ OBJ_Inv_TTC_V_31 : 29312|1@1+ (1,0) [0|1] "bool" MCU
 SG_ OBJ_Inv_TTC_STD_31 : 29313|12@1+ (0.001,0) [0|4] "INV(s)" MCU
 SG_ OBJ_Inv_TTC_STD_V_31 : 29325|1@1+ (1,0) [0|1] "bool" MCU
 SG_ OBJ_Relative_Long_Acc_31 : 29326|10@1+ (0.05,-20) [-20|20] "m_per_s2" MCU
 SG_ OBJ_Relative_Long_Acc_V_31 : 29336|1@1+ (1,0) [0|1] "bool" MCU
 SG_ Reserved_9_31 : 29337|7@1+ (1,0) [0|0] "NA" MCU
 SG_ OBJ_Relative_Long_Acc_STD_31 : 29344|10@1+ (0.01,0) [0|7.3] "m_per_s2" MCU
 SG_ OBJ_Rel_Long_Acc_STD_V_31 : 29354|1@1+ (1,0) [0|1] "bool" MCU
 SG_ OBJ_Relative_Long_Velocity_31 : 29355|13@1+ (0.05,-120) [-120|130] "m_per_s" MCU
 SG_ OBJ_Relative_Long_Velocity_V_31 : 29368|1@1+ (1,0) [0|1] "bool" MCU
 SG_ Reserved_10_31 : 29369|7@1+ (1,0) [0|0] "NA" MCU
 SG_ OBJ_Relative_Long_Vel_STD_31 : 29376|14@1+ (0.01,0) [0|130] "m_per_s" MCU
 SG_ OBJ_Rel_Long_Vel_STD_V_31 : 29390|1@1+ (1,0) [0|1] "bool" MCU
 SG_ OBJ_Relative_Lat_Velocity_31 : 29391|11@1+ (0.05,-50) [-50|50] "m_per_s" MCU
 SG_ OBJ_Relative_Lat_Velocity_V_31 : 29402|1@1+ (1,0) [0|1] "bool" MCU
 SG_ Reserved_11_31 : 29403|5@1+ (1,0) [0|0] "NA" MCU
 SG_ OBJ_Relative_Lat_Velocity_STD_31 : 29408|13@1+ (0.01,0) [0|50] "m_per_s" MCU
 SG_ OBJ_Rel_Lat_Vel_STD_V_31 : 29421|1@1+ (1,0) [0|1] "bool" MCU
 SG_ OBJ_Long_Distance_31 : 29422|14@1+ (0.05,-200) [-200|500] "m" MCU
 SG_ OBJ_Long_Distance_V_31 : 29436|1@1+ (1,0) [0|1] "bool" MCU
 SG_ Reserved_12_31 : 29437|3@1+ (1,0) [0|0] "NA" MCU
 SG_ OBJ_Long_Distance_STD_31 : 29440|15@1+ (0.01,0) [0|250] "m" MCU
 SG_ OBJ_Long_Distance_STD_V_31 : 29455|1@1+ (1,0) [0|1] "bool" MCU
 SG_ OBJ_Lat_Distance_31 : 29456|12@1+ (0.05,-100) [-100|100] "m" MCU
 SG_ OBJ_Lat_Distance_V_31 : 29468|1@1+ (1,0) [0|1] "bool" MCU
 SG_ Reserved_13_31 : 29469|3@1+ (1,0) [0|0] "NA" MCU
 SG_ OBJ_Lat_Distance_STD_31 : 29472|14@1+ (0.01,0) [0|100] "m" MCU
 SG_ OBJ_Lat_Distance_STD_V_31 : 29486|1@1+ (1,0) [0|1] "bool" MCU
 SG_ OBJ_Absolute_Speed_31 : 29487|12@1+ (0.05,-65) [-65|65] "m_per_s" MCU
 SG_ OBJ_Absolute_Speed_V_31 : 29499|1@1+ (1,0) [0|1] "bool" MCU
 SG_ Reserved_14_31 : 29500|4@1+ (1,0) [0|0] "NA" MCU
 SG_ OBJ_Absolute_Speed_STD_31 : 29504|13@1+ (0.01,0) [0|65] "m_per_s" MCU
 SG_ OBJ_Absolute_Speed_STD_V_31 : 29517|1@1+ (1,0) [0|1] "bool" MCU
 SG_ OBJ_Heading_31 : 29518|10@1+ (0.01,-3.14) [-3.14|3.14] "rad" MCU
 SG_ OBJ_Heading_V_31 : 29528|1@1+ (1,0) [0|1] "bool" MCU
 SG_ Reserved_15_31 : 29529|7@1+ (1,0) [0|0] "NA" MCU
 SG_ OBJ_Heading_STD_31 : 29536|15@1+ (0.0001,0) [0|3.14] "rad" MCU
 SG_ OBJ_Heading_STD_V_31 : 29551|1@1+ (1,0) [0|1] "bool" MCU
 SG_ OBJ_Angle_Rate_STD_31 : 29552|15@1+ (0.0001,0) [0|2.2318] "RPS" MCU
 SG_ OBJ_Angle_Rate_STD_V_31 : 29567|1@1+ (1,0) [0|1] "bool" MCU
 SG_ OBJ_Angle_Rate_31 : 29568|12@1+ (0.002,-2.234) [-2.234|2.2318] "RPS" MCU
 SG_ OBJ_Angle_Rate_V_31 : 29580|1@1+ (1,0) [0|1] "bool" MCU
 SG_ OBJ_Angle_Right_31 : 29581|14@1+ (0.0002,-1.571) [-1.571|1.571] "rad" MCU
 SG_ OBJ_Angle_Right_V_31 : 29595|1@1+ (1,0) [0|1] "bool" MCU
 SG_ Reserved_16_31 : 29596|4@1+ (1,0) [0|0] "NA" MCU
 SG_ OBJ_Angle_Right_STD_31 : 29600|14@1+ (0.0001,0) [0|1.571] "rad" MCU
 SG_ OBJ_Angle_Right_STD_V_31 : 29614|1@1+ (1,0) [0|1] "bool" MCU
 SG_ OBJ_Angle_Left_31 : 29615|14@1+ (0.0002,-1.571) [-1.571|1.571] "rad" MCU
 SG_ OBJ_Angle_Left_V_31 : 29629|1@1+ (1,0) [0|1] "bool" MCU
 SG_ Reserved_17_31 : 29630|2@1+ (1,0) [0|0] "NA" MCU
 SG_ OBJ_Angle_Left_STD_31 : 29632|14@1+ (0.0001,0) [0|1.571] "rad" MCU
 SG_ OBJ_Angle_Left_STD_V_31 : 29646|1@1+ (1,0) [0|1] "bool" MCU
 SG_ OBJ_Angle_Side_31 : 29647|14@1+ (0.0002,-1.571) [-1.571|1.571] "rad" MCU
 SG_ OBJ_Angle_Side_V_31 : 29661|1@1+ (1,0) [0|1] "bool" MCU
 SG_ Reserved_18_31 : 29662|2@1+ (1,0) [0|0] "NA" MCU
 SG_ OBJ_Angle_Side_STD_31 : 29664|14@1+ (0.0001,0) [0|1.571] "rad" MCU
 SG_ OBJ_Angle_Side_STD_V_31 : 29678|1@1+ (1,0) [0|1] "bool" MCU
 SG_ OBJ_Angle_Mid_V_31 : 29679|1@1+ (1,0) [0|1] "bool" MCU
 SG_ OBJ_Angle_Mid_31 : 29680|14@1+ (0.0002,-1.571) [-1.571|1.571] "rad" MCU
 SG_ Reserved_19_31 : 29694|2@1+ (1,0) [0|0] "NA" MCU
 SG_ OBJ_Angle_Mid_STD_31 : 29696|14@1+ (0.0001,0) [0|1.571] "rad" MCU
 SG_ OBJ_Angle_Mid_STD_V_31 : 29710|1@1+ (1,0) [0|1] "bool" MCU
 SG_ OBJ_Angle_Bottom_V_31 : 29711|1@1+ (1,0) [0|1] "bool" MCU
 SG_ OBJ_Angle_Bottom_31 : 29712|14@1+ (0.0002,-1.571) [-1.571|1.571] "rad" MCU
 SG_ Reserved_20_31 : 29726|2@1+ (1,0) [0|0] "NA" MCU
 SG_ OBJ_Angle_Bottom_STD_31 : 29728|14@1+ (0.0001,0) [0|1.571] "rad" MCU
 SG_ OBJ_Angle_Bottom_STD_V_31 : 29742|1@1+ (1,0) [0|1] "bool" MCU
 SG_ OBJ_Visibility_Side_V_31 : 29743|1@1+ (1,0) [0|1] "bool" MCU
 SG_ OBJ_Visibility_Side_31 : 29744|2@1+ (1,0) [0|2] "ENUM" MCU
 SG_ OBJ_Is_In_Drivable_Area_31 : 29746|1@1+ (1,0) [0|1] "bool" MCU
 SG_ OBJ_Is_In_Drivable_Area_V_31 : 29747|1@1+ (1,0) [0|1] "bool" MCU
 SG_ OBJ_Is_VeryClose_V_31 : 29748|1@1+ (1,0) [0|1] "bool" MCU
 SG_ OBJ_Is_VeryClose_31 : 29749|1@1+ (1,0) [0|1] "bool" MCU
 SG_ OBJ_Buffer_C4_31 : 29750|2@1+ (1,0) [0|2] "NA" MCU
 SG_ OBJ_Buffer_C5_31 : 29752|2@1+ (1,0) [0|2] "NA" MCU
 SG_ OBJ_Buffer_C6_31 : 29754|2@1+ (1,0) [0|2] "NA" MCU
 SG_ OBJ_Buffer_C7_31 : 29756|2@1+ (1,0) [0|2] "NA" MCU
 SG_ Reserved_21_31 : 29758|2@1+ (1,0) [0|0] "NA" MCU
 SG_ OBJ_OverlapAngleEgoLaneR_31 : 29760|10@1+ (0.01,-3.14) [-3.14|3.14] "rad" MCU
 SG_ OBJ_OverlapAngleEgoLaneR_V_31 : 29770|1@1+ (1,0) [0|1] "bool" MCU
 SG_ OBJ_OverlapAngleEgoLaneL_31 : 29771|10@1+ (0.01,-3.14) [-3.14|3.14] "rad" MCU
 SG_ OBJ_OverlapAngleEgoLaneL_V_31 : 29781|1@1+ (1,0) [0|1] "bool" MCU
 SG_ OBJ_Is_EMERGENCY_VCL_31 : 29782|1@1+ (1,0) [0|1] "bool" MCU
 SG_ OBJ_EMERGENCY_LIGHT_COLOR_31 : 29783|4@1+ (1,0) [0|15] "BITWIZE" MCU
 SG_ OBJ_EMERGENCY_V_31 : 29787|1@1+ (1,0) [0|1] "bool" MCU
 SG_ Reserved_22_31 : 29788|4@1+ (1,0) [0|0] "NA" MCU
 SG_ OBJ_Angle_Top_31 : 29792|14@1+ (0.0002,0) [0|3.1415] "rad" MCU
 SG_ OBJ_Angle_Top_V_31 : 29806|1@1+ (1,0) [0|1] "bool" MCU
 SG_ OBJ_Angle_Top_STD_31 : 29807|15@1+ (0.0001,0) [0|3.1415] "rad" MCU
 SG_ OBJ_Angle_Top_STD_V_31 : 29822|1@1+ (1,0) [0|1] "bool" MCU
 SG_ OBJ_Buffer_C14_31 : 29823|1@1+ (1,0) [0|1] "NA" MCU
 SG_ OBJ_Buffer_C15_31 : 29824|1@1+ (1,0) [0|1] "NA" MCU
 SG_ OBJ_Buffer_C18_31 : 29825|2@1+ (1,0) [0|2] "NA" MCU
 SG_ OBJ_Buffer_C19_31 : 29827|1@1+ (1,0) [0|1] "NA" MCU
 SG_ Reserved_23_31 : 29828|28@1+ (1,0) [0|0] "NA" MCU
 SG_ OBJ_CRC_32 : 29856|32@1+ (1,0) [0|4294967295] "NA" MCU
 SG_ OBJ_ID_32 : 29888|8@1+ (1,0) [0|255] "counter" MCU
 SG_ OBJ_Existence_Probability_32 : 29896|8@1+ (0.01,0) [0|1] "NA" MCU
 SG_ OBJ_Fusion_Source_32 : 29904|16@1+ (1,0) [0|65535] "BITWIZE" MCU
 SG_ OBJ_Triggered_SDM_32 : 29920|2@1+ (1,0) [0|2] "ENUM" MCU
 SG_ OBJ_Motion_Category_32 : 29922|4@1+ (1,0) [0|13] "ENUM" MCU
 SG_ OBJ_Buffer_C0_32 : 29926|7@1+ (0.01,0) [0|1] "NA" MCU
 SG_ OBJ_Object_Age_32 : 29933|11@1+ (1,0) [0|2047] "frames" MCU
 SG_ OBJ_Measuring_Status_32 : 29944|3@1+ (1,0) [0|7] "BITWIZE" MCU
 SG_ OBJ_Object_Class_32 : 29947|4@1+ (1,0) [0|8] "ENUM" MCU
 SG_ Reserved_4_32 : 29951|1@1+ (1,0) [0|0] "NA" MCU
 SG_ OBJ_Class_Probability_32 : 29952|7@1+ (0.01,0) [0|1] "NA" MCU
 SG_ OBJ_Car_Probability_32 : 29959|7@1+ (0.01,0) [0|1] "NA" MCU
 SG_ OBJ_Truck_Probability_32 : 29966|7@1+ (0.01,0) [0|1] "NA" MCU
 SG_ OBJ_Bike_Probability_32 : 29973|7@1+ (0.01,0) [0|1] "NA" MCU
 SG_ OBJ_Camera_Source_32 : 29980|4@1+ (1,0) [0|15] "ENUM" MCU
 SG_ OBJ_Motion_Status_32 : 29984|3@1+ (1,0) [0|5] "ENUM" MCU
 SG_ OBJ_Motion_Orientation_32 : 29987|4@1+ (1,0) [0|13] "ENUM" MCU
 SG_ OBJ_Has_Cut_Lane_32 : 29991|1@1+ (1,0) [0|1] "bool" MCU
 SG_ OBJ_Has_Cut_Path_32 : 29992|1@1+ (1,0) [0|1] "bool" MCU
 SG_ OBJ_Brake_Light_32 : 29993|1@1+ (1,0) [0|1] "bool" MCU
 SG_ OBJ_Turn_Indicator_Right_32 : 29994|1@1+ (1,0) [0|1] "bool" MCU
 SG_ OBJ_Turn_Indicator_Left_32 : 29995|1@1+ (1,0) [0|1] "bool" MCU
 SG_ OBJ_Light_Indicator_Validity_32 : 29996|1@1+ (1,0) [0|1] "bool" MCU
 SG_ OBJ_Right_Out_Of_Image_32 : 29997|1@1+ (1,0) [0|1] "bool" MCU
 SG_ OBJ_Left_Out_Of_Image_32 : 29998|1@1+ (1,0) [0|1] "bool" MCU
 SG_ OBJ_Right_Out_Of_Image_V_32 : 29999|1@1+ (1,0) [0|1] "bool" MCU
 SG_ OBJ_Left_Out_Of_Image_V_32 : 30000|1@1+ (1,0) [0|1] "bool" MCU
 SG_ OBJ_Top_Out_Of_Image_32 : 30001|1@1+ (1,0) [0|1] "bool" MCU
 SG_ OBJ_Bottom_Out_Of_Image_32 : 30002|1@1+ (1,0) [0|1] "bool" MCU
 SG_ OBJ_Top_Out_Of_Image_V_32 : 30003|1@1+ (1,0) [0|1] "bool" MCU
 SG_ OBJ_Bottom_Out_Of_Image_V_32 : 30004|1@1+ (1,0) [0|1] "bool" MCU
 SG_ OBJ_Lane_Assignment_32 : 30005|3@1+ (1,0) [0|5] "ENUM" MCU
 SG_ OBJ_Lane_Assignment_V_32 : 30008|1@1+ (1,0) [0|1] "bool" MCU
 SG_ OBJ_Age_Seconds_32 : 30009|7@1+ (1,0) [0|100] "s" MCU
 SG_ OBJ_Age_Seconds_V_32 : 30016|1@1+ (1,0) [0|1] "bool" MCU
 SG_ OBJ_Width_32 : 30017|9@1+ (0.01,0) [0.4|2.95] "m" MCU
 SG_ OBJ_Width_V_32 : 30026|1@1+ (1,0) [0|1] "bool" MCU
 SG_ OBJ_Width_STD_32 : 30027|11@1+ (0.001,0) [0|2] "m" MCU
 SG_ OBJ_Width_STD_V_32 : 30038|1@1+ (1,0) [0|1] "bool" MCU
 SG_ OBJ_Length_32 : 30039|9@1+ (0.05,0) [1.2|21] "m" MCU
 SG_ OBJ_Length_V_32 : 30048|1@1+ (1,0) [0|1] "bool" MCU
 SG_ OBJ_Length_STD_32 : 30049|10@1+ (0.01,0) [0|10] "m" MCU
 SG_ OBJ_Length_STD_V_32 : 30059|1@1+ (1,0) [0|1] "bool" MCU
 SG_ OBJ_Radar_ID_32 : 30060|8@1+ (1,0) [0|255] "counter" MCU
 SG_ OBJ_Height_32 : 30068|9@1+ (0.01,0) [0|2.95] "m" MCU
 SG_ OBJ_Height_V_32 : 30077|1@1+ (1,0) [0|1] "bool" MCU
 SG_ Reserved_5_32 : 30078|2@1+ (1,0) [0|0] "NA" MCU
 SG_ OBJ_Height_STD_32 : 30080|11@1+ (0.001,0) [0|2] "m" MCU
 SG_ OBJ_Height_STD_V_32 : 30091|1@1+ (1,0) [0|1] "bool" MCU
 SG_ OBJ_Abs_Long_Velocity_32 : 30092|12@1+ (0.05,-100) [-100|100] "m_per_s" MCU
 SG_ OBJ_Abs_Long_Velocity_V_32 : 30104|1@1+ (1,0) [0|1] "bool" MCU
 SG_ Reserved_6_32 : 30105|7@1+ (1,0) [0|0] "NA" MCU
 SG_ OBJ_Abs_Long_Velocity_STD_32 : 30112|13@1+ (0.01,0) [0|65] "m_per_s" MCU
 SG_ OBJ_Abs_Long_Vel_STD_V_32 : 30125|1@1+ (1,0) [0|1] "bool" MCU
 SG_ OBJ_Abs_Lat_Velocity_32 : 30126|11@1+ (0.05,-50) [-50|50] "m_per_s" MCU
 SG_ OBJ_Abs_Lat_Velocity_V_32 : 30137|1@1+ (1,0) [0|1] "bool" MCU
 SG_ Reserved_7_32 : 30138|6@1+ (1,0) [0|0] "NA" MCU
 SG_ OBJ_Abs_Lat_Velocity_STD_32 : 30144|13@1+ (0.01,0) [0|50] "m_per_s" MCU
 SG_ OBJ_Abs_Lat_Vel_STD_V_32 : 30157|1@1+ (1,0) [0|1] "bool" MCU
 SG_ OBJ_Abs_Long_Acc_32 : 30158|9@1+ (0.05,-10) [-10|10] "m_per_s2" MCU
 SG_ OBJ_Abs_Long_Acc_V_32 : 30167|1@1+ (1,0) [0|1] "bool" MCU
 SG_ Reserved_8_32 : 30168|8@1+ (1,0) [0|0] "NA" MCU
 SG_ OBJ_Abs_Long_Acc_STD_32 : 30176|10@1+ (0.01,0) [0|7.3] "m_per_s2" MCU
 SG_ OBJ_Abs_Long_Acc_STD_V_32 : 30186|1@1+ (1,0) [0|1] "bool" MCU
 SG_ OBJ_Abs_Lat_Acc_32 : 30187|9@1+ (0.05,-10) [-10|10] "m_per_s2" MCU
 SG_ OBJ_Abs_Lat_Acc_V_32 : 30196|1@1+ (1,0) [0|1] "bool" MCU
 SG_ OBJ_Abs_Lat_Acc_STD_32 : 30197|10@1+ (0.01,0) [0|7.3] "m_per_s2" MCU
 SG_ OBJ_Abs_Lat_Acc_STD_V_32 : 30207|1@1+ (1,0) [0|1] "bool" MCU
 SG_ OBJ_Abs_Acceleration_32 : 30208|9@1+ (0.05,-12.7) [-12.7|12.7] "m_per_s2" MCU
 SG_ OBJ_Abs_Acceleration_V_32 : 30217|1@1+ (1,0) [0|1] "bool" MCU
 SG_ OBJ_Abs_Acc_STD_32 : 30218|10@1+ (0.01,0) [0|7.3] "m_per_s2" MCU
 SG_ OBJ_Abs_Acc_STD_V_32 : 30228|1@1+ (1,0) [0|1] "bool" MCU
 SG_ OBJ_Inv_TTC_32 : 30229|11@1+ (0.01,-8) [-8|8] "INV(s)" MCU
 SG_ OBJ_Inv_TTC_V_32 : 30240|1@1+ (1,0) [0|1] "bool" MCU
 SG_ OBJ_Inv_TTC_STD_32 : 30241|12@1+ (0.001,0) [0|4] "INV(s)" MCU
 SG_ OBJ_Inv_TTC_STD_V_32 : 30253|1@1+ (1,0) [0|1] "bool" MCU
 SG_ OBJ_Relative_Long_Acc_32 : 30254|10@1+ (0.05,-20) [-20|20] "m_per_s2" MCU
 SG_ OBJ_Relative_Long_Acc_V_32 : 30264|1@1+ (1,0) [0|1] "bool" MCU
 SG_ Reserved_9_32 : 30265|7@1+ (1,0) [0|0] "NA" MCU
 SG_ OBJ_Relative_Long_Acc_STD_32 : 30272|10@1+ (0.01,0) [0|7.3] "m_per_s2" MCU
 SG_ OBJ_Rel_Long_Acc_STD_V_32 : 30282|1@1+ (1,0) [0|1] "bool" MCU
 SG_ OBJ_Relative_Long_Velocity_32 : 30283|13@1+ (0.05,-120) [-120|130] "m_per_s" MCU
 SG_ OBJ_Relative_Long_Velocity_V_32 : 30296|1@1+ (1,0) [0|1] "bool" MCU
 SG_ Reserved_10_32 : 30297|7@1+ (1,0) [0|0] "NA" MCU
 SG_ OBJ_Relative_Long_Vel_STD_32 : 30304|14@1+ (0.01,0) [0|130] "m_per_s" MCU
 SG_ OBJ_Rel_Long_Vel_STD_V_32 : 30318|1@1+ (1,0) [0|1] "bool" MCU
 SG_ OBJ_Relative_Lat_Velocity_32 : 30319|11@1+ (0.05,-50) [-50|50] "m_per_s" MCU
 SG_ OBJ_Relative_Lat_Velocity_V_32 : 30330|1@1+ (1,0) [0|1] "bool" MCU
 SG_ Reserved_11_32 : 30331|5@1+ (1,0) [0|0] "NA" MCU
 SG_ OBJ_Relative_Lat_Velocity_STD_32 : 30336|13@1+ (0.01,0) [0|50] "m_per_s" MCU
 SG_ OBJ_Rel_Lat_Vel_STD_V_32 : 30349|1@1+ (1,0) [0|1] "bool" MCU
 SG_ OBJ_Long_Distance_32 : 30350|14@1+ (0.05,-200) [-200|500] "m" MCU
 SG_ OBJ_Long_Distance_V_32 : 30364|1@1+ (1,0) [0|1] "bool" MCU
 SG_ Reserved_12_32 : 30365|3@1+ (1,0) [0|0] "NA" MCU
 SG_ OBJ_Long_Distance_STD_32 : 30368|15@1+ (0.01,0) [0|250] "m" MCU
 SG_ OBJ_Long_Distance_STD_V_32 : 30383|1@1+ (1,0) [0|1] "bool" MCU
 SG_ OBJ_Lat_Distance_32 : 30384|12@1+ (0.05,-100) [-100|100] "m" MCU
 SG_ OBJ_Lat_Distance_V_32 : 30396|1@1+ (1,0) [0|1] "bool" MCU
 SG_ Reserved_13_32 : 30397|3@1+ (1,0) [0|0] "NA" MCU
 SG_ OBJ_Lat_Distance_STD_32 : 30400|14@1+ (0.01,0) [0|100] "m" MCU
 SG_ OBJ_Lat_Distance_STD_V_32 : 30414|1@1+ (1,0) [0|1] "bool" MCU
 SG_ OBJ_Absolute_Speed_32 : 30415|12@1+ (0.05,-65) [-65|65] "m_per_s" MCU
 SG_ OBJ_Absolute_Speed_V_32 : 30427|1@1+ (1,0) [0|1] "bool" MCU
 SG_ Reserved_14_32 : 30428|4@1+ (1,0) [0|0] "NA" MCU
 SG_ OBJ_Absolute_Speed_STD_32 : 30432|13@1+ (0.01,0) [0|65] "m_per_s" MCU
 SG_ OBJ_Absolute_Speed_STD_V_32 : 30445|1@1+ (1,0) [0|1] "bool" MCU
 SG_ OBJ_Heading_32 : 30446|10@1+ (0.01,-3.14) [-3.14|3.14] "rad" MCU
 SG_ OBJ_Heading_V_32 : 30456|1@1+ (1,0) [0|1] "bool" MCU
 SG_ Reserved_15_32 : 30457|7@1+ (1,0) [0|0] "NA" MCU
 SG_ OBJ_Heading_STD_32 : 30464|15@1+ (0.0001,0) [0|3.14] "rad" MCU
 SG_ OBJ_Heading_STD_V_32 : 30479|1@1+ (1,0) [0|1] "bool" MCU
 SG_ OBJ_Angle_Rate_STD_32 : 30480|15@1+ (0.0001,0) [0|2.2318] "RPS" MCU
 SG_ OBJ_Angle_Rate_STD_V_32 : 30495|1@1+ (1,0) [0|1] "bool" MCU
 SG_ OBJ_Angle_Rate_32 : 30496|12@1+ (0.002,-2.234) [-2.234|2.2318] "RPS" MCU
 SG_ OBJ_Angle_Rate_V_32 : 30508|1@1+ (1,0) [0|1] "bool" MCU
 SG_ OBJ_Angle_Right_32 : 30509|14@1+ (0.0002,-1.571) [-1.571|1.571] "rad" MCU
 SG_ OBJ_Angle_Right_V_32 : 30523|1@1+ (1,0) [0|1] "bool" MCU
 SG_ Reserved_16_32 : 30524|4@1+ (1,0) [0|0] "NA" MCU
 SG_ OBJ_Angle_Right_STD_32 : 30528|14@1+ (0.0001,0) [0|1.571] "rad" MCU
 SG_ OBJ_Angle_Right_STD_V_32 : 30542|1@1+ (1,0) [0|1] "bool" MCU
 SG_ OBJ_Angle_Left_32 : 30543|14@1+ (0.0002,-1.571) [-1.571|1.571] "rad" MCU
 SG_ OBJ_Angle_Left_V_32 : 30557|1@1+ (1,0) [0|1] "bool" MCU
 SG_ Reserved_17_32 : 30558|2@1+ (1,0) [0|0] "NA" MCU
 SG_ OBJ_Angle_Left_STD_32 : 30560|14@1+ (0.0001,0) [0|1.571] "rad" MCU
 SG_ OBJ_Angle_Left_STD_V_32 : 30574|1@1+ (1,0) [0|1] "bool" MCU
 SG_ OBJ_Angle_Side_32 : 30575|14@1+ (0.0002,-1.571) [-1.571|1.571] "rad" MCU
 SG_ OBJ_Angle_Side_V_32 : 30589|1@1+ (1,0) [0|1] "bool" MCU
 SG_ Reserved_18_32 : 30590|2@1+ (1,0) [0|0] "NA" MCU
 SG_ OBJ_Angle_Side_STD_32 : 30592|14@1+ (0.0001,0) [0|1.571] "rad" MCU
 SG_ OBJ_Angle_Side_STD_V_32 : 30606|1@1+ (1,0) [0|1] "bool" MCU
 SG_ OBJ_Angle_Mid_V_32 : 30607|1@1+ (1,0) [0|1] "bool" MCU
 SG_ OBJ_Angle_Mid_32 : 30608|14@1+ (0.0002,-1.571) [-1.571|1.571] "rad" MCU
 SG_ Reserved_19_32 : 30622|2@1+ (1,0) [0|0] "NA" MCU
 SG_ OBJ_Angle_Mid_STD_32 : 30624|14@1+ (0.0001,0) [0|1.571] "rad" MCU
 SG_ OBJ_Angle_Mid_STD_V_32 : 30638|1@1+ (1,0) [0|1] "bool" MCU
 SG_ OBJ_Angle_Bottom_V_32 : 30639|1@1+ (1,0) [0|1] "bool" MCU
 SG_ OBJ_Angle_Bottom_32 : 30640|14@1+ (0.0002,-1.571) [-1.571|1.571] "rad" MCU
 SG_ Reserved_20_32 : 30654|2@1+ (1,0) [0|0] "NA" MCU
 SG_ OBJ_Angle_Bottom_STD_32 : 30656|14@1+ (0.0001,0) [0|1.571] "rad" MCU
 SG_ OBJ_Angle_Bottom_STD_V_32 : 30670|1@1+ (1,0) [0|1] "bool" MCU
 SG_ OBJ_Visibility_Side_V_32 : 30671|1@1+ (1,0) [0|1] "bool" MCU
 SG_ OBJ_Visibility_Side_32 : 30672|2@1+ (1,0) [0|2] "ENUM" MCU
 SG_ OBJ_Is_In_Drivable_Area_32 : 30674|1@1+ (1,0) [0|1] "bool" MCU
 SG_ OBJ_Is_In_Drivable_Area_V_32 : 30675|1@1+ (1,0) [0|1] "bool" MCU
 SG_ OBJ_Is_VeryClose_V_32 : 30676|1@1+ (1,0) [0|1] "bool" MCU
 SG_ OBJ_Is_VeryClose_32 : 30677|1@1+ (1,0) [0|1] "bool" MCU
 SG_ OBJ_Buffer_C4_32 : 30678|2@1+ (1,0) [0|2] "NA" MCU
 SG_ OBJ_Buffer_C5_32 : 30680|2@1+ (1,0) [0|2] "NA" MCU
 SG_ OBJ_Buffer_C6_32 : 30682|2@1+ (1,0) [0|2] "NA" MCU
 SG_ OBJ_Buffer_C7_32 : 30684|2@1+ (1,0) [0|2] "NA" MCU
 SG_ Reserved_21_32 : 30686|2@1+ (1,0) [0|0] "NA" MCU
 SG_ OBJ_OverlapAngleEgoLaneR_32 : 30688|10@1+ (0.01,-3.14) [-3.14|3.14] "rad" MCU
 SG_ OBJ_OverlapAngleEgoLaneR_V_32 : 30698|1@1+ (1,0) [0|1] "bool" MCU
 SG_ OBJ_OverlapAngleEgoLaneL_32 : 30699|10@1+ (0.01,-3.14) [-3.14|3.14] "rad" MCU
 SG_ OBJ_OverlapAngleEgoLaneL_V_32 : 30709|1@1+ (1,0) [0|1] "bool" MCU
 SG_ OBJ_Is_EMERGENCY_VCL_32 : 30710|1@1+ (1,0) [0|1] "bool" MCU
 SG_ OBJ_EMERGENCY_LIGHT_COLOR_32 : 30711|4@1+ (1,0) [0|15] "BITWIZE" MCU
 SG_ OBJ_EMERGENCY_V_32 : 30715|1@1+ (1,0) [0|1] "bool" MCU
 SG_ Reserved_22_32 : 30716|4@1+ (1,0) [0|0] "NA" MCU
 SG_ OBJ_Angle_Top_32 : 30720|14@1+ (0.0002,0) [0|3.1415] "rad" MCU
 SG_ OBJ_Angle_Top_V_32 : 30734|1@1+ (1,0) [0|1] "bool" MCU
 SG_ OBJ_Angle_Top_STD_32 : 30735|15@1+ (0.0001,0) [0|3.1415] "rad" MCU
 SG_ OBJ_Angle_Top_STD_V_32 : 30750|1@1+ (1,0) [0|1] "bool" MCU
 SG_ OBJ_Buffer_C14_32 : 30751|1@1+ (1,0) [0|1] "NA" MCU
 SG_ OBJ_Buffer_C15_32 : 30752|1@1+ (1,0) [0|1] "NA" MCU
 SG_ OBJ_Buffer_C18_32 : 30753|2@1+ (1,0) [0|2] "NA" MCU
 SG_ OBJ_Buffer_C19_32 : 30755|1@1+ (1,0) [0|1] "NA" MCU
 SG_ Reserved_23_32 : 30756|28@1+ (1,0) [0|0] "NA" MCU
 SG_ OBJ_CRC_33 : 30784|32@1+ (1,0) [0|4294967295] "NA" MCU
 SG_ OBJ_ID_33 : 30816|8@1+ (1,0) [0|255] "counter" MCU
 SG_ OBJ_Existence_Probability_33 : 30824|8@1+ (0.01,0) [0|1] "NA" MCU
 SG_ OBJ_Fusion_Source_33 : 30832|16@1+ (1,0) [0|65535] "BITWIZE" MCU
 SG_ OBJ_Triggered_SDM_33 : 30848|2@1+ (1,0) [0|2] "ENUM" MCU
 SG_ OBJ_Motion_Category_33 : 30850|4@1+ (1,0) [0|13] "ENUM" MCU
 SG_ OBJ_Buffer_C0_33 : 30854|7@1+ (0.01,0) [0|1] "NA" MCU
 SG_ OBJ_Object_Age_33 : 30861|11@1+ (1,0) [0|2047] "frames" MCU
 SG_ OBJ_Measuring_Status_33 : 30872|3@1+ (1,0) [0|7] "BITWIZE" MCU
 SG_ OBJ_Object_Class_33 : 30875|4@1+ (1,0) [0|8] "ENUM" MCU
 SG_ Reserved_4_33 : 30879|1@1+ (1,0) [0|0] "NA" MCU
 SG_ OBJ_Class_Probability_33 : 30880|7@1+ (0.01,0) [0|1] "NA" MCU
 SG_ OBJ_Car_Probability_33 : 30887|7@1+ (0.01,0) [0|1] "NA" MCU
 SG_ OBJ_Truck_Probability_33 : 30894|7@1+ (0.01,0) [0|1] "NA" MCU
 SG_ OBJ_Bike_Probability_33 : 30901|7@1+ (0.01,0) [0|1] "NA" MCU
 SG_ OBJ_Camera_Source_33 : 30908|4@1+ (1,0) [0|15] "ENUM" MCU
 SG_ OBJ_Motion_Status_33 : 30912|3@1+ (1,0) [0|5] "ENUM" MCU
 SG_ OBJ_Motion_Orientation_33 : 30915|4@1+ (1,0) [0|13] "ENUM" MCU
 SG_ OBJ_Has_Cut_Lane_33 : 30919|1@1+ (1,0) [0|1] "bool" MCU
 SG_ OBJ_Has_Cut_Path_33 : 30920|1@1+ (1,0) [0|1] "bool" MCU
 SG_ OBJ_Brake_Light_33 : 30921|1@1+ (1,0) [0|1] "bool" MCU
 SG_ OBJ_Turn_Indicator_Right_33 : 30922|1@1+ (1,0) [0|1] "bool" MCU
 SG_ OBJ_Turn_Indicator_Left_33 : 30923|1@1+ (1,0) [0|1] "bool" MCU
 SG_ OBJ_Light_Indicator_Validity_33 : 30924|1@1+ (1,0) [0|1] "bool" MCU
 SG_ OBJ_Right_Out_Of_Image_33 : 30925|1@1+ (1,0) [0|1] "bool" MCU
 SG_ OBJ_Left_Out_Of_Image_33 : 30926|1@1+ (1,0) [0|1] "bool" MCU
 SG_ OBJ_Right_Out_Of_Image_V_33 : 30927|1@1+ (1,0) [0|1] "bool" MCU
 SG_ OBJ_Left_Out_Of_Image_V_33 : 30928|1@1+ (1,0) [0|1] "bool" MCU
 SG_ OBJ_Top_Out_Of_Image_33 : 30929|1@1+ (1,0) [0|1] "bool" MCU
 SG_ OBJ_Bottom_Out_Of_Image_33 : 30930|1@1+ (1,0) [0|1] "bool" MCU
 SG_ OBJ_Top_Out_Of_Image_V_33 : 30931|1@1+ (1,0) [0|1] "bool" MCU
 SG_ OBJ_Bottom_Out_Of_Image_V_33 : 30932|1@1+ (1,0) [0|1] "bool" MCU
 SG_ OBJ_Lane_Assignment_33 : 30933|3@1+ (1,0) [0|5] "ENUM" MCU
 SG_ OBJ_Lane_Assignment_V_33 : 30936|1@1+ (1,0) [0|1] "bool" MCU
 SG_ OBJ_Age_Seconds_33 : 30937|7@1+ (1,0) [0|100] "s" MCU
 SG_ OBJ_Age_Seconds_V_33 : 30944|1@1+ (1,0) [0|1] "bool" MCU
 SG_ OBJ_Width_33 : 30945|9@1+ (0.01,0) [0.4|2.95] "m" MCU
 SG_ OBJ_Width_V_33 : 30954|1@1+ (1,0) [0|1] "bool" MCU
 SG_ OBJ_Width_STD_33 : 30955|11@1+ (0.001,0) [0|2] "m" MCU
 SG_ OBJ_Width_STD_V_33 : 30966|1@1+ (1,0) [0|1] "bool" MCU
 SG_ OBJ_Length_33 : 30967|9@1+ (0.05,0) [1.2|21] "m" MCU
 SG_ OBJ_Length_V_33 : 30976|1@1+ (1,0) [0|1] "bool" MCU
 SG_ OBJ_Length_STD_33 : 30977|10@1+ (0.01,0) [0|10] "m" MCU
 SG_ OBJ_Length_STD_V_33 : 30987|1@1+ (1,0) [0|1] "bool" MCU
 SG_ OBJ_Radar_ID_33 : 30988|8@1+ (1,0) [0|255] "counter" MCU
 SG_ OBJ_Height_33 : 30996|9@1+ (0.01,0) [0|2.95] "m" MCU
 SG_ OBJ_Height_V_33 : 31005|1@1+ (1,0) [0|1] "bool" MCU
 SG_ Reserved_5_33 : 31006|2@1+ (1,0) [0|0] "NA" MCU
 SG_ OBJ_Height_STD_33 : 31008|11@1+ (0.001,0) [0|2] "m" MCU
 SG_ OBJ_Height_STD_V_33 : 31019|1@1+ (1,0) [0|1] "bool" MCU
 SG_ OBJ_Abs_Long_Velocity_33 : 31020|12@1+ (0.05,-100) [-100|100] "m_per_s" MCU
 SG_ OBJ_Abs_Long_Velocity_V_33 : 31032|1@1+ (1,0) [0|1] "bool" MCU
 SG_ Reserved_6_33 : 31033|7@1+ (1,0) [0|0] "NA" MCU
 SG_ OBJ_Abs_Long_Velocity_STD_33 : 31040|13@1+ (0.01,0) [0|65] "m_per_s" MCU
 SG_ OBJ_Abs_Long_Vel_STD_V_33 : 31053|1@1+ (1,0) [0|1] "bool" MCU
 SG_ OBJ_Abs_Lat_Velocity_33 : 31054|11@1+ (0.05,-50) [-50|50] "m_per_s" MCU
 SG_ OBJ_Abs_Lat_Velocity_V_33 : 31065|1@1+ (1,0) [0|1] "bool" MCU
 SG_ Reserved_7_33 : 31066|6@1+ (1,0) [0|0] "NA" MCU
 SG_ OBJ_Abs_Lat_Velocity_STD_33 : 31072|13@1+ (0.01,0) [0|50] "m_per_s" MCU
 SG_ OBJ_Abs_Lat_Vel_STD_V_33 : 31085|1@1+ (1,0) [0|1] "bool" MCU
 SG_ OBJ_Abs_Long_Acc_33 : 31086|9@1+ (0.05,-10) [-10|10] "m_per_s2" MCU
 SG_ OBJ_Abs_Long_Acc_V_33 : 31095|1@1+ (1,0) [0|1] "bool" MCU
 SG_ Reserved_8_33 : 31096|8@1+ (1,0) [0|0] "NA" MCU
 SG_ OBJ_Abs_Long_Acc_STD_33 : 31104|10@1+ (0.01,0) [0|7.3] "m_per_s2" MCU
 SG_ OBJ_Abs_Long_Acc_STD_V_33 : 31114|1@1+ (1,0) [0|1] "bool" MCU
 SG_ OBJ_Abs_Lat_Acc_33 : 31115|9@1+ (0.05,-10) [-10|10] "m_per_s2" MCU
 SG_ OBJ_Abs_Lat_Acc_V_33 : 31124|1@1+ (1,0) [0|1] "bool" MCU
 SG_ OBJ_Abs_Lat_Acc_STD_33 : 31125|10@1+ (0.01,0) [0|7.3] "m_per_s2" MCU
 SG_ OBJ_Abs_Lat_Acc_STD_V_33 : 31135|1@1+ (1,0) [0|1] "bool" MCU
 SG_ OBJ_Abs_Acceleration_33 : 31136|9@1+ (0.05,-12.7) [-12.7|12.7] "m_per_s2" MCU
 SG_ OBJ_Abs_Acceleration_V_33 : 31145|1@1+ (1,0) [0|1] "bool" MCU
 SG_ OBJ_Abs_Acc_STD_33 : 31146|10@1+ (0.01,0) [0|7.3] "m_per_s2" MCU
 SG_ OBJ_Abs_Acc_STD_V_33 : 31156|1@1+ (1,0) [0|1] "bool" MCU
 SG_ OBJ_Inv_TTC_33 : 31157|11@1+ (0.01,-8) [-8|8] "INV(s)" MCU
 SG_ OBJ_Inv_TTC_V_33 : 31168|1@1+ (1,0) [0|1] "bool" MCU
 SG_ OBJ_Inv_TTC_STD_33 : 31169|12@1+ (0.001,0) [0|4] "INV(s)" MCU
 SG_ OBJ_Inv_TTC_STD_V_33 : 31181|1@1+ (1,0) [0|1] "bool" MCU
 SG_ OBJ_Relative_Long_Acc_33 : 31182|10@1+ (0.05,-20) [-20|20] "m_per_s2" MCU
 SG_ OBJ_Relative_Long_Acc_V_33 : 31192|1@1+ (1,0) [0|1] "bool" MCU
 SG_ Reserved_9_33 : 31193|7@1+ (1,0) [0|0] "NA" MCU
 SG_ OBJ_Relative_Long_Acc_STD_33 : 31200|10@1+ (0.01,0) [0|7.3] "m_per_s2" MCU
 SG_ OBJ_Rel_Long_Acc_STD_V_33 : 31210|1@1+ (1,0) [0|1] "bool" MCU
 SG_ OBJ_Relative_Long_Velocity_33 : 31211|13@1+ (0.05,-120) [-120|130] "m_per_s" MCU
 SG_ OBJ_Relative_Long_Velocity_V_33 : 31224|1@1+ (1,0) [0|1] "bool" MCU
 SG_ Reserved_10_33 : 31225|7@1+ (1,0) [0|0] "NA" MCU
 SG_ OBJ_Relative_Long_Vel_STD_33 : 31232|14@1+ (0.01,0) [0|130] "m_per_s" MCU
 SG_ OBJ_Rel_Long_Vel_STD_V_33 : 31246|1@1+ (1,0) [0|1] "bool" MCU
 SG_ OBJ_Relative_Lat_Velocity_33 : 31247|11@1+ (0.05,-50) [-50|50] "m_per_s" MCU
 SG_ OBJ_Relative_Lat_Velocity_V_33 : 31258|1@1+ (1,0) [0|1] "bool" MCU
 SG_ Reserved_11_33 : 31259|5@1+ (1,0) [0|0] "NA" MCU
 SG_ OBJ_Relative_Lat_Velocity_STD_33 : 31264|13@1+ (0.01,0) [0|50] "m_per_s" MCU
 SG_ OBJ_Rel_Lat_Vel_STD_V_33 : 31277|1@1+ (1,0) [0|1] "bool" MCU
 SG_ OBJ_Long_Distance_33 : 31278|14@1+ (0.05,-200) [-200|500] "m" MCU
 SG_ OBJ_Long_Distance_V_33 : 31292|1@1+ (1,0) [0|1] "bool" MCU
 SG_ Reserved_12_33 : 31293|3@1+ (1,0) [0|0] "NA" MCU
 SG_ OBJ_Long_Distance_STD_33 : 31296|15@1+ (0.01,0) [0|250] "m" MCU
 SG_ OBJ_Long_Distance_STD_V_33 : 31311|1@1+ (1,0) [0|1] "bool" MCU
 SG_ OBJ_Lat_Distance_33 : 31312|12@1+ (0.05,-100) [-100|100] "m" MCU
 SG_ OBJ_Lat_Distance_V_33 : 31324|1@1+ (1,0) [0|1] "bool" MCU
 SG_ Reserved_13_33 : 31325|3@1+ (1,0) [0|0] "NA" MCU
 SG_ OBJ_Lat_Distance_STD_33 : 31328|14@1+ (0.01,0) [0|100] "m" MCU
 SG_ OBJ_Lat_Distance_STD_V_33 : 31342|1@1+ (1,0) [0|1] "bool" MCU
 SG_ OBJ_Absolute_Speed_33 : 31343|12@1+ (0.05,-65) [-65|65] "m_per_s" MCU
 SG_ OBJ_Absolute_Speed_V_33 : 31355|1@1+ (1,0) [0|1] "bool" MCU
 SG_ Reserved_14_33 : 31356|4@1+ (1,0) [0|0] "NA" MCU
 SG_ OBJ_Absolute_Speed_STD_33 : 31360|13@1+ (0.01,0) [0|65] "m_per_s" MCU
 SG_ OBJ_Absolute_Speed_STD_V_33 : 31373|1@1+ (1,0) [0|1] "bool" MCU
 SG_ OBJ_Heading_33 : 31374|10@1+ (0.01,-3.14) [-3.14|3.14] "rad" MCU
 SG_ OBJ_Heading_V_33 : 31384|1@1+ (1,0) [0|1] "bool" MCU
 SG_ Reserved_15_33 : 31385|7@1+ (1,0) [0|0] "NA" MCU
 SG_ OBJ_Heading_STD_33 : 31392|15@1+ (0.0001,0) [0|3.14] "rad" MCU
 SG_ OBJ_Heading_STD_V_33 : 31407|1@1+ (1,0) [0|1] "bool" MCU
 SG_ OBJ_Angle_Rate_STD_33 : 31408|15@1+ (0.0001,0) [0|2.2318] "RPS" MCU
 SG_ OBJ_Angle_Rate_STD_V_33 : 31423|1@1+ (1,0) [0|1] "bool" MCU
 SG_ OBJ_Angle_Rate_33 : 31424|12@1+ (0.002,-2.234) [-2.234|2.2318] "RPS" MCU
 SG_ OBJ_Angle_Rate_V_33 : 31436|1@1+ (1,0) [0|1] "bool" MCU
 SG_ OBJ_Angle_Right_33 : 31437|14@1+ (0.0002,-1.571) [-1.571|1.571] "rad" MCU
 SG_ OBJ_Angle_Right_V_33 : 31451|1@1+ (1,0) [0|1] "bool" MCU
 SG_ Reserved_16_33 : 31452|4@1+ (1,0) [0|0] "NA" MCU
 SG_ OBJ_Angle_Right_STD_33 : 31456|14@1+ (0.0001,0) [0|1.571] "rad" MCU
 SG_ OBJ_Angle_Right_STD_V_33 : 31470|1@1+ (1,0) [0|1] "bool" MCU
 SG_ OBJ_Angle_Left_33 : 31471|14@1+ (0.0002,-1.571) [-1.571|1.571] "rad" MCU
 SG_ OBJ_Angle_Left_V_33 : 31485|1@1+ (1,0) [0|1] "bool" MCU
 SG_ Reserved_17_33 : 31486|2@1+ (1,0) [0|0] "NA" MCU
 SG_ OBJ_Angle_Left_STD_33 : 31488|14@1+ (0.0001,0) [0|1.571] "rad" MCU
 SG_ OBJ_Angle_Left_STD_V_33 : 31502|1@1+ (1,0) [0|1] "bool" MCU
 SG_ OBJ_Angle_Side_33 : 31503|14@1+ (0.0002,-1.571) [-1.571|1.571] "rad" MCU
 SG_ OBJ_Angle_Side_V_33 : 31517|1@1+ (1,0) [0|1] "bool" MCU
 SG_ Reserved_18_33 : 31518|2@1+ (1,0) [0|0] "NA" MCU
 SG_ OBJ_Angle_Side_STD_33 : 31520|14@1+ (0.0001,0) [0|1.571] "rad" MCU
 SG_ OBJ_Angle_Side_STD_V_33 : 31534|1@1+ (1,0) [0|1] "bool" MCU
 SG_ OBJ_Angle_Mid_V_33 : 31535|1@1+ (1,0) [0|1] "bool" MCU
 SG_ OBJ_Angle_Mid_33 : 31536|14@1+ (0.0002,-1.571) [-1.571|1.571] "rad" MCU
 SG_ Reserved_19_33 : 31550|2@1+ (1,0) [0|0] "NA" MCU
 SG_ OBJ_Angle_Mid_STD_33 : 31552|14@1+ (0.0001,0) [0|1.571] "rad" MCU
 SG_ OBJ_Angle_Mid_STD_V_33 : 31566|1@1+ (1,0) [0|1] "bool" MCU
 SG_ OBJ_Angle_Bottom_V_33 : 31567|1@1+ (1,0) [0|1] "bool" MCU
 SG_ OBJ_Angle_Bottom_33 : 31568|14@1+ (0.0002,-1.571) [-1.571|1.571] "rad" MCU
 SG_ Reserved_20_33 : 31582|2@1+ (1,0) [0|0] "NA" MCU
 SG_ OBJ_Angle_Bottom_STD_33 : 31584|14@1+ (0.0001,0) [0|1.571] "rad" MCU
 SG_ OBJ_Angle_Bottom_STD_V_33 : 31598|1@1+ (1,0) [0|1] "bool" MCU
 SG_ OBJ_Visibility_Side_V_33 : 31599|1@1+ (1,0) [0|1] "bool" MCU
 SG_ OBJ_Visibility_Side_33 : 31600|2@1+ (1,0) [0|2] "ENUM" MCU
 SG_ OBJ_Is_In_Drivable_Area_33 : 31602|1@1+ (1,0) [0|1] "bool" MCU
 SG_ OBJ_Is_In_Drivable_Area_V_33 : 31603|1@1+ (1,0) [0|1] "bool" MCU
 SG_ OBJ_Is_VeryClose_V_33 : 31604|1@1+ (1,0) [0|1] "bool" MCU
 SG_ OBJ_Is_VeryClose_33 : 31605|1@1+ (1,0) [0|1] "bool" MCU
 SG_ OBJ_Buffer_C4_33 : 31606|2@1+ (1,0) [0|2] "NA" MCU
 SG_ OBJ_Buffer_C5_33 : 31608|2@1+ (1,0) [0|2] "NA" MCU
 SG_ OBJ_Buffer_C6_33 : 31610|2@1+ (1,0) [0|2] "NA" MCU
 SG_ OBJ_Buffer_C7_33 : 31612|2@1+ (1,0) [0|2] "NA" MCU
 SG_ Reserved_21_33 : 31614|2@1+ (1,0) [0|0] "NA" MCU
 SG_ OBJ_OverlapAngleEgoLaneR_33 : 31616|10@1+ (0.01,-3.14) [-3.14|3.14] "rad" MCU
 SG_ OBJ_OverlapAngleEgoLaneR_V_33 : 31626|1@1+ (1,0) [0|1] "bool" MCU
 SG_ OBJ_OverlapAngleEgoLaneL_33 : 31627|10@1+ (0.01,-3.14) [-3.14|3.14] "rad" MCU
 SG_ OBJ_OverlapAngleEgoLaneL_V_33 : 31637|1@1+ (1,0) [0|1] "bool" MCU
 SG_ OBJ_Is_EMERGENCY_VCL_33 : 31638|1@1+ (1,0) [0|1] "bool" MCU
 SG_ OBJ_EMERGENCY_LIGHT_COLOR_33 : 31639|4@1+ (1,0) [0|15] "BITWIZE" MCU
 SG_ OBJ_EMERGENCY_V_33 : 31643|1@1+ (1,0) [0|1] "bool" MCU
 SG_ Reserved_22_33 : 31644|4@1+ (1,0) [0|0] "NA" MCU
 SG_ OBJ_Angle_Top_33 : 31648|14@1+ (0.0002,0) [0|3.1415] "rad" MCU
 SG_ OBJ_Angle_Top_V_33 : 31662|1@1+ (1,0) [0|1] "bool" MCU
 SG_ OBJ_Angle_Top_STD_33 : 31663|15@1+ (0.0001,0) [0|3.1415] "rad" MCU
 SG_ OBJ_Angle_Top_STD_V_33 : 31678|1@1+ (1,0) [0|1] "bool" MCU
 SG_ OBJ_Buffer_C14_33 : 31679|1@1+ (1,0) [0|1] "NA" MCU
 SG_ OBJ_Buffer_C15_33 : 31680|1@1+ (1,0) [0|1] "NA" MCU
 SG_ OBJ_Buffer_C18_33 : 31681|2@1+ (1,0) [0|2] "NA" MCU
 SG_ OBJ_Buffer_C19_33 : 31683|1@1+ (1,0) [0|1] "NA" MCU
 SG_ Reserved_23_33 : 31684|28@1+ (1,0) [0|0] "NA" MCU
 SG_ OBJ_CRC_34 : 31712|32@1+ (1,0) [0|4294967295] "NA" MCU
 SG_ OBJ_ID_34 : 31744|8@1+ (1,0) [0|255] "counter" MCU
 SG_ OBJ_Existence_Probability_34 : 31752|8@1+ (0.01,0) [0|1] "NA" MCU
 SG_ OBJ_Fusion_Source_34 : 31760|16@1+ (1,0) [0|65535] "BITWIZE" MCU
 SG_ OBJ_Triggered_SDM_34 : 31776|2@1+ (1,0) [0|2] "ENUM" MCU
 SG_ OBJ_Motion_Category_34 : 31778|4@1+ (1,0) [0|13] "ENUM" MCU
 SG_ OBJ_Buffer_C0_34 : 31782|7@1+ (0.01,0) [0|1] "NA" MCU
 SG_ OBJ_Object_Age_34 : 31789|11@1+ (1,0) [0|2047] "frames" MCU
 SG_ OBJ_Measuring_Status_34 : 31800|3@1+ (1,0) [0|7] "BITWIZE" MCU
 SG_ OBJ_Object_Class_34 : 31803|4@1+ (1,0) [0|8] "ENUM" MCU
 SG_ Reserved_4_34 : 31807|1@1+ (1,0) [0|0] "NA" MCU
 SG_ OBJ_Class_Probability_34 : 31808|7@1+ (0.01,0) [0|1] "NA" MCU
 SG_ OBJ_Car_Probability_34 : 31815|7@1+ (0.01,0) [0|1] "NA" MCU
 SG_ OBJ_Truck_Probability_34 : 31822|7@1+ (0.01,0) [0|1] "NA" MCU
 SG_ OBJ_Bike_Probability_34 : 31829|7@1+ (0.01,0) [0|1] "NA" MCU
 SG_ OBJ_Camera_Source_34 : 31836|4@1+ (1,0) [0|15] "ENUM" MCU
 SG_ OBJ_Motion_Status_34 : 31840|3@1+ (1,0) [0|5] "ENUM" MCU
 SG_ OBJ_Motion_Orientation_34 : 31843|4@1+ (1,0) [0|13] "ENUM" MCU
 SG_ OBJ_Has_Cut_Lane_34 : 31847|1@1+ (1,0) [0|1] "bool" MCU
 SG_ OBJ_Has_Cut_Path_34 : 31848|1@1+ (1,0) [0|1] "bool" MCU
 SG_ OBJ_Brake_Light_34 : 31849|1@1+ (1,0) [0|1] "bool" MCU
 SG_ OBJ_Turn_Indicator_Right_34 : 31850|1@1+ (1,0) [0|1] "bool" MCU
 SG_ OBJ_Turn_Indicator_Left_34 : 31851|1@1+ (1,0) [0|1] "bool" MCU
 SG_ OBJ_Light_Indicator_Validity_34 : 31852|1@1+ (1,0) [0|1] "bool" MCU
 SG_ OBJ_Right_Out_Of_Image_34 : 31853|1@1+ (1,0) [0|1] "bool" MCU
 SG_ OBJ_Left_Out_Of_Image_34 : 31854|1@1+ (1,0) [0|1] "bool" MCU
 SG_ OBJ_Right_Out_Of_Image_V_34 : 31855|1@1+ (1,0) [0|1] "bool" MCU
 SG_ OBJ_Left_Out_Of_Image_V_34 : 31856|1@1+ (1,0) [0|1] "bool" MCU
 SG_ OBJ_Top_Out_Of_Image_34 : 31857|1@1+ (1,0) [0|1] "bool" MCU
 SG_ OBJ_Bottom_Out_Of_Image_34 : 31858|1@1+ (1,0) [0|1] "bool" MCU
 SG_ OBJ_Top_Out_Of_Image_V_34 : 31859|1@1+ (1,0) [0|1] "bool" MCU
 SG_ OBJ_Bottom_Out_Of_Image_V_34 : 31860|1@1+ (1,0) [0|1] "bool" MCU
 SG_ OBJ_Lane_Assignment_34 : 31861|3@1+ (1,0) [0|5] "ENUM" MCU
 SG_ OBJ_Lane_Assignment_V_34 : 31864|1@1+ (1,0) [0|1] "bool" MCU
 SG_ OBJ_Age_Seconds_34 : 31865|7@1+ (1,0) [0|100] "s" MCU
 SG_ OBJ_Age_Seconds_V_34 : 31872|1@1+ (1,0) [0|1] "bool" MCU
 SG_ OBJ_Width_34 : 31873|9@1+ (0.01,0) [0.4|2.95] "m" MCU
 SG_ OBJ_Width_V_34 : 31882|1@1+ (1,0) [0|1] "bool" MCU
 SG_ OBJ_Width_STD_34 : 31883|11@1+ (0.001,0) [0|2] "m" MCU
 SG_ OBJ_Width_STD_V_34 : 31894|1@1+ (1,0) [0|1] "bool" MCU
 SG_ OBJ_Length_34 : 31895|9@1+ (0.05,0) [1.2|21] "m" MCU
 SG_ OBJ_Length_V_34 : 31904|1@1+ (1,0) [0|1] "bool" MCU
 SG_ OBJ_Length_STD_34 : 31905|10@1+ (0.01,0) [0|10] "m" MCU
 SG_ OBJ_Length_STD_V_34 : 31915|1@1+ (1,0) [0|1] "bool" MCU
 SG_ OBJ_Radar_ID_34 : 31916|8@1+ (1,0) [0|255] "counter" MCU
 SG_ OBJ_Height_34 : 31924|9@1+ (0.01,0) [0|2.95] "m" MCU
 SG_ OBJ_Height_V_34 : 31933|1@1+ (1,0) [0|1] "bool" MCU
 SG_ Reserved_5_34 : 31934|2@1+ (1,0) [0|0] "NA" MCU
 SG_ OBJ_Height_STD_34 : 31936|11@1+ (0.001,0) [0|2] "m" MCU
 SG_ OBJ_Height_STD_V_34 : 31947|1@1+ (1,0) [0|1] "bool" MCU
 SG_ OBJ_Abs_Long_Velocity_34 : 31948|12@1+ (0.05,-100) [-100|100] "m_per_s" MCU
 SG_ OBJ_Abs_Long_Velocity_V_34 : 31960|1@1+ (1,0) [0|1] "bool" MCU
 SG_ Reserved_6_34 : 31961|7@1+ (1,0) [0|0] "NA" MCU
 SG_ OBJ_Abs_Long_Velocity_STD_34 : 31968|13@1+ (0.01,0) [0|65] "m_per_s" MCU
 SG_ OBJ_Abs_Long_Vel_STD_V_34 : 31981|1@1+ (1,0) [0|1] "bool" MCU
 SG_ OBJ_Abs_Lat_Velocity_34 : 31982|11@1+ (0.05,-50) [-50|50] "m_per_s" MCU
 SG_ OBJ_Abs_Lat_Velocity_V_34 : 31993|1@1+ (1,0) [0|1] "bool" MCU
 SG_ Reserved_7_34 : 31994|6@1+ (1,0) [0|0] "NA" MCU
 SG_ OBJ_Abs_Lat_Velocity_STD_34 : 32000|13@1+ (0.01,0) [0|50] "m_per_s" MCU
 SG_ OBJ_Abs_Lat_Vel_STD_V_34 : 32013|1@1+ (1,0) [0|1] "bool" MCU
 SG_ OBJ_Abs_Long_Acc_34 : 32014|9@1+ (0.05,-10) [-10|10] "m_per_s2" MCU
 SG_ OBJ_Abs_Long_Acc_V_34 : 32023|1@1+ (1,0) [0|1] "bool" MCU
 SG_ Reserved_8_34 : 32024|8@1+ (1,0) [0|0] "NA" MCU
 SG_ OBJ_Abs_Long_Acc_STD_34 : 32032|10@1+ (0.01,0) [0|7.3] "m_per_s2" MCU
 SG_ OBJ_Abs_Long_Acc_STD_V_34 : 32042|1@1+ (1,0) [0|1] "bool" MCU
 SG_ OBJ_Abs_Lat_Acc_34 : 32043|9@1+ (0.05,-10) [-10|10] "m_per_s2" MCU
 SG_ OBJ_Abs_Lat_Acc_V_34 : 32052|1@1+ (1,0) [0|1] "bool" MCU
 SG_ OBJ_Abs_Lat_Acc_STD_34 : 32053|10@1+ (0.01,0) [0|7.3] "m_per_s2" MCU
 SG_ OBJ_Abs_Lat_Acc_STD_V_34 : 32063|1@1+ (1,0) [0|1] "bool" MCU
 SG_ OBJ_Abs_Acceleration_34 : 32064|9@1+ (0.05,-12.7) [-12.7|12.7] "m_per_s2" MCU
 SG_ OBJ_Abs_Acceleration_V_34 : 32073|1@1+ (1,0) [0|1] "bool" MCU
 SG_ OBJ_Abs_Acc_STD_34 : 32074|10@1+ (0.01,0) [0|7.3] "m_per_s2" MCU
 SG_ OBJ_Abs_Acc_STD_V_34 : 32084|1@1+ (1,0) [0|1] "bool" MCU
 SG_ OBJ_Inv_TTC_34 : 32085|11@1+ (0.01,-8) [-8|8] "INV(s)" MCU
 SG_ OBJ_Inv_TTC_V_34 : 32096|1@1+ (1,0) [0|1] "bool" MCU
 SG_ OBJ_Inv_TTC_STD_34 : 32097|12@1+ (0.001,0) [0|4] "INV(s)" MCU
 SG_ OBJ_Inv_TTC_STD_V_34 : 32109|1@1+ (1,0) [0|1] "bool" MCU
 SG_ OBJ_Relative_Long_Acc_34 : 32110|10@1+ (0.05,-20) [-20|20] "m_per_s2" MCU
 SG_ OBJ_Relative_Long_Acc_V_34 : 32120|1@1+ (1,0) [0|1] "bool" MCU
 SG_ Reserved_9_34 : 32121|7@1+ (1,0) [0|0] "NA" MCU
 SG_ OBJ_Relative_Long_Acc_STD_34 : 32128|10@1+ (0.01,0) [0|7.3] "m_per_s2" MCU
 SG_ OBJ_Rel_Long_Acc_STD_V_34 : 32138|1@1+ (1,0) [0|1] "bool" MCU
 SG_ OBJ_Relative_Long_Velocity_34 : 32139|13@1+ (0.05,-120) [-120|130] "m_per_s" MCU
 SG_ OBJ_Relative_Long_Velocity_V_34 : 32152|1@1+ (1,0) [0|1] "bool" MCU
 SG_ Reserved_10_34 : 32153|7@1+ (1,0) [0|0] "NA" MCU
 SG_ OBJ_Relative_Long_Vel_STD_34 : 32160|14@1+ (0.01,0) [0|130] "m_per_s" MCU
 SG_ OBJ_Rel_Long_Vel_STD_V_34 : 32174|1@1+ (1,0) [0|1] "bool" MCU
 SG_ OBJ_Relative_Lat_Velocity_34 : 32175|11@1+ (0.05,-50) [-50|50] "m_per_s" MCU
 SG_ OBJ_Relative_Lat_Velocity_V_34 : 32186|1@1+ (1,0) [0|1] "bool" MCU
 SG_ Reserved_11_34 : 32187|5@1+ (1,0) [0|0] "NA" MCU
 SG_ OBJ_Relative_Lat_Velocity_STD_34 : 32192|13@1+ (0.01,0) [0|50] "m_per_s" MCU
 SG_ OBJ_Rel_Lat_Vel_STD_V_34 : 32205|1@1+ (1,0) [0|1] "bool" MCU
 SG_ OBJ_Long_Distance_34 : 32206|14@1+ (0.05,-200) [-200|500] "m" MCU
 SG_ OBJ_Long_Distance_V_34 : 32220|1@1+ (1,0) [0|1] "bool" MCU
 SG_ Reserved_12_34 : 32221|3@1+ (1,0) [0|0] "NA" MCU
 SG_ OBJ_Long_Distance_STD_34 : 32224|15@1+ (0.01,0) [0|250] "m" MCU
 SG_ OBJ_Long_Distance_STD_V_34 : 32239|1@1+ (1,0) [0|1] "bool" MCU
 SG_ OBJ_Lat_Distance_34 : 32240|12@1+ (0.05,-100) [-100|100] "m" MCU
 SG_ OBJ_Lat_Distance_V_34 : 32252|1@1+ (1,0) [0|1] "bool" MCU
 SG_ Reserved_13_34 : 32253|3@1+ (1,0) [0|0] "NA" MCU
 SG_ OBJ_Lat_Distance_STD_34 : 32256|14@1+ (0.01,0) [0|100] "m" MCU
 SG_ OBJ_Lat_Distance_STD_V_34 : 32270|1@1+ (1,0) [0|1] "bool" MCU
 SG_ OBJ_Absolute_Speed_34 : 32271|12@1+ (0.05,-65) [-65|65] "m_per_s" MCU
 SG_ OBJ_Absolute_Speed_V_34 : 32283|1@1+ (1,0) [0|1] "bool" MCU
 SG_ Reserved_14_34 : 32284|4@1+ (1,0) [0|0] "NA" MCU

CM_ SG_ 154 OBJ_Is_VeryClose_28 "Indicates whether the target is very close to the host such that it is hard to measure its distance. Currently relevant for peds only";
CM_ SG_ 154 OBJ_OverlapAngleEgoLaneR_28 "Lateral distance to the middle of the RL and RR corners.";
CM_ SG_ 154 OBJ_OverlapAngleEgoLaneR_V_28 "Validator for OBJ_OverlapAngleEgoLaneR";
CM_ SG_ 154 OBJ_OverlapAngleEgoLaneL_28 "Lateral distance to the middle of the RL and RR corners.  ";
CM_ SG_ 154 OBJ_OverlapAngleEgoLaneL_V_28 "Validator for OBJ_OverlapAngleEgoLaneL";
CM_ SG_ 154 OBJ_Is_EMERGENCY_VCL_28 "Is Object an Emergency Vehicle";
CM_ SG_ 154 OBJ_EMERGENCY_LIGHT_COLOR_28 "Emergency Color";
CM_ SG_ 154 OBJ_EMERGENCY_V_28 "Are OBJ_Is_EMERGENCY_VCL and OBJ_EMERGENCY_LIGHT_COLOR Valid";
CM_ SG_ 154 OBJ_Angle_Top_28 "From VD touching point on the ground till the roof of the car";
CM_ SG_ 154 OBJ_Angle_Top_V_28 "Validator for OBJ_Angle_Top ";
CM_ SG_ 154 OBJ_Angle_Top_STD_28 "STD for OBJ_Angle_Top";
CM_ SG_ 154 OBJ_Angle_Top_STD_V_28 "Validator for OBJ_Angle_Top_STD. ";
CM_ SG_ 154 OBJ_CRC_29 "Calculated over all element signals. From the signal after the CRC until the first signal in the next elements OBJ_CRC_N+1  not including";
CM_ SG_ 154 OBJ_ID_29 "The detected object ID. Range is 1-255, while 0 indicates that the field in unfilled.";
CM_ SG_ 154 OBJ_Existence_Probability_29 "The existence probability of the reported object";
CM_ SG_ 154 OBJ_Fusion_Source_29 "sources ids used for fusion";
CM_ SG_ 154 OBJ_Triggered_SDM_29 "Indicates whether the object has trigered the SDM (Safety Diagnostic Manager) alert.";
CM_ SG_ 154 OBJ_Motion_Category_29 "Relevant for VD only. Full description of values can be found at the ACC guide.";
CM_ SG_ 154 OBJ_Object_Age_29 "The number of frames in which the object was recognized.";
CM_ SG_ 154 OBJ_Measuring_Status_29 "Measurment status. Old vs New marks if this is the first frame in which the object is reported. Predicted vs Measured marks if the report is raw or has been predicted forward in time using the measured dynamics and ego motion.";
CM_ SG_ 154 OBJ_Object_Class_29 "Indicates the object type. Uncertain is outputted in case the probability that a vehicle is a truck is very similar to the probability that it is a car. ";
CM_ SG_ 154 OBJ_Class_Probability_29 "The probability of this type classification.";
CM_ SG_ 154 OBJ_Car_Probability_29 "The probability the object is a car";
CM_ SG_ 154 OBJ_Truck_Probability_29 "The probability the object is a Truck";
CM_ SG_ 154 OBJ_Bike_Probability_29 "The probability the object is a Bike";
CM_ SG_ 154 OBJ_Camera_Source_29 "The camera in which this object was detected (best choice).";
CM_ SG_ 154 OBJ_Motion_Status_29 "MOVING - the object is moving STATIONARY - the object was never seen moving STOPPED -  the object was moving and has stopped MOVING_SLOWLY - the object is moving very slowly";
CM_ SG_ 154 OBJ_Motion_Orientation_29 "The direction of the targets heading compared to the host. ";
CM_ SG_ 154 OBJ_Has_Cut_Lane_29 "Indicates whether the object cut the host's (right or left) lane. In case there are no lanes, indicates whether the objects is at most 1 meters away from the host.";
CM_ SG_ 154 OBJ_Has_Cut_Path_29 "Indicates whether the object is in the host's path.";
CM_ SG_ 154 OBJ_Brake_Light_29 "Indication for brake lights ";
CM_ SG_ 154 OBJ_Turn_Indicator_Right_29 "Indication for blinking right light.";
CM_ SG_ 154 OBJ_Turn_Indicator_Left_29 "Indication for blinking left light ";
CM_ SG_ 154 OBJ_Light_Indicator_Validity_29 "Validator for light indicators";
CM_ SG_ 154 OBJ_Right_Out_Of_Image_29 "Indicates whether the measurment are predicted out of the right side of the image bounderies.";
CM_ SG_ 154 OBJ_Left_Out_Of_Image_29 "Indicates whether if measurment are predicted out of  the left side of the image bounderies";
CM_ SG_ 154 OBJ_Right_Out_Of_Image_V_29 "validator";
CM_ SG_ 154 OBJ_Left_Out_Of_Image_V_29 "validator";
CM_ SG_ 154 OBJ_Top_Out_Of_Image_29 "Indicates whether if measurment are predicted out of  the top of the image bounderies";
CM_ SG_ 154 OBJ_Bottom_Out_Of_Image_29 "Indicates whether if measurment are predicted out of  the bottom of the image bounderies";
CM_ SG_ 154 OBJ_Top_Out_Of_Image_V_29 "validator";
CM_ SG_ 154 OBJ_Bottom_Out_Of_Image_V_29 "validator";
CM_ SG_ 154 OBJ_Lane_Assignment_29 "The object's lane relative to the host lane.";
CM_ SG_ 154 OBJ_Lane_Assignment_V_29 "Validator for lane assignment";
CM_ SG_ 154 OBJ_Age_Seconds_29 "Time in seconds in which the object was recognized. ";
CM_ SG_ 154 OBJ_Age_Seconds_V_29 "Validator for object age";
CM_ SG_ 154 OBJ_Width_29 "The width of the target vehicle in the world (not to be mistaken with the width of the visible part of the vehicle).";
CM_ SG_ 154 OBJ_Width_V_29 "Validator for object width";
CM_ SG_ 154 OBJ_Width_STD_29 "Standard deviation for object width";
CM_ SG_ 154 OBJ_Width_STD_V_29 "Validator for the standard deviation of object width";
CM_ SG_ 154 OBJ_Length_29 "The length of the vehicle in the world. For crossing bicycles it gives the viewed length of the bicycle.";
CM_ SG_ 154 OBJ_Length_V_29 "Validator for object length.";
CM_ SG_ 154 OBJ_Length_STD_29 "Standard deviation for object length.";
CM_ SG_ 154 OBJ_Length_STD_V_29 "Validator for the standard deviation of object length.";
CM_ SG_ 154 OBJ_Radar_ID_29 "Radar Object ID of the Fused Object, Only relvant when OBJ_Fusion_Source is not Camera only";
CM_ SG_ 154 OBJ_Height_29 "The height of the object in the world. ";
CM_ SG_ 154 OBJ_Height_V_29 "Validator for object height.";
CM_ SG_ 154 OBJ_Height_STD_29 "Standard deviation for object height.";
CM_ SG_ 154 OBJ_Height_STD_V_29 "Validator for the standard deviation of object height.";
CM_ SG_ 154 OBJ_Abs_Long_Velocity_29 "Absolute longitudinal velocity.";
CM_ SG_ 154 OBJ_Abs_Long_Velocity_V_29 "Validator for absolute longitudinal velocity.";
CM_ SG_ 154 OBJ_Abs_Long_Velocity_STD_29 "Standard deviation of absolute longitudinal velocity.";
CM_ SG_ 154 OBJ_Abs_Long_Vel_STD_V_29 "Validator for the standard deviation of the absolute longitudinal velocity.";
CM_ SG_ 154 OBJ_Abs_Lat_Velocity_29 "The lateral ground speed of the object.";
CM_ SG_ 154 OBJ_Abs_Lat_Velocity_V_29 "Validator for the lateral ground speed of the object.";
CM_ SG_ 154 OBJ_Abs_Lat_Velocity_STD_29 "STD of the lateral ground speed of the object.";
CM_ SG_ 154 OBJ_Abs_Lat_Vel_STD_V_29 "Validator for the STD of the lateral ground speed of the object.";
CM_ SG_ 154 OBJ_Abs_Long_Acc_29 "The longitudinal ground acceleration of the object.";
CM_ SG_ 154 OBJ_Abs_Long_Acc_V_29 "Validator for the longitudinal ground acceleration of the object.";
CM_ SG_ 154 OBJ_Abs_Long_Acc_STD_29 "STD of the longitudinal ground acceleration of the object.";
CM_ SG_ 154 OBJ_Abs_Long_Acc_STD_V_29 "Validator for the STD of the longitudinal ground acceleration of the object.";
CM_ SG_ 154 OBJ_Abs_Lat_Acc_29 "The lateral ground acceleration of the object.";
CM_ SG_ 154 OBJ_Abs_Lat_Acc_V_29 "Validator for the lateral ground acceleration of the object.";
CM_ SG_ 154 OBJ_Abs_Lat_Acc_STD_29 "STD of the lateral ground acceleration of the object.";
CM_ SG_ 154 OBJ_Abs_Lat_Acc_STD_V_29 "Validator for the STD of the lateral ground acceleration of the object.";
CM_ SG_ 154 OBJ_Abs_Acceleration_29 "The absolute ground acceleration in the target's heading direction.";
CM_ SG_ 154 OBJ_Abs_Acceleration_V_29 "Validator for the absolute ground acceleration.";
CM_ SG_ 154 OBJ_Abs_Acc_STD_29 "STD of the absolute ground acceleration.";
CM_ SG_ 154 OBJ_Abs_Acc_STD_V_29 "Validator for the STD of the absolute ground acceleration.";
CM_ SG_ 154 OBJ_Inv_TTC_29 "Inverse TTC (time to collision).";
CM_ SG_ 154 OBJ_Inv_TTC_STD_29 "STD for inverse TTC .";
CM_ SG_ 154 OBJ_Inv_TTC_STD_V_29 "Validator for the STD for inverse TTC .";
CM_ SG_ 154 OBJ_Relative_Long_Acc_29 "The relative lateral ground acceleration of the object.";
CM_ SG_ 154 OBJ_Relative_Long_Acc_V_29 "Validator for the relative lateral ground acceleration of the object.";
CM_ SG_ 154 OBJ_Relative_Long_Acc_STD_29 "STD of the relative lateral ground acceleration of the object.";
CM_ SG_ 154 OBJ_Rel_Long_Acc_STD_V_29 "Validator for the STD of the relative lateral ground acceleration.";
CM_ SG_ 154 OBJ_Relative_Long_Velocity_29 "The relative longtitudinal speed between the target and ego vehicle. ";
CM_ SG_ 154 OBJ_Relative_Long_Velocity_V_29 "Validator for the relative longtitudinal speed.";
CM_ SG_ 154 OBJ_Relative_Long_Vel_STD_29 "STD of the relative longtitudinal speed.";
CM_ SG_ 154 OBJ_Rel_Long_Vel_STD_V_29 "Validator for the STD of the relative longtitudinal speed.";
CM_ SG_ 154 OBJ_Relative_Lat_Velocity_29 "The relative lateral speed between the target and ego vehicle. ";
CM_ SG_ 154 OBJ_Relative_Lat_Velocity_V_29 "Validator for the relative lateral speed. ";
CM_ SG_ 154 OBJ_Relative_Lat_Velocity_STD_29 "STD of the relative lateral speed. ";
CM_ SG_ 154 OBJ_Rel_Lat_Vel_STD_V_29 "Validator for the STD of the relative lateral speed. ";
CM_ SG_ 154 OBJ_Long_Distance_29 "The longitudinal distance to middle of the rear bumper (middle of the RL and RR corners) of the target.";
CM_ SG_ 154 OBJ_Long_Distance_V_29 "Validator of the longtitudinal distance field";
CM_ SG_ 154 OBJ_Long_Distance_STD_29 "STD of the  longtitudinal distance.";
CM_ SG_ 154 OBJ_Long_Distance_STD_V_29 "Validator for the STD of the  longtitudinal distance.";
CM_ SG_ 154 OBJ_Lat_Distance_29 "Lateral distance to the middle of the RL and RR corners.  ";
CM_ SG_ 154 OBJ_Lat_Distance_V_29 "Validator for the lateral distance of the object.";
CM_ SG_ 154 OBJ_Lat_Distance_STD_29 "STD of the lateral distance of the object.";
CM_ SG_ 154 OBJ_Lat_Distance_STD_V_29 "Validator for the STD of the lateral distance of the object.";
CM_ SG_ 154 OBJ_Absolute_Speed_29 "The absolute ground speed in the targets' heading direction.";
CM_ SG_ 154 OBJ_Absolute_Speed_V_29 "Validator for the absolute ground speed.";
CM_ SG_ 154 OBJ_Absolute_Speed_STD_29 "STD of the absolute ground speed.";
CM_ SG_ 154 OBJ_Absolute_Speed_STD_V_29 "Validator for the STD of the absolute ground speed.";
CM_ SG_ 154 OBJ_Heading_29 "The angle beetweenthe host longitudinal axis and target's heading (clockwise, e.g. PI/2 is a target crossing from left to right).";
CM_ SG_ 154 OBJ_Heading_V_29 "Validator for the object heading.";
CM_ SG_ 154 OBJ_Heading_STD_29 "STD of the object heading.";
CM_ SG_ 154 OBJ_Heading_STD_V_29 "Validator for the STD of the object heading.";
CM_ SG_ 154 OBJ_Angle_Rate_STD_29 "Standard deviation of the angular speed. (radians)";
CM_ SG_ 154 OBJ_Angle_Rate_STD_V_29 "Validator for the STD of the angular speed.";
CM_ SG_ 154 OBJ_Angle_Rate_29 "The momentary angular speed of the object. (radians)";
CM_ SG_ 154 OBJ_Angle_Rate_V_29 "Validator for the angular speed.";
CM_ SG_ 154 OBJ_Angle_Right_29 "The angle between the host longitudinal axis and the right side of the front / rear of the target (the visible one). The positive side is to the host's right.";
CM_ SG_ 154 OBJ_Angle_Right_V_29 "Validator for angleRight";
CM_ SG_ 154 OBJ_Angle_Right_STD_29 "Standard deviation of angleRight";
CM_ SG_ 154 OBJ_Angle_Right_STD_V_29 "Validator for the standard deviation of angleRight.";
CM_ SG_ 154 OBJ_Angle_Left_29 "The angle between the host longitudinal axis and the left side of the front / rear of the target (the visible one). The positive side is to the host's right.";
CM_ SG_ 154 OBJ_Angle_Left_V_29 "Validator for angleLeft.";
CM_ SG_ 154 OBJ_Angle_Left_STD_29 "Standard deviation of angleLeft.";
CM_ SG_ 154 OBJ_Angle_Left_STD_V_29 "Validator for the standard deviation of angleLeft.";
CM_ SG_ 154 OBJ_Angle_Side_29 "The angle between the host longitudinal axis and the far visible edge - the visible edge of the front / rear of the target that is not visible. Currently supported for vehicles only.";
CM_ SG_ 154 OBJ_Angle_Side_V_29 "Validator for angleSide.";
CM_ SG_ 154 OBJ_Angle_Side_STD_29 "Standard deviation of angleSide.";
CM_ SG_ 154 OBJ_Angle_Side_STD_V_29 "Validator for the STD of angleSide.";
CM_ SG_ 154 OBJ_Angle_Mid_V_29 "Validator for angleMid.";
CM_ SG_ 154 OBJ_Angle_Mid_29 "The angle between the host longitudinal axis and the middle of the front / rear of the target (the visible one). The positive side is to the host's right.";
CM_ SG_ 154 OBJ_Angle_Mid_STD_29 "Standard deviation of angleMid.";
CM_ SG_ 154 OBJ_Angle_Mid_STD_V_29 "Validator for the STD of angleMid.";
CM_ SG_ 154 OBJ_Angle_Bottom_V_29 "Validator for OBJAngle_Bottom. ";
CM_ SG_ 154 OBJ_Angle_Bottom_29 "The angle between the longitudinal axis and the Bottom of the front / rear of the target (the visible one). The positive side is to the host's bottom";
CM_ SG_ 154 OBJ_Angle_Bottom_STD_29 "STD for OBJAngle_Bottom. ";
CM_ SG_ 154 OBJ_Angle_Bottom_STD_V_29 "Validator for OBJAngle_Bottom_STD. ";
CM_ SG_ 154 OBJ_Visibility_Side_V_29 "Currently Supported for VD only";
CM_ SG_ 154 OBJ_Visibility_Side_29 "From what car  side is the object visible";
CM_ SG_ 154 OBJ_Is_In_Drivable_Area_29 "Indicates whether the target is in a driveable area.";
CM_ SG_ 154 OBJ_Is_In_Drivable_Area_V_29 "Validator for OBJ_Is_In_Drivable_Area.";
CM_ SG_ 154 OBJ_Is_VeryClose_V_29 "Validator for OBJ_Is_VeryClose. ";
CM_ SG_ 154 OBJ_Is_VeryClose_29 "Indicates whether the target is very close to the host such that it is hard to measure its distance. Currently relevant for peds only";
CM_ SG_ 154 OBJ_OverlapAngleEgoLaneR_29 "Lateral distance to the middle of the RL and RR corners.";
CM_ SG_ 154 OBJ_OverlapAngleEgoLaneR_V_29 "Validator for OBJ_OverlapAngleEgoLaneR";
CM_ SG_ 154 OBJ_OverlapAngleEgoLaneL_29 "Lateral distance to the middle of the RL and RR corners.  ";
CM_ SG_ 154 OBJ_OverlapAngleEgoLaneL_V_29 "Validator for OBJ_OverlapAngleEgoLaneL";
CM_ SG_ 154 OBJ_Is_EMERGENCY_VCL_29 "Is Object an Emergency Vehicle";
CM_ SG_ 154 OBJ_EMERGENCY_LIGHT_COLOR_29 "Emergency Color";
CM_ SG_ 154 OBJ_EMERGENCY_V_29 "Are OBJ_Is_EMERGENCY_VCL and OBJ_EMERGENCY_LIGHT_COLOR Valid";
CM_ SG_ 154 OBJ_Angle_Top_29 "From VD touching point on the ground till the roof of the car";
CM_ SG_ 154 OBJ_Angle_Top_V_29 "Validator for OBJ_Angle_Top ";
CM_ SG_ 154 OBJ_Angle_Top_STD_29 "STD for OBJ_Angle_Top";
CM_ SG_ 154 OBJ_Angle_Top_STD_V_29 "Validator for OBJ_Angle_Top_STD. ";
CM_ SG_ 154 OBJ_CRC_30 "Calculated over all element signals. From the signal after the CRC until the first signal in the next elements OBJ_CRC_N+1  not including";
CM_ SG_ 154 OBJ_ID_30 "The detected object ID. Range is 1-255, while 0 indicates that the field in unfilled.";
CM_ SG_ 154 OBJ_Existence_Probability_30 "The existence probability of the reported object";
CM_ SG_ 154 OBJ_Fusion_Source_30 "sources ids used for fusion";
CM_ SG_ 154 OBJ_Triggered_SDM_30 "Indicates whether the object has trigered the SDM (Safety Diagnostic Manager) alert.";
CM_ SG_ 154 OBJ_Motion_Category_30 "Relevant for VD only. Full description of values can be found at the ACC guide.";
CM_ SG_ 154 OBJ_Object_Age_30 "The number of frames in which the object was recognized.";
CM_ SG_ 154 OBJ_Measuring_Status_30 "Measurment status. Old vs New marks if this is the first frame in which the object is reported. Predicted vs Measured marks if the report is raw or has been predicted forward in time using the measured dynamics and ego motion.";
CM_ SG_ 154 OBJ_Object_Class_30 "Indicates the object type. Uncertain is outputted in case the probability that a vehicle is a truck is very similar to the probability that it is a car. ";
CM_ SG_ 154 OBJ_Class_Probability_30 "The probability of this type classification.";
CM_ SG_ 154 OBJ_Car_Probability_30 "The probability the object is a car";
CM_ SG_ 154 OBJ_Truck_Probability_30 "The probability the object is a Truck";
CM_ SG_ 154 OBJ_Bike_Probability_30 "The probability the object is a Bike";
CM_ SG_ 154 OBJ_Camera_Source_30 "The camera in which this object was detected (best choice).";
CM_ SG_ 154 OBJ_Motion_Status_30 "MOVING - the object is moving STATIONARY - the object was never seen moving STOPPED -  the object was moving and has stopped MOVING_SLOWLY - the object is moving very slowly";
CM_ SG_ 154 OBJ_Motion_Orientation_30 "The direction of the targets heading compared to the host. ";
CM_ SG_ 154 OBJ_Has_Cut_Lane_30 "Indicates whether the object cut the host's (right or left) lane. In case there are no lanes, indicates whether the objects is at most 1 meters away from the host.";
CM_ SG_ 154 OBJ_Has_Cut_Path_30 "Indicates whether the object is in the host's path.";
CM_ SG_ 154 OBJ_Brake_Light_30 "Indication for brake lights ";
CM_ SG_ 154 OBJ_Turn_Indicator_Right_30 "Indication for blinking right light.";
CM_ SG_ 154 OBJ_Turn_Indicator_Left_30 "Indication for blinking left light ";
CM_ SG_ 154 OBJ_Light_Indicator_Validity_30 "Validator for light indicators";
CM_ SG_ 154 OBJ_Right_Out_Of_Image_30 "Indicates whether the measurment are predicted out of the right side of the image bounderies.";
CM_ SG_ 154 OBJ_Left_Out_Of_Image_30 "Indicates whether if measurment are predicted out of  the left side of the image bounderies";
CM_ SG_ 154 OBJ_Right_Out_Of_Image_V_30 "validator";
CM_ SG_ 154 OBJ_Left_Out_Of_Image_V_30 "validator";
CM_ SG_ 154 OBJ_Top_Out_Of_Image_30 "Indicates whether if measurment are predicted out of  the top of the image bounderies";
CM_ SG_ 154 OBJ_Bottom_Out_Of_Image_30 "Indicates whether if measurment are predicted out of  the bottom of the image bounderies";
CM_ SG_ 154 OBJ_Top_Out_Of_Image_V_30 "validator";
CM_ SG_ 154 OBJ_Bottom_Out_Of_Image_V_30 "validator";
CM_ SG_ 154 OBJ_Lane_Assignment_30 "The object's lane relative to the host lane.";
CM_ SG_ 154 OBJ_Lane_Assignment_V_30 "Validator for lane assignment";
CM_ SG_ 154 OBJ_Age_Seconds_30 "Time in seconds in which the object was recognized. ";
CM_ SG_ 154 OBJ_Age_Seconds_V_30 "Validator for object age";
CM_ SG_ 154 OBJ_Width_30 "The width of the target vehicle in the world (not to be mistaken with the width of the visible part of the vehicle).";
CM_ SG_ 154 OBJ_Width_V_30 "Validator for object width";
CM_ SG_ 154 OBJ_Width_STD_30 "Standard deviation for object width";
CM_ SG_ 154 OBJ_Width_STD_V_30 "Validator for the standard deviation of object width";
CM_ SG_ 154 OBJ_Length_30 "The length of the vehicle in the world. For crossing bicycles it gives the viewed length of the bicycle.";
CM_ SG_ 154 OBJ_Length_V_30 "Validator for object length.";
CM_ SG_ 154 OBJ_Length_STD_30 "Standard deviation for object length.";
CM_ SG_ 154 OBJ_Length_STD_V_30 "Validator for the standard deviation of object length.";
CM_ SG_ 154 OBJ_Radar_ID_30 "Radar Object ID of the Fused Object, Only relvant when OBJ_Fusion_Source is not Camera only";
CM_ SG_ 154 OBJ_Height_30 "The height of the object in the world. ";
CM_ SG_ 154 OBJ_Height_V_30 "Validator for object height.";
CM_ SG_ 154 OBJ_Height_STD_30 "Standard deviation for object height.";
CM_ SG_ 154 OBJ_Height_STD_V_30 "Validator for the standard deviation of object height.";
CM_ SG_ 154 OBJ_Abs_Long_Velocity_30 "Absolute longitudinal velocity.";
CM_ SG_ 154 OBJ_Abs_Long_Velocity_V_30 "Validator for absolute longitudinal velocity.";
CM_ SG_ 154 OBJ_Abs_Long_Velocity_STD_30 "Standard deviation of absolute longitudinal velocity.";
CM_ SG_ 154 OBJ_Abs_Long_Vel_STD_V_30 "Validator for the standard deviation of the absolute longitudinal velocity.";
CM_ SG_ 154 OBJ_Abs_Lat_Velocity_30 "The lateral ground speed of the object.";
CM_ SG_ 154 OBJ_Abs_Lat_Velocity_V_30 "Validator for the lateral ground speed of the object.";
CM_ SG_ 154 OBJ_Abs_Lat_Velocity_STD_30 "STD of the lateral ground speed of the object.";
CM_ SG_ 154 OBJ_Abs_Lat_Vel_STD_V_30 "Validator for the STD of the lateral ground speed of the object.";
CM_ SG_ 154 OBJ_Abs_Long_Acc_30 "The longitudinal ground acceleration of the object.";
CM_ SG_ 154 OBJ_Abs_Long_Acc_V_30 "Validator for the longitudinal ground acceleration of the object.";
CM_ SG_ 154 OBJ_Abs_Long_Acc_STD_30 "STD of the longitudinal ground acceleration of the object.";
CM_ SG_ 154 OBJ_Abs_Long_Acc_STD_V_30 "Validator for the STD of the longitudinal ground acceleration of the object.";
CM_ SG_ 154 OBJ_Abs_Lat_Acc_30 "The lateral ground acceleration of the object.";
CM_ SG_ 154 OBJ_Abs_Lat_Acc_V_30 "Validator for the lateral ground acceleration of the object.";
CM_ SG_ 154 OBJ_Abs_Lat_Acc_STD_30 "STD of the lateral ground acceleration of the object.";
CM_ SG_ 154 OBJ_Abs_Lat_Acc_STD_V_30 "Validator for the STD of the lateral ground acceleration of the object.";
CM_ SG_ 154 OBJ_Abs_Acceleration_30 "The absolute ground acceleration in the target's heading direction.";
CM_ SG_ 154 OBJ_Abs_Acceleration_V_30 "Validator for the absolute ground acceleration.";
CM_ SG_ 154 OBJ_Abs_Acc_STD_30 "STD of the absolute ground acceleration.";
CM_ SG_ 154 OBJ_Abs_Acc_STD_V_30 "Validator for the STD of the absolute ground acceleration.";
CM_ SG_ 154 OBJ_Inv_TTC_30 "Inverse TTC (time to collision).";
CM_ SG_ 154 OBJ_Inv_TTC_STD_30 "STD for inverse TTC .";
CM_ SG_ 154 OBJ_Inv_TTC_STD_V_30 "Validator for the STD for inverse TTC .";
CM_ SG_ 154 OBJ_Relative_Long_Acc_30 "The relative lateral ground acceleration of the object.";
CM_ SG_ 154 OBJ_Relative_Long_Acc_V_30 "Validator for the relative lateral ground acceleration of the object.";
CM_ SG_ 154 OBJ_Relative_Long_Acc_STD_30 "STD of the relative lateral ground acceleration of the object.";
CM_ SG_ 154 OBJ_Rel_Long_Acc_STD_V_30 "Validator for the STD of the relative lateral ground acceleration.";
CM_ SG_ 154 OBJ_Relative_Long_Velocity_30 "The relative longtitudinal speed between the target and ego vehicle. ";
CM_ SG_ 154 OBJ_Relative_Long_Velocity_V_30 "Validator for the relative longtitudinal speed.";
CM_ SG_ 154 OBJ_Relative_Long_Vel_STD_30 "STD of the relative longtitudinal speed.";
CM_ SG_ 154 OBJ_Rel_Long_Vel_STD_V_30 "Validator for the STD of the relative longtitudinal speed.";
CM_ SG_ 154 OBJ_Relative_Lat_Velocity_30 "The relative lateral speed between the target and ego vehicle. ";
CM_ SG_ 154 OBJ_Relative_Lat_Velocity_V_30 "Validator for the relative lateral speed. ";
CM_ SG_ 154 OBJ_Relative_Lat_Velocity_STD_30 "STD of the relative lateral speed. ";
CM_ SG_ 154 OBJ_Rel_Lat_Vel_STD_V_30 "Validator for the STD of the relative lateral speed. ";
CM_ SG_ 154 OBJ_Long_Distance_30 "The longitudinal distance to middle of the rear bumper (middle of the RL and RR corners) of the target.";
CM_ SG_ 154 OBJ_Long_Distance_V_30 "Validator of the longtitudinal distance field";
CM_ SG_ 154 OBJ_Long_Distance_STD_30 "STD of the  longtitudinal distance.";
CM_ SG_ 154 OBJ_Long_Distance_STD_V_30 "Validator for the STD of the  longtitudinal distance.";
CM_ SG_ 154 OBJ_Lat_Distance_30 "Lateral distance to the middle of the RL and RR corners.  ";
CM_ SG_ 154 OBJ_Lat_Distance_V_30 "Validator for the lateral distance of the object.";
CM_ SG_ 154 OBJ_Lat_Distance_STD_30 "STD of the lateral distance of the object.";
CM_ SG_ 154 OBJ_Lat_Distance_STD_V_30 "Validator for the STD of the lateral distance of the object.";
CM_ SG_ 154 OBJ_Absolute_Speed_30 "The absolute ground speed in the targets' heading direction.";
CM_ SG_ 154 OBJ_Absolute_Speed_V_30 "Validator for the absolute ground speed.";
CM_ SG_ 154 OBJ_Absolute_Speed_STD_30 "STD of the absolute ground speed.";
CM_ SG_ 154 OBJ_Absolute_Speed_STD_V_30 "Validator for the STD of the absolute ground speed.";
CM_ SG_ 154 OBJ_Heading_30 "The angle beetweenthe host longitudinal axis and target's heading (clockwise, e.g. PI/2 is a target crossing from left to right).";
CM_ SG_ 154 OBJ_Heading_V_30 "Validator for the object heading.";
CM_ SG_ 154 OBJ_Heading_STD_30 "STD of the object heading.";
CM_ SG_ 154 OBJ_Heading_STD_V_30 "Validator for the STD of the object heading.";
CM_ SG_ 154 OBJ_Angle_Rate_STD_30 "Standard deviation of the angular speed. (radians)";
CM_ SG_ 154 OBJ_Angle_Rate_STD_V_30 "Validator for the STD of the angular speed.";
CM_ SG_ 154 OBJ_Angle_Rate_30 "The momentary angular speed of the object. (radians)";
CM_ SG_ 154 OBJ_Angle_Rate_V_30 "Validator for the angular speed.";
CM_ SG_ 154 OBJ_Angle_Right_30 "The angle between the host longitudinal axis and the right side of the front / rear of the target (the visible one). The positive side is to the host's right.";
CM_ SG_ 154 OBJ_Angle_Right_V_30 "Validator for angleRight";
CM_ SG_ 154 OBJ_Angle_Right_STD_30 "Standard deviation of angleRight";
CM_ SG_ 154 OBJ_Angle_Right_STD_V_30 "Validator for the standard deviation of angleRight.";
CM_ SG_ 154 OBJ_Angle_Left_30 "The angle between the host longitudinal axis and the left side of the front / rear of the target (the visible one). The positive side is to the host's right.";
CM_ SG_ 154 OBJ_Angle_Left_V_30 "Validator for angleLeft.";
CM_ SG_ 154 OBJ_Angle_Left_STD_30 "Standard deviation of angleLeft.";
CM_ SG_ 154 OBJ_Angle_Left_STD_V_30 "Validator for the standard deviation of angleLeft.";
CM_ SG_ 154 OBJ_Angle_Side_30 "The angle between the host longitudinal axis and the far visible edge - the visible edge of the front / rear of the target that is not visible. Currently supported for vehicles only.";
CM_ SG_ 154 OBJ_Angle_Side_V_30 "Validator for angleSide.";
CM_ SG_ 154 OBJ_Angle_Side_STD_30 "Standard deviation of angleSide.";
CM_ SG_ 154 OBJ_Angle_Side_STD_V_30 "Validator for the STD of angleSide.";
CM_ SG_ 154 OBJ_Angle_Mid_V_30 "Validator for angleMid.";
CM_ SG_ 154 OBJ_Angle_Mid_30 "The angle between the host longitudinal axis and the middle of the front / rear of the target (the visible one). The positive side is to the host's right.";
CM_ SG_ 154 OBJ_Angle_Mid_STD_30 "Standard deviation of angleMid.";
CM_ SG_ 154 OBJ_Angle_Mid_STD_V_30 "Validator for the STD of angleMid.";
CM_ SG_ 154 OBJ_Angle_Bottom_V_30 "Validator for OBJAngle_Bottom. ";
CM_ SG_ 154 OBJ_Angle_Bottom_30 "The angle between the longitudinal axis and the Bottom of the front / rear of the target (the visible one). The positive side is to the host's bottom";
CM_ SG_ 154 OBJ_Angle_Bottom_STD_30 "STD for OBJAngle_Bottom. ";
CM_ SG_ 154 OBJ_Angle_Bottom_STD_V_30 "Validator for OBJAngle_Bottom_STD. ";
CM_ SG_ 154 OBJ_Visibility_Side_V_30 "Currently Supported for VD only";
CM_ SG_ 154 OBJ_Visibility_Side_30 "From what car  side is the object visible";
CM_ SG_ 154 OBJ_Is_In_Drivable_Area_30 "Indicates whether the target is in a driveable area.";
CM_ SG_ 154 OBJ_Is_In_Drivable_Area_V_30 "Validator for OBJ_Is_In_Drivable_Area.";
CM_ SG_ 154 OBJ_Is_VeryClose_V_30 "Validator for OBJ_Is_VeryClose. ";
CM_ SG_ 154 OBJ_Is_VeryClose_30 "Indicates whether the target is very close to the host such that it is hard to measure its distance. Currently relevant for peds only";
CM_ SG_ 154 OBJ_OverlapAngleEgoLaneR_30 "Lateral distance to the middle of the RL and RR corners.";
CM_ SG_ 154 OBJ_OverlapAngleEgoLaneR_V_30 "Validator for OBJ_OverlapAngleEgoLaneR";
CM_ SG_ 154 OBJ_OverlapAngleEgoLaneL_30 "Lateral distance to the middle of the RL and RR corners.  ";
CM_ SG_ 154 OBJ_OverlapAngleEgoLaneL_V_30 "Validator for OBJ_OverlapAngleEgoLaneL";
CM_ SG_ 154 OBJ_Is_EMERGENCY_VCL_30 "Is Object an Emergency Vehicle";
CM_ SG_ 154 OBJ_EMERGENCY_LIGHT_COLOR_30 "Emergency Color";
CM_ SG_ 154 OBJ_EMERGENCY_V_30 "Are OBJ_Is_EMERGENCY_VCL and OBJ_EMERGENCY_LIGHT_COLOR Valid";
CM_ SG_ 154 OBJ_Angle_Top_30 "From VD touching point on the ground till the roof of the car";
CM_ SG_ 154 OBJ_Angle_Top_V_30 "Validator for OBJ_Angle_Top ";
CM_ SG_ 154 OBJ_Angle_Top_STD_30 "STD for OBJ_Angle_Top";
CM_ SG_ 154 OBJ_Angle_Top_STD_V_30 "Validator for OBJ_Angle_Top_STD. ";
CM_ SG_ 154 OBJ_CRC_31 "Calculated over all element signals. From the signal after the CRC until the first signal in the next elements OBJ_CRC_N+1  not including";
CM_ SG_ 154 OBJ_ID_31 "The detected object ID. Range is 1-255, while 0 indicates that the field in unfilled.";
CM_ SG_ 154 OBJ_Existence_Probability_31 "The existence probability of the reported object";
CM_ SG_ 154 OBJ_Fusion_Source_31 "sources ids used for fusion";
CM_ SG_ 154 OBJ_Triggered_SDM_31 "Indicates whether the object has trigered the SDM (Safety Diagnostic Manager) alert.";
CM_ SG_ 154 OBJ_Motion_Category_31 "Relevant for VD only. Full description of values can be found at the ACC guide.";
CM_ SG_ 154 OBJ_Object_Age_31 "The number of frames in which the object was recognized.";
CM_ SG_ 154 OBJ_Measuring_Status_31 "Measurment status. Old vs New marks if this is the first frame in which the object is reported. Predicted vs Measured marks if the report is raw or has been predicted forward in time using the measured dynamics and ego motion.";
CM_ SG_ 154 OBJ_Object_Class_31 "Indicates the object type. Uncertain is outputted in case the probability that a vehicle is a truck is very similar to the probability that it is a car. ";
CM_ SG_ 154 OBJ_Class_Probability_31 "The probability of this type classification.";
CM_ SG_ 154 OBJ_Car_Probability_31 "The probability the object is a car";
CM_ SG_ 154 OBJ_Truck_Probability_31 "The probability the object is a Truck";
CM_ SG_ 154 OBJ_Bike_Probability_31 "The probability the object is a Bike";
CM_ SG_ 154 OBJ_Camera_Source_31 "The camera in which this object was detected (best choice).";
CM_ SG_ 154 OBJ_Motion_Status_31 "MOVING - the object is moving STATIONARY - the object was never seen moving STOPPED -  the object was moving and has stopped MOVING_SLOWLY - the object is moving very slowly";
CM_ SG_ 154 OBJ_Motion_Orientation_31 "The direction of the targets heading compared to the host. ";
CM_ SG_ 154 OBJ_Has_Cut_Lane_31 "Indicates whether the object cut the host's (right or left) lane. In case there are no lanes, indicates whether the objects is at most 1 meters away from the host.";
CM_ SG_ 154 OBJ_Has_Cut_Path_31 "Indicates whether the object is in the host's path.";
CM_ SG_ 154 OBJ_Brake_Light_31 "Indication for brake lights ";
CM_ SG_ 154 OBJ_Turn_Indicator_Right_31 "Indication for blinking right light.";
CM_ SG_ 154 OBJ_Turn_Indicator_Left_31 "Indication for blinking left light ";
CM_ SG_ 154 OBJ_Light_Indicator_Validity_31 "Validator for light indicators";
CM_ SG_ 154 OBJ_Right_Out_Of_Image_31 "Indicates whether the measurment are predicted out of the right side of the image bounderies.";
CM_ SG_ 154 OBJ_Left_Out_Of_Image_31 "Indicates whether if measurment are predicted out of  the left side of the image bounderies";
CM_ SG_ 154 OBJ_Right_Out_Of_Image_V_31 "validator";
CM_ SG_ 154 OBJ_Left_Out_Of_Image_V_31 "validator";
CM_ SG_ 154 OBJ_Top_Out_Of_Image_31 "Indicates whether if measurment are predicted out of  the top of the image bounderies";
CM_ SG_ 154 OBJ_Bottom_Out_Of_Image_31 "Indicates whether if measurment are predicted out of  the bottom of the image bounderies";
CM_ SG_ 154 OBJ_Top_Out_Of_Image_V_31 "validator";
CM_ SG_ 154 OBJ_Bottom_Out_Of_Image_V_31 "validator";
CM_ SG_ 154 OBJ_Lane_Assignment_31 "The object's lane relative to the host lane.";
CM_ SG_ 154 OBJ_Lane_Assignment_V_31 "Validator for lane assignment";
CM_ SG_ 154 OBJ_Age_Seconds_31 "Time in seconds in which the object was recognized. ";
CM_ SG_ 154 OBJ_Age_Seconds_V_31 "Validator for object age";
CM_ SG_ 154 OBJ_Width_31 "The width of the target vehicle in the world (not to be mistaken with the width of the visible part of the vehicle).";
CM_ SG_ 154 OBJ_Width_V_31 "Validator for object width";
CM_ SG_ 154 OBJ_Width_STD_31 "Standard deviation for object width";
CM_ SG_ 154 OBJ_Width_STD_V_31 "Validator for the standard deviation of object width";
CM_ SG_ 154 OBJ_Length_31 "The length of the vehicle in the world. For crossing bicycles it gives the viewed length of the bicycle.";
CM_ SG_ 154 OBJ_Length_V_31 "Validator for object length.";
CM_ SG_ 154 OBJ_Length_STD_31 "Standard deviation for object length.";
CM_ SG_ 154 OBJ_Length_STD_V_31 "Validator for the standard deviation of object length.";
CM_ SG_ 154 OBJ_Radar_ID_31 "Radar Object ID of the Fused Object, Only relvant when OBJ_Fusion_Source is not Camera only";
CM_ SG_ 154 OBJ_Height_31 "The height of the object in the world. ";
CM_ SG_ 154 OBJ_Height_V_31 "Validator for object height.";
CM_ SG_ 154 OBJ_Height_STD_31 "Standard deviation for object height.";
CM_ SG_ 154 OBJ_Height_STD_V_31 "Validator for the standard deviation of object height.";
CM_ SG_ 154 OBJ_Abs_Long_Velocity_31 "Absolute longitudinal velocity.";
CM_ SG_ 154 OBJ_Abs_Long_Velocity_V_31 "Validator for absolute longitudinal velocity.";
CM_ SG_ 154 OBJ_Abs_Long_Velocity_STD_31 "Standard deviation of absolute longitudinal velocity.";
CM_ SG_ 154 OBJ_Abs_Long_Vel_STD_V_31 "Validator for the standard deviation of the absolute longitudinal velocity.";
CM_ SG_ 154 OBJ_Abs_Lat_Velocity_31 "The lateral ground speed of the object.";
CM_ SG_ 154 OBJ_Abs_Lat_Velocity_V_31 "Validator for the lateral ground speed of the object.";
CM_ SG_ 154 OBJ_Abs_Lat_Velocity_STD_31 "STD of the lateral ground speed of the object.";
CM_ SG_ 154 OBJ_Abs_Lat_Vel_STD_V_31 "Validator for the STD of the lateral ground speed of the object.";
CM_ SG_ 154 OBJ_Abs_Long_Acc_31 "The longitudinal ground acceleration of the object.";
CM_ SG_ 154 OBJ_Abs_Long_Acc_V_31 "Validator for the longitudinal ground acceleration of the object.";
CM_ SG_ 154 OBJ_Abs_Long_Acc_STD_31 "STD of the longitudinal ground acceleration of the object.";
CM_ SG_ 154 OBJ_Abs_Long_Acc_STD_V_31 "Validator for the STD of the longitudinal ground acceleration of the object.";
CM_ SG_ 154 OBJ_Abs_Lat_Acc_31 "The lateral ground acceleration of the object.";
CM_ SG_ 154 OBJ_Abs_Lat_Acc_V_31 "Validator for the lateral ground acceleration of the object.";
CM_ SG_ 154 OBJ_Abs_Lat_Acc_STD_31 "STD of the lateral ground acceleration of the object.";
CM_ SG_ 154 OBJ_Abs_Lat_Acc_STD_V_31 "Validator for the STD of the lateral ground acceleration of the object.";
CM_ SG_ 154 OBJ_Abs_Acceleration_31 "The absolute ground acceleration in the target's heading direction.";
CM_ SG_ 154 OBJ_Abs_Acceleration_V_31 "Validator for the absolute ground acceleration.";
CM_ SG_ 154 OBJ_Abs_Acc_STD_31 "STD of the absolute ground acceleration.";
CM_ SG_ 154 OBJ_Abs_Acc_STD_V_31 "Validator for the STD of the absolute ground acceleration.";
CM_ SG_ 154 OBJ_Inv_TTC_31 "Inverse TTC (time to collision).";
CM_ SG_ 154 OBJ_Inv_TTC_STD_31 "STD for inverse TTC .";
CM_ SG_ 154 OBJ_Inv_TTC_STD_V_31 "Validator for the STD for inverse TTC .";
CM_ SG_ 154 OBJ_Relative_Long_Acc_31 "The relative lateral ground acceleration of the object.";
CM_ SG_ 154 OBJ_Relative_Long_Acc_V_31 "Validator for the relative lateral ground acceleration of the object.";
CM_ SG_ 154 OBJ_Relative_Long_Acc_STD_31 "STD of the relative lateral ground acceleration of the object.";
CM_ SG_ 154 OBJ_Rel_Long_Acc_STD_V_31 "Validator for the STD of the relative lateral ground acceleration.";
CM_ SG_ 154 OBJ_Relative_Long_Velocity_31 "The relative longtitudinal speed between the target and ego vehicle. ";
CM_ SG_ 154 OBJ_Relative_Long_Velocity_V_31 "Validator for the relative longtitudinal speed.";
CM_ SG_ 154 OBJ_Relative_Long_Vel_STD_31 "STD of the relative longtitudinal speed.";
CM_ SG_ 154 OBJ_Rel_Long_Vel_STD_V_31 "Validator for the STD of the relative longtitudinal speed.";
CM_ SG_ 154 OBJ_Relative_Lat_Velocity_31 "The relative lateral speed between the target and ego vehicle. ";
CM_ SG_ 154 OBJ_Relative_Lat_Velocity_V_31 "Validator for the relative lateral speed. ";
CM_ SG_ 154 OBJ_Relative_Lat_Velocity_STD_31 "STD of the relative lateral speed. ";
CM_ SG_ 154 OBJ_Rel_Lat_Vel_STD_V_31 "Validator for the STD of the relative lateral speed. ";
CM_ SG_ 154 OBJ_Long_Distance_31 "The longitudinal distance to middle of the rear bumper (middle of the RL and RR corners) of the target.";
CM_ SG_ 154 OBJ_Long_Distance_V_31 "Validator of the longtitudinal distance field";
CM_ SG_ 154 OBJ_Long_Distance_STD_31 "STD of the  longtitudinal distance.";
CM_ SG_ 154 OBJ_Long_Distance_STD_V_31 "Validator for the STD of the  longtitudinal distance.";
CM_ SG_ 154 OBJ_Lat_Distance_31 "Lateral distance to the middle of the RL and RR corners.  ";
CM_ SG_ 154 OBJ_Lat_Distance_V_31 "Validator for the lateral distance of the object.";
CM_ SG_ 154 OBJ_Lat_Distance_STD_31 "STD of the lateral distance of the object.";
CM_ SG_ 154 OBJ_Lat_Distance_STD_V_31 "Validator for the STD of the lateral distance of the object.";
CM_ SG_ 154 OBJ_Absolute_Speed_31 "The absolute ground speed in the targets' heading direction.";
CM_ SG_ 154 OBJ_Absolute_Speed_V_31 "Validator for the absolute ground speed.";
CM_ SG_ 154 OBJ_Absolute_Speed_STD_31 "STD of the absolute ground speed.";
CM_ SG_ 154 OBJ_Absolute_Speed_STD_V_31 "Validator for the STD of the absolute ground speed.";
CM_ SG_ 154 OBJ_Heading_31 "The angle beetweenthe host longitudinal axis and target's heading (clockwise, e.g. PI/2 is a target crossing from left to right).";
CM_ SG_ 154 OBJ_Heading_V_31 "Validator for the object heading.";
CM_ SG_ 154 OBJ_Heading_STD_31 "STD of the object heading.";
CM_ SG_ 154 OBJ_Heading_STD_V_31 "Validator for the STD of the object heading.";
CM_ SG_ 154 OBJ_Angle_Rate_STD_31 "Standard deviation of the angular speed. (radians)";
CM_ SG_ 154 OBJ_Angle_Rate_STD_V_31 "Validator for the STD of the angular speed.";
CM_ SG_ 154 OBJ_Angle_Rate_31 "The momentary angular speed of the object. (radians)";
CM_ SG_ 154 OBJ_Angle_Rate_V_31 "Validator for the angular speed.";
CM_ SG_ 154 OBJ_Angle_Right_31 "The angle between the host longitudinal axis and the right side of the front / rear of the target (the visible one). The positive side is to the host's right.";
CM_ SG_ 154 OBJ_Angle_Right_V_31 "Validator for angleRight";
CM_ SG_ 154 OBJ_Angle_Right_STD_31 "Standard deviation of angleRight";
CM_ SG_ 154 OBJ_Angle_Right_STD_V_31 "Validator for the standard deviation of angleRight.";
CM_ SG_ 154 OBJ_Angle_Left_31 "The angle between the host longitudinal axis and the left side of the front / rear of the target (the visible one). The positive side is to the host's right.";
CM_ SG_ 154 OBJ_Angle_Left_V_31 "Validator for angleLeft.";
CM_ SG_ 154 OBJ_Angle_Left_STD_31 "Standard deviation of angleLeft.";
CM_ SG_ 154 OBJ_Angle_Left_STD_V_31 "Validator for the standard deviation of angleLeft.";
CM_ SG_ 154 OBJ_Angle_Side_31 "The angle between the host longitudinal axis and the far visible edge - the visible edge of the front / rear of the target that is not visible. Currently supported for vehicles only.";
CM_ SG_ 154 OBJ_Angle_Side_V_31 "Validator for angleSide.";
CM_ SG_ 154 OBJ_Angle_Side_STD_31 "Standard deviation of angleSide.";
CM_ SG_ 154 OBJ_Angle_Side_STD_V_31 "Validator for the STD of angleSide.";
CM_ SG_ 154 OBJ_Angle_Mid_V_31 "Validator for angleMid.";
CM_ SG_ 154 OBJ_Angle_Mid_31 "The angle between the host longitudinal axis and the middle of the front / rear of the target (the visible one). The positive side is to the host's right.";
CM_ SG_ 154 OBJ_Angle_Mid_STD_31 "Standard deviation of angleMid.";
CM_ SG_ 154 OBJ_Angle_Mid_STD_V_31 "Validator for the STD of angleMid.";
CM_ SG_ 154 OBJ_Angle_Bottom_V_31 "Validator for OBJAngle_Bottom. ";
CM_ SG_ 154 OBJ_Angle_Bottom_31 "The angle between the longitudinal axis and the Bottom of the front / rear of the target (the visible one). The positive side is to the host's bottom";
CM_ SG_ 154 OBJ_Angle_Bottom_STD_31 "STD for OBJAngle_Bottom. ";
CM_ SG_ 154 OBJ_Angle_Bottom_STD_V_31 "Validator for OBJAngle_Bottom_STD. ";
CM_ SG_ 154 OBJ_Visibility_Side_V_31 "Currently Supported for VD only";
CM_ SG_ 154 OBJ_Visibility_Side_31 "From what car  side is the object visible";
CM_ SG_ 154 OBJ_Is_In_Drivable_Area_31 "Indicates whether the target is in a driveable area.";
CM_ SG_ 154 OBJ_Is_In_Drivable_Area_V_31 "Validator for OBJ_Is_In_Drivable_Area.";
CM_ SG_ 154 OBJ_Is_VeryClose_V_31 "Validator for OBJ_Is_VeryClose. ";
CM_ SG_ 154 OBJ_Is_VeryClose_31 "Indicates whether the target is very close to the host such that it is hard to measure its distance. Currently relevant for peds only";
CM_ SG_ 154 OBJ_OverlapAngleEgoLaneR_31 "Lateral distance to the middle of the RL and RR corners.";
CM_ SG_ 154 OBJ_OverlapAngleEgoLaneR_V_31 "Validator for OBJ_OverlapAngleEgoLaneR";
CM_ SG_ 154 OBJ_OverlapAngleEgoLaneL_31 "Lateral distance to the middle of the RL and RR corners.  ";
CM_ SG_ 154 OBJ_OverlapAngleEgoLaneL_V_31 "Validator for OBJ_OverlapAngleEgoLaneL";
CM_ SG_ 154 OBJ_Is_EMERGENCY_VCL_31 "Is Object an Emergency Vehicle";
CM_ SG_ 154 OBJ_EMERGENCY_LIGHT_COLOR_31 "Emergency Color";
CM_ SG_ 154 OBJ_EMERGENCY_V_31 "Are OBJ_Is_EMERGENCY_VCL and OBJ_EMERGENCY_LIGHT_COLOR Valid";
CM_ SG_ 154 OBJ_Angle_Top_31 "From VD touching point on the ground till the roof of the car";
CM_ SG_ 154 OBJ_Angle_Top_V_31 "Validator for OBJ_Angle_Top ";
CM_ SG_ 154 OBJ_Angle_Top_STD_31 "STD for OBJ_Angle_Top";
CM_ SG_ 154 OBJ_Angle_Top_STD_V_31 "Validator for OBJ_Angle_Top_STD. ";
CM_ SG_ 154 OBJ_CRC_32 "Calculated over all element signals. From the signal after the CRC until the first signal in the next elements OBJ_CRC_N+1  not including";
CM_ SG_ 154 OBJ_ID_32 "The detected object ID. Range is 1-255, while 0 indicates that the field in unfilled.";
CM_ SG_ 154 OBJ_Existence_Probability_32 "The existence probability of the reported object";
CM_ SG_ 154 OBJ_Fusion_Source_32 "sources ids used for fusion";
CM_ SG_ 154 OBJ_Triggered_SDM_32 "Indicates whether the object has trigered the SDM (Safety Diagnostic Manager) alert.";
CM_ SG_ 154 OBJ_Motion_Category_32 "Relevant for VD only. Full description of values can be found at the ACC guide.";
CM_ SG_ 154 OBJ_Object_Age_32 "The number of frames in which the object was recognized.";
CM_ SG_ 154 OBJ_Measuring_Status_32 "Measurment status. Old vs New marks if this is the first frame in which the object is reported. Predicted vs Measured marks if the report is raw or has been predicted forward in time using the measured dynamics and ego motion.";
CM_ SG_ 154 OBJ_Object_Class_32 "Indicates the object type. Uncertain is outputted in case the probability that a vehicle is a truck is very similar to the probability that it is a car. ";
CM_ SG_ 154 OBJ_Class_Probability_32 "The probability of this type classification.";
CM_ SG_ 154 OBJ_Car_Probability_32 "The probability the object is a car";
CM_ SG_ 154 OBJ_Truck_Probability_32 "The probability the object is a Truck";
CM_ SG_ 154 OBJ_Bike_Probability_32 "The probability the object is a Bike";
CM_ SG_ 154 OBJ_Camera_Source_32 "The camera in which this object was detected (best choice).";
CM_ SG_ 154 OBJ_Motion_Status_32 "MOVING - the object is moving STATIONARY - the object was never seen moving STOPPED -  the object was moving and has stopped MOVING_SLOWLY - the object is moving very slowly";
CM_ SG_ 154 OBJ_Motion_Orientation_32 "The direction of the targets heading compared to the host. ";
CM_ SG_ 154 OBJ_Has_Cut_Lane_32 "Indicates whether the object cut the host's (right or left) lane. In case there are no lanes, indicates whether the objects is at most 1 meters away from the host.";
CM_ SG_ 154 OBJ_Has_Cut_Path_32 "Indicates whether the object is in the host's path.";
CM_ SG_ 154 OBJ_Brake_Light_32 "Indication for brake lights ";
CM_ SG_ 154 OBJ_Turn_Indicator_Right_32 "Indication for blinking right light.";
CM_ SG_ 154 OBJ_Turn_Indicator_Left_32 "Indication for blinking left light ";
CM_ SG_ 154 OBJ_Light_Indicator_Validity_32 "Validator for light indicators";
CM_ SG_ 154 OBJ_Right_Out_Of_Image_32 "Indicates whether the measurment are predicted out of the right side of the image bounderies.";
CM_ SG_ 154 OBJ_Left_Out_Of_Image_32 "Indicates whether if measurment are predicted out of  the left side of the image bounderies";
CM_ SG_ 154 OBJ_Right_Out_Of_Image_V_32 "validator";
CM_ SG_ 154 OBJ_Left_Out_Of_Image_V_32 "validator";
CM_ SG_ 154 OBJ_Top_Out_Of_Image_32 "Indicates whether if measurment are predicted out of  the top of the image bounderies";
CM_ SG_ 154 OBJ_Bottom_Out_Of_Image_32 "Indicates whether if measurment are predicted out of  the bottom of the image bounderies";
CM_ SG_ 154 OBJ_Top_Out_Of_Image_V_32 "validator";
CM_ SG_ 154 OBJ_Bottom_Out_Of_Image_V_32 "validator";
CM_ SG_ 154 OBJ_Lane_Assignment_32 "The object's lane relative to the host lane.";
CM_ SG_ 154 OBJ_Lane_Assignment_V_32 "Validator for lane assignment";
CM_ SG_ 154 OBJ_Age_Seconds_32 "Time in seconds in which the object was recognized. ";
CM_ SG_ 154 OBJ_Age_Seconds_V_32 "Validator for object age";
CM_ SG_ 154 OBJ_Width_32 "The width of the target vehicle in the world (not to be mistaken with the width of the visible part of the vehicle).";
CM_ SG_ 154 OBJ_Width_V_32 "Validator for object width";
CM_ SG_ 154 OBJ_Width_STD_32 "Standard deviation for object width";
CM_ SG_ 154 OBJ_Width_STD_V_32 "Validator for the standard deviation of object width";
CM_ SG_ 154 OBJ_Length_32 "The length of the vehicle in the world. For crossing bicycles it gives the viewed length of the bicycle.";
CM_ SG_ 154 OBJ_Length_V_32 "Validator for object length.";
CM_ SG_ 154 OBJ_Length_STD_32 "Standard deviation for object length.";
CM_ SG_ 154 OBJ_Length_STD_V_32 "Validator for the standard deviation of object length.";
CM_ SG_ 154 OBJ_Radar_ID_32 "Radar Object ID of the Fused Object, Only relvant when OBJ_Fusion_Source is not Camera only";
CM_ SG_ 154 OBJ_Height_32 "The height of the object in the world. ";
CM_ SG_ 154 OBJ_Height_V_32 "Validator for object height.";
CM_ SG_ 154 OBJ_Height_STD_32 "Standard deviation for object height.";
CM_ SG_ 154 OBJ_Height_STD_V_32 "Validator for the standard deviation of object height.";
CM_ SG_ 154 OBJ_Abs_Long_Velocity_32 "Absolute longitudinal velocity.";
CM_ SG_ 154 OBJ_Abs_Long_Velocity_V_32 "Validator for absolute longitudinal velocity.";
CM_ SG_ 154 OBJ_Abs_Long_Velocity_STD_32 "Standard deviation of absolute longitudinal velocity.";
CM_ SG_ 154 OBJ_Abs_Long_Vel_STD_V_32 "Validator for the standard deviation of the absolute longitudinal velocity.";
CM_ SG_ 154 OBJ_Abs_Lat_Velocity_32 "The lateral ground speed of the object.";
CM_ SG_ 154 OBJ_Abs_Lat_Velocity_V_32 "Validator for the lateral ground speed of the object.";
CM_ SG_ 154 OBJ_Abs_Lat_Velocity_STD_32 "STD of the lateral ground speed of the object.";
CM_ SG_ 154 OBJ_Abs_Lat_Vel_STD_V_32 "Validator for the STD of the lateral ground speed of the object.";
CM_ SG_ 154 OBJ_Abs_Long_Acc_32 "The longitudinal ground acceleration of the object.";
CM_ SG_ 154 OBJ_Abs_Long_Acc_V_32 "Validator for the longitudinal ground acceleration of the object.";
CM_ SG_ 154 OBJ_Abs_Long_Acc_STD_32 "STD of the longitudinal ground acceleration of the object.";
CM_ SG_ 154 OBJ_Abs_Long_Acc_STD_V_32 "Validator for the STD of the longitudinal ground acceleration of the object.";
CM_ SG_ 154 OBJ_Abs_Lat_Acc_32 "The lateral ground acceleration of the object.";
CM_ SG_ 154 OBJ_Abs_Lat_Acc_V_32 "Validator for the lateral ground acceleration of the object.";
CM_ SG_ 154 OBJ_Abs_Lat_Acc_STD_32 "STD of the lateral ground acceleration of the object.";
CM_ SG_ 154 OBJ_Abs_Lat_Acc_STD_V_32 "Validator for the STD of the lateral ground acceleration of the object.";
CM_ SG_ 154 OBJ_Abs_Acceleration_32 "The absolute ground acceleration in the target's heading direction.";
CM_ SG_ 154 OBJ_Abs_Acceleration_V_32 "Validator for the absolute ground acceleration.";
CM_ SG_ 154 OBJ_Abs_Acc_STD_32 "STD of the absolute ground acceleration.";
CM_ SG_ 154 OBJ_Abs_Acc_STD_V_32 "Validator for the STD of the absolute ground acceleration.";
CM_ SG_ 154 OBJ_Inv_TTC_32 "Inverse TTC (time to collision).";
CM_ SG_ 154 OBJ_Inv_TTC_STD_32 "STD for inverse TTC .";
CM_ SG_ 154 OBJ_Inv_TTC_STD_V_32 "Validator for the STD for inverse TTC .";
CM_ SG_ 154 OBJ_Relative_Long_Acc_32 "The relative lateral ground acceleration of the object.";
CM_ SG_ 154 OBJ_Relative_Long_Acc_V_32 "Validator for the relative lateral ground acceleration of the object.";
CM_ SG_ 154 OBJ_Relative_Long_Acc_STD_32 "STD of the relative lateral ground acceleration of the object.";
CM_ SG_ 154 OBJ_Rel_Long_Acc_STD_V_32 "Validator for the STD of the relative lateral ground acceleration.";
CM_ SG_ 154 OBJ_Relative_Long_Velocity_32 "The relative longtitudinal speed between the target and ego vehicle. ";
CM_ SG_ 154 OBJ_Relative_Long_Velocity_V_32 "Validator for the relative longtitudinal speed.";
CM_ SG_ 154 OBJ_Relative_Long_Vel_STD_32 "STD of the relative longtitudinal speed.";
CM_ SG_ 154 OBJ_Rel_Long_Vel_STD_V_32 "Validator for the STD of the relative longtitudinal speed.";
CM_ SG_ 154 OBJ_Relative_Lat_Velocity_32 "The relative lateral speed between the target and ego vehicle. ";
CM_ SG_ 154 OBJ_Relative_Lat_Velocity_V_32 "Validator for the relative lateral speed. ";
CM_ SG_ 154 OBJ_Relative_Lat_Velocity_STD_32 "STD of the relative lateral speed. ";
CM_ SG_ 154 OBJ_Rel_Lat_Vel_STD_V_32 "Validator for the STD of the relative lateral speed. ";
CM_ SG_ 154 OBJ_Long_Distance_32 "The longitudinal distance to middle of the rear bumper (middle of the RL and RR corners) of the target.";
CM_ SG_ 154 OBJ_Long_Distance_V_32 "Validator of the longtitudinal distance field";
CM_ SG_ 154 OBJ_Long_Distance_STD_32 "STD of the  longtitudinal distance.";
CM_ SG_ 154 OBJ_Long_Distance_STD_V_32 "Validator for the STD of the  longtitudinal distance.";
CM_ SG_ 154 OBJ_Lat_Distance_32 "Lateral distance to the middle of the RL and RR corners.  ";
CM_ SG_ 154 OBJ_Lat_Distance_V_32 "Validator for the lateral distance of the object.";
CM_ SG_ 154 OBJ_Lat_Distance_STD_32 "STD of the lateral distance of the object.";
CM_ SG_ 154 OBJ_Lat_Distance_STD_V_32 "Validator for the STD of the lateral distance of the object.";
CM_ SG_ 154 OBJ_Absolute_Speed_32 "The absolute ground speed in the targets' heading direction.";
CM_ SG_ 154 OBJ_Absolute_Speed_V_32 "Validator for the absolute ground speed.";
CM_ SG_ 154 OBJ_Absolute_Speed_STD_32 "STD of the absolute ground speed.";
CM_ SG_ 154 OBJ_Absolute_Speed_STD_V_32 "Validator for the STD of the absolute ground speed.";
CM_ SG_ 154 OBJ_Heading_32 "The angle beetweenthe host longitudinal axis and target's heading (clockwise, e.g. PI/2 is a target crossing from left to right).";
CM_ SG_ 154 OBJ_Heading_V_32 "Validator for the object heading.";
CM_ SG_ 154 OBJ_Heading_STD_32 "STD of the object heading.";
CM_ SG_ 154 OBJ_Heading_STD_V_32 "Validator for the STD of the object heading.";
CM_ SG_ 154 OBJ_Angle_Rate_STD_32 "Standard deviation of the angular speed. (radians)";
CM_ SG_ 154 OBJ_Angle_Rate_STD_V_32 "Validator for the STD of the angular speed.";
CM_ SG_ 154 OBJ_Angle_Rate_32 "The momentary angular speed of the object. (radians)";
CM_ SG_ 154 OBJ_Angle_Rate_V_32 "Validator for the angular speed.";
CM_ SG_ 154 OBJ_Angle_Right_32 "The angle between the host longitudinal axis and the right side of the front / rear of the target (the visible one). The positive side is to the host's right.";
CM_ SG_ 154 OBJ_Angle_Right_V_32 "Validator for angleRight";
CM_ SG_ 154 OBJ_Angle_Right_STD_32 "Standard deviation of angleRight";
CM_ SG_ 154 OBJ_Angle_Right_STD_V_32 "Validator for the standard deviation of angleRight.";
CM_ SG_ 154 OBJ_Angle_Left_32 "The angle between the host longitudinal axis and the left side of the front / rear of the target (the visible one). The positive side is to the host's right.";
CM_ SG_ 154 OBJ_Angle_Left_V_32 "Validator for angleLeft.";
CM_ SG_ 154 OBJ_Angle_Left_STD_32 "Standard deviation of angleLeft.";
CM_ SG_ 154 OBJ_Angle_Left_STD_V_32 "Validator for the standard deviation of angleLeft.";
CM_ SG_ 154 OBJ_Angle_Side_32 "The angle between the host longitudinal axis and the far visible edge - the visible edge of the front / rear of the target that is not visible. Currently supported for vehicles only.";
CM_ SG_ 154 OBJ_Angle_Side_V_32 "Validator for angleSide.";
CM_ SG_ 154 OBJ_Angle_Side_STD_32 "Standard deviation of angleSide.";
CM_ SG_ 154 OBJ_Angle_Side_STD_V_32 "Validator for the STD of angleSide.";
CM_ SG_ 154 OBJ_Angle_Mid_V_32 "Validator for angleMid.";
CM_ SG_ 154 OBJ_Angle_Mid_32 "The angle between the host longitudinal axis and the middle of the front / rear of the target (the visible one). The positive side is to the host's right.";
CM_ SG_ 154 OBJ_Angle_Mid_STD_32 "Standard deviation of angleMid.";
CM_ SG_ 154 OBJ_Angle_Mid_STD_V_32 "Validator for the STD of angleMid.";
CM_ SG_ 154 OBJ_Angle_Bottom_V_32 "Validator for OBJAngle_Bottom. ";
CM_ SG_ 154 OBJ_Angle_Bottom_32 "The angle between the longitudinal axis and the Bottom of the front / rear of the target (the visible one). The positive side is to the host's bottom";
CM_ SG_ 154 OBJ_Angle_Bottom_STD_32 "STD for OBJAngle_Bottom. ";
CM_ SG_ 154 OBJ_Angle_Bottom_STD_V_32 "Validator for OBJAngle_Bottom_STD. ";
CM_ SG_ 154 OBJ_Visibility_Side_V_32 "Currently Supported for VD only";
CM_ SG_ 154 OBJ_Visibility_Side_32 "From what car  side is the object visible";
CM_ SG_ 154 OBJ_Is_In_Drivable_Area_32 "Indicates whether the target is in a driveable area.";
CM_ SG_ 154 OBJ_Is_In_Drivable_Area_V_32 "Validator for OBJ_Is_In_Drivable_Area.";
CM_ SG_ 154 OBJ_Is_VeryClose_V_32 "Validator for OBJ_Is_VeryClose. ";
CM_ SG_ 154 OBJ_Is_VeryClose_32 "Indicates whether the target is very close to the host such that it is hard to measure its distance. Currently relevant for peds only";
CM_ SG_ 154 OBJ_OverlapAngleEgoLaneR_32 "Lateral distance to the middle of the RL and RR corners.";
CM_ SG_ 154 OBJ_OverlapAngleEgoLaneR_V_32 "Validator for OBJ_OverlapAngleEgoLaneR";
CM_ SG_ 154 OBJ_OverlapAngleEgoLaneL_32 "Lateral distance to the middle of the RL and RR corners.  ";
CM_ SG_ 154 OBJ_OverlapAngleEgoLaneL_V_32 "Validator for OBJ_OverlapAngleEgoLaneL";
CM_ SG_ 154 OBJ_Is_EMERGENCY_VCL_32 "Is Object an Emergency Vehicle";
CM_ SG_ 154 OBJ_EMERGENCY_LIGHT_COLOR_32 "Emergency Color";
CM_ SG_ 154 OBJ_EMERGENCY_V_32 "Are OBJ_Is_EMERGENCY_VCL and OBJ_EMERGENCY_LIGHT_COLOR Valid";
CM_ SG_ 154 OBJ_Angle_Top_32 "From VD touching point on the ground till the roof of the car";
CM_ SG_ 154 OBJ_Angle_Top_V_32 "Validator for OBJ_Angle_Top ";
CM_ SG_ 154 OBJ_Angle_Top_STD_32 "STD for OBJ_Angle_Top";
CM_ SG_ 154 OBJ_Angle_Top_STD_V_32 "Validator for OBJ_Angle_Top_STD. ";
CM_ SG_ 154 OBJ_CRC_33 "Calculated over all element signals. From the signal after the CRC until the first signal in the next elements OBJ_CRC_N+1  not including";
CM_ SG_ 154 OBJ_ID_33 "The detected object ID. Range is 1-255, while 0 indicates that the field in unfilled.";
CM_ SG_ 154 OBJ_Existence_Probability_33 "The existence probability of the reported object";
CM_ SG_ 154 OBJ_Fusion_Source_33 "sources ids used for fusion";
CM_ SG_ 154 OBJ_Triggered_SDM_33 "Indicates whether the object has trigered the SDM (Safety Diagnostic Manager) alert.";
CM_ SG_ 154 OBJ_Motion_Category_33 "Relevant for VD only. Full description of values can be found at the ACC guide.";
CM_ SG_ 154 OBJ_Object_Age_33 "The number of frames in which the object was recognized.";
CM_ SG_ 154 OBJ_Measuring_Status_33 "Measurment status. Old vs New marks if this is the first frame in which the object is reported. Predicted vs Measured marks if the report is raw or has been predicted forward in time using the measured dynamics and ego motion.";
CM_ SG_ 154 OBJ_Object_Class_33 "Indicates the object type. Uncertain is outputted in case the probability that a vehicle is a truck is very similar to the probability that it is a car. ";
CM_ SG_ 154 OBJ_Class_Probability_33 "The probability of this type classification.";
CM_ SG_ 154 OBJ_Car_Probability_33 "The probability the object is a car";
CM_ SG_ 154 OBJ_Truck_Probability_33 "The probability the object is a Truck";
CM_ SG_ 154 OBJ_Bike_Probability_33 "The probability the object is a Bike";
CM_ SG_ 154 OBJ_Camera_Source_33 "The camera in which this object was detected (best choice).";
CM_ SG_ 154 OBJ_Motion_Status_33 "MOVING - the object is moving STATIONARY - the object was never seen moving STOPPED -  the object was moving and has stopped MOVING_SLOWLY - the object is moving very slowly";
CM_ SG_ 154 OBJ_Motion_Orientation_33 "The direction of the targets heading compared to the host. ";
CM_ SG_ 154 OBJ_Has_Cut_Lane_33 "Indicates whether the object cut the host's (right or left) lane. In case there are no lanes, indicates whether the objects is at most 1 meters away from the host.";
CM_ SG_ 154 OBJ_Has_Cut_Path_33 "Indicates whether the object is in the host's path.";
CM_ SG_ 154 OBJ_Brake_Light_33 "Indication for brake lights ";
CM_ SG_ 154 OBJ_Turn_Indicator_Right_33 "Indication for blinking right light.";
CM_ SG_ 154 OBJ_Turn_Indicator_Left_33 "Indication for blinking left light ";
CM_ SG_ 154 OBJ_Light_Indicator_Validity_33 "Validator for light indicators";
CM_ SG_ 154 OBJ_Right_Out_Of_Image_33 "Indicates whether the measurment are predicted out of the right side of the image bounderies.";
CM_ SG_ 154 OBJ_Left_Out_Of_Image_33 "Indicates whether if measurment are predicted out of  the left side of the image bounderies";
CM_ SG_ 154 OBJ_Right_Out_Of_Image_V_33 "validator";
CM_ SG_ 154 OBJ_Left_Out_Of_Image_V_33 "validator";
CM_ SG_ 154 OBJ_Top_Out_Of_Image_33 "Indicates whether if measurment are predicted out of  the top of the image bounderies";
CM_ SG_ 154 OBJ_Bottom_Out_Of_Image_33 "Indicates whether if measurment are predicted out of  the bottom of the image bounderies";
CM_ SG_ 154 OBJ_Top_Out_Of_Image_V_33 "validator";
CM_ SG_ 154 OBJ_Bottom_Out_Of_Image_V_33 "validator";
CM_ SG_ 154 OBJ_Lane_Assignment_33 "The object's lane relative to the host lane.";
CM_ SG_ 154 OBJ_Lane_Assignment_V_33 "Validator for lane assignment";
CM_ SG_ 154 OBJ_Age_Seconds_33 "Time in seconds in which the object was recognized. ";
CM_ SG_ 154 OBJ_Age_Seconds_V_33 "Validator for object age";
CM_ SG_ 154 OBJ_Width_33 "The width of the target vehicle in the world (not to be mistaken with the width of the visible part of the vehicle).";
CM_ SG_ 154 OBJ_Width_V_33 "Validator for object width";
CM_ SG_ 154 OBJ_Width_STD_33 "Standard deviation for object width";
CM_ SG_ 154 OBJ_Width_STD_V_33 "Validator for the standard deviation of object width";
CM_ SG_ 154 OBJ_Length_33 "The length of the vehicle in the world. For crossing bicycles it gives the viewed length of the bicycle.";
CM_ SG_ 154 OBJ_Length_V_33 "Validator for object length.";
CM_ SG_ 154 OBJ_Length_STD_33 "Standard deviation for object length.";
CM_ SG_ 154 OBJ_Length_STD_V_33 "Validator for the standard deviation of object length.";
CM_ SG_ 154 OBJ_Radar_ID_33 "Radar Object ID of the Fused Object, Only relvant when OBJ_Fusion_Source is not Camera only";
CM_ SG_ 154 OBJ_Height_33 "The height of the object in the world. ";
CM_ SG_ 154 OBJ_Height_V_33 "Validator for object height.";
CM_ SG_ 154 OBJ_Height_STD_33 "Standard deviation for object height.";
CM_ SG_ 154 OBJ_Height_STD_V_33 "Validator for the standard deviation of object height.";
CM_ SG_ 154 OBJ_Abs_Long_Velocity_33 "Absolute longitudinal velocity.";
CM_ SG_ 154 OBJ_Abs_Long_Velocity_V_33 "Validator for absolute longitudinal velocity.";
CM_ SG_ 154 OBJ_Abs_Long_Velocity_STD_33 "Standard deviation of absolute longitudinal velocity.";
CM_ SG_ 154 OBJ_Abs_Long_Vel_STD_V_33 "Validator for the standard deviation of the absolute longitudinal velocity.";
CM_ SG_ 154 OBJ_Abs_Lat_Velocity_33 "The lateral ground speed of the object.";
CM_ SG_ 154 OBJ_Abs_Lat_Velocity_V_33 "Validator for the lateral ground speed of the object.";
CM_ SG_ 154 OBJ_Abs_Lat_Velocity_STD_33 "STD of the lateral ground speed of the object.";
CM_ SG_ 154 OBJ_Abs_Lat_Vel_STD_V_33 "Validator for the STD of the lateral ground speed of the object.";
CM_ SG_ 154 OBJ_Abs_Long_Acc_33 "The longitudinal ground acceleration of the object.";
CM_ SG_ 154 OBJ_Abs_Long_Acc_V_33 "Validator for the longitudinal ground acceleration of the object.";
CM_ SG_ 154 OBJ_Abs_Long_Acc_STD_33 "STD of the longitudinal ground acceleration of the object.";
CM_ SG_ 154 OBJ_Abs_Long_Acc_STD_V_33 "Validator for the STD of the longitudinal ground acceleration of the object.";
CM_ SG_ 154 OBJ_Abs_Lat_Acc_33 "The lateral ground acceleration of the object.";
CM_ SG_ 154 OBJ_Abs_Lat_Acc_V_33 "Validator for the lateral ground acceleration of the object.";
CM_ SG_ 154 OBJ_Abs_Lat_Acc_STD_33 "STD of the lateral ground acceleration of the object.";
CM_ SG_ 154 OBJ_Abs_Lat_Acc_STD_V_33 "Validator for the STD of the lateral ground acceleration of the object.";
CM_ SG_ 154 OBJ_Abs_Acceleration_33 "The absolute ground acceleration in the target's heading direction.";
CM_ SG_ 154 OBJ_Abs_Acceleration_V_33 "Validator for the absolute ground acceleration.";
CM_ SG_ 154 OBJ_Abs_Acc_STD_33 "STD of the absolute ground acceleration.";
CM_ SG_ 154 OBJ_Abs_Acc_STD_V_33 "Validator for the STD of the absolute ground acceleration.";
CM_ SG_ 154 OBJ_Inv_TTC_33 "Inverse TTC (time to collision).";
CM_ SG_ 154 OBJ_Inv_TTC_STD_33 "STD for inverse TTC .";
CM_ SG_ 154 OBJ_Inv_TTC_STD_V_33 "Validator for the STD for inverse TTC .";
CM_ SG_ 154 OBJ_Relative_Long_Acc_33 "The relative lateral ground acceleration of the object.";
CM_ SG_ 154 OBJ_Relative_Long_Acc_V_33 "Validator for the relative lateral ground acceleration of the object.";
CM_ SG_ 154 OBJ_Relative_Long_Acc_STD_33 "STD of the relative lateral ground acceleration of the object.";
CM_ SG_ 154 OBJ_Rel_Long_Acc_STD_V_33 "Validator for the STD of the relative lateral ground acceleration.";
CM_ SG_ 154 OBJ_Relative_Long_Velocity_33 "The relative longtitudinal speed between the target and ego vehicle. ";
CM_ SG_ 154 OBJ_Relative_Long_Velocity_V_33 "Validator for the relative longtitudinal speed.";
CM_ SG_ 154 OBJ_Relative_Long_Vel_STD_33 "STD of the relative longtitudinal speed.";
CM_ SG_ 154 OBJ_Rel_Long_Vel_STD_V_33 "Validator for the STD of the relative longtitudinal speed.";
CM_ SG_ 154 OBJ_Relative_Lat_Velocity_33 "The relative lateral speed between the target and ego vehicle. ";
CM_ SG_ 154 OBJ_Relative_Lat_Velocity_V_33 "Validator for the relative lateral speed. ";
CM_ SG_ 154 OBJ_Relative_Lat_Velocity_STD_33 "STD of the relative lateral speed. ";
CM_ SG_ 154 OBJ_Rel_Lat_Vel_STD_V_33 "Validator for the STD of the relative lateral speed. ";
CM_ SG_ 154 OBJ_Long_Distance_33 "The longitudinal distance to middle of the rear bumper (middle of the RL and RR corners) of the target.";
CM_ SG_ 154 OBJ_Long_Distance_V_33 "Validator of the longtitudinal distance field";
CM_ SG_ 154 OBJ_Long_Distance_STD_33 "STD of the  longtitudinal distance.";
CM_ SG_ 154 OBJ_Long_Distance_STD_V_33 "Validator for the STD of the  longtitudinal distance.";
CM_ SG_ 154 OBJ_Lat_Distance_33 "Lateral distance to the middle of the RL and RR corners.  ";
CM_ SG_ 154 OBJ_Lat_Distance_V_33 "Validator for the lateral distance of the object.";
CM_ SG_ 154 OBJ_Lat_Distance_STD_33 "STD of the lateral distance of the object.";
CM_ SG_ 154 OBJ_Lat_Distance_STD_V_33 "Validator for the STD of the lateral distance of the object.";
CM_ SG_ 154 OBJ_Absolute_Speed_33 "The absolute ground speed in the targets' heading direction.";
CM_ SG_ 154 OBJ_Absolute_Speed_V_33 "Validator for the absolute ground speed.";
CM_ SG_ 154 OBJ_Absolute_Speed_STD_33 "STD of the absolute ground speed.";
CM_ SG_ 154 OBJ_Absolute_Speed_STD_V_33 "Validator for the STD of the absolute ground speed.";
CM_ SG_ 154 OBJ_Heading_33 "The angle beetweenthe host longitudinal axis and target's heading (clockwise, e.g. PI/2 is a target crossing from left to right).";
CM_ SG_ 154 OBJ_Heading_V_33 "Validator for the object heading.";
CM_ SG_ 154 OBJ_Heading_STD_33 "STD of the object heading.";
CM_ SG_ 154 OBJ_Heading_STD_V_33 "Validator for the STD of the object heading.";
CM_ SG_ 154 OBJ_Angle_Rate_STD_33 "Standard deviation of the angular speed. (radians)";
CM_ SG_ 154 OBJ_Angle_Rate_STD_V_33 "Validator for the STD of the angular speed.";
CM_ SG_ 154 OBJ_Angle_Rate_33 "The momentary angular speed of the object. (radians)";
CM_ SG_ 154 OBJ_Angle_Rate_V_33 "Validator for the angular speed.";
CM_ SG_ 154 OBJ_Angle_Right_33 "The angle between the host longitudinal axis and the right side of the front / rear of the target (the visible one). The positive side is to the host's right.";
CM_ SG_ 154 OBJ_Angle_Right_V_33 "Validator for angleRight";
CM_ SG_ 154 OBJ_Angle_Right_STD_33 "Standard deviation of angleRight";
CM_ SG_ 154 OBJ_Angle_Right_STD_V_33 "Validator for the standard deviation of angleRight.";
CM_ SG_ 154 OBJ_Angle_Left_33 "The angle between the host longitudinal axis and the left side of the front / rear of the target (the visible one). The positive side is to the host's right.";
CM_ SG_ 154 OBJ_Angle_Left_V_33 "Validator for angleLeft.";
CM_ SG_ 154 OBJ_Angle_Left_STD_33 "Standard deviation of angleLeft.";
CM_ SG_ 154 OBJ_Angle_Left_STD_V_33 "Validator for the standard deviation of angleLeft.";
CM_ SG_ 154 OBJ_Angle_Side_33 "The angle between the host longitudinal axis and the far visible edge - the visible edge of the front / rear of the target that is not visible. Currently supported for vehicles only.";
CM_ SG_ 154 OBJ_Angle_Side_V_33 "Validator for angleSide.";
CM_ SG_ 154 OBJ_Angle_Side_STD_33 "Standard deviation of angleSide.";
CM_ SG_ 154 OBJ_Angle_Side_STD_V_33 "Validator for the STD of angleSide.";
CM_ SG_ 154 OBJ_Angle_Mid_V_33 "Validator for angleMid.";
CM_ SG_ 154 OBJ_Angle_Mid_33 "The angle between the host longitudinal axis and the middle of the front / rear of the target (the visible one). The positive side is to the host's right.";
CM_ SG_ 154 OBJ_Angle_Mid_STD_33 "Standard deviation of angleMid.";
CM_ SG_ 154 OBJ_Angle_Mid_STD_V_33 "Validator for the STD of angleMid.";
CM_ SG_ 154 OBJ_Angle_Bottom_V_33 "Validator for OBJAngle_Bottom. ";
CM_ SG_ 154 OBJ_Angle_Bottom_33 "The angle between the longitudinal axis and the Bottom of the front / rear of the target (the visible one). The positive side is to the host's bottom";
CM_ SG_ 154 OBJ_Angle_Bottom_STD_33 "STD for OBJAngle_Bottom. ";
CM_ SG_ 154 OBJ_Angle_Bottom_STD_V_33 "Validator for OBJAngle_Bottom_STD. ";
CM_ SG_ 154 OBJ_Visibility_Side_V_33 "Currently Supported for VD only";
CM_ SG_ 154 OBJ_Visibility_Side_33 "From what car  side is the object visible";
CM_ SG_ 154 OBJ_Is_In_Drivable_Area_33 "Indicates whether the target is in a driveable area.";
CM_ SG_ 154 OBJ_Is_In_Drivable_Area_V_33 "Validator for OBJ_Is_In_Drivable_Area.";
CM_ SG_ 154 OBJ_Is_VeryClose_V_33 "Validator for OBJ_Is_VeryClose. ";
CM_ SG_ 154 OBJ_Is_VeryClose_33 "Indicates whether the target is very close to the host such that it is hard to measure its distance. Currently relevant for peds only";
CM_ SG_ 154 OBJ_OverlapAngleEgoLaneR_33 "Lateral distance to the middle of the RL and RR corners.";
CM_ SG_ 154 OBJ_OverlapAngleEgoLaneR_V_33 "Validator for OBJ_OverlapAngleEgoLaneR";
CM_ SG_ 154 OBJ_OverlapAngleEgoLaneL_33 "Lateral distance to the middle of the RL and RR corners.  ";
CM_ SG_ 154 OBJ_OverlapAngleEgoLaneL_V_33 "Validator for OBJ_OverlapAngleEgoLaneL";
CM_ SG_ 154 OBJ_Is_EMERGENCY_VCL_33 "Is Object an Emergency Vehicle";
CM_ SG_ 154 OBJ_EMERGENCY_LIGHT_COLOR_33 "Emergency Color";
CM_ SG_ 154 OBJ_EMERGENCY_V_33 "Are OBJ_Is_EMERGENCY_VCL and OBJ_EMERGENCY_LIGHT_COLOR Valid";
CM_ SG_ 154 OBJ_Angle_Top_33 "From VD touching point on the ground till the roof of the car";
CM_ SG_ 154 OBJ_Angle_Top_V_33 "Validator for OBJ_Angle_Top ";
CM_ SG_ 154 OBJ_Angle_Top_STD_33 "STD for OBJ_Angle_Top";
CM_ SG_ 154 OBJ_Angle_Top_STD_V_33 "Validator for OBJ_Angle_Top_STD. ";
CM_ SG_ 154 OBJ_CRC_34 "Calculated over all element signals. From the signal after the CRC until the first signal in the next elements OBJ_CRC_N+1  not including";
CM_ SG_ 154 OBJ_ID_34 "The detected object ID. Range is 1-255, while 0 indicates that the field in unfilled.";
CM_ SG_ 154 OBJ_Existence_Probability_34 "The existence probability of the reported object";
CM_ SG_ 154 OBJ_Fusion_Source_34 "sources ids used for fusion";
CM_ SG_ 154 OBJ_Triggered_SDM_34 "Indicates whether the object has trigered the SDM (Safety Diagnostic Manager) alert.";
CM_ SG_ 154 OBJ_Motion_Category_34 "Relevant for VD only. Full description of values can be found at the ACC guide.";
CM_ SG_ 154 OBJ_Object_Age_34 "The number of frames in which the object was recognized.";
CM_ SG_ 154 OBJ_Measuring_Status_34 "Measurment status. Old vs New marks if this is the first frame in which the object is reported. Predicted vs Measured marks if the report is raw or has been predicted forward in time using the measured dynamics and ego motion.";
CM_ SG_ 154 OBJ_Object_Class_34 "Indicates the object type. Uncertain is outputted in case the probability that a vehicle is a truck is very similar to the probability that it is a car. ";
CM_ SG_ 154 OBJ_Class_Probability_34 "The probability of this type classification.";
CM_ SG_ 154 OBJ_Car_Probability_34 "The probability the object is a car";
CM_ SG_ 154 OBJ_Truck_Probability_34 "The probability the object is a Truck";
CM_ SG_ 154 OBJ_Bike_Probability_34 "The probability the object is a Bike";
CM_ SG_ 154 OBJ_Camera_Source_34 "The camera in which this object was detected (best choice).";
CM_ SG_ 154 OBJ_Motion_Status_34 "MOVING - the object is moving STATIONARY - the object was never seen moving STOPPED -  the object was moving and has stopped MOVING_SLOWLY - the object is moving very slowly";
CM_ SG_ 154 OBJ_Motion_Orientation_34 "The direction of the targets heading compared to the host. ";
CM_ SG_ 154 OBJ_Has_Cut_Lane_34 "Indicates whether the object cut the host's (right or left) lane. In case there are no lanes, indicates whether the objects is at most 1 meters away from the host.";
CM_ SG_ 154 OBJ_Has_Cut_Path_34 "Indicates whether the object is in the host's path.";
CM_ SG_ 154 OBJ_Brake_Light_34 "Indication for brake lights ";
CM_ SG_ 154 OBJ_Turn_Indicator_Right_34 "Indication for blinking right light.";
CM_ SG_ 154 OBJ_Turn_Indicator_Left_34 "Indication for blinking left light ";
CM_ SG_ 154 OBJ_Light_Indicator_Validity_34 "Validator for light indicators";
CM_ SG_ 154 OBJ_Right_Out_Of_Image_34 "Indicates whether the measurment are predicted out of the right side of the image bounderies.";
CM_ SG_ 154 OBJ_Left_Out_Of_Image_34 "Indicates whether if measurment are predicted out of  the left side of the image bounderies";
CM_ SG_ 154 OBJ_Right_Out_Of_Image_V_34 "validator";
CM_ SG_ 154 OBJ_Left_Out_Of_Image_V_34 "validator";
CM_ SG_ 154 OBJ_Top_Out_Of_Image_34 "Indicates whether if measurment are predicted out of  the top of the image bounderies";
CM_ SG_ 154 OBJ_Bottom_Out_Of_Image_34 "Indicates whether if measurment are predicted out of  the bottom of the image bounderies";
CM_ SG_ 154 OBJ_Top_Out_Of_Image_V_34 "validator";
CM_ SG_ 154 OBJ_Bottom_Out_Of_Image_V_34 "validator";
CM_ SG_ 154 OBJ_Lane_Assignment_34 "The object's lane relative to the host lane.";
CM_ SG_ 154 OBJ_Lane_Assignment_V_34 "Validator for lane assignment";
CM_ SG_ 154 OBJ_Age_Seconds_34 "Time in seconds in which the object was recognized. ";
CM_ SG_ 154 OBJ_Age_Seconds_V_34 "Validator for object age";
CM_ SG_ 154 OBJ_Width_34 "The width of the target vehicle in the world (not to be mistaken with the width of the visible part of the vehicle).";
CM_ SG_ 154 OBJ_Width_V_34 "Validator for object width";
CM_ SG_ 154 OBJ_Width_STD_34 "Standard deviation for object width";
CM_ SG_ 154 OBJ_Width_STD_V_34 "Validator for the standard deviation of object width";
CM_ SG_ 154 OBJ_Length_34 "The length of the vehicle in the world. For crossing bicycles it gives the viewed length of the bicycle.";
CM_ SG_ 154 OBJ_Length_V_34 "Validator for object length.";
CM_ SG_ 154 OBJ_Length_STD_34 "Standard deviation for object length.";
CM_ SG_ 154 OBJ_Length_STD_V_34 "Validator for the standard deviation of object length.";
CM_ SG_ 154 OBJ_Radar_ID_34 "Radar Object ID of the Fused Object, Only relvant when OBJ_Fusion_Source is not Camera only";
CM_ SG_ 154 OBJ_Height_34 "The height of the object in the world. ";
CM_ SG_ 154 OBJ_Height_V_34 "Validator for object height.";
CM_ SG_ 154 OBJ_Height_STD_34 "Standard deviation for object height.";
CM_ SG_ 154 OBJ_Height_STD_V_34 "Validator for the standard deviation of object height.";
CM_ SG_ 154 OBJ_Abs_Long_Velocity_34 "Absolute longitudinal velocity.";
CM_ SG_ 154 OBJ_Abs_Long_Velocity_V_34 "Validator for absolute longitudinal velocity.";
CM_ SG_ 154 OBJ_Abs_Long_Velocity_STD_34 "Standard deviation of absolute longitudinal velocity.";
CM_ SG_ 154 OBJ_Abs_Long_Vel_STD_V_34 "Validator for the standard deviation of the absolute longitudinal velocity.";
CM_ SG_ 154 OBJ_Abs_Lat_Velocity_34 "The lateral ground speed of the object.";
CM_ SG_ 154 OBJ_Abs_Lat_Velocity_V_34 "Validator for the lateral ground speed of the object.";
CM_ SG_ 154 OBJ_Abs_Lat_Velocity_STD_34 "STD of the lateral ground speed of the object.";
CM_ SG_ 154 OBJ_Abs_Lat_Vel_STD_V_34 "Validator for the STD of the lateral ground speed of the object.";
CM_ SG_ 154 OBJ_Abs_Long_Acc_34 "The longitudinal ground acceleration of the object.";
CM_ SG_ 154 OBJ_Abs_Long_Acc_V_34 "Validator for the longitudinal ground acceleration of the object.";
CM_ SG_ 154 OBJ_Abs_Long_Acc_STD_34 "STD of the longitudinal ground acceleration of the object.";
CM_ SG_ 154 OBJ_Abs_Long_Acc_STD_V_34 "Validator for the STD of the longitudinal ground acceleration of the object.";
CM_ SG_ 154 OBJ_Abs_Lat_Acc_34 "The lateral ground acceleration of the object.";
CM_ SG_ 154 OBJ_Abs_Lat_Acc_V_34 "Validator for the lateral ground acceleration of the object.";
CM_ SG_ 154 OBJ_Abs_Lat_Acc_STD_34 "STD of the lateral ground acceleration of the object.";
CM_ SG_ 154 OBJ_Abs_Lat_Acc_STD_V_34 "Validator for the STD of the lateral ground acceleration of the object.";
CM_ SG_ 154 OBJ_Abs_Acceleration_34 "The absolute ground acceleration in the target's heading direction.";
CM_ SG_ 154 OBJ_Abs_Acceleration_V_34 "Validator for the absolute ground acceleration.";
CM_ SG_ 154 OBJ_Abs_Acc_STD_34 "STD of the absolute ground acceleration.";
CM_ SG_ 154 OBJ_Abs_Acc_STD_V_34 "Validator for the STD of the absolute ground acceleration.";
CM_ SG_ 154 OBJ_Inv_TTC_34 "Inverse TTC (time to collision).";
CM_ SG_ 154 OBJ_Inv_TTC_STD_34 "STD for inverse TTC .";
CM_ SG_ 154 OBJ_Inv_TTC_STD_V_34 "Validator for the STD for inverse TTC .";
CM_ SG_ 154 OBJ_Relative_Long_Acc_34 "The relative lateral ground acceleration of the object.";
CM_ SG_ 154 OBJ_Relative_Long_Acc_V_34 "Validator for the relative lateral ground acceleration of the object.";
CM_ SG_ 154 OBJ_Relative_Long_Acc_STD_34 "STD of the relative lateral ground acceleration of the object.";
CM_ SG_ 154 OBJ_Rel_Long_Acc_STD_V_34 "Validator for the STD of the relative lateral ground acceleration.";
CM_ SG_ 154 OBJ_Relative_Long_Velocity_34 "The relative longtitudinal speed between the target and ego vehicle. ";
CM_ SG_ 154 OBJ_Relative_Long_Velocity_V_34 "Validator for the relative longtitudinal speed.";
CM_ SG_ 154 OBJ_Relative_Long_Vel_STD_34 "STD of the relative longtitudinal speed.";
CM_ SG_ 154 OBJ_Rel_Long_Vel_STD_V_34 "Validator for the STD of the relative longtitudinal speed.";
CM_ SG_ 154 OBJ_Relative_Lat_Velocity_34 "The relative lateral speed between the target and ego vehicle. ";
CM_ SG_ 154 OBJ_Relative_Lat_Velocity_V_34 "Validator for the relative lateral speed. ";
CM_ SG_ 154 OBJ_Relative_Lat_Velocity_STD_34 "STD of the relative lateral speed. ";
CM_ SG_ 154 OBJ_Rel_Lat_Vel_STD_V_34 "Validator for the STD of the relative lateral speed. ";
CM_ SG_ 154 OBJ_Long_Distance_34 "The longitudinal distance to middle of the rear bumper (middle of the RL and RR corners) of the target.";
CM_ SG_ 154 OBJ_Long_Distance_V_34 "Validator of the longtitudinal distance field";
CM_ SG_ 154 OBJ_Long_Distance_STD_34 "STD of the  longtitudinal distance.";
CM_ SG_ 154 OBJ_Long_Distance_STD_V_34 "Validator for the STD of the  longtitudinal distance.";
CM_ SG_ 154 OBJ_Lat_Distance_34 "Lateral distance to the middle of the RL and RR corners.  ";
CM_ SG_ 154 OBJ_Lat_Distance_V_34 "Validator for the lateral distance of the object.";
CM_ SG_ 154 OBJ_Lat_Distance_STD_34 "STD of the lateral distance of the object.";
CM_ SG_ 154 OBJ_Lat_Distance_STD_V_34 "Validator for the STD of the lateral distance of the object.";
CM_ SG_ 154 OBJ_Absolute_Speed_34 "The absolute ground speed in the targets' heading direction.";
CM_ SG_ 154 OBJ_Absolute_Speed_V_34 "Validator for the absolute ground speed.";
BA_DEF_ SG_  "GenSigStartValue" INT 0 0;
BA_DEF_DEF_  "GenSigStartValue" 0;
BA_ "GenSigStartValue" SG_ 154 OBJ_Width_29 40;
BA_ "GenSigStartValue" SG_ 154 OBJ_Length_29 24;
BA_ "GenSigStartValue" SG_ 154 OBJ_Width_30 40;
BA_ "GenSigStartValue" SG_ 154 OBJ_Length_30 24;
BA_ "GenSigStartValue" SG_ 154 OBJ_Width_31 40;
BA_ "GenSigStartValue" SG_ 154 OBJ_Length_31 24;
BA_ "GenSigStartValue" SG_ 154 OBJ_Width_32 40;
BA_ "GenSigStartValue" SG_ 154 OBJ_Length_32 24;
BA_ "GenSigStartValue" SG_ 154 OBJ_Width_33 40;
BA_ "GenSigStartValue" SG_ 154 OBJ_Length_33 24;
BA_ "GenSigStartValue" SG_ 154 OBJ_Width_34 40;
BA_ "GenSigStartValue" SG_ 154 OBJ_Length_34 24;
VAL_ 154 OBJ_Is_VeryClose_28 1 "TRUE" 0 "FALSE" ;
VAL_ 154 OBJ_OverlapAngleEgoLaneR_V_28 1 "VALID" 0 "INVALID" ;
VAL_ 154 OBJ_OverlapAngleEgoLaneL_V_28 1 "VALID" 0 "INVALID" ;
VAL_ 154 OBJ_Is_EMERGENCY_VCL_28 1 "TRUE" 0 "FALSE" ;
VAL_ 154 OBJ_EMERGENCY_LIGHT_COLOR_28 3 "(1000)ORANGE" 2 "(0100)BLUE" 1 "(0010)RED" 0 "(0001)OTHER" ;
VAL_ 154 OBJ_EMERGENCY_V_28 1 "TRUE" 0 "FALSE" ;
VAL_ 154 OBJ_Angle_Top_V_28 1 "VALID" 0 "INVALID" ;
VAL_ 154 OBJ_Angle_Top_STD_V_28 1 "VALID" 0 "INVALID" ;
VAL_ 154 OBJ_Fusion_Source_29 2 "(BIT_2)RADAR2" 1 "(BIT_1)RADAR1" 0 "(BIT_0)CAMERA" ;
VAL_ 154 OBJ_Triggered_SDM_29 2 "NOT_TRIGGERED" 1 "TRIGGERED" 0 "NOT_AVAILABLE" ;
VAL_ 154 OBJ_Motion_Category_29 13 "ONCOMING" 12 "PRECEEDING" 11 "MOVING" 10 "RTAP" 9 "LTAP" 8 "CROSSING" 7 "MOVING_OUT" 6 "MOVING_IN" 5 "CLOSE_CUT_IN" 4 "PASSING_OUT" 3 "PASSING_IN" 2 "PASSING" 1 "UNDEFINED" 0 "UNFILLED" ;
VAL_ 154 OBJ_Measuring_Status_29 2 "(BIT_2)NOT_VALID_OR_VALID" 1 "(BIT_1)PREDICTED_OR_MEASURED" 0 "(BIT_0)OLD_OR_NEW" ;
VAL_ 154 OBJ_Object_Class_29 8 "UNCERTAIN_VCL" 7 "ANIMAL" 6 "GENERAL_OBJECT" 5 "PEDESTRIAN" 4 "BICYCLE" 3 "MOTORBIKE" 2 "TRUCK" 1 "CAR" 0 "UNFILLED" ;
VAL_ 154 OBJ_Camera_Source_29 11 "PARKING_RIGHT" 10 "PARKING_LEFT" 9 "PARKING_REAR" 8 "PARKING_FRONT" 7 "FRONT_CORNER_RIGHT" 6 "FRONT_CORNER_LEFT" 5 "REAR_CORNER_RIGHT" 4 "REAR_CORNER_LEFT" 3 "REAR" 2 "FRONT_FISHEYE" 1 "FRONT_NARROW" 0 "FRONT_MAIN" ;
VAL_ 154 OBJ_Motion_Status_29 5 "MOVING_SLOWLY" 4 "STOPPED" 3 "STATIONARY" 2 "MOVING" 1 "UNKNOWN" 0 "INVALID" ;
VAL_ 154 OBJ_Motion_Orientation_29 13 "INVALID" 12 "NORTH" 11 "NORTH_WEST" 9 "WEST" 7 "SOUTH_WEST" 6 "SOUTH" 5 "SOUTH_EAST" 3 "EAST" 1 "NORTH_EAST" 0 "UNKNOWN" ;
VAL_ 154 OBJ_Has_Cut_Lane_29 1 "TRUE" 0 "FALSE" ;
VAL_ 154 OBJ_Has_Cut_Path_29 1 "TRUE" 0 "FALSE" ;
VAL_ 154 OBJ_Brake_Light_29 1 "TRUE" 0 "FALSE" ;
VAL_ 154 OBJ_Turn_Indicator_Right_29 1 "TRUE" 0 "FALSE" ;
VAL_ 154 OBJ_Turn_Indicator_Left_29 1 "TRUE" 0 "FALSE" ;
VAL_ 154 OBJ_Light_Indicator_Validity_29 1 "TRUE" 0 "FALSE" ;
VAL_ 154 OBJ_Right_Out_Of_Image_29 1 "TRUE" 0 "FALSE" ;
VAL_ 154 OBJ_Left_Out_Of_Image_29 1 "TRUE" 0 "FALSE" ;
VAL_ 154 OBJ_Right_Out_Of_Image_V_29 1 "TRUE" 0 "FALSE" ;
VAL_ 154 OBJ_Left_Out_Of_Image_V_29 1 "TRUE" 0 "FALSE" ;
VAL_ 154 OBJ_Top_Out_Of_Image_29 1 "TRUE" 0 "FALSE" ;
VAL_ 154 OBJ_Bottom_Out_Of_Image_29 1 "TRUE" 0 "FALSE" ;
VAL_ 154 OBJ_Top_Out_Of_Image_V_29 1 "VALID" 0 "INVALID" ;
VAL_ 154 OBJ_Bottom_Out_Of_Image_V_29 1 "VALID" 0 "INVALID" ;
VAL_ 154 OBJ_Lane_Assignment_29 5 "RIGHT_RIGHT" 4 "RIGHT" 3 "HOST" 2 "LEFT" 1 "LEFT_LEFT" 0 "UNKNOWN" ;
VAL_ 154 OBJ_Lane_Assignment_V_29 1 "VALID" 0 "INVALID" ;
VAL_ 154 OBJ_Age_Seconds_V_29 1 "VALID" 0 "INVALID" ;
VAL_ 154 OBJ_Width_V_29 1 "VALID" 0 "INVALID" ;
VAL_ 154 OBJ_Width_STD_V_29 1 "VALID" 0 "INVALID" ;
VAL_ 154 OBJ_Length_V_29 1 "VALID" 0 "INVALID" ;
VAL_ 154 OBJ_Length_STD_V_29 1 "VALID" 0 "INVALID" ;
VAL_ 154 OBJ_Height_V_29 1 "VALID" 0 "INVALID" ;
VAL_ 154 OBJ_Height_STD_V_29 1 "VALID" 0 "INVALID" ;
VAL_ 154 OBJ_Abs_Long_Velocity_V_29 1 "VALID" 0 "INVALID" ;
VAL_ 154 OBJ_Abs_Long_Vel_STD_V_29 1 "VALID" 0 "INVALID" ;
VAL_ 154 OBJ_Abs_Lat_Velocity_V_29 1 "VALID" 0 "INVALID" ;
VAL_ 154 OBJ_Abs_Lat_Vel_STD_V_29 1 "VALID" 0 "INVALID" ;
VAL_ 154 OBJ_Abs_Long_Acc_V_29 1 "VALID" 0 "INVALID" ;
VAL_ 154 OBJ_Abs_Long_Acc_STD_V_29 1 "VALID" 0 "INVALID" ;
VAL_ 154 OBJ_Abs_Lat_Acc_V_29 1 "VALID" 0 "INVALID" ;
VAL_ 154 OBJ_Abs_Lat_Acc_STD_V_29 1 "VALID" 0 "INVALID" ;
VAL_ 154 OBJ_Abs_Acceleration_V_29 1 "VALID" 0 "INVALID" ;
VAL_ 154 OBJ_Abs_Acc_STD_V_29 1 "VALID" 0 "INVALID" ;
VAL_ 154 OBJ_Inv_TTC_V_29 1 "VALID" 0 "INVALID" ;
VAL_ 154 OBJ_Inv_TTC_STD_V_29 1 "VALID" 0 "INVALID" ;
VAL_ 154 OBJ_Relative_Long_Acc_V_29 1 "VALID" 0 "INVALID" ;
VAL_ 154 OBJ_Rel_Long_Acc_STD_V_29 1 "VALID" 0 "INVALID" ;
VAL_ 154 OBJ_Relative_Long_Velocity_V_29 1 "VALID" 0 "INVALID" ;
VAL_ 154 OBJ_Rel_Long_Vel_STD_V_29 1 "VALID" 0 "INVALID" ;
VAL_ 154 OBJ_Relative_Lat_Velocity_V_29 1 "VALID" 0 "INVALID" ;
VAL_ 154 OBJ_Rel_Lat_Vel_STD_V_29 1 "VALID" 0 "INVALID" ;
VAL_ 154 OBJ_Long_Distance_V_29 1 "VALID" 0 "INVALID" ;
VAL_ 154 OBJ_Long_Distance_STD_V_29 1 "VALID" 0 "INVALID" ;
VAL_ 154 OBJ_Lat_Distance_V_29 1 "VALID" 0 "INVALID" ;
VAL_ 154 OBJ_Lat_Distance_STD_V_29 1 "VALID" 0 "INVALID" ;
VAL_ 154 OBJ_Absolute_Speed_V_29 1 "VALID" 0 "INVALID" ;
VAL_ 154 OBJ_Absolute_Speed_STD_V_29 1 "VALID" 0 "INVALID" ;
VAL_ 154 OBJ_Heading_V_29 1 "VALID" 0 "INVALID" ;
VAL_ 154 OBJ_Heading_STD_V_29 1 "VALID" 0 "INVALID" ;
VAL_ 154 OBJ_Angle_Rate_STD_V_29 1 "VALID" 0 "INVALID" ;
VAL_ 154 OBJ_Angle_Rate_V_29 1 "VALID" 0 "INVALID" ;
VAL_ 154 OBJ_Angle_Right_V_29 1 "VALID" 0 "INVALID" ;
VAL_ 154 OBJ_Angle_Right_STD_V_29 1 "VALID" 0 "INVALID" ;
VAL_ 154 OBJ_Angle_Left_V_29 1 "VALID" 0 "INVALID" ;
VAL_ 154 OBJ_Angle_Left_STD_V_29 1 "VALID" 0 "INVALID" ;
VAL_ 154 OBJ_Angle_Side_V_29 1 "VALID" 0 "INVALID" ;
VAL_ 154 OBJ_Angle_Side_STD_V_29 1 "VALID" 0 "INVALID" ;
VAL_ 154 OBJ_Angle_Mid_V_29 1 "VALID" 0 "INVALID" ;
VAL_ 154 OBJ_Angle_Mid_STD_V_29 1 "VALID" 0 "INVALID" ;
VAL_ 154 OBJ_Angle_Bottom_V_29 1 "VALID" 0 "INVALID" ;
VAL_ 154 OBJ_Angle_Bottom_STD_V_29 1 "VALID" 0 "INVALID" ;
VAL_ 154 OBJ_Visibility_Side_V_29 1 "VALID" 0 "INVALID" ;
VAL_ 154 OBJ_Visibility_Side_29 2 "REAR" 1 "FRONT" 0 "NOT_VISIBLE" ;
VAL_ 154 OBJ_Is_In_Drivable_Area_29 1 "TRUE" 0 "FALSE" ;
VAL_ 154 OBJ_Is_In_Drivable_Area_V_29 1 "VALID" 0 "INVALID" ;
VAL_ 154 OBJ_Is_VeryClose_V_29 1 "VALID" 0 "INVALID" ;
VAL_ 154 OBJ_Is_VeryClose_29 1 "TRUE" 0 "FALSE" ;
VAL_ 154 OBJ_OverlapAngleEgoLaneR_V_29 1 "VALID" 0 "INVALID" ;
VAL_ 154 OBJ_OverlapAngleEgoLaneL_V_29 1 "VALID" 0 "INVALID" ;
VAL_ 154 OBJ_Is_EMERGENCY_VCL_29 1 "TRUE" 0 "FALSE" ;
VAL_ 154 OBJ_EMERGENCY_LIGHT_COLOR_29 3 "(1000)ORANGE" 2 "(0100)BLUE" 1 "(0010)RED" 0 "(0001)OTHER" ;
VAL_ 154 OBJ_EMERGENCY_V_29 1 "TRUE" 0 "FALSE" ;
VAL_ 154 OBJ_Angle_Top_V_29 1 "VALID" 0 "INVALID" ;
VAL_ 154 OBJ_Angle_Top_STD_V_29 1 "VALID" 0 "INVALID" ;
VAL_ 154 OBJ_Fusion_Source_30 2 "(BIT_2)RADAR2" 1 "(BIT_1)RADAR1" 0 "(BIT_0)CAMERA" ;
VAL_ 154 OBJ_Triggered_SDM_30 2 "NOT_TRIGGERED" 1 "TRIGGERED" 0 "NOT_AVAILABLE" ;
VAL_ 154 OBJ_Motion_Category_30 13 "ONCOMING" 12 "PRECEEDING" 11 "MOVING" 10 "RTAP" 9 "LTAP" 8 "CROSSING" 7 "MOVING_OUT" 6 "MOVING_IN" 5 "CLOSE_CUT_IN" 4 "PASSING_OUT" 3 "PASSING_IN" 2 "PASSING" 1 "UNDEFINED" 0 "UNFILLED" ;
VAL_ 154 OBJ_Measuring_Status_30 2 "(BIT_2)NOT_VALID_OR_VALID" 1 "(BIT_1)PREDICTED_OR_MEASURED" 0 "(BIT_0)OLD_OR_NEW" ;
VAL_ 154 OBJ_Object_Class_30 8 "UNCERTAIN_VCL" 7 "ANIMAL" 6 "GENERAL_OBJECT" 5 "PEDESTRIAN" 4 "BICYCLE" 3 "MOTORBIKE" 2 "TRUCK" 1 "CAR" 0 "UNFILLED" ;
VAL_ 154 OBJ_Camera_Source_30 11 "PARKING_RIGHT" 10 "PARKING_LEFT" 9 "PARKING_REAR" 8 "PARKING_FRONT" 7 "FRONT_CORNER_RIGHT" 6 "FRONT_CORNER_LEFT" 5 "REAR_CORNER_RIGHT" 4 "REAR_CORNER_LEFT" 3 "REAR" 2 "FRONT_FISHEYE" 1 "FRONT_NARROW" 0 "FRONT_MAIN" ;
VAL_ 154 OBJ_Motion_Status_30 5 "MOVING_SLOWLY" 4 "STOPPED" 3 "STATIONARY" 2 "MOVING" 1 "UNKNOWN" 0 "INVALID" ;
VAL_ 154 OBJ_Motion_Orientation_30 13 "INVALID" 12 "NORTH" 11 "NORTH_WEST" 9 "WEST" 7 "SOUTH_WEST" 6 "SOUTH" 5 "SOUTH_EAST" 3 "EAST" 1 "NORTH_EAST" 0 "UNKNOWN" ;
VAL_ 154 OBJ_Has_Cut_Lane_30 1 "TRUE" 0 "FALSE" ;
VAL_ 154 OBJ_Has_Cut_Path_30 1 "TRUE" 0 "FALSE" ;
VAL_ 154 OBJ_Brake_Light_30 1 "TRUE" 0 "FALSE" ;
VAL_ 154 OBJ_Turn_Indicator_Right_30 1 "TRUE" 0 "FALSE" ;
VAL_ 154 OBJ_Turn_Indicator_Left_30 1 "TRUE" 0 "FALSE" ;
VAL_ 154 OBJ_Light_Indicator_Validity_30 1 "TRUE" 0 "FALSE" ;
VAL_ 154 OBJ_Right_Out_Of_Image_30 1 "TRUE" 0 "FALSE" ;
VAL_ 154 OBJ_Left_Out_Of_Image_30 1 "TRUE" 0 "FALSE" ;
VAL_ 154 OBJ_Right_Out_Of_Image_V_30 1 "TRUE" 0 "FALSE" ;
VAL_ 154 OBJ_Left_Out_Of_Image_V_30 1 "TRUE" 0 "FALSE" ;
VAL_ 154 OBJ_Top_Out_Of_Image_30 1 "TRUE" 0 "FALSE" ;
VAL_ 154 OBJ_Bottom_Out_Of_Image_30 1 "TRUE" 0 "FALSE" ;
VAL_ 154 OBJ_Top_Out_Of_Image_V_30 1 "VALID" 0 "INVALID" ;
VAL_ 154 OBJ_Bottom_Out_Of_Image_V_30 1 "VALID" 0 "INVALID" ;
VAL_ 154 OBJ_Lane_Assignment_30 5 "RIGHT_RIGHT" 4 "RIGHT" 3 "HOST" 2 "LEFT" 1 "LEFT_LEFT" 0 "UNKNOWN" ;
VAL_ 154 OBJ_Lane_Assignment_V_30 1 "VALID" 0 "INVALID" ;
VAL_ 154 OBJ_Age_Seconds_V_30 1 "VALID" 0 "INVALID" ;
VAL_ 154 OBJ_Width_V_30 1 "VALID" 0 "INVALID" ;
VAL_ 154 OBJ_Width_STD_V_30 1 "VALID" 0 "INVALID" ;
VAL_ 154 OBJ_Length_V_30 1 "VALID" 0 "INVALID" ;
VAL_ 154 OBJ_Length_STD_V_30 1 "VALID" 0 "INVALID" ;
VAL_ 154 OBJ_Height_V_30 1 "VALID" 0 "INVALID" ;
VAL_ 154 OBJ_Height_STD_V_30 1 "VALID" 0 "INVALID" ;
VAL_ 154 OBJ_Abs_Long_Velocity_V_30 1 "VALID" 0 "INVALID" ;
VAL_ 154 OBJ_Abs_Long_Vel_STD_V_30 1 "VALID" 0 "INVALID" ;
VAL_ 154 OBJ_Abs_Lat_Velocity_V_30 1 "VALID" 0 "INVALID" ;
VAL_ 154 OBJ_Abs_Lat_Vel_STD_V_30 1 "VALID" 0 "INVALID" ;
VAL_ 154 OBJ_Abs_Long_Acc_V_30 1 "VALID" 0 "INVALID" ;
VAL_ 154 OBJ_Abs_Long_Acc_STD_V_30 1 "VALID" 0 "INVALID" ;
VAL_ 154 OBJ_Abs_Lat_Acc_V_30 1 "VALID" 0 "INVALID" ;
VAL_ 154 OBJ_Abs_Lat_Acc_STD_V_30 1 "VALID" 0 "INVALID" ;
VAL_ 154 OBJ_Abs_Acceleration_V_30 1 "VALID" 0 "INVALID" ;
VAL_ 154 OBJ_Abs_Acc_STD_V_30 1 "VALID" 0 "INVALID" ;
VAL_ 154 OBJ_Inv_TTC_V_30 1 "VALID" 0 "INVALID" ;
VAL_ 154 OBJ_Inv_TTC_STD_V_30 1 "VALID" 0 "INVALID" ;
VAL_ 154 OBJ_Relative_Long_Acc_V_30 1 "VALID" 0 "INVALID" ;
VAL_ 154 OBJ_Rel_Long_Acc_STD_V_30 1 "VALID" 0 "INVALID" ;
VAL_ 154 OBJ_Relative_Long_Velocity_V_30 1 "VALID" 0 "INVALID" ;
VAL_ 154 OBJ_Rel_Long_Vel_STD_V_30 1 "VALID" 0 "INVALID" ;
VAL_ 154 OBJ_Relative_Lat_Velocity_V_30 1 "VALID" 0 "INVALID" ;
VAL_ 154 OBJ_Rel_Lat_Vel_STD_V_30 1 "VALID" 0 "INVALID" ;
VAL_ 154 OBJ_Long_Distance_V_30 1 "VALID" 0 "INVALID" ;
VAL_ 154 OBJ_Long_Distance_STD_V_30 1 "VALID" 0 "INVALID" ;
VAL_ 154 OBJ_Lat_Distance_V_30 1 "VALID" 0 "INVALID" ;
VAL_ 154 OBJ_Lat_Distance_STD_V_30 1 "VALID" 0 "INVALID" ;
VAL_ 154 OBJ_Absolute_Speed_V_30 1 "VALID" 0 "INVALID" ;
VAL_ 154 OBJ_Absolute_Speed_STD_V_30 1 "VALID" 0 "INVALID" ;
VAL_ 154 OBJ_Heading_V_30 1 "VALID" 0 "INVALID" ;
VAL_ 154 OBJ_Heading_STD_V_30 1 "VALID" 0 "INVALID" ;
VAL_ 154 OBJ_Angle_Rate_STD_V_30 1 "VALID" 0 "INVALID" ;
VAL_ 154 OBJ_Angle_Rate_V_30 1 "VALID" 0 "INVALID" ;
VAL_ 154 OBJ_Angle_Right_V_30 1 "VALID" 0 "INVALID" ;
VAL_ 154 OBJ_Angle_Right_STD_V_30 1 "VALID" 0 "INVALID" ;
VAL_ 154 OBJ_Angle_Left_V_30 1 "VALID" 0 "INVALID" ;
VAL_ 154 OBJ_Angle_Left_STD_V_30 1 "VALID" 0 "INVALID" ;
VAL_ 154 OBJ_Angle_Side_V_30 1 "VALID" 0 "INVALID" ;
VAL_ 154 OBJ_Angle_Side_STD_V_30 1 "VALID" 0 "INVALID" ;
VAL_ 154 OBJ_Angle_Mid_V_30 1 "VALID" 0 "INVALID" ;
VAL_ 154 OBJ_Angle_Mid_STD_V_30 1 "VALID" 0 "INVALID" ;
VAL_ 154 OBJ_Angle_Bottom_V_30 1 "VALID" 0 "INVALID" ;
VAL_ 154 OBJ_Angle_Bottom_STD_V_30 1 "VALID" 0 "INVALID" ;
VAL_ 154 OBJ_Visibility_Side_V_30 1 "VALID" 0 "INVALID" ;
VAL_ 154 OBJ_Visibility_Side_30 2 "REAR" 1 "FRONT" 0 "NOT_VISIBLE" ;
VAL_ 154 OBJ_Is_In_Drivable_Area_30 1 "TRUE" 0 "FALSE" ;
VAL_ 154 OBJ_Is_In_Drivable_Area_V_30 1 "VALID" 0 "INVALID" ;
VAL_ 154 OBJ_Is_VeryClose_V_30 1 "VALID" 0 "INVALID" ;
VAL_ 154 OBJ_Is_VeryClose_30 1 "TRUE" 0 "FALSE" ;
VAL_ 154 OBJ_OverlapAngleEgoLaneR_V_30 1 "VALID" 0 "INVALID" ;
VAL_ 154 OBJ_OverlapAngleEgoLaneL_V_30 1 "VALID" 0 "INVALID" ;
VAL_ 154 OBJ_Is_EMERGENCY_VCL_30 1 "TRUE" 0 "FALSE" ;
VAL_ 154 OBJ_EMERGENCY_LIGHT_COLOR_30 3 "(1000)ORANGE" 2 "(0100)BLUE" 1 "(0010)RED" 0 "(0001)OTHER" ;
VAL_ 154 OBJ_EMERGENCY_V_30 1 "TRUE" 0 "FALSE" ;
VAL_ 154 OBJ_Angle_Top_V_30 1 "VALID" 0 "INVALID" ;
VAL_ 154 OBJ_Angle_Top_STD_V_30 1 "VALID" 0 "INVALID" ;
VAL_ 154 OBJ_Fusion_Source_31 2 "(BIT_2)RADAR2" 1 "(BIT_1)RADAR1" 0 "(BIT_0)CAMERA" ;
VAL_ 154 OBJ_Triggered_SDM_31 2 "NOT_TRIGGERED" 1 "TRIGGERED" 0 "NOT_AVAILABLE" ;
VAL_ 154 OBJ_Motion_Category_31 13 "ONCOMING" 12 "PRECEEDING" 11 "MOVING" 10 "RTAP" 9 "LTAP" 8 "CROSSING" 7 "MOVING_OUT" 6 "MOVING_IN" 5 "CLOSE_CUT_IN" 4 "PASSING_OUT" 3 "PASSING_IN" 2 "PASSING" 1 "UNDEFINED" 0 "UNFILLED" ;
VAL_ 154 OBJ_Measuring_Status_31 2 "(BIT_2)NOT_VALID_OR_VALID" 1 "(BIT_1)PREDICTED_OR_MEASURED" 0 "(BIT_0)OLD_OR_NEW" ;
VAL_ 154 OBJ_Object_Class_31 8 "UNCERTAIN_VCL" 7 "ANIMAL" 6 "GENERAL_OBJECT" 5 "PEDESTRIAN" 4 "BICYCLE" 3 "MOTORBIKE" 2 "TRUCK" 1 "CAR" 0 "UNFILLED" ;
VAL_ 154 OBJ_Camera_Source_31 11 "PARKING_RIGHT" 10 "PARKING_LEFT" 9 "PARKING_REAR" 8 "PARKING_FRONT" 7 "FRONT_CORNER_RIGHT" 6 "FRONT_CORNER_LEFT" 5 "REAR_CORNER_RIGHT" 4 "REAR_CORNER_LEFT" 3 "REAR" 2 "FRONT_FISHEYE" 1 "FRONT_NARROW" 0 "FRONT_MAIN" ;
VAL_ 154 OBJ_Motion_Status_31 5 "MOVING_SLOWLY" 4 "STOPPED" 3 "STATIONARY" 2 "MOVING" 1 "UNKNOWN" 0 "INVALID" ;
VAL_ 154 OBJ_Motion_Orientation_31 13 "INVALID" 12 "NORTH" 11 "NORTH_WEST" 9 "WEST" 7 "SOUTH_WEST" 6 "SOUTH" 5 "SOUTH_EAST" 3 "EAST" 1 "NORTH_EAST" 0 "UNKNOWN" ;
VAL_ 154 OBJ_Has_Cut_Lane_31 1 "TRUE" 0 "FALSE" ;
VAL_ 154 OBJ_Has_Cut_Path_31 1 "TRUE" 0 "FALSE" ;
VAL_ 154 OBJ_Brake_Light_31 1 "TRUE" 0 "FALSE" ;
VAL_ 154 OBJ_Turn_Indicator_Right_31 1 "TRUE" 0 "FALSE" ;
VAL_ 154 OBJ_Turn_Indicator_Left_31 1 "TRUE" 0 "FALSE" ;
VAL_ 154 OBJ_Light_Indicator_Validity_31 1 "TRUE" 0 "FALSE" ;
VAL_ 154 OBJ_Right_Out_Of_Image_31 1 "TRUE" 0 "FALSE" ;
VAL_ 154 OBJ_Left_Out_Of_Image_31 1 "TRUE" 0 "FALSE" ;
VAL_ 154 OBJ_Right_Out_Of_Image_V_31 1 "TRUE" 0 "FALSE" ;
VAL_ 154 OBJ_Left_Out_Of_Image_V_31 1 "TRUE" 0 "FALSE" ;
VAL_ 154 OBJ_Top_Out_Of_Image_31 1 "TRUE" 0 "FALSE" ;
VAL_ 154 OBJ_Bottom_Out_Of_Image_31 1 "TRUE" 0 "FALSE" ;
VAL_ 154 OBJ_Top_Out_Of_Image_V_31 1 "VALID" 0 "INVALID" ;
VAL_ 154 OBJ_Bottom_Out_Of_Image_V_31 1 "VALID" 0 "INVALID" ;
VAL_ 154 OBJ_Lane_Assignment_31 5 "RIGHT_RIGHT" 4 "RIGHT" 3 "HOST" 2 "LEFT" 1 "LEFT_LEFT" 0 "UNKNOWN" ;
VAL_ 154 OBJ_Lane_Assignment_V_31 1 "VALID" 0 "INVALID" ;
VAL_ 154 OBJ_Age_Seconds_V_31 1 "VALID" 0 "INVALID" ;
VAL_ 154 OBJ_Width_V_31 1 "VALID" 0 "INVALID" ;
VAL_ 154 OBJ_Width_STD_V_31 1 "VALID" 0 "INVALID" ;
VAL_ 154 OBJ_Length_V_31 1 "VALID" 0 "INVALID" ;
VAL_ 154 OBJ_Length_STD_V_31 1 "VALID" 0 "INVALID" ;
VAL_ 154 OBJ_Height_V_31 1 "VALID" 0 "INVALID" ;
VAL_ 154 OBJ_Height_STD_V_31 1 "VALID" 0 "INVALID" ;
VAL_ 154 OBJ_Abs_Long_Velocity_V_31 1 "VALID" 0 "INVALID" ;
VAL_ 154 OBJ_Abs_Long_Vel_STD_V_31 1 "VALID" 0 "INVALID" ;
VAL_ 154 OBJ_Abs_Lat_Velocity_V_31 1 "VALID" 0 "INVALID" ;
VAL_ 154 OBJ_Abs_Lat_Vel_STD_V_31 1 "VALID" 0 "INVALID" ;
VAL_ 154 OBJ_Abs_Long_Acc_V_31 1 "VALID" 0 "INVALID" ;
VAL_ 154 OBJ_Abs_Long_Acc_STD_V_31 1 "VALID" 0 "INVALID" ;
VAL_ 154 OBJ_Abs_Lat_Acc_V_31 1 "VALID" 0 "INVALID" ;
VAL_ 154 OBJ_Abs_Lat_Acc_STD_V_31 1 "VALID" 0 "INVALID" ;
VAL_ 154 OBJ_Abs_Acceleration_V_31 1 "VALID" 0 "INVALID" ;
VAL_ 154 OBJ_Abs_Acc_STD_V_31 1 "VALID" 0 "INVALID" ;
VAL_ 154 OBJ_Inv_TTC_V_31 1 "VALID" 0 "INVALID" ;
VAL_ 154 OBJ_Inv_TTC_STD_V_31 1 "VALID" 0 "INVALID" ;
VAL_ 154 OBJ_Relative_Long_Acc_V_31 1 "VALID" 0 "INVALID" ;
VAL_ 154 OBJ_Rel_Long_Acc_STD_V_31 1 "VALID" 0 "INVALID" ;
VAL_ 154 OBJ_Relative_Long_Velocity_V_31 1 "VALID" 0 "INVALID" ;
VAL_ 154 OBJ_Rel_Long_Vel_STD_V_31 1 "VALID" 0 "INVALID" ;
VAL_ 154 OBJ_Relative_Lat_Velocity_V_31 1 "VALID" 0 "INVALID" ;
VAL_ 154 OBJ_Rel_Lat_Vel_STD_V_31 1 "VALID" 0 "INVALID" ;
VAL_ 154 OBJ_Long_Distance_V_31 1 "VALID" 0 "INVALID" ;
VAL_ 154 OBJ_Long_Distance_STD_V_31 1 "VALID" 0 "INVALID" ;
VAL_ 154 OBJ_Lat_Distance_V_31 1 "VALID" 0 "INVALID" ;
VAL_ 154 OBJ_Lat_Distance_STD_V_31 1 "VALID" 0 "INVALID" ;
VAL_ 154 OBJ_Absolute_Speed_V_31 1 "VALID" 0 "INVALID" ;
VAL_ 154 OBJ_Absolute_Speed_STD_V_31 1 "VALID" 0 "INVALID" ;
VAL_ 154 OBJ_Heading_V_31 1 "VALID" 0 "INVALID" ;
VAL_ 154 OBJ_Heading_STD_V_31 1 "VALID" 0 "INVALID" ;
VAL_ 154 OBJ_Angle_Rate_STD_V_31 1 "VALID" 0 "INVALID" ;
VAL_ 154 OBJ_Angle_Rate_V_31 1 "VALID" 0 "INVALID" ;
VAL_ 154 OBJ_Angle_Right_V_31 1 "VALID" 0 "INVALID" ;
VAL_ 154 OBJ_Angle_Right_STD_V_31 1 "VALID" 0 "INVALID" ;
VAL_ 154 OBJ_Angle_Left_V_31 1 "VALID" 0 "INVALID" ;
VAL_ 154 OBJ_Angle_Left_STD_V_31 1 "VALID" 0 "INVALID" ;
VAL_ 154 OBJ_Angle_Side_V_31 1 "VALID" 0 "INVALID" ;
VAL_ 154 OBJ_Angle_Side_STD_V_31 1 "VALID" 0 "INVALID" ;
VAL_ 154 OBJ_Angle_Mid_V_31 1 "VALID" 0 "INVALID" ;
VAL_ 154 OBJ_Angle_Mid_STD_V_31 1 "VALID" 0 "INVALID" ;
VAL_ 154 OBJ_Angle_Bottom_V_31 1 "VALID" 0 "INVALID" ;
VAL_ 154 OBJ_Angle_Bottom_STD_V_31 1 "VALID" 0 "INVALID" ;
VAL_ 154 OBJ_Visibility_Side_V_31 1 "VALID" 0 "INVALID" ;
VAL_ 154 OBJ_Visibility_Side_31 2 "REAR" 1 "FRONT" 0 "NOT_VISIBLE" ;
VAL_ 154 OBJ_Is_In_Drivable_Area_31 1 "TRUE" 0 "FALSE" ;
VAL_ 154 OBJ_Is_In_Drivable_Area_V_31 1 "VALID" 0 "INVALID" ;
VAL_ 154 OBJ_Is_VeryClose_V_31 1 "VALID" 0 "INVALID" ;
VAL_ 154 OBJ_Is_VeryClose_31 1 "TRUE" 0 "FALSE" ;
VAL_ 154 OBJ_OverlapAngleEgoLaneR_V_31 1 "VALID" 0 "INVALID" ;
VAL_ 154 OBJ_OverlapAngleEgoLaneL_V_31 1 "VALID" 0 "INVALID" ;
VAL_ 154 OBJ_Is_EMERGENCY_VCL_31 1 "TRUE" 0 "FALSE" ;
VAL_ 154 OBJ_EMERGENCY_LIGHT_COLOR_31 3 "(1000)ORANGE" 2 "(0100)BLUE" 1 "(0010)RED" 0 "(0001)OTHER" ;
VAL_ 154 OBJ_EMERGENCY_V_31 1 "TRUE" 0 "FALSE" ;
VAL_ 154 OBJ_Angle_Top_V_31 1 "VALID" 0 "INVALID" ;
VAL_ 154 OBJ_Angle_Top_STD_V_31 1 "VALID" 0 "INVALID" ;
VAL_ 154 OBJ_Fusion_Source_32 2 "(BIT_2)RADAR2" 1 "(BIT_1)RADAR1" 0 "(BIT_0)CAMERA" ;
VAL_ 154 OBJ_Triggered_SDM_32 2 "NOT_TRIGGERED" 1 "TRIGGERED" 0 "NOT_AVAILABLE" ;
VAL_ 154 OBJ_Motion_Category_32 13 "ONCOMING" 12 "PRECEEDING" 11 "MOVING" 10 "RTAP" 9 "LTAP" 8 "CROSSING" 7 "MOVING_OUT" 6 "MOVING_IN" 5 "CLOSE_CUT_IN" 4 "PASSING_OUT" 3 "PASSING_IN" 2 "PASSING" 1 "UNDEFINED" 0 "UNFILLED" ;
VAL_ 154 OBJ_Measuring_Status_32 2 "(BIT_2)NOT_VALID_OR_VALID" 1 "(BIT_1)PREDICTED_OR_MEASURED" 0 "(BIT_0)OLD_OR_NEW" ;
VAL_ 154 OBJ_Object_Class_32 8 "UNCERTAIN_VCL" 7 "ANIMAL" 6 "GENERAL_OBJECT" 5 "PEDESTRIAN" 4 "BICYCLE" 3 "MOTORBIKE" 2 "TRUCK" 1 "CAR" 0 "UNFILLED" ;
VAL_ 154 OBJ_Camera_Source_32 11 "PARKING_RIGHT" 10 "PARKING_LEFT" 9 "PARKING_REAR" 8 "PARKING_FRONT" 7 "FRONT_CORNER_RIGHT" 6 "FRONT_CORNER_LEFT" 5 "REAR_CORNER_RIGHT" 4 "REAR_CORNER_LEFT" 3 "REAR" 2 "FRONT_FISHEYE" 1 "FRONT_NARROW" 0 "FRONT_MAIN" ;
VAL_ 154 OBJ_Motion_Status_32 5 "MOVING_SLOWLY" 4 "STOPPED" 3 "STATIONARY" 2 "MOVING" 1 "UNKNOWN" 0 "INVALID" ;
VAL_ 154 OBJ_Motion_Orientation_32 13 "INVALID" 12 "NORTH" 11 "NORTH_WEST" 9 "WEST" 7 "SOUTH_WEST" 6 "SOUTH" 5 "SOUTH_EAST" 3 "EAST" 1 "NORTH_EAST" 0 "UNKNOWN" ;
VAL_ 154 OBJ_Has_Cut_Lane_32 1 "TRUE" 0 "FALSE" ;
VAL_ 154 OBJ_Has_Cut_Path_32 1 "TRUE" 0 "FALSE" ;
VAL_ 154 OBJ_Brake_Light_32 1 "TRUE" 0 "FALSE" ;
VAL_ 154 OBJ_Turn_Indicator_Right_32 1 "TRUE" 0 "FALSE" ;
VAL_ 154 OBJ_Turn_Indicator_Left_32 1 "TRUE" 0 "FALSE" ;
VAL_ 154 OBJ_Light_Indicator_Validity_32 1 "TRUE" 0 "FALSE" ;
VAL_ 154 OBJ_Right_Out_Of_Image_32 1 "TRUE" 0 "FALSE" ;
VAL_ 154 OBJ_Left_Out_Of_Image_32 1 "TRUE" 0 "FALSE" ;
VAL_ 154 OBJ_Right_Out_Of_Image_V_32 1 "TRUE" 0 "FALSE" ;
VAL_ 154 OBJ_Left_Out_Of_Image_V_32 1 "TRUE" 0 "FALSE" ;
VAL_ 154 OBJ_Top_Out_Of_Image_32 1 "TRUE" 0 "FALSE" ;
VAL_ 154 OBJ_Bottom_Out_Of_Image_32 1 "TRUE" 0 "FALSE" ;
VAL_ 154 OBJ_Top_Out_Of_Image_V_32 1 "VALID" 0 "INVALID" ;
VAL_ 154 OBJ_Bottom_Out_Of_Image_V_32 1 "VALID" 0 "INVALID" ;
VAL_ 154 OBJ_Lane_Assignment_32 5 "RIGHT_RIGHT" 4 "RIGHT" 3 "HOST" 2 "LEFT" 1 "LEFT_LEFT" 0 "UNKNOWN" ;
VAL_ 154 OBJ_Lane_Assignment_V_32 1 "VALID" 0 "INVALID" ;
VAL_ 154 OBJ_Age_Seconds_V_32 1 "VALID" 0 "INVALID" ;
VAL_ 154 OBJ_Width_V_32 1 "VALID" 0 "INVALID" ;
VAL_ 154 OBJ_Width_STD_V_32 1 "VALID" 0 "INVALID" ;
VAL_ 154 OBJ_Length_V_32 1 "VALID" 0 "INVALID" ;
VAL_ 154 OBJ_Length_STD_V_32 1 "VALID" 0 "INVALID" ;
VAL_ 154 OBJ_Height_V_32 1 "VALID" 0 "INVALID" ;
VAL_ 154 OBJ_Height_STD_V_32 1 "VALID" 0 "INVALID" ;
VAL_ 154 OBJ_Abs_Long_Velocity_V_32 1 "VALID" 0 "INVALID" ;
VAL_ 154 OBJ_Abs_Long_Vel_STD_V_32 1 "VALID" 0 "INVALID" ;
VAL_ 154 OBJ_Abs_Lat_Velocity_V_32 1 "VALID" 0 "INVALID" ;
VAL_ 154 OBJ_Abs_Lat_Vel_STD_V_32 1 "VALID" 0 "INVALID" ;
VAL_ 154 OBJ_Abs_Long_Acc_V_32 1 "VALID" 0 "INVALID" ;
VAL_ 154 OBJ_Abs_Long_Acc_STD_V_32 1 "VALID" 0 "INVALID" ;
VAL_ 154 OBJ_Abs_Lat_Acc_V_32 1 "VALID" 0 "INVALID" ;
VAL_ 154 OBJ_Abs_Lat_Acc_STD_V_32 1 "VALID" 0 "INVALID" ;
VAL_ 154 OBJ_Abs_Acceleration_V_32 1 "VALID" 0 "INVALID" ;
VAL_ 154 OBJ_Abs_Acc_STD_V_32 1 "VALID" 0 "INVALID" ;
VAL_ 154 OBJ_Inv_TTC_V_32 1 "VALID" 0 "INVALID" ;
VAL_ 154 OBJ_Inv_TTC_STD_V_32 1 "VALID" 0 "INVALID" ;
VAL_ 154 OBJ_Relative_Long_Acc_V_32 1 "VALID" 0 "INVALID" ;
VAL_ 154 OBJ_Rel_Long_Acc_STD_V_32 1 "VALID" 0 "INVALID" ;
VAL_ 154 OBJ_Relative_Long_Velocity_V_32 1 "VALID" 0 "INVALID" ;
VAL_ 154 OBJ_Rel_Long_Vel_STD_V_32 1 "VALID" 0 "INVALID" ;
VAL_ 154 OBJ_Relative_Lat_Velocity_V_32 1 "VALID" 0 "INVALID" ;
VAL_ 154 OBJ_Rel_Lat_Vel_STD_V_32 1 "VALID" 0 "INVALID" ;
VAL_ 154 OBJ_Long_Distance_V_32 1 "VALID" 0 "INVALID" ;
VAL_ 154 OBJ_Long_Distance_STD_V_32 1 "VALID" 0 "INVALID" ;
VAL_ 154 OBJ_Lat_Distance_V_32 1 "VALID" 0 "INVALID" ;
VAL_ 154 OBJ_Lat_Distance_STD_V_32 1 "VALID" 0 "INVALID" ;
VAL_ 154 OBJ_Absolute_Speed_V_32 1 "VALID" 0 "INVALID" ;
VAL_ 154 OBJ_Absolute_Speed_STD_V_32 1 "VALID" 0 "INVALID" ;
VAL_ 154 OBJ_Heading_V_32 1 "VALID" 0 "INVALID" ;
VAL_ 154 OBJ_Heading_STD_V_32 1 "VALID" 0 "INVALID" ;
VAL_ 154 OBJ_Angle_Rate_STD_V_32 1 "VALID" 0 "INVALID" ;
VAL_ 154 OBJ_Angle_Rate_V_32 1 "VALID" 0 "INVALID" ;
VAL_ 154 OBJ_Angle_Right_V_32 1 "VALID" 0 "INVALID" ;
VAL_ 154 OBJ_Angle_Right_STD_V_32 1 "VALID" 0 "INVALID" ;
VAL_ 154 OBJ_Angle_Left_V_32 1 "VALID" 0 "INVALID" ;
VAL_ 154 OBJ_Angle_Left_STD_V_32 1 "VALID" 0 "INVALID" ;
VAL_ 154 OBJ_Angle_Side_V_32 1 "VALID" 0 "INVALID" ;
VAL_ 154 OBJ_Angle_Side_STD_V_32 1 "VALID" 0 "INVALID" ;
VAL_ 154 OBJ_Angle_Mid_V_32 1 "VALID" 0 "INVALID" ;
VAL_ 154 OBJ_Angle_Mid_STD_V_32 1 "VALID" 0 "INVALID" ;
VAL_ 154 OBJ_Angle_Bottom_V_32 1 "VALID" 0 "INVALID" ;
VAL_ 154 OBJ_Angle_Bottom_STD_V_32 1 "VALID" 0 "INVALID" ;
VAL_ 154 OBJ_Visibility_Side_V_32 1 "VALID" 0 "INVALID" ;
VAL_ 154 OBJ_Visibility_Side_32 2 "REAR" 1 "FRONT" 0 "NOT_VISIBLE" ;
VAL_ 154 OBJ_Is_In_Drivable_Area_32 1 "TRUE" 0 "FALSE" ;
VAL_ 154 OBJ_Is_In_Drivable_Area_V_32 1 "VALID" 0 "INVALID" ;
VAL_ 154 OBJ_Is_VeryClose_V_32 1 "VALID" 0 "INVALID" ;
VAL_ 154 OBJ_Is_VeryClose_32 1 "TRUE" 0 "FALSE" ;
VAL_ 154 OBJ_OverlapAngleEgoLaneR_V_32 1 "VALID" 0 "INVALID" ;
VAL_ 154 OBJ_OverlapAngleEgoLaneL_V_32 1 "VALID" 0 "INVALID" ;
VAL_ 154 OBJ_Is_EMERGENCY_VCL_32 1 "TRUE" 0 "FALSE" ;
VAL_ 154 OBJ_EMERGENCY_LIGHT_COLOR_32 3 "(1000)ORANGE" 2 "(0100)BLUE" 1 "(0010)RED" 0 "(0001)OTHER" ;
VAL_ 154 OBJ_EMERGENCY_V_32 1 "TRUE" 0 "FALSE" ;
VAL_ 154 OBJ_Angle_Top_V_32 1 "VALID" 0 "INVALID" ;
VAL_ 154 OBJ_Angle_Top_STD_V_32 1 "VALID" 0 "INVALID" ;
VAL_ 154 OBJ_Fusion_Source_33 2 "(BIT_2)RADAR2" 1 "(BIT_1)RADAR1" 0 "(BIT_0)CAMERA" ;
VAL_ 154 OBJ_Triggered_SDM_33 2 "NOT_TRIGGERED" 1 "TRIGGERED" 0 "NOT_AVAILABLE" ;
VAL_ 154 OBJ_Motion_Category_33 13 "ONCOMING" 12 "PRECEEDING" 11 "MOVING" 10 "RTAP" 9 "LTAP" 8 "CROSSING" 7 "MOVING_OUT" 6 "MOVING_IN" 5 "CLOSE_CUT_IN" 4 "PASSING_OUT" 3 "PASSING_IN" 2 "PASSING" 1 "UNDEFINED" 0 "UNFILLED" ;
VAL_ 154 OBJ_Measuring_Status_33 2 "(BIT_2)NOT_VALID_OR_VALID" 1 "(BIT_1)PREDICTED_OR_MEASURED" 0 "(BIT_0)OLD_OR_NEW" ;
VAL_ 154 OBJ_Object_Class_33 8 "UNCERTAIN_VCL" 7 "ANIMAL" 6 "GENERAL_OBJECT" 5 "PEDESTRIAN" 4 "BICYCLE" 3 "MOTORBIKE" 2 "TRUCK" 1 "CAR" 0 "UNFILLED" ;
VAL_ 154 OBJ_Camera_Source_33 11 "PARKING_RIGHT" 10 "PARKING_LEFT" 9 "PARKING_REAR" 8 "PARKING_FRONT" 7 "FRONT_CORNER_RIGHT" 6 "FRONT_CORNER_LEFT" 5 "REAR_CORNER_RIGHT" 4 "REAR_CORNER_LEFT" 3 "REAR" 2 "FRONT_FISHEYE" 1 "FRONT_NARROW" 0 "FRONT_MAIN" ;
VAL_ 154 OBJ_Motion_Status_33 5 "MOVING_SLOWLY" 4 "STOPPED" 3 "STATIONARY" 2 "MOVING" 1 "UNKNOWN" 0 "INVALID" ;
VAL_ 154 OBJ_Motion_Orientation_33 13 "INVALID" 12 "NORTH" 11 "NORTH_WEST" 9 "WEST" 7 "SOUTH_WEST" 6 "SOUTH" 5 "SOUTH_EAST" 3 "EAST" 1 "NORTH_EAST" 0 "UNKNOWN" ;
VAL_ 154 OBJ_Has_Cut_Lane_33 1 "TRUE" 0 "FALSE" ;
VAL_ 154 OBJ_Has_Cut_Path_33 1 "TRUE" 0 "FALSE" ;
VAL_ 154 OBJ_Brake_Light_33 1 "TRUE" 0 "FALSE" ;
VAL_ 154 OBJ_Turn_Indicator_Right_33 1 "TRUE" 0 "FALSE" ;
VAL_ 154 OBJ_Turn_Indicator_Left_33 1 "TRUE" 0 "FALSE" ;
VAL_ 154 OBJ_Light_Indicator_Validity_33 1 "TRUE" 0 "FALSE" ;
VAL_ 154 OBJ_Right_Out_Of_Image_33 1 "TRUE" 0 "FALSE" ;
VAL_ 154 OBJ_Left_Out_Of_Image_33 1 "TRUE" 0 "FALSE" ;
VAL_ 154 OBJ_Right_Out_Of_Image_V_33 1 "TRUE" 0 "FALSE" ;
VAL_ 154 OBJ_Left_Out_Of_Image_V_33 1 "TRUE" 0 "FALSE" ;
VAL_ 154 OBJ_Top_Out_Of_Image_33 1 "TRUE" 0 "FALSE" ;
VAL_ 154 OBJ_Bottom_Out_Of_Image_33 1 "TRUE" 0 "FALSE" ;
VAL_ 154 OBJ_Top_Out_Of_Image_V_33 1 "VALID" 0 "INVALID" ;
VAL_ 154 OBJ_Bottom_Out_Of_Image_V_33 1 "VALID" 0 "INVALID" ;
VAL_ 154 OBJ_Lane_Assignment_33 5 "RIGHT_RIGHT" 4 "RIGHT" 3 "HOST" 2 "LEFT" 1 "LEFT_LEFT" 0 "UNKNOWN" ;
VAL_ 154 OBJ_Lane_Assignment_V_33 1 "VALID" 0 "INVALID" ;
VAL_ 154 OBJ_Age_Seconds_V_33 1 "VALID" 0 "INVALID" ;
VAL_ 154 OBJ_Width_V_33 1 "VALID" 0 "INVALID" ;
VAL_ 154 OBJ_Width_STD_V_33 1 "VALID" 0 "INVALID" ;
VAL_ 154 OBJ_Length_V_33 1 "VALID" 0 "INVALID" ;
VAL_ 154 OBJ_Length_STD_V_33 1 "VALID" 0 "INVALID" ;
VAL_ 154 OBJ_Height_V_33 1 "VALID" 0 "INVALID" ;
VAL_ 154 OBJ_Height_STD_V_33 1 "VALID" 0 "INVALID" ;
VAL_ 154 OBJ_Abs_Long_Velocity_V_33 1 "VALID" 0 "INVALID" ;
VAL_ 154 OBJ_Abs_Long_Vel_STD_V_33 1 "VALID" 0 "INVALID" ;
VAL_ 154 OBJ_Abs_Lat_Velocity_V_33 1 "VALID" 0 "INVALID" ;
VAL_ 154 OBJ_Abs_Lat_Vel_STD_V_33 1 "VALID" 0 "INVALID" ;
VAL_ 154 OBJ_Abs_Long_Acc_V_33 1 "VALID" 0 "INVALID" ;
VAL_ 154 OBJ_Abs_Long_Acc_STD_V_33 1 "VALID" 0 "INVALID" ;
VAL_ 154 OBJ_Abs_Lat_Acc_V_33 1 "VALID" 0 "INVALID" ;
VAL_ 154 OBJ_Abs_Lat_Acc_STD_V_33 1 "VALID" 0 "INVALID" ;
VAL_ 154 OBJ_Abs_Acceleration_V_33 1 "VALID" 0 "INVALID" ;
VAL_ 154 OBJ_Abs_Acc_STD_V_33 1 "VALID" 0 "INVALID" ;
VAL_ 154 OBJ_Inv_TTC_V_33 1 "VALID" 0 "INVALID" ;
VAL_ 154 OBJ_Inv_TTC_STD_V_33 1 "VALID" 0 "INVALID" ;
VAL_ 154 OBJ_Relative_Long_Acc_V_33 1 "VALID" 0 "INVALID" ;
VAL_ 154 OBJ_Rel_Long_Acc_STD_V_33 1 "VALID" 0 "INVALID" ;
VAL_ 154 OBJ_Relative_Long_Velocity_V_33 1 "VALID" 0 "INVALID" ;
VAL_ 154 OBJ_Rel_Long_Vel_STD_V_33 1 "VALID" 0 "INVALID" ;
VAL_ 154 OBJ_Relative_Lat_Velocity_V_33 1 "VALID" 0 "INVALID" ;
VAL_ 154 OBJ_Rel_Lat_Vel_STD_V_33 1 "VALID" 0 "INVALID" ;
VAL_ 154 OBJ_Long_Distance_V_33 1 "VALID" 0 "INVALID" ;
VAL_ 154 OBJ_Long_Distance_STD_V_33 1 "VALID" 0 "INVALID" ;
VAL_ 154 OBJ_Lat_Distance_V_33 1 "VALID" 0 "INVALID" ;
VAL_ 154 OBJ_Lat_Distance_STD_V_33 1 "VALID" 0 "INVALID" ;
VAL_ 154 OBJ_Absolute_Speed_V_33 1 "VALID" 0 "INVALID" ;
VAL_ 154 OBJ_Absolute_Speed_STD_V_33 1 "VALID" 0 "INVALID" ;
VAL_ 154 OBJ_Heading_V_33 1 "VALID" 0 "INVALID" ;
VAL_ 154 OBJ_Heading_STD_V_33 1 "VALID" 0 "INVALID" ;
VAL_ 154 OBJ_Angle_Rate_STD_V_33 1 "VALID" 0 "INVALID" ;
VAL_ 154 OBJ_Angle_Rate_V_33 1 "VALID" 0 "INVALID" ;
VAL_ 154 OBJ_Angle_Right_V_33 1 "VALID" 0 "INVALID" ;
VAL_ 154 OBJ_Angle_Right_STD_V_33 1 "VALID" 0 "INVALID" ;
VAL_ 154 OBJ_Angle_Left_V_33 1 "VALID" 0 "INVALID" ;
VAL_ 154 OBJ_Angle_Left_STD_V_33 1 "VALID" 0 "INVALID" ;
VAL_ 154 OBJ_Angle_Side_V_33 1 "VALID" 0 "INVALID" ;
VAL_ 154 OBJ_Angle_Side_STD_V_33 1 "VALID" 0 "INVALID" ;
VAL_ 154 OBJ_Angle_Mid_V_33 1 "VALID" 0 "INVALID" ;
VAL_ 154 OBJ_Angle_Mid_STD_V_33 1 "VALID" 0 "INVALID" ;
VAL_ 154 OBJ_Angle_Bottom_V_33 1 "VALID" 0 "INVALID" ;
VAL_ 154 OBJ_Angle_Bottom_STD_V_33 1 "VALID" 0 "INVALID" ;
VAL_ 154 OBJ_Visibility_Side_V_33 1 "VALID" 0 "INVALID" ;
VAL_ 154 OBJ_Visibility_Side_33 2 "REAR" 1 "FRONT" 0 "NOT_VISIBLE" ;
VAL_ 154 OBJ_Is_In_Drivable_Area_33 1 "TRUE" 0 "FALSE" ;
VAL_ 154 OBJ_Is_In_Drivable_Area_V_33 1 "VALID" 0 "INVALID" ;
VAL_ 154 OBJ_Is_VeryClose_V_33 1 "VALID" 0 "INVALID" ;
VAL_ 154 OBJ_Is_VeryClose_33 1 "TRUE" 0 "FALSE" ;
VAL_ 154 OBJ_OverlapAngleEgoLaneR_V_33 1 "VALID" 0 "INVALID" ;
VAL_ 154 OBJ_OverlapAngleEgoLaneL_V_33 1 "VALID" 0 "INVALID" ;
VAL_ 154 OBJ_Is_EMERGENCY_VCL_33 1 "TRUE" 0 "FALSE" ;
VAL_ 154 OBJ_EMERGENCY_LIGHT_COLOR_33 3 "(1000)ORANGE" 2 "(0100)BLUE" 1 "(0010)RED" 0 "(0001)OTHER" ;
VAL_ 154 OBJ_EMERGENCY_V_33 1 "TRUE" 0 "FALSE" ;
VAL_ 154 OBJ_Angle_Top_V_33 1 "VALID" 0 "INVALID" ;
VAL_ 154 OBJ_Angle_Top_STD_V_33 1 "VALID" 0 "INVALID" ;
VAL_ 154 OBJ_Fusion_Source_34 2 "(BIT_2)RADAR2" 1 "(BIT_1)RADAR1" 0 "(BIT_0)CAMERA" ;
VAL_ 154 OBJ_Triggered_SDM_34 2 "NOT_TRIGGERED" 1 "TRIGGERED" 0 "NOT_AVAILABLE" ;
VAL_ 154 OBJ_Motion_Category_34 13 "ONCOMING" 12 "PRECEEDING" 11 "MOVING" 10 "RTAP" 9 "LTAP" 8 "CROSSING" 7 "MOVING_OUT" 6 "MOVING_IN" 5 "CLOSE_CUT_IN" 4 "PASSING_OUT" 3 "PASSING_IN" 2 "PASSING" 1 "UNDEFINED" 0 "UNFILLED" ;
VAL_ 154 OBJ_Measuring_Status_34 2 "(BIT_2)NOT_VALID_OR_VALID" 1 "(BIT_1)PREDICTED_OR_MEASURED" 0 "(BIT_0)OLD_OR_NEW" ;
VAL_ 154 OBJ_Object_Class_34 8 "UNCERTAIN_VCL" 7 "ANIMAL" 6 "GENERAL_OBJECT" 5 "PEDESTRIAN" 4 "BICYCLE" 3 "MOTORBIKE" 2 "TRUCK" 1 "CAR" 0 "UNFILLED" ;
VAL_ 154 OBJ_Camera_Source_34 11 "PARKING_RIGHT" 10 "PARKING_LEFT" 9 "PARKING_REAR" 8 "PARKING_FRONT" 7 "FRONT_CORNER_RIGHT" 6 "FRONT_CORNER_LEFT" 5 "REAR_CORNER_RIGHT" 4 "REAR_CORNER_LEFT" 3 "REAR" 2 "FRONT_FISHEYE" 1 "FRONT_NARROW" 0 "FRONT_MAIN" ;
VAL_ 154 OBJ_Motion_Status_34 5 "MOVING_SLOWLY" 4 "STOPPED" 3 "STATIONARY" 2 "MOVING" 1 "UNKNOWN" 0 "INVALID" ;
VAL_ 154 OBJ_Motion_Orientation_34 13 "INVALID" 12 "NORTH" 11 "NORTH_WEST" 9 "WEST" 7 "SOUTH_WEST" 6 "SOUTH" 5 "SOUTH_EAST" 3 "EAST" 1 "NORTH_EAST" 0 "UNKNOWN" ;
VAL_ 154 OBJ_Has_Cut_Lane_34 1 "TRUE" 0 "FALSE" ;
VAL_ 154 OBJ_Has_Cut_Path_34 1 "TRUE" 0 "FALSE" ;
VAL_ 154 OBJ_Brake_Light_34 1 "TRUE" 0 "FALSE" ;
VAL_ 154 OBJ_Turn_Indicator_Right_34 1 "TRUE" 0 "FALSE" ;
VAL_ 154 OBJ_Turn_Indicator_Left_34 1 "TRUE" 0 "FALSE" ;
VAL_ 154 OBJ_Light_Indicator_Validity_34 1 "TRUE" 0 "FALSE" ;
VAL_ 154 OBJ_Right_Out_Of_Image_34 1 "TRUE" 0 "FALSE" ;
VAL_ 154 OBJ_Left_Out_Of_Image_34 1 "TRUE" 0 "FALSE" ;
VAL_ 154 OBJ_Right_Out_Of_Image_V_34 1 "TRUE" 0 "FALSE" ;
VAL_ 154 OBJ_Left_Out_Of_Image_V_34 1 "TRUE" 0 "FALSE" ;
VAL_ 154 OBJ_Top_Out_Of_Image_34 1 "TRUE" 0 "FALSE" ;
VAL_ 154 OBJ_Bottom_Out_Of_Image_34 1 "TRUE" 0 "FALSE" ;
VAL_ 154 OBJ_Top_Out_Of_Image_V_34 1 "VALID" 0 "INVALID" ;
VAL_ 154 OBJ_Bottom_Out_Of_Image_V_34 1 "VALID" 0 "INVALID" ;
VAL_ 154 OBJ_Lane_Assignment_34 5 "RIGHT_RIGHT" 4 "RIGHT" 3 "HOST" 2 "LEFT" 1 "LEFT_LEFT" 0 "UNKNOWN" ;
VAL_ 154 OBJ_Lane_Assignment_V_34 1 "VALID" 0 "INVALID" ;
VAL_ 154 OBJ_Age_Seconds_V_34 1 "VALID" 0 "INVALID" ;
VAL_ 154 OBJ_Width_V_34 1 "VALID" 0 "INVALID" ;
VAL_ 154 OBJ_Width_STD_V_34 1 "VALID" 0 "INVALID" ;
VAL_ 154 OBJ_Length_V_34 1 "VALID" 0 "INVALID" ;
VAL_ 154 OBJ_Length_STD_V_34 1 "VALID" 0 "INVALID" ;
VAL_ 154 OBJ_Height_V_34 1 "VALID" 0 "INVALID" ;
VAL_ 154 OBJ_Height_STD_V_34 1 "VALID" 0 "INVALID" ;
VAL_ 154 OBJ_Abs_Long_Velocity_V_34 1 "VALID" 0 "INVALID" ;
VAL_ 154 OBJ_Abs_Long_Vel_STD_V_34 1 "VALID" 0 "INVALID" ;
VAL_ 154 OBJ_Abs_Lat_Velocity_V_34 1 "VALID" 0 "INVALID" ;
VAL_ 154 OBJ_Abs_Lat_Vel_STD_V_34 1 "VALID" 0 "INVALID" ;
VAL_ 154 OBJ_Abs_Long_Acc_V_34 1 "VALID" 0 "INVALID" ;
VAL_ 154 OBJ_Abs_Long_Acc_STD_V_34 1 "VALID" 0 "INVALID" ;
VAL_ 154 OBJ_Abs_Lat_Acc_V_34 1 "VALID" 0 "INVALID" ;
VAL_ 154 OBJ_Abs_Lat_Acc_STD_V_34 1 "VALID" 0 "INVALID" ;
VAL_ 154 OBJ_Abs_Acceleration_V_34 1 "VALID" 0 "INVALID" ;
VAL_ 154 OBJ_Abs_Acc_STD_V_34 1 "VALID" 0 "INVALID" ;
VAL_ 154 OBJ_Inv_TTC_V_34 1 "VALID" 0 "INVALID" ;
VAL_ 154 OBJ_Inv_TTC_STD_V_34 1 "VALID" 0 "INVALID" ;
VAL_ 154 OBJ_Relative_Long_Acc_V_34 1 "VALID" 0 "INVALID" ;
VAL_ 154 OBJ_Rel_Long_Acc_STD_V_34 1 "VALID" 0 "INVALID" ;
VAL_ 154 OBJ_Relative_Long_Velocity_V_34 1 "VALID" 0 "INVALID" ;
VAL_ 154 OBJ_Rel_Long_Vel_STD_V_34 1 "VALID" 0 "INVALID" ;
VAL_ 154 OBJ_Relative_Lat_Velocity_V_34 1 "VALID" 0 "INVALID" ;
VAL_ 154 OBJ_Rel_Lat_Vel_STD_V_34 1 "VALID" 0 "INVALID" ;
VAL_ 154 OBJ_Long_Distance_V_34 1 "VALID" 0 "INVALID" ;
VAL_ 154 OBJ_Long_Distance_STD_V_34 1 "VALID" 0 "INVALID" ;
VAL_ 154 OBJ_Lat_Distance_V_34 1 "VALID" 0 "INVALID" ;
VAL_ 154 OBJ_Lat_Distance_STD_V_34 1 "VALID" 0 "INVALID" ;
VAL_ 154 OBJ_Absolute_Speed_V_34 1 "VALID" 0 "INVALID" ;
