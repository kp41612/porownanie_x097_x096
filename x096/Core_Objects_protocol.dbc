VERSION "14"
// BundelVersion=v4.20.10_RC1
NS_ :

BS_:

BU_: EyeQ4 MCU

BO_ 154 Core_Objects_protocol: 4660 EyeQ4
 SG_ OBJ_Zero_byte : 0|8@1+ (1,0) [0|255] "NA" MCU
 SG_ Reserved_1 : 8|24@1+ (1,0) [0|0] "NA" MCU
 SG_ OBJ_Header_CRC : 32|32@1+ (1,0) [0|4294967295] "NA" MCU
 SG_ OBJ_Protocol_Version : 64|8@1+ (1,0) [14|14] "counter" MCU
 SG_ OBJ_Sync_ID : 72|8@1+ (1,0) [0|255] "counter" MCU
 SG_ OBJ_VRU_Count : 80|5@1+ (1,0) [0|20] "counter" MCU
 SG_ OBJ_VD_Count : 85|5@1+ (1,0) [0|20] "counter" MCU
 SG_ OBJ_General_OBJ_Count : 90|4@1+ (1,0) [0|10] "counter" MCU
 SG_ Reserved_2 : 94|2@1+ (1,0) [0|0] "NA" MCU
 SG_ OBJ_Animal_Count : 96|4@1+ (1,0) [0|10] "counter" MCU
 SG_ OBJ_VD_NIV_Left : 100|8@1+ (1,0) [0|255] "ID" MCU
 SG_ OBJ_VD_NIV_Right : 108|8@1+ (1,0) [0|255] "ID" MCU
 SG_ OBJ_VD_CIPV_ID : 116|8@1+ (1,0) [0|255] "ID" MCU
 SG_ OBJ_VD_CIPV_Lost : 124|2@1+ (1,0) [0|2] "ENUM" MCU
 SG_ OBJ_VD_Allow_Acc : 126|2@1+ (1,0) [0|2] "ENUM" MCU
 SG_ OBJ_Is_Blocked_Left : 128|1@1+ (1,0) [0|1] "bool" MCU
 SG_ OBJ_Is_Blocked_Right : 129|1@1+ (1,0) [0|1] "bool" MCU
 SG_ OBJ_Buffer_C16 : 130|8@1+ (1,0) [0|255] "NA" MCU
 SG_ OBJ_Buffer_C17 : 138|2@1+ (1,0) [0|2] "NA" MCU
 SG_ Reserved_3 : 140|20@1+ (1,0) [0|0] "NA" MCU
 SG_ OBJ_CRC_0 : 160|32@1+ (1,0) [0|4294967295] "NA" MCU
 SG_ OBJ_ID_0 : 192|8@1+ (1,0) [0|255] "counter" MCU
 SG_ OBJ_Existence_Probability_0 : 200|8@1+ (0.01,0) [0|1] "NA" MCU
 SG_ OBJ_Fusion_Source_0 : 208|16@1+ (1,0) [0|65535] "BITWIZE" MCU
 SG_ OBJ_Triggered_SDM_0 : 224|2@1+ (1,0) [0|2] "ENUM" MCU
 SG_ OBJ_Motion_Category_0 : 226|4@1+ (1,0) [0|13] "ENUM" MCU
 SG_ OBJ_Buffer_C0_0 : 230|7@1+ (0.01,0) [0|1] "NA" MCU
 SG_ OBJ_Object_Age_0 : 237|11@1+ (1,0) [0|2047] "frames" MCU
 SG_ OBJ_Measuring_Status_0 : 248|3@1+ (1,0) [0|7] "BITWIZE" MCU
 SG_ OBJ_Object_Class_0 : 251|4@1+ (1,0) [0|8] "ENUM" MCU
 SG_ Reserved_4_0 : 255|1@1+ (1,0) [0|0] "NA" MCU
 SG_ OBJ_Class_Probability_0 : 256|7@1+ (0.01,0) [0|1] "NA" MCU
 SG_ OBJ_Car_Probability_0 : 263|7@1+ (0.01,0) [0|1] "NA" MCU
 SG_ OBJ_Truck_Probability_0 : 270|7@1+ (0.01,0) [0|1] "NA" MCU
 SG_ OBJ_Bike_Probability_0 : 277|7@1+ (0.01,0) [0|1] "NA" MCU
 SG_ OBJ_Camera_Source_0 : 284|4@1+ (1,0) [0|15] "ENUM" MCU
 SG_ OBJ_Motion_Status_0 : 288|3@1+ (1,0) [0|5] "ENUM" MCU
 SG_ OBJ_Motion_Orientation_0 : 291|4@1+ (1,0) [0|13] "ENUM" MCU
 SG_ OBJ_Has_Cut_Lane_0 : 295|1@1+ (1,0) [0|1] "bool" MCU
 SG_ OBJ_Has_Cut_Path_0 : 296|1@1+ (1,0) [0|1] "bool" MCU
 SG_ OBJ_Brake_Light_0 : 297|1@1+ (1,0) [0|1] "bool" MCU
 SG_ OBJ_Turn_Indicator_Right_0 : 298|1@1+ (1,0) [0|1] "bool" MCU
 SG_ OBJ_Turn_Indicator_Left_0 : 299|1@1+ (1,0) [0|1] "bool" MCU
 SG_ OBJ_Light_Indicator_Validity_0 : 300|1@1+ (1,0) [0|1] "bool" MCU
 SG_ OBJ_Right_Out_Of_Image_0 : 301|1@1+ (1,0) [0|1] "bool" MCU
 SG_ OBJ_Left_Out_Of_Image_0 : 302|1@1+ (1,0) [0|1] "bool" MCU
 SG_ OBJ_Right_Out_Of_Image_V_0 : 303|1@1+ (1,0) [0|1] "bool" MCU
 SG_ OBJ_Left_Out_Of_Image_V_0 : 304|1@1+ (1,0) [0|1] "bool" MCU
 SG_ OBJ_Top_Out_Of_Image_0 : 305|1@1+ (1,0) [0|1] "bool" MCU
 SG_ OBJ_Bottom_Out_Of_Image_0 : 306|1@1+ (1,0) [0|1] "bool" MCU
 SG_ OBJ_Top_Out_Of_Image_V_0 : 307|1@1+ (1,0) [0|1] "bool" MCU
 SG_ OBJ_Bottom_Out_Of_Image_V_0 : 308|1@1+ (1,0) [0|1] "bool" MCU
 SG_ OBJ_Lane_Assignment_0 : 309|3@1+ (1,0) [0|5] "ENUM" MCU
 SG_ OBJ_Lane_Assignment_V_0 : 312|1@1+ (1,0) [0|1] "bool" MCU
 SG_ OBJ_Age_Seconds_0 : 313|7@1+ (1,0) [0|100] "s" MCU
 SG_ OBJ_Age_Seconds_V_0 : 320|1@1+ (1,0) [0|1] "bool" MCU
 SG_ OBJ_Width_0 : 321|9@1+ (0.01,0) [0.4|2.95] "m" MCU
 SG_ OBJ_Width_V_0 : 330|1@1+ (1,0) [0|1] "bool" MCU
 SG_ OBJ_Width_STD_0 : 331|11@1+ (0.001,0) [0|2] "m" MCU
 SG_ OBJ_Width_STD_V_0 : 342|1@1+ (1,0) [0|1] "bool" MCU
 SG_ OBJ_Length_0 : 343|9@1+ (0.05,0) [1.2|21] "m" MCU
 SG_ OBJ_Length_V_0 : 352|1@1+ (1,0) [0|1] "bool" MCU
 SG_ OBJ_Length_STD_0 : 353|10@1+ (0.01,0) [0|10] "m" MCU
 SG_ OBJ_Length_STD_V_0 : 363|1@1+ (1,0) [0|1] "bool" MCU
 SG_ OBJ_Radar_ID_0 : 364|8@1+ (1,0) [0|255] "counter" MCU
 SG_ OBJ_Height_0 : 372|9@1+ (0.01,0) [0|2.95] "m" MCU
 SG_ OBJ_Height_V_0 : 381|1@1+ (1,0) [0|1] "bool" MCU
 SG_ Reserved_5_0 : 382|2@1+ (1,0) [0|0] "NA" MCU
 SG_ OBJ_Height_STD_0 : 384|11@1+ (0.001,0) [0|2] "m" MCU
 SG_ OBJ_Height_STD_V_0 : 395|1@1+ (1,0) [0|1] "bool" MCU
 SG_ OBJ_Abs_Long_Velocity_0 : 396|12@1+ (0.05,-100) [-100|100] "m_per_s" MCU
 SG_ OBJ_Abs_Long_Velocity_V_0 : 408|1@1+ (1,0) [0|1] "bool" MCU
 SG_ Reserved_6_0 : 409|7@1+ (1,0) [0|0] "NA" MCU
 SG_ OBJ_Abs_Long_Velocity_STD_0 : 416|13@1+ (0.01,0) [0|65] "m_per_s" MCU
 SG_ OBJ_Abs_Long_Vel_STD_V_0 : 429|1@1+ (1,0) [0|1] "bool" MCU
 SG_ OBJ_Abs_Lat_Velocity_0 : 430|11@1+ (0.05,-50) [-50|50] "m_per_s" MCU
 SG_ OBJ_Abs_Lat_Velocity_V_0 : 441|1@1+ (1,0) [0|1] "bool" MCU
 SG_ Reserved_7_0 : 442|6@1+ (1,0) [0|0] "NA" MCU
 SG_ OBJ_Abs_Lat_Velocity_STD_0 : 448|13@1+ (0.01,0) [0|50] "m_per_s" MCU
 SG_ OBJ_Abs_Lat_Vel_STD_V_0 : 461|1@1+ (1,0) [0|1] "bool" MCU
 SG_ OBJ_Abs_Long_Acc_0 : 462|9@1+ (0.05,-10) [-10|10] "m_per_s2" MCU
 SG_ OBJ_Abs_Long_Acc_V_0 : 471|1@1+ (1,0) [0|1] "bool" MCU
 SG_ Reserved_8_0 : 472|8@1+ (1,0) [0|0] "NA" MCU
 SG_ OBJ_Abs_Long_Acc_STD_0 : 480|10@1+ (0.01,0) [0|7.3] "m_per_s2" MCU
 SG_ OBJ_Abs_Long_Acc_STD_V_0 : 490|1@1+ (1,0) [0|1] "bool" MCU
 SG_ OBJ_Abs_Lat_Acc_0 : 491|9@1+ (0.05,-10) [-10|10] "m_per_s2" MCU
 SG_ OBJ_Abs_Lat_Acc_V_0 : 500|1@1+ (1,0) [0|1] "bool" MCU
 SG_ OBJ_Abs_Lat_Acc_STD_0 : 501|10@1+ (0.01,0) [0|7.3] "m_per_s2" MCU
 SG_ OBJ_Abs_Lat_Acc_STD_V_0 : 511|1@1+ (1,0) [0|1] "bool" MCU
 SG_ OBJ_Abs_Acceleration_0 : 512|9@1+ (0.05,-12.7) [-12.7|12.7] "m_per_s2" MCU
 SG_ OBJ_Abs_Acceleration_V_0 : 521|1@1+ (1,0) [0|1] "bool" MCU
 SG_ OBJ_Abs_Acc_STD_0 : 522|10@1+ (0.01,0) [0|7.3] "m_per_s2" MCU
 SG_ OBJ_Abs_Acc_STD_V_0 : 532|1@1+ (1,0) [0|1] "bool" MCU
 SG_ OBJ_Inv_TTC_0 : 533|11@1+ (0.01,-8) [-8|8] "INV(s)" MCU
 SG_ OBJ_Inv_TTC_V_0 : 544|1@1+ (1,0) [0|1] "bool" MCU
 SG_ OBJ_Inv_TTC_STD_0 : 545|12@1+ (0.001,0) [0|4] "INV(s)" MCU
 SG_ OBJ_Inv_TTC_STD_V_0 : 557|1@1+ (1,0) [0|1] "bool" MCU
 SG_ OBJ_Relative_Long_Acc_0 : 558|10@1+ (0.05,-20) [-20|20] "m_per_s2" MCU
 SG_ OBJ_Relative_Long_Acc_V_0 : 568|1@1+ (1,0) [0|1] "bool" MCU
 SG_ Reserved_9_0 : 569|7@1+ (1,0) [0|0] "NA" MCU
 SG_ OBJ_Relative_Long_Acc_STD_0 : 576|10@1+ (0.01,0) [0|7.3] "m_per_s2" MCU
 SG_ OBJ_Rel_Long_Acc_STD_V_0 : 586|1@1+ (1,0) [0|1] "bool" MCU
 SG_ OBJ_Relative_Long_Velocity_0 : 587|13@1+ (0.05,-120) [-120|130] "m_per_s" MCU
 SG_ OBJ_Relative_Long_Velocity_V_0 : 600|1@1+ (1,0) [0|1] "bool" MCU
 SG_ Reserved_10_0 : 601|7@1+ (1,0) [0|0] "NA" MCU
 SG_ OBJ_Relative_Long_Vel_STD_0 : 608|14@1+ (0.01,0) [0|130] "m_per_s" MCU
 SG_ OBJ_Rel_Long_Vel_STD_V_0 : 622|1@1+ (1,0) [0|1] "bool" MCU
 SG_ OBJ_Relative_Lat_Velocity_0 : 623|11@1+ (0.05,-50) [-50|50] "m_per_s" MCU
 SG_ OBJ_Relative_Lat_Velocity_V_0 : 634|1@1+ (1,0) [0|1] "bool" MCU
 SG_ Reserved_11_0 : 635|5@1+ (1,0) [0|0] "NA" MCU
 SG_ OBJ_Relative_Lat_Velocity_STD_0 : 640|13@1+ (0.01,0) [0|50] "m_per_s" MCU
 SG_ OBJ_Rel_Lat_Vel_STD_V_0 : 653|1@1+ (1,0) [0|1] "bool" MCU
 SG_ OBJ_Long_Distance_0 : 654|14@1+ (0.05,-200) [-200|500] "m" MCU
 SG_ OBJ_Long_Distance_V_0 : 668|1@1+ (1,0) [0|1] "bool" MCU
 SG_ Reserved_12_0 : 669|3@1+ (1,0) [0|0] "NA" MCU
 SG_ OBJ_Long_Distance_STD_0 : 672|15@1+ (0.01,0) [0|250] "m" MCU
 SG_ OBJ_Long_Distance_STD_V_0 : 687|1@1+ (1,0) [0|1] "bool" MCU
 SG_ OBJ_Lat_Distance_0 : 688|12@1+ (0.05,-100) [-100|100] "m" MCU
 SG_ OBJ_Lat_Distance_V_0 : 700|1@1+ (1,0) [0|1] "bool" MCU
 SG_ Reserved_13_0 : 701|3@1+ (1,0) [0|0] "NA" MCU
 SG_ OBJ_Lat_Distance_STD_0 : 704|14@1+ (0.01,0) [0|100] "m" MCU
 SG_ OBJ_Lat_Distance_STD_V_0 : 718|1@1+ (1,0) [0|1] "bool" MCU
 SG_ OBJ_Absolute_Speed_0 : 719|12@1+ (0.05,-65) [-65|65] "m_per_s" MCU
 SG_ OBJ_Absolute_Speed_V_0 : 731|1@1+ (1,0) [0|1] "bool" MCU
 SG_ Reserved_14_0 : 732|4@1+ (1,0) [0|0] "NA" MCU
 SG_ OBJ_Absolute_Speed_STD_0 : 736|13@1+ (0.01,0) [0|65] "m_per_s" MCU
 SG_ OBJ_Absolute_Speed_STD_V_0 : 749|1@1+ (1,0) [0|1] "bool" MCU
 SG_ OBJ_Heading_0 : 750|10@1+ (0.01,-3.14) [-3.14|3.14] "rad" MCU
 SG_ OBJ_Heading_V_0 : 760|1@1+ (1,0) [0|1] "bool" MCU
 SG_ Reserved_15_0 : 761|7@1+ (1,0) [0|0] "NA" MCU
 SG_ OBJ_Heading_STD_0 : 768|15@1+ (0.0001,0) [0|3.14] "rad" MCU
 SG_ OBJ_Heading_STD_V_0 : 783|1@1+ (1,0) [0|1] "bool" MCU
 SG_ OBJ_Angle_Rate_STD_0 : 784|15@1+ (0.0001,0) [0|2.2318] "RPS" MCU
 SG_ OBJ_Angle_Rate_STD_V_0 : 799|1@1+ (1,0) [0|1] "bool" MCU
 SG_ OBJ_Angle_Rate_0 : 800|12@1+ (0.002,-2.234) [-2.234|2.2318] "RPS" MCU
 SG_ OBJ_Angle_Rate_V_0 : 812|1@1+ (1,0) [0|1] "bool" MCU
 SG_ OBJ_Angle_Right_0 : 813|14@1+ (0.0002,-1.571) [-1.571|1.571] "rad" MCU
 SG_ OBJ_Angle_Right_V_0 : 827|1@1+ (1,0) [0|1] "bool" MCU
 SG_ Reserved_16_0 : 828|4@1+ (1,0) [0|0] "NA" MCU
 SG_ OBJ_Angle_Right_STD_0 : 832|14@1+ (0.0001,0) [0|1.571] "rad" MCU
 SG_ OBJ_Angle_Right_STD_V_0 : 846|1@1+ (1,0) [0|1] "bool" MCU
 SG_ OBJ_Angle_Left_0 : 847|14@1+ (0.0002,-1.571) [-1.571|1.571] "rad" MCU
 SG_ OBJ_Angle_Left_V_0 : 861|1@1+ (1,0) [0|1] "bool" MCU
 SG_ Reserved_17_0 : 862|2@1+ (1,0) [0|0] "NA" MCU
 SG_ OBJ_Angle_Left_STD_0 : 864|14@1+ (0.0001,0) [0|1.571] "rad" MCU
 SG_ OBJ_Angle_Left_STD_V_0 : 878|1@1+ (1,0) [0|1] "bool" MCU
 SG_ OBJ_Angle_Side_0 : 879|14@1+ (0.0002,-1.571) [-1.571|1.571] "rad" MCU
 SG_ OBJ_Angle_Side_V_0 : 893|1@1+ (1,0) [0|1] "bool" MCU
 SG_ Reserved_18_0 : 894|2@1+ (1,0) [0|0] "NA" MCU
 SG_ OBJ_Angle_Side_STD_0 : 896|14@1+ (0.0001,0) [0|1.571] "rad" MCU
 SG_ OBJ_Angle_Side_STD_V_0 : 910|1@1+ (1,0) [0|1] "bool" MCU
 SG_ OBJ_Angle_Mid_V_0 : 911|1@1+ (1,0) [0|1] "bool" MCU
 SG_ OBJ_Angle_Mid_0 : 912|14@1+ (0.0002,-1.571) [-1.571|1.571] "rad" MCU
 SG_ Reserved_19_0 : 926|2@1+ (1,0) [0|0] "NA" MCU
 SG_ OBJ_Angle_Mid_STD_0 : 928|14@1+ (0.0001,0) [0|1.571] "rad" MCU
 SG_ OBJ_Angle_Mid_STD_V_0 : 942|1@1+ (1,0) [0|1] "bool" MCU
 SG_ OBJ_Angle_Bottom_V_0 : 943|1@1+ (1,0) [0|1] "bool" MCU
 SG_ OBJ_Angle_Bottom_0 : 944|14@1+ (0.0002,-1.571) [-1.571|1.571] "rad" MCU
 SG_ Reserved_20_0 : 958|2@1+ (1,0) [0|0] "NA" MCU
 SG_ OBJ_Angle_Bottom_STD_0 : 960|14@1+ (0.0001,0) [0|1.571] "rad" MCU
 SG_ OBJ_Angle_Bottom_STD_V_0 : 974|1@1+ (1,0) [0|1] "bool" MCU
 SG_ OBJ_Visibility_Side_V_0 : 975|1@1+ (1,0) [0|1] "bool" MCU
 SG_ OBJ_Visibility_Side_0 : 976|2@1+ (1,0) [0|2] "ENUM" MCU
 SG_ OBJ_Is_In_Drivable_Area_0 : 978|1@1+ (1,0) [0|1] "bool" MCU
 SG_ OBJ_Is_In_Drivable_Area_V_0 : 979|1@1+ (1,0) [0|1] "bool" MCU
 SG_ OBJ_Is_VeryClose_V_0 : 980|1@1+ (1,0) [0|1] "bool" MCU
 SG_ OBJ_Is_VeryClose_0 : 981|1@1+ (1,0) [0|1] "bool" MCU
 SG_ OBJ_Buffer_C4_0 : 982|2@1+ (1,0) [0|2] "NA" MCU
 SG_ OBJ_Buffer_C5_0 : 984|2@1+ (1,0) [0|2] "NA" MCU
 SG_ OBJ_Buffer_C6_0 : 986|2@1+ (1,0) [0|2] "NA" MCU
 SG_ OBJ_Buffer_C7_0 : 988|2@1+ (1,0) [0|2] "NA" MCU
 SG_ Reserved_21_0 : 990|2@1+ (1,0) [0|0] "NA" MCU
 SG_ OBJ_OverlapAngleEgoLaneR_0 : 992|10@1+ (0.01,-3.14) [-3.14|3.14] "rad" MCU
 SG_ OBJ_OverlapAngleEgoLaneR_V_0 : 1002|1@1+ (1,0) [0|1] "bool" MCU
 SG_ OBJ_OverlapAngleEgoLaneL_0 : 1003|10@1+ (0.01,-3.14) [-3.14|3.14] "rad" MCU
 SG_ OBJ_OverlapAngleEgoLaneL_V_0 : 1013|1@1+ (1,0) [0|1] "bool" MCU
 SG_ OBJ_Is_EMERGENCY_VCL_0 : 1014|1@1+ (1,0) [0|1] "bool" MCU
 SG_ OBJ_EMERGENCY_LIGHT_COLOR_0 : 1015|4@1+ (1,0) [0|15] "BITWIZE" MCU
 SG_ OBJ_EMERGENCY_V_0 : 1019|1@1+ (1,0) [0|1] "bool" MCU
 SG_ Reserved_22_0 : 1020|4@1+ (1,0) [0|0] "NA" MCU
 SG_ OBJ_Angle_Top_0 : 1024|14@1+ (0.0002,0) [0|3.1415] "rad" MCU
 SG_ OBJ_Angle_Top_V_0 : 1038|1@1+ (1,0) [0|1] "bool" MCU
 SG_ OBJ_Angle_Top_STD_0 : 1039|15@1+ (0.0001,0) [0|3.1415] "rad" MCU
 SG_ OBJ_Angle_Top_STD_V_0 : 1054|1@1+ (1,0) [0|1] "bool" MCU
 SG_ OBJ_Buffer_C14_0 : 1055|1@1+ (1,0) [0|1] "NA" MCU
 SG_ OBJ_Buffer_C15_0 : 1056|1@1+ (1,0) [0|1] "NA" MCU
 SG_ OBJ_Buffer_C18_0 : 1057|2@1+ (1,0) [0|2] "NA" MCU
 SG_ OBJ_Buffer_C19_0 : 1059|1@1+ (1,0) [0|1] "NA" MCU
 SG_ Reserved_23_0 : 1060|28@1+ (1,0) [0|0] "NA" MCU
 SG_ OBJ_CRC_1 : 1088|32@1+ (1,0) [0|4294967295] "NA" MCU
 SG_ OBJ_ID_1 : 1120|8@1+ (1,0) [0|255] "counter" MCU
 SG_ OBJ_Existence_Probability_1 : 1128|8@1+ (0.01,0) [0|1] "NA" MCU
 SG_ OBJ_Fusion_Source_1 : 1136|16@1+ (1,0) [0|65535] "BITWIZE" MCU
 SG_ OBJ_Triggered_SDM_1 : 1152|2@1+ (1,0) [0|2] "ENUM" MCU
 SG_ OBJ_Motion_Category_1 : 1154|4@1+ (1,0) [0|13] "ENUM" MCU
 SG_ OBJ_Buffer_C0_1 : 1158|7@1+ (0.01,0) [0|1] "NA" MCU
 SG_ OBJ_Object_Age_1 : 1165|11@1+ (1,0) [0|2047] "frames" MCU
 SG_ OBJ_Measuring_Status_1 : 1176|3@1+ (1,0) [0|7] "BITWIZE" MCU
 SG_ OBJ_Object_Class_1 : 1179|4@1+ (1,0) [0|8] "ENUM" MCU
 SG_ Reserved_4_1 : 1183|1@1+ (1,0) [0|0] "NA" MCU
 SG_ OBJ_Class_Probability_1 : 1184|7@1+ (0.01,0) [0|1] "NA" MCU
 SG_ OBJ_Car_Probability_1 : 1191|7@1+ (0.01,0) [0|1] "NA" MCU
 SG_ OBJ_Truck_Probability_1 : 1198|7@1+ (0.01,0) [0|1] "NA" MCU
 SG_ OBJ_Bike_Probability_1 : 1205|7@1+ (0.01,0) [0|1] "NA" MCU
 SG_ OBJ_Camera_Source_1 : 1212|4@1+ (1,0) [0|15] "ENUM" MCU
 SG_ OBJ_Motion_Status_1 : 1216|3@1+ (1,0) [0|5] "ENUM" MCU
 SG_ OBJ_Motion_Orientation_1 : 1219|4@1+ (1,0) [0|13] "ENUM" MCU
 SG_ OBJ_Has_Cut_Lane_1 : 1223|1@1+ (1,0) [0|1] "bool" MCU
 SG_ OBJ_Has_Cut_Path_1 : 1224|1@1+ (1,0) [0|1] "bool" MCU
 SG_ OBJ_Brake_Light_1 : 1225|1@1+ (1,0) [0|1] "bool" MCU
 SG_ OBJ_Turn_Indicator_Right_1 : 1226|1@1+ (1,0) [0|1] "bool" MCU
 SG_ OBJ_Turn_Indicator_Left_1 : 1227|1@1+ (1,0) [0|1] "bool" MCU
 SG_ OBJ_Light_Indicator_Validity_1 : 1228|1@1+ (1,0) [0|1] "bool" MCU
 SG_ OBJ_Right_Out_Of_Image_1 : 1229|1@1+ (1,0) [0|1] "bool" MCU
 SG_ OBJ_Left_Out_Of_Image_1 : 1230|1@1+ (1,0) [0|1] "bool" MCU
 SG_ OBJ_Right_Out_Of_Image_V_1 : 1231|1@1+ (1,0) [0|1] "bool" MCU
 SG_ OBJ_Left_Out_Of_Image_V_1 : 1232|1@1+ (1,0) [0|1] "bool" MCU
 SG_ OBJ_Top_Out_Of_Image_1 : 1233|1@1+ (1,0) [0|1] "bool" MCU
 SG_ OBJ_Bottom_Out_Of_Image_1 : 1234|1@1+ (1,0) [0|1] "bool" MCU
 SG_ OBJ_Top_Out_Of_Image_V_1 : 1235|1@1+ (1,0) [0|1] "bool" MCU
 SG_ OBJ_Bottom_Out_Of_Image_V_1 : 1236|1@1+ (1,0) [0|1] "bool" MCU
 SG_ OBJ_Lane_Assignment_1 : 1237|3@1+ (1,0) [0|5] "ENUM" MCU
 SG_ OBJ_Lane_Assignment_V_1 : 1240|1@1+ (1,0) [0|1] "bool" MCU
 SG_ OBJ_Age_Seconds_1 : 1241|7@1+ (1,0) [0|100] "s" MCU
 SG_ OBJ_Age_Seconds_V_1 : 1248|1@1+ (1,0) [0|1] "bool" MCU
 SG_ OBJ_Width_1 : 1249|9@1+ (0.01,0) [0.4|2.95] "m" MCU
 SG_ OBJ_Width_V_1 : 1258|1@1+ (1,0) [0|1] "bool" MCU
 SG_ OBJ_Width_STD_1 : 1259|11@1+ (0.001,0) [0|2] "m" MCU
 SG_ OBJ_Width_STD_V_1 : 1270|1@1+ (1,0) [0|1] "bool" MCU
 SG_ OBJ_Length_1 : 1271|9@1+ (0.05,0) [1.2|21] "m" MCU
 SG_ OBJ_Length_V_1 : 1280|1@1+ (1,0) [0|1] "bool" MCU
 SG_ OBJ_Length_STD_1 : 1281|10@1+ (0.01,0) [0|10] "m" MCU
 SG_ OBJ_Length_STD_V_1 : 1291|1@1+ (1,0) [0|1] "bool" MCU
 SG_ OBJ_Radar_ID_1 : 1292|8@1+ (1,0) [0|255] "counter" MCU
 SG_ OBJ_Height_1 : 1300|9@1+ (0.01,0) [0|2.95] "m" MCU
 SG_ OBJ_Height_V_1 : 1309|1@1+ (1,0) [0|1] "bool" MCU
 SG_ Reserved_5_1 : 1310|2@1+ (1,0) [0|0] "NA" MCU
 SG_ OBJ_Height_STD_1 : 1312|11@1+ (0.001,0) [0|2] "m" MCU
 SG_ OBJ_Height_STD_V_1 : 1323|1@1+ (1,0) [0|1] "bool" MCU
 SG_ OBJ_Abs_Long_Velocity_1 : 1324|12@1+ (0.05,-100) [-100|100] "m_per_s" MCU
 SG_ OBJ_Abs_Long_Velocity_V_1 : 1336|1@1+ (1,0) [0|1] "bool" MCU
 SG_ Reserved_6_1 : 1337|7@1+ (1,0) [0|0] "NA" MCU
 SG_ OBJ_Abs_Long_Velocity_STD_1 : 1344|13@1+ (0.01,0) [0|65] "m_per_s" MCU
 SG_ OBJ_Abs_Long_Vel_STD_V_1 : 1357|1@1+ (1,0) [0|1] "bool" MCU
 SG_ OBJ_Abs_Lat_Velocity_1 : 1358|11@1+ (0.05,-50) [-50|50] "m_per_s" MCU
 SG_ OBJ_Abs_Lat_Velocity_V_1 : 1369|1@1+ (1,0) [0|1] "bool" MCU
 SG_ Reserved_7_1 : 1370|6@1+ (1,0) [0|0] "NA" MCU
 SG_ OBJ_Abs_Lat_Velocity_STD_1 : 1376|13@1+ (0.01,0) [0|50] "m_per_s" MCU
 SG_ OBJ_Abs_Lat_Vel_STD_V_1 : 1389|1@1+ (1,0) [0|1] "bool" MCU
 SG_ OBJ_Abs_Long_Acc_1 : 1390|9@1+ (0.05,-10) [-10|10] "m_per_s2" MCU
 SG_ OBJ_Abs_Long_Acc_V_1 : 1399|1@1+ (1,0) [0|1] "bool" MCU
 SG_ Reserved_8_1 : 1400|8@1+ (1,0) [0|0] "NA" MCU
 SG_ OBJ_Abs_Long_Acc_STD_1 : 1408|10@1+ (0.01,0) [0|7.3] "m_per_s2" MCU
 SG_ OBJ_Abs_Long_Acc_STD_V_1 : 1418|1@1+ (1,0) [0|1] "bool" MCU
 SG_ OBJ_Abs_Lat_Acc_1 : 1419|9@1+ (0.05,-10) [-10|10] "m_per_s2" MCU
 SG_ OBJ_Abs_Lat_Acc_V_1 : 1428|1@1+ (1,0) [0|1] "bool" MCU
 SG_ OBJ_Abs_Lat_Acc_STD_1 : 1429|10@1+ (0.01,0) [0|7.3] "m_per_s2" MCU
 SG_ OBJ_Abs_Lat_Acc_STD_V_1 : 1439|1@1+ (1,0) [0|1] "bool" MCU
 SG_ OBJ_Abs_Acceleration_1 : 1440|9@1+ (0.05,-12.7) [-12.7|12.7] "m_per_s2" MCU
 SG_ OBJ_Abs_Acceleration_V_1 : 1449|1@1+ (1,0) [0|1] "bool" MCU
 SG_ OBJ_Abs_Acc_STD_1 : 1450|10@1+ (0.01,0) [0|7.3] "m_per_s2" MCU
 SG_ OBJ_Abs_Acc_STD_V_1 : 1460|1@1+ (1,0) [0|1] "bool" MCU
 SG_ OBJ_Inv_TTC_1 : 1461|11@1+ (0.01,-8) [-8|8] "INV(s)" MCU
 SG_ OBJ_Inv_TTC_V_1 : 1472|1@1+ (1,0) [0|1] "bool" MCU
 SG_ OBJ_Inv_TTC_STD_1 : 1473|12@1+ (0.001,0) [0|4] "INV(s)" MCU
 SG_ OBJ_Inv_TTC_STD_V_1 : 1485|1@1+ (1,0) [0|1] "bool" MCU
 SG_ OBJ_Relative_Long_Acc_1 : 1486|10@1+ (0.05,-20) [-20|20] "m_per_s2" MCU
 SG_ OBJ_Relative_Long_Acc_V_1 : 1496|1@1+ (1,0) [0|1] "bool" MCU
 SG_ Reserved_9_1 : 1497|7@1+ (1,0) [0|0] "NA" MCU
 SG_ OBJ_Relative_Long_Acc_STD_1 : 1504|10@1+ (0.01,0) [0|7.3] "m_per_s2" MCU
 SG_ OBJ_Rel_Long_Acc_STD_V_1 : 1514|1@1+ (1,0) [0|1] "bool" MCU
 SG_ OBJ_Relative_Long_Velocity_1 : 1515|13@1+ (0.05,-120) [-120|130] "m_per_s" MCU
 SG_ OBJ_Relative_Long_Velocity_V_1 : 1528|1@1+ (1,0) [0|1] "bool" MCU
 SG_ Reserved_10_1 : 1529|7@1+ (1,0) [0|0] "NA" MCU
 SG_ OBJ_Relative_Long_Vel_STD_1 : 1536|14@1+ (0.01,0) [0|130] "m_per_s" MCU
 SG_ OBJ_Rel_Long_Vel_STD_V_1 : 1550|1@1+ (1,0) [0|1] "bool" MCU
 SG_ OBJ_Relative_Lat_Velocity_1 : 1551|11@1+ (0.05,-50) [-50|50] "m_per_s" MCU
 SG_ OBJ_Relative_Lat_Velocity_V_1 : 1562|1@1+ (1,0) [0|1] "bool" MCU
 SG_ Reserved_11_1 : 1563|5@1+ (1,0) [0|0] "NA" MCU
 SG_ OBJ_Relative_Lat_Velocity_STD_1 : 1568|13@1+ (0.01,0) [0|50] "m_per_s" MCU
 SG_ OBJ_Rel_Lat_Vel_STD_V_1 : 1581|1@1+ (1,0) [0|1] "bool" MCU
 SG_ OBJ_Long_Distance_1 : 1582|14@1+ (0.05,-200) [-200|500] "m" MCU
 SG_ OBJ_Long_Distance_V_1 : 1596|1@1+ (1,0) [0|1] "bool" MCU
 SG_ Reserved_12_1 : 1597|3@1+ (1,0) [0|0] "NA" MCU
 SG_ OBJ_Long_Distance_STD_1 : 1600|15@1+ (0.01,0) [0|250] "m" MCU
 SG_ OBJ_Long_Distance_STD_V_1 : 1615|1@1+ (1,0) [0|1] "bool" MCU
 SG_ OBJ_Lat_Distance_1 : 1616|12@1+ (0.05,-100) [-100|100] "m" MCU
 SG_ OBJ_Lat_Distance_V_1 : 1628|1@1+ (1,0) [0|1] "bool" MCU
 SG_ Reserved_13_1 : 1629|3@1+ (1,0) [0|0] "NA" MCU
 SG_ OBJ_Lat_Distance_STD_1 : 1632|14@1+ (0.01,0) [0|100] "m" MCU
 SG_ OBJ_Lat_Distance_STD_V_1 : 1646|1@1+ (1,0) [0|1] "bool" MCU
 SG_ OBJ_Absolute_Speed_1 : 1647|12@1+ (0.05,-65) [-65|65] "m_per_s" MCU
 SG_ OBJ_Absolute_Speed_V_1 : 1659|1@1+ (1,0) [0|1] "bool" MCU
 SG_ Reserved_14_1 : 1660|4@1+ (1,0) [0|0] "NA" MCU
 SG_ OBJ_Absolute_Speed_STD_1 : 1664|13@1+ (0.01,0) [0|65] "m_per_s" MCU
 SG_ OBJ_Absolute_Speed_STD_V_1 : 1677|1@1+ (1,0) [0|1] "bool" MCU
 SG_ OBJ_Heading_1 : 1678|10@1+ (0.01,-3.14) [-3.14|3.14] "rad" MCU
 SG_ OBJ_Heading_V_1 : 1688|1@1+ (1,0) [0|1] "bool" MCU
 SG_ Reserved_15_1 : 1689|7@1+ (1,0) [0|0] "NA" MCU
 SG_ OBJ_Heading_STD_1 : 1696|15@1+ (0.0001,0) [0|3.14] "rad" MCU
 SG_ OBJ_Heading_STD_V_1 : 1711|1@1+ (1,0) [0|1] "bool" MCU
 SG_ OBJ_Angle_Rate_STD_1 : 1712|15@1+ (0.0001,0) [0|2.2318] "RPS" MCU
 SG_ OBJ_Angle_Rate_STD_V_1 : 1727|1@1+ (1,0) [0|1] "bool" MCU
 SG_ OBJ_Angle_Rate_1 : 1728|12@1+ (0.002,-2.234) [-2.234|2.2318] "RPS" MCU
 SG_ OBJ_Angle_Rate_V_1 : 1740|1@1+ (1,0) [0|1] "bool" MCU
 SG_ OBJ_Angle_Right_1 : 1741|14@1+ (0.0002,-1.571) [-1.571|1.571] "rad" MCU
 SG_ OBJ_Angle_Right_V_1 : 1755|1@1+ (1,0) [0|1] "bool" MCU
 SG_ Reserved_16_1 : 1756|4@1+ (1,0) [0|0] "NA" MCU
 SG_ OBJ_Angle_Right_STD_1 : 1760|14@1+ (0.0001,0) [0|1.571] "rad" MCU
 SG_ OBJ_Angle_Right_STD_V_1 : 1774|1@1+ (1,0) [0|1] "bool" MCU
 SG_ OBJ_Angle_Left_1 : 1775|14@1+ (0.0002,-1.571) [-1.571|1.571] "rad" MCU
 SG_ OBJ_Angle_Left_V_1 : 1789|1@1+ (1,0) [0|1] "bool" MCU
 SG_ Reserved_17_1 : 1790|2@1+ (1,0) [0|0] "NA" MCU
 SG_ OBJ_Angle_Left_STD_1 : 1792|14@1+ (0.0001,0) [0|1.571] "rad" MCU
 SG_ OBJ_Angle_Left_STD_V_1 : 1806|1@1+ (1,0) [0|1] "bool" MCU
 SG_ OBJ_Angle_Side_1 : 1807|14@1+ (0.0002,-1.571) [-1.571|1.571] "rad" MCU
 SG_ OBJ_Angle_Side_V_1 : 1821|1@1+ (1,0) [0|1] "bool" MCU
 SG_ Reserved_18_1 : 1822|2@1+ (1,0) [0|0] "NA" MCU
 SG_ OBJ_Angle_Side_STD_1 : 1824|14@1+ (0.0001,0) [0|1.571] "rad" MCU
 SG_ OBJ_Angle_Side_STD_V_1 : 1838|1@1+ (1,0) [0|1] "bool" MCU
 SG_ OBJ_Angle_Mid_V_1 : 1839|1@1+ (1,0) [0|1] "bool" MCU
 SG_ OBJ_Angle_Mid_1 : 1840|14@1+ (0.0002,-1.571) [-1.571|1.571] "rad" MCU
 SG_ Reserved_19_1 : 1854|2@1+ (1,0) [0|0] "NA" MCU
 SG_ OBJ_Angle_Mid_STD_1 : 1856|14@1+ (0.0001,0) [0|1.571] "rad" MCU
 SG_ OBJ_Angle_Mid_STD_V_1 : 1870|1@1+ (1,0) [0|1] "bool" MCU
 SG_ OBJ_Angle_Bottom_V_1 : 1871|1@1+ (1,0) [0|1] "bool" MCU
 SG_ OBJ_Angle_Bottom_1 : 1872|14@1+ (0.0002,-1.571) [-1.571|1.571] "rad" MCU
 SG_ Reserved_20_1 : 1886|2@1+ (1,0) [0|0] "NA" MCU
 SG_ OBJ_Angle_Bottom_STD_1 : 1888|14@1+ (0.0001,0) [0|1.571] "rad" MCU
 SG_ OBJ_Angle_Bottom_STD_V_1 : 1902|1@1+ (1,0) [0|1] "bool" MCU
 SG_ OBJ_Visibility_Side_V_1 : 1903|1@1+ (1,0) [0|1] "bool" MCU
 SG_ OBJ_Visibility_Side_1 : 1904|2@1+ (1,0) [0|2] "ENUM" MCU
 SG_ OBJ_Is_In_Drivable_Area_1 : 1906|1@1+ (1,0) [0|1] "bool" MCU
 SG_ OBJ_Is_In_Drivable_Area_V_1 : 1907|1@1+ (1,0) [0|1] "bool" MCU
 SG_ OBJ_Is_VeryClose_V_1 : 1908|1@1+ (1,0) [0|1] "bool" MCU
 SG_ OBJ_Is_VeryClose_1 : 1909|1@1+ (1,0) [0|1] "bool" MCU
 SG_ OBJ_Buffer_C4_1 : 1910|2@1+ (1,0) [0|2] "NA" MCU
 SG_ OBJ_Buffer_C5_1 : 1912|2@1+ (1,0) [0|2] "NA" MCU
 SG_ OBJ_Buffer_C6_1 : 1914|2@1+ (1,0) [0|2] "NA" MCU
 SG_ OBJ_Buffer_C7_1 : 1916|2@1+ (1,0) [0|2] "NA" MCU
 SG_ Reserved_21_1 : 1918|2@1+ (1,0) [0|0] "NA" MCU
 SG_ OBJ_OverlapAngleEgoLaneR_1 : 1920|10@1+ (0.01,-3.14) [-3.14|3.14] "rad" MCU
 SG_ OBJ_OverlapAngleEgoLaneR_V_1 : 1930|1@1+ (1,0) [0|1] "bool" MCU
 SG_ OBJ_OverlapAngleEgoLaneL_1 : 1931|10@1+ (0.01,-3.14) [-3.14|3.14] "rad" MCU
 SG_ OBJ_OverlapAngleEgoLaneL_V_1 : 1941|1@1+ (1,0) [0|1] "bool" MCU
 SG_ OBJ_Is_EMERGENCY_VCL_1 : 1942|1@1+ (1,0) [0|1] "bool" MCU
 SG_ OBJ_EMERGENCY_LIGHT_COLOR_1 : 1943|4@1+ (1,0) [0|15] "BITWIZE" MCU
 SG_ OBJ_EMERGENCY_V_1 : 1947|1@1+ (1,0) [0|1] "bool" MCU
 SG_ Reserved_22_1 : 1948|4@1+ (1,0) [0|0] "NA" MCU
 SG_ OBJ_Angle_Top_1 : 1952|14@1+ (0.0002,0) [0|3.1415] "rad" MCU
 SG_ OBJ_Angle_Top_V_1 : 1966|1@1+ (1,0) [0|1] "bool" MCU
 SG_ OBJ_Angle_Top_STD_1 : 1967|15@1+ (0.0001,0) [0|3.1415] "rad" MCU
 SG_ OBJ_Angle_Top_STD_V_1 : 1982|1@1+ (1,0) [0|1] "bool" MCU
 SG_ OBJ_Buffer_C14_1 : 1983|1@1+ (1,0) [0|1] "NA" MCU
 SG_ OBJ_Buffer_C15_1 : 1984|1@1+ (1,0) [0|1] "NA" MCU
 SG_ OBJ_Buffer_C18_1 : 1985|2@1+ (1,0) [0|2] "NA" MCU
 SG_ OBJ_Buffer_C19_1 : 1987|1@1+ (1,0) [0|1] "NA" MCU
 SG_ Reserved_23_1 : 1988|28@1+ (1,0) [0|0] "NA" MCU
 SG_ OBJ_CRC_2 : 2016|32@1+ (1,0) [0|4294967295] "NA" MCU
 SG_ OBJ_ID_2 : 2048|8@1+ (1,0) [0|255] "counter" MCU
 SG_ OBJ_Existence_Probability_2 : 2056|8@1+ (0.01,0) [0|1] "NA" MCU
 SG_ OBJ_Fusion_Source_2 : 2064|16@1+ (1,0) [0|65535] "BITWIZE" MCU
 SG_ OBJ_Triggered_SDM_2 : 2080|2@1+ (1,0) [0|2] "ENUM" MCU
 SG_ OBJ_Motion_Category_2 : 2082|4@1+ (1,0) [0|13] "ENUM" MCU
 SG_ OBJ_Buffer_C0_2 : 2086|7@1+ (0.01,0) [0|1] "NA" MCU
 SG_ OBJ_Object_Age_2 : 2093|11@1+ (1,0) [0|2047] "frames" MCU
 SG_ OBJ_Measuring_Status_2 : 2104|3@1+ (1,0) [0|7] "BITWIZE" MCU
 SG_ OBJ_Object_Class_2 : 2107|4@1+ (1,0) [0|8] "ENUM" MCU
 SG_ Reserved_4_2 : 2111|1@1+ (1,0) [0|0] "NA" MCU
 SG_ OBJ_Class_Probability_2 : 2112|7@1+ (0.01,0) [0|1] "NA" MCU
 SG_ OBJ_Car_Probability_2 : 2119|7@1+ (0.01,0) [0|1] "NA" MCU
 SG_ OBJ_Truck_Probability_2 : 2126|7@1+ (0.01,0) [0|1] "NA" MCU
 SG_ OBJ_Bike_Probability_2 : 2133|7@1+ (0.01,0) [0|1] "NA" MCU
 SG_ OBJ_Camera_Source_2 : 2140|4@1+ (1,0) [0|15] "ENUM" MCU
 SG_ OBJ_Motion_Status_2 : 2144|3@1+ (1,0) [0|5] "ENUM" MCU
 SG_ OBJ_Motion_Orientation_2 : 2147|4@1+ (1,0) [0|13] "ENUM" MCU
 SG_ OBJ_Has_Cut_Lane_2 : 2151|1@1+ (1,0) [0|1] "bool" MCU
 SG_ OBJ_Has_Cut_Path_2 : 2152|1@1+ (1,0) [0|1] "bool" MCU
 SG_ OBJ_Brake_Light_2 : 2153|1@1+ (1,0) [0|1] "bool" MCU
 SG_ OBJ_Turn_Indicator_Right_2 : 2154|1@1+ (1,0) [0|1] "bool" MCU
 SG_ OBJ_Turn_Indicator_Left_2 : 2155|1@1+ (1,0) [0|1] "bool" MCU
 SG_ OBJ_Light_Indicator_Validity_2 : 2156|1@1+ (1,0) [0|1] "bool" MCU
 SG_ OBJ_Right_Out_Of_Image_2 : 2157|1@1+ (1,0) [0|1] "bool" MCU
 SG_ OBJ_Left_Out_Of_Image_2 : 2158|1@1+ (1,0) [0|1] "bool" MCU
 SG_ OBJ_Right_Out_Of_Image_V_2 : 2159|1@1+ (1,0) [0|1] "bool" MCU
 SG_ OBJ_Left_Out_Of_Image_V_2 : 2160|1@1+ (1,0) [0|1] "bool" MCU
 SG_ OBJ_Top_Out_Of_Image_2 : 2161|1@1+ (1,0) [0|1] "bool" MCU
 SG_ OBJ_Bottom_Out_Of_Image_2 : 2162|1@1+ (1,0) [0|1] "bool" MCU
 SG_ OBJ_Top_Out_Of_Image_V_2 : 2163|1@1+ (1,0) [0|1] "bool" MCU
 SG_ OBJ_Bottom_Out_Of_Image_V_2 : 2164|1@1+ (1,0) [0|1] "bool" MCU
 SG_ OBJ_Lane_Assignment_2 : 2165|3@1+ (1,0) [0|5] "ENUM" MCU
 SG_ OBJ_Lane_Assignment_V_2 : 2168|1@1+ (1,0) [0|1] "bool" MCU
 SG_ OBJ_Age_Seconds_2 : 2169|7@1+ (1,0) [0|100] "s" MCU
 SG_ OBJ_Age_Seconds_V_2 : 2176|1@1+ (1,0) [0|1] "bool" MCU
 SG_ OBJ_Width_2 : 2177|9@1+ (0.01,0) [0.4|2.95] "m" MCU
 SG_ OBJ_Width_V_2 : 2186|1@1+ (1,0) [0|1] "bool" MCU
 SG_ OBJ_Width_STD_2 : 2187|11@1+ (0.001,0) [0|2] "m" MCU
 SG_ OBJ_Width_STD_V_2 : 2198|1@1+ (1,0) [0|1] "bool" MCU
 SG_ OBJ_Length_2 : 2199|9@1+ (0.05,0) [1.2|21] "m" MCU
 SG_ OBJ_Length_V_2 : 2208|1@1+ (1,0) [0|1] "bool" MCU
 SG_ OBJ_Length_STD_2 : 2209|10@1+ (0.01,0) [0|10] "m" MCU
 SG_ OBJ_Length_STD_V_2 : 2219|1@1+ (1,0) [0|1] "bool" MCU
 SG_ OBJ_Radar_ID_2 : 2220|8@1+ (1,0) [0|255] "counter" MCU
 SG_ OBJ_Height_2 : 2228|9@1+ (0.01,0) [0|2.95] "m" MCU
 SG_ OBJ_Height_V_2 : 2237|1@1+ (1,0) [0|1] "bool" MCU
 SG_ Reserved_5_2 : 2238|2@1+ (1,0) [0|0] "NA" MCU
 SG_ OBJ_Height_STD_2 : 2240|11@1+ (0.001,0) [0|2] "m" MCU
 SG_ OBJ_Height_STD_V_2 : 2251|1@1+ (1,0) [0|1] "bool" MCU
 SG_ OBJ_Abs_Long_Velocity_2 : 2252|12@1+ (0.05,-100) [-100|100] "m_per_s" MCU
 SG_ OBJ_Abs_Long_Velocity_V_2 : 2264|1@1+ (1,0) [0|1] "bool" MCU
 SG_ Reserved_6_2 : 2265|7@1+ (1,0) [0|0] "NA" MCU
 SG_ OBJ_Abs_Long_Velocity_STD_2 : 2272|13@1+ (0.01,0) [0|65] "m_per_s" MCU
 SG_ OBJ_Abs_Long_Vel_STD_V_2 : 2285|1@1+ (1,0) [0|1] "bool" MCU
 SG_ OBJ_Abs_Lat_Velocity_2 : 2286|11@1+ (0.05,-50) [-50|50] "m_per_s" MCU
 SG_ OBJ_Abs_Lat_Velocity_V_2 : 2297|1@1+ (1,0) [0|1] "bool" MCU
 SG_ Reserved_7_2 : 2298|6@1+ (1,0) [0|0] "NA" MCU
 SG_ OBJ_Abs_Lat_Velocity_STD_2 : 2304|13@1+ (0.01,0) [0|50] "m_per_s" MCU
 SG_ OBJ_Abs_Lat_Vel_STD_V_2 : 2317|1@1+ (1,0) [0|1] "bool" MCU
 SG_ OBJ_Abs_Long_Acc_2 : 2318|9@1+ (0.05,-10) [-10|10] "m_per_s2" MCU
 SG_ OBJ_Abs_Long_Acc_V_2 : 2327|1@1+ (1,0) [0|1] "bool" MCU
 SG_ Reserved_8_2 : 2328|8@1+ (1,0) [0|0] "NA" MCU
 SG_ OBJ_Abs_Long_Acc_STD_2 : 2336|10@1+ (0.01,0) [0|7.3] "m_per_s2" MCU
 SG_ OBJ_Abs_Long_Acc_STD_V_2 : 2346|1@1+ (1,0) [0|1] "bool" MCU
 SG_ OBJ_Abs_Lat_Acc_2 : 2347|9@1+ (0.05,-10) [-10|10] "m_per_s2" MCU
 SG_ OBJ_Abs_Lat_Acc_V_2 : 2356|1@1+ (1,0) [0|1] "bool" MCU
 SG_ OBJ_Abs_Lat_Acc_STD_2 : 2357|10@1+ (0.01,0) [0|7.3] "m_per_s2" MCU
 SG_ OBJ_Abs_Lat_Acc_STD_V_2 : 2367|1@1+ (1,0) [0|1] "bool" MCU
 SG_ OBJ_Abs_Acceleration_2 : 2368|9@1+ (0.05,-12.7) [-12.7|12.7] "m_per_s2" MCU
 SG_ OBJ_Abs_Acceleration_V_2 : 2377|1@1+ (1,0) [0|1] "bool" MCU
 SG_ OBJ_Abs_Acc_STD_2 : 2378|10@1+ (0.01,0) [0|7.3] "m_per_s2" MCU
 SG_ OBJ_Abs_Acc_STD_V_2 : 2388|1@1+ (1,0) [0|1] "bool" MCU
 SG_ OBJ_Inv_TTC_2 : 2389|11@1+ (0.01,-8) [-8|8] "INV(s)" MCU
 SG_ OBJ_Inv_TTC_V_2 : 2400|1@1+ (1,0) [0|1] "bool" MCU
 SG_ OBJ_Inv_TTC_STD_2 : 2401|12@1+ (0.001,0) [0|4] "INV(s)" MCU
 SG_ OBJ_Inv_TTC_STD_V_2 : 2413|1@1+ (1,0) [0|1] "bool" MCU
 SG_ OBJ_Relative_Long_Acc_2 : 2414|10@1+ (0.05,-20) [-20|20] "m_per_s2" MCU
 SG_ OBJ_Relative_Long_Acc_V_2 : 2424|1@1+ (1,0) [0|1] "bool" MCU
 SG_ Reserved_9_2 : 2425|7@1+ (1,0) [0|0] "NA" MCU
 SG_ OBJ_Relative_Long_Acc_STD_2 : 2432|10@1+ (0.01,0) [0|7.3] "m_per_s2" MCU
 SG_ OBJ_Rel_Long_Acc_STD_V_2 : 2442|1@1+ (1,0) [0|1] "bool" MCU
 SG_ OBJ_Relative_Long_Velocity_2 : 2443|13@1+ (0.05,-120) [-120|130] "m_per_s" MCU
 SG_ OBJ_Relative_Long_Velocity_V_2 : 2456|1@1+ (1,0) [0|1] "bool" MCU
 SG_ Reserved_10_2 : 2457|7@1+ (1,0) [0|0] "NA" MCU
 SG_ OBJ_Relative_Long_Vel_STD_2 : 2464|14@1+ (0.01,0) [0|130] "m_per_s" MCU
 SG_ OBJ_Rel_Long_Vel_STD_V_2 : 2478|1@1+ (1,0) [0|1] "bool" MCU
 SG_ OBJ_Relative_Lat_Velocity_2 : 2479|11@1+ (0.05,-50) [-50|50] "m_per_s" MCU
 SG_ OBJ_Relative_Lat_Velocity_V_2 : 2490|1@1+ (1,0) [0|1] "bool" MCU
 SG_ Reserved_11_2 : 2491|5@1+ (1,0) [0|0] "NA" MCU
 SG_ OBJ_Relative_Lat_Velocity_STD_2 : 2496|13@1+ (0.01,0) [0|50] "m_per_s" MCU
 SG_ OBJ_Rel_Lat_Vel_STD_V_2 : 2509|1@1+ (1,0) [0|1] "bool" MCU
 SG_ OBJ_Long_Distance_2 : 2510|14@1+ (0.05,-200) [-200|500] "m" MCU
 SG_ OBJ_Long_Distance_V_2 : 2524|1@1+ (1,0) [0|1] "bool" MCU
 SG_ Reserved_12_2 : 2525|3@1+ (1,0) [0|0] "NA" MCU
 SG_ OBJ_Long_Distance_STD_2 : 2528|15@1+ (0.01,0) [0|250] "m" MCU
 SG_ OBJ_Long_Distance_STD_V_2 : 2543|1@1+ (1,0) [0|1] "bool" MCU
 SG_ OBJ_Lat_Distance_2 : 2544|12@1+ (0.05,-100) [-100|100] "m" MCU
 SG_ OBJ_Lat_Distance_V_2 : 2556|1@1+ (1,0) [0|1] "bool" MCU
 SG_ Reserved_13_2 : 2557|3@1+ (1,0) [0|0] "NA" MCU
 SG_ OBJ_Lat_Distance_STD_2 : 2560|14@1+ (0.01,0) [0|100] "m" MCU
 SG_ OBJ_Lat_Distance_STD_V_2 : 2574|1@1+ (1,0) [0|1] "bool" MCU
 SG_ OBJ_Absolute_Speed_2 : 2575|12@1+ (0.05,-65) [-65|65] "m_per_s" MCU
 SG_ OBJ_Absolute_Speed_V_2 : 2587|1@1+ (1,0) [0|1] "bool" MCU
 SG_ Reserved_14_2 : 2588|4@1+ (1,0) [0|0] "NA" MCU
 SG_ OBJ_Absolute_Speed_STD_2 : 2592|13@1+ (0.01,0) [0|65] "m_per_s" MCU
 SG_ OBJ_Absolute_Speed_STD_V_2 : 2605|1@1+ (1,0) [0|1] "bool" MCU
 SG_ OBJ_Heading_2 : 2606|10@1+ (0.01,-3.14) [-3.14|3.14] "rad" MCU
 SG_ OBJ_Heading_V_2 : 2616|1@1+ (1,0) [0|1] "bool" MCU
 SG_ Reserved_15_2 : 2617|7@1+ (1,0) [0|0] "NA" MCU
 SG_ OBJ_Heading_STD_2 : 2624|15@1+ (0.0001,0) [0|3.14] "rad" MCU
 SG_ OBJ_Heading_STD_V_2 : 2639|1@1+ (1,0) [0|1] "bool" MCU
 SG_ OBJ_Angle_Rate_STD_2 : 2640|15@1+ (0.0001,0) [0|2.2318] "RPS" MCU
 SG_ OBJ_Angle_Rate_STD_V_2 : 2655|1@1+ (1,0) [0|1] "bool" MCU
 SG_ OBJ_Angle_Rate_2 : 2656|12@1+ (0.002,-2.234) [-2.234|2.2318] "RPS" MCU
 SG_ OBJ_Angle_Rate_V_2 : 2668|1@1+ (1,0) [0|1] "bool" MCU
 SG_ OBJ_Angle_Right_2 : 2669|14@1+ (0.0002,-1.571) [-1.571|1.571] "rad" MCU
 SG_ OBJ_Angle_Right_V_2 : 2683|1@1+ (1,0) [0|1] "bool" MCU
 SG_ Reserved_16_2 : 2684|4@1+ (1,0) [0|0] "NA" MCU
 SG_ OBJ_Angle_Right_STD_2 : 2688|14@1+ (0.0001,0) [0|1.571] "rad" MCU
 SG_ OBJ_Angle_Right_STD_V_2 : 2702|1@1+ (1,0) [0|1] "bool" MCU
 SG_ OBJ_Angle_Left_2 : 2703|14@1+ (0.0002,-1.571) [-1.571|1.571] "rad" MCU
 SG_ OBJ_Angle_Left_V_2 : 2717|1@1+ (1,0) [0|1] "bool" MCU
 SG_ Reserved_17_2 : 2718|2@1+ (1,0) [0|0] "NA" MCU
 SG_ OBJ_Angle_Left_STD_2 : 2720|14@1+ (0.0001,0) [0|1.571] "rad" MCU
 SG_ OBJ_Angle_Left_STD_V_2 : 2734|1@1+ (1,0) [0|1] "bool" MCU
 SG_ OBJ_Angle_Side_2 : 2735|14@1+ (0.0002,-1.571) [-1.571|1.571] "rad" MCU
 SG_ OBJ_Angle_Side_V_2 : 2749|1@1+ (1,0) [0|1] "bool" MCU
 SG_ Reserved_18_2 : 2750|2@1+ (1,0) [0|0] "NA" MCU
 SG_ OBJ_Angle_Side_STD_2 : 2752|14@1+ (0.0001,0) [0|1.571] "rad" MCU
 SG_ OBJ_Angle_Side_STD_V_2 : 2766|1@1+ (1,0) [0|1] "bool" MCU
 SG_ OBJ_Angle_Mid_V_2 : 2767|1@1+ (1,0) [0|1] "bool" MCU
 SG_ OBJ_Angle_Mid_2 : 2768|14@1+ (0.0002,-1.571) [-1.571|1.571] "rad" MCU
 SG_ Reserved_19_2 : 2782|2@1+ (1,0) [0|0] "NA" MCU
 SG_ OBJ_Angle_Mid_STD_2 : 2784|14@1+ (0.0001,0) [0|1.571] "rad" MCU
 SG_ OBJ_Angle_Mid_STD_V_2 : 2798|1@1+ (1,0) [0|1] "bool" MCU
 SG_ OBJ_Angle_Bottom_V_2 : 2799|1@1+ (1,0) [0|1] "bool" MCU
 SG_ OBJ_Angle_Bottom_2 : 2800|14@1+ (0.0002,-1.571) [-1.571|1.571] "rad" MCU
 SG_ Reserved_20_2 : 2814|2@1+ (1,0) [0|0] "NA" MCU
 SG_ OBJ_Angle_Bottom_STD_2 : 2816|14@1+ (0.0001,0) [0|1.571] "rad" MCU
 SG_ OBJ_Angle_Bottom_STD_V_2 : 2830|1@1+ (1,0) [0|1] "bool" MCU
 SG_ OBJ_Visibility_Side_V_2 : 2831|1@1+ (1,0) [0|1] "bool" MCU
 SG_ OBJ_Visibility_Side_2 : 2832|2@1+ (1,0) [0|2] "ENUM" MCU
 SG_ OBJ_Is_In_Drivable_Area_2 : 2834|1@1+ (1,0) [0|1] "bool" MCU
 SG_ OBJ_Is_In_Drivable_Area_V_2 : 2835|1@1+ (1,0) [0|1] "bool" MCU
 SG_ OBJ_Is_VeryClose_V_2 : 2836|1@1+ (1,0) [0|1] "bool" MCU
 SG_ OBJ_Is_VeryClose_2 : 2837|1@1+ (1,0) [0|1] "bool" MCU
 SG_ OBJ_Buffer_C4_2 : 2838|2@1+ (1,0) [0|2] "NA" MCU
 SG_ OBJ_Buffer_C5_2 : 2840|2@1+ (1,0) [0|2] "NA" MCU
 SG_ OBJ_Buffer_C6_2 : 2842|2@1+ (1,0) [0|2] "NA" MCU
 SG_ OBJ_Buffer_C7_2 : 2844|2@1+ (1,0) [0|2] "NA" MCU
 SG_ Reserved_21_2 : 2846|2@1+ (1,0) [0|0] "NA" MCU
 SG_ OBJ_OverlapAngleEgoLaneR_2 : 2848|10@1+ (0.01,-3.14) [-3.14|3.14] "rad" MCU
 SG_ OBJ_OverlapAngleEgoLaneR_V_2 : 2858|1@1+ (1,0) [0|1] "bool" MCU
 SG_ OBJ_OverlapAngleEgoLaneL_2 : 2859|10@1+ (0.01,-3.14) [-3.14|3.14] "rad" MCU
 SG_ OBJ_OverlapAngleEgoLaneL_V_2 : 2869|1@1+ (1,0) [0|1] "bool" MCU
 SG_ OBJ_Is_EMERGENCY_VCL_2 : 2870|1@1+ (1,0) [0|1] "bool" MCU
 SG_ OBJ_EMERGENCY_LIGHT_COLOR_2 : 2871|4@1+ (1,0) [0|15] "BITWIZE" MCU
 SG_ OBJ_EMERGENCY_V_2 : 2875|1@1+ (1,0) [0|1] "bool" MCU
 SG_ Reserved_22_2 : 2876|4@1+ (1,0) [0|0] "NA" MCU
 SG_ OBJ_Angle_Top_2 : 2880|14@1+ (0.0002,0) [0|3.1415] "rad" MCU
 SG_ OBJ_Angle_Top_V_2 : 2894|1@1+ (1,0) [0|1] "bool" MCU
 SG_ OBJ_Angle_Top_STD_2 : 2895|15@1+ (0.0001,0) [0|3.1415] "rad" MCU
 SG_ OBJ_Angle_Top_STD_V_2 : 2910|1@1+ (1,0) [0|1] "bool" MCU
 SG_ OBJ_Buffer_C14_2 : 2911|1@1+ (1,0) [0|1] "NA" MCU
 SG_ OBJ_Buffer_C15_2 : 2912|1@1+ (1,0) [0|1] "NA" MCU
 SG_ OBJ_Buffer_C18_2 : 2913|2@1+ (1,0) [0|2] "NA" MCU
 SG_ OBJ_Buffer_C19_2 : 2915|1@1+ (1,0) [0|1] "NA" MCU
 SG_ Reserved_23_2 : 2916|28@1+ (1,0) [0|0] "NA" MCU
 SG_ OBJ_CRC_3 : 2944|32@1+ (1,0) [0|4294967295] "NA" MCU
 SG_ OBJ_ID_3 : 2976|8@1+ (1,0) [0|255] "counter" MCU
 SG_ OBJ_Existence_Probability_3 : 2984|8@1+ (0.01,0) [0|1] "NA" MCU
 SG_ OBJ_Fusion_Source_3 : 2992|16@1+ (1,0) [0|65535] "BITWIZE" MCU
 SG_ OBJ_Triggered_SDM_3 : 3008|2@1+ (1,0) [0|2] "ENUM" MCU
 SG_ OBJ_Motion_Category_3 : 3010|4@1+ (1,0) [0|13] "ENUM" MCU
 SG_ OBJ_Buffer_C0_3 : 3014|7@1+ (0.01,0) [0|1] "NA" MCU
 SG_ OBJ_Object_Age_3 : 3021|11@1+ (1,0) [0|2047] "frames" MCU
 SG_ OBJ_Measuring_Status_3 : 3032|3@1+ (1,0) [0|7] "BITWIZE" MCU
 SG_ OBJ_Object_Class_3 : 3035|4@1+ (1,0) [0|8] "ENUM" MCU
 SG_ Reserved_4_3 : 3039|1@1+ (1,0) [0|0] "NA" MCU
 SG_ OBJ_Class_Probability_3 : 3040|7@1+ (0.01,0) [0|1] "NA" MCU
 SG_ OBJ_Car_Probability_3 : 3047|7@1+ (0.01,0) [0|1] "NA" MCU
 SG_ OBJ_Truck_Probability_3 : 3054|7@1+ (0.01,0) [0|1] "NA" MCU
 SG_ OBJ_Bike_Probability_3 : 3061|7@1+ (0.01,0) [0|1] "NA" MCU
 SG_ OBJ_Camera_Source_3 : 3068|4@1+ (1,0) [0|15] "ENUM" MCU
 SG_ OBJ_Motion_Status_3 : 3072|3@1+ (1,0) [0|5] "ENUM" MCU
 SG_ OBJ_Motion_Orientation_3 : 3075|4@1+ (1,0) [0|13] "ENUM" MCU
 SG_ OBJ_Has_Cut_Lane_3 : 3079|1@1+ (1,0) [0|1] "bool" MCU
 SG_ OBJ_Has_Cut_Path_3 : 3080|1@1+ (1,0) [0|1] "bool" MCU
 SG_ OBJ_Brake_Light_3 : 3081|1@1+ (1,0) [0|1] "bool" MCU
 SG_ OBJ_Turn_Indicator_Right_3 : 3082|1@1+ (1,0) [0|1] "bool" MCU
 SG_ OBJ_Turn_Indicator_Left_3 : 3083|1@1+ (1,0) [0|1] "bool" MCU
 SG_ OBJ_Light_Indicator_Validity_3 : 3084|1@1+ (1,0) [0|1] "bool" MCU
 SG_ OBJ_Right_Out_Of_Image_3 : 3085|1@1+ (1,0) [0|1] "bool" MCU
 SG_ OBJ_Left_Out_Of_Image_3 : 3086|1@1+ (1,0) [0|1] "bool" MCU
 SG_ OBJ_Right_Out_Of_Image_V_3 : 3087|1@1+ (1,0) [0|1] "bool" MCU
 SG_ OBJ_Left_Out_Of_Image_V_3 : 3088|1@1+ (1,0) [0|1] "bool" MCU
 SG_ OBJ_Top_Out_Of_Image_3 : 3089|1@1+ (1,0) [0|1] "bool" MCU
 SG_ OBJ_Bottom_Out_Of_Image_3 : 3090|1@1+ (1,0) [0|1] "bool" MCU
 SG_ OBJ_Top_Out_Of_Image_V_3 : 3091|1@1+ (1,0) [0|1] "bool" MCU
 SG_ OBJ_Bottom_Out_Of_Image_V_3 : 3092|1@1+ (1,0) [0|1] "bool" MCU
 SG_ OBJ_Lane_Assignment_3 : 3093|3@1+ (1,0) [0|5] "ENUM" MCU
 SG_ OBJ_Lane_Assignment_V_3 : 3096|1@1+ (1,0) [0|1] "bool" MCU
 SG_ OBJ_Age_Seconds_3 : 3097|7@1+ (1,0) [0|100] "s" MCU
 SG_ OBJ_Age_Seconds_V_3 : 3104|1@1+ (1,0) [0|1] "bool" MCU
 SG_ OBJ_Width_3 : 3105|9@1+ (0.01,0) [0.4|2.95] "m" MCU
 SG_ OBJ_Width_V_3 : 3114|1@1+ (1,0) [0|1] "bool" MCU
 SG_ OBJ_Width_STD_3 : 3115|11@1+ (0.001,0) [0|2] "m" MCU
 SG_ OBJ_Width_STD_V_3 : 3126|1@1+ (1,0) [0|1] "bool" MCU
 SG_ OBJ_Length_3 : 3127|9@1+ (0.05,0) [1.2|21] "m" MCU
 SG_ OBJ_Length_V_3 : 3136|1@1+ (1,0) [0|1] "bool" MCU
 SG_ OBJ_Length_STD_3 : 3137|10@1+ (0.01,0) [0|10] "m" MCU
 SG_ OBJ_Length_STD_V_3 : 3147|1@1+ (1,0) [0|1] "bool" MCU
 SG_ OBJ_Radar_ID_3 : 3148|8@1+ (1,0) [0|255] "counter" MCU
 SG_ OBJ_Height_3 : 3156|9@1+ (0.01,0) [0|2.95] "m" MCU
 SG_ OBJ_Height_V_3 : 3165|1@1+ (1,0) [0|1] "bool" MCU
 SG_ Reserved_5_3 : 3166|2@1+ (1,0) [0|0] "NA" MCU
 SG_ OBJ_Height_STD_3 : 3168|11@1+ (0.001,0) [0|2] "m" MCU
 SG_ OBJ_Height_STD_V_3 : 3179|1@1+ (1,0) [0|1] "bool" MCU
 SG_ OBJ_Abs_Long_Velocity_3 : 3180|12@1+ (0.05,-100) [-100|100] "m_per_s" MCU
 SG_ OBJ_Abs_Long_Velocity_V_3 : 3192|1@1+ (1,0) [0|1] "bool" MCU
 SG_ Reserved_6_3 : 3193|7@1+ (1,0) [0|0] "NA" MCU
 SG_ OBJ_Abs_Long_Velocity_STD_3 : 3200|13@1+ (0.01,0) [0|65] "m_per_s" MCU
 SG_ OBJ_Abs_Long_Vel_STD_V_3 : 3213|1@1+ (1,0) [0|1] "bool" MCU
 SG_ OBJ_Abs_Lat_Velocity_3 : 3214|11@1+ (0.05,-50) [-50|50] "m_per_s" MCU
 SG_ OBJ_Abs_Lat_Velocity_V_3 : 3225|1@1+ (1,0) [0|1] "bool" MCU
 SG_ Reserved_7_3 : 3226|6@1+ (1,0) [0|0] "NA" MCU
 SG_ OBJ_Abs_Lat_Velocity_STD_3 : 3232|13@1+ (0.01,0) [0|50] "m_per_s" MCU
 SG_ OBJ_Abs_Lat_Vel_STD_V_3 : 3245|1@1+ (1,0) [0|1] "bool" MCU
 SG_ OBJ_Abs_Long_Acc_3 : 3246|9@1+ (0.05,-10) [-10|10] "m_per_s2" MCU
 SG_ OBJ_Abs_Long_Acc_V_3 : 3255|1@1+ (1,0) [0|1] "bool" MCU
 SG_ Reserved_8_3 : 3256|8@1+ (1,0) [0|0] "NA" MCU
 SG_ OBJ_Abs_Long_Acc_STD_3 : 3264|10@1+ (0.01,0) [0|7.3] "m_per_s2" MCU
 SG_ OBJ_Abs_Long_Acc_STD_V_3 : 3274|1@1+ (1,0) [0|1] "bool" MCU
 SG_ OBJ_Abs_Lat_Acc_3 : 3275|9@1+ (0.05,-10) [-10|10] "m_per_s2" MCU
 SG_ OBJ_Abs_Lat_Acc_V_3 : 3284|1@1+ (1,0) [0|1] "bool" MCU
 SG_ OBJ_Abs_Lat_Acc_STD_3 : 3285|10@1+ (0.01,0) [0|7.3] "m_per_s2" MCU
 SG_ OBJ_Abs_Lat_Acc_STD_V_3 : 3295|1@1+ (1,0) [0|1] "bool" MCU
 SG_ OBJ_Abs_Acceleration_3 : 3296|9@1+ (0.05,-12.7) [-12.7|12.7] "m_per_s2" MCU
 SG_ OBJ_Abs_Acceleration_V_3 : 3305|1@1+ (1,0) [0|1] "bool" MCU
 SG_ OBJ_Abs_Acc_STD_3 : 3306|10@1+ (0.01,0) [0|7.3] "m_per_s2" MCU
 SG_ OBJ_Abs_Acc_STD_V_3 : 3316|1@1+ (1,0) [0|1] "bool" MCU
 SG_ OBJ_Inv_TTC_3 : 3317|11@1+ (0.01,-8) [-8|8] "INV(s)" MCU
 SG_ OBJ_Inv_TTC_V_3 : 3328|1@1+ (1,0) [0|1] "bool" MCU
 SG_ OBJ_Inv_TTC_STD_3 : 3329|12@1+ (0.001,0) [0|4] "INV(s)" MCU
 SG_ OBJ_Inv_TTC_STD_V_3 : 3341|1@1+ (1,0) [0|1] "bool" MCU
 SG_ OBJ_Relative_Long_Acc_3 : 3342|10@1+ (0.05,-20) [-20|20] "m_per_s2" MCU
 SG_ OBJ_Relative_Long_Acc_V_3 : 3352|1@1+ (1,0) [0|1] "bool" MCU
 SG_ Reserved_9_3 : 3353|7@1+ (1,0) [0|0] "NA" MCU
 SG_ OBJ_Relative_Long_Acc_STD_3 : 3360|10@1+ (0.01,0) [0|7.3] "m_per_s2" MCU
 SG_ OBJ_Rel_Long_Acc_STD_V_3 : 3370|1@1+ (1,0) [0|1] "bool" MCU
 SG_ OBJ_Relative_Long_Velocity_3 : 3371|13@1+ (0.05,-120) [-120|130] "m_per_s" MCU
 SG_ OBJ_Relative_Long_Velocity_V_3 : 3384|1@1+ (1,0) [0|1] "bool" MCU
 SG_ Reserved_10_3 : 3385|7@1+ (1,0) [0|0] "NA" MCU
 SG_ OBJ_Relative_Long_Vel_STD_3 : 3392|14@1+ (0.01,0) [0|130] "m_per_s" MCU
 SG_ OBJ_Rel_Long_Vel_STD_V_3 : 3406|1@1+ (1,0) [0|1] "bool" MCU
 SG_ OBJ_Relative_Lat_Velocity_3 : 3407|11@1+ (0.05,-50) [-50|50] "m_per_s" MCU
 SG_ OBJ_Relative_Lat_Velocity_V_3 : 3418|1@1+ (1,0) [0|1] "bool" MCU
 SG_ Reserved_11_3 : 3419|5@1+ (1,0) [0|0] "NA" MCU
 SG_ OBJ_Relative_Lat_Velocity_STD_3 : 3424|13@1+ (0.01,0) [0|50] "m_per_s" MCU
 SG_ OBJ_Rel_Lat_Vel_STD_V_3 : 3437|1@1+ (1,0) [0|1] "bool" MCU
 SG_ OBJ_Long_Distance_3 : 3438|14@1+ (0.05,-200) [-200|500] "m" MCU
 SG_ OBJ_Long_Distance_V_3 : 3452|1@1+ (1,0) [0|1] "bool" MCU
 SG_ Reserved_12_3 : 3453|3@1+ (1,0) [0|0] "NA" MCU
 SG_ OBJ_Long_Distance_STD_3 : 3456|15@1+ (0.01,0) [0|250] "m" MCU
 SG_ OBJ_Long_Distance_STD_V_3 : 3471|1@1+ (1,0) [0|1] "bool" MCU
 SG_ OBJ_Lat_Distance_3 : 3472|12@1+ (0.05,-100) [-100|100] "m" MCU
 SG_ OBJ_Lat_Distance_V_3 : 3484|1@1+ (1,0) [0|1] "bool" MCU
 SG_ Reserved_13_3 : 3485|3@1+ (1,0) [0|0] "NA" MCU
 SG_ OBJ_Lat_Distance_STD_3 : 3488|14@1+ (0.01,0) [0|100] "m" MCU
 SG_ OBJ_Lat_Distance_STD_V_3 : 3502|1@1+ (1,0) [0|1] "bool" MCU
 SG_ OBJ_Absolute_Speed_3 : 3503|12@1+ (0.05,-65) [-65|65] "m_per_s" MCU
 SG_ OBJ_Absolute_Speed_V_3 : 3515|1@1+ (1,0) [0|1] "bool" MCU
 SG_ Reserved_14_3 : 3516|4@1+ (1,0) [0|0] "NA" MCU
 SG_ OBJ_Absolute_Speed_STD_3 : 3520|13@1+ (0.01,0) [0|65] "m_per_s" MCU
 SG_ OBJ_Absolute_Speed_STD_V_3 : 3533|1@1+ (1,0) [0|1] "bool" MCU
 SG_ OBJ_Heading_3 : 3534|10@1+ (0.01,-3.14) [-3.14|3.14] "rad" MCU
 SG_ OBJ_Heading_V_3 : 3544|1@1+ (1,0) [0|1] "bool" MCU
 SG_ Reserved_15_3 : 3545|7@1+ (1,0) [0|0] "NA" MCU
 SG_ OBJ_Heading_STD_3 : 3552|15@1+ (0.0001,0) [0|3.14] "rad" MCU
 SG_ OBJ_Heading_STD_V_3 : 3567|1@1+ (1,0) [0|1] "bool" MCU
 SG_ OBJ_Angle_Rate_STD_3 : 3568|15@1+ (0.0001,0) [0|2.2318] "RPS" MCU
 SG_ OBJ_Angle_Rate_STD_V_3 : 3583|1@1+ (1,0) [0|1] "bool" MCU
 SG_ OBJ_Angle_Rate_3 : 3584|12@1+ (0.002,-2.234) [-2.234|2.2318] "RPS" MCU
 SG_ OBJ_Angle_Rate_V_3 : 3596|1@1+ (1,0) [0|1] "bool" MCU
 SG_ OBJ_Angle_Right_3 : 3597|14@1+ (0.0002,-1.571) [-1.571|1.571] "rad" MCU
 SG_ OBJ_Angle_Right_V_3 : 3611|1@1+ (1,0) [0|1] "bool" MCU
 SG_ Reserved_16_3 : 3612|4@1+ (1,0) [0|0] "NA" MCU
 SG_ OBJ_Angle_Right_STD_3 : 3616|14@1+ (0.0001,0) [0|1.571] "rad" MCU
 SG_ OBJ_Angle_Right_STD_V_3 : 3630|1@1+ (1,0) [0|1] "bool" MCU
 SG_ OBJ_Angle_Left_3 : 3631|14@1+ (0.0002,-1.571) [-1.571|1.571] "rad" MCU
 SG_ OBJ_Angle_Left_V_3 : 3645|1@1+ (1,0) [0|1] "bool" MCU
 SG_ Reserved_17_3 : 3646|2@1+ (1,0) [0|0] "NA" MCU
 SG_ OBJ_Angle_Left_STD_3 : 3648|14@1+ (0.0001,0) [0|1.571] "rad" MCU
 SG_ OBJ_Angle_Left_STD_V_3 : 3662|1@1+ (1,0) [0|1] "bool" MCU
 SG_ OBJ_Angle_Side_3 : 3663|14@1+ (0.0002,-1.571) [-1.571|1.571] "rad" MCU
 SG_ OBJ_Angle_Side_V_3 : 3677|1@1+ (1,0) [0|1] "bool" MCU
 SG_ Reserved_18_3 : 3678|2@1+ (1,0) [0|0] "NA" MCU
 SG_ OBJ_Angle_Side_STD_3 : 3680|14@1+ (0.0001,0) [0|1.571] "rad" MCU
 SG_ OBJ_Angle_Side_STD_V_3 : 3694|1@1+ (1,0) [0|1] "bool" MCU
 SG_ OBJ_Angle_Mid_V_3 : 3695|1@1+ (1,0) [0|1] "bool" MCU
 SG_ OBJ_Angle_Mid_3 : 3696|14@1+ (0.0002,-1.571) [-1.571|1.571] "rad" MCU
 SG_ Reserved_19_3 : 3710|2@1+ (1,0) [0|0] "NA" MCU
 SG_ OBJ_Angle_Mid_STD_3 : 3712|14@1+ (0.0001,0) [0|1.571] "rad" MCU
 SG_ OBJ_Angle_Mid_STD_V_3 : 3726|1@1+ (1,0) [0|1] "bool" MCU
 SG_ OBJ_Angle_Bottom_V_3 : 3727|1@1+ (1,0) [0|1] "bool" MCU
 SG_ OBJ_Angle_Bottom_3 : 3728|14@1+ (0.0002,-1.571) [-1.571|1.571] "rad" MCU
 SG_ Reserved_20_3 : 3742|2@1+ (1,0) [0|0] "NA" MCU
 SG_ OBJ_Angle_Bottom_STD_3 : 3744|14@1+ (0.0001,0) [0|1.571] "rad" MCU
 SG_ OBJ_Angle_Bottom_STD_V_3 : 3758|1@1+ (1,0) [0|1] "bool" MCU
 SG_ OBJ_Visibility_Side_V_3 : 3759|1@1+ (1,0) [0|1] "bool" MCU
 SG_ OBJ_Visibility_Side_3 : 3760|2@1+ (1,0) [0|2] "ENUM" MCU
 SG_ OBJ_Is_In_Drivable_Area_3 : 3762|1@1+ (1,0) [0|1] "bool" MCU
 SG_ OBJ_Is_In_Drivable_Area_V_3 : 3763|1@1+ (1,0) [0|1] "bool" MCU
 SG_ OBJ_Is_VeryClose_V_3 : 3764|1@1+ (1,0) [0|1] "bool" MCU
 SG_ OBJ_Is_VeryClose_3 : 3765|1@1+ (1,0) [0|1] "bool" MCU
 SG_ OBJ_Buffer_C4_3 : 3766|2@1+ (1,0) [0|2] "NA" MCU
 SG_ OBJ_Buffer_C5_3 : 3768|2@1+ (1,0) [0|2] "NA" MCU
 SG_ OBJ_Buffer_C6_3 : 3770|2@1+ (1,0) [0|2] "NA" MCU
 SG_ OBJ_Buffer_C7_3 : 3772|2@1+ (1,0) [0|2] "NA" MCU
 SG_ Reserved_21_3 : 3774|2@1+ (1,0) [0|0] "NA" MCU
 SG_ OBJ_OverlapAngleEgoLaneR_3 : 3776|10@1+ (0.01,-3.14) [-3.14|3.14] "rad" MCU
 SG_ OBJ_OverlapAngleEgoLaneR_V_3 : 3786|1@1+ (1,0) [0|1] "bool" MCU
 SG_ OBJ_OverlapAngleEgoLaneL_3 : 3787|10@1+ (0.01,-3.14) [-3.14|3.14] "rad" MCU
 SG_ OBJ_OverlapAngleEgoLaneL_V_3 : 3797|1@1+ (1,0) [0|1] "bool" MCU
 SG_ OBJ_Is_EMERGENCY_VCL_3 : 3798|1@1+ (1,0) [0|1] "bool" MCU
 SG_ OBJ_EMERGENCY_LIGHT_COLOR_3 : 3799|4@1+ (1,0) [0|15] "BITWIZE" MCU
 SG_ OBJ_EMERGENCY_V_3 : 3803|1@1+ (1,0) [0|1] "bool" MCU
 SG_ Reserved_22_3 : 3804|4@1+ (1,0) [0|0] "NA" MCU
 SG_ OBJ_Angle_Top_3 : 3808|14@1+ (0.0002,0) [0|3.1415] "rad" MCU
 SG_ OBJ_Angle_Top_V_3 : 3822|1@1+ (1,0) [0|1] "bool" MCU
 SG_ OBJ_Angle_Top_STD_3 : 3823|15@1+ (0.0001,0) [0|3.1415] "rad" MCU
 SG_ OBJ_Angle_Top_STD_V_3 : 3838|1@1+ (1,0) [0|1] "bool" MCU
 SG_ OBJ_Buffer_C14_3 : 3839|1@1+ (1,0) [0|1] "NA" MCU
 SG_ OBJ_Buffer_C15_3 : 3840|1@1+ (1,0) [0|1] "NA" MCU
 SG_ OBJ_Buffer_C18_3 : 3841|2@1+ (1,0) [0|2] "NA" MCU
 SG_ OBJ_Buffer_C19_3 : 3843|1@1+ (1,0) [0|1] "NA" MCU
 SG_ Reserved_23_3 : 3844|28@1+ (1,0) [0|0] "NA" MCU
 SG_ OBJ_CRC_4 : 3872|32@1+ (1,0) [0|4294967295] "NA" MCU
 SG_ OBJ_ID_4 : 3904|8@1+ (1,0) [0|255] "counter" MCU
 SG_ OBJ_Existence_Probability_4 : 3912|8@1+ (0.01,0) [0|1] "NA" MCU
 SG_ OBJ_Fusion_Source_4 : 3920|16@1+ (1,0) [0|65535] "BITWIZE" MCU
 SG_ OBJ_Triggered_SDM_4 : 3936|2@1+ (1,0) [0|2] "ENUM" MCU
 SG_ OBJ_Motion_Category_4 : 3938|4@1+ (1,0) [0|13] "ENUM" MCU
 SG_ OBJ_Buffer_C0_4 : 3942|7@1+ (0.01,0) [0|1] "NA" MCU
 SG_ OBJ_Object_Age_4 : 3949|11@1+ (1,0) [0|2047] "frames" MCU
 SG_ OBJ_Measuring_Status_4 : 3960|3@1+ (1,0) [0|7] "BITWIZE" MCU
 SG_ OBJ_Object_Class_4 : 3963|4@1+ (1,0) [0|8] "ENUM" MCU
 SG_ Reserved_4_4 : 3967|1@1+ (1,0) [0|0] "NA" MCU
 SG_ OBJ_Class_Probability_4 : 3968|7@1+ (0.01,0) [0|1] "NA" MCU
 SG_ OBJ_Car_Probability_4 : 3975|7@1+ (0.01,0) [0|1] "NA" MCU
 SG_ OBJ_Truck_Probability_4 : 3982|7@1+ (0.01,0) [0|1] "NA" MCU
 SG_ OBJ_Bike_Probability_4 : 3989|7@1+ (0.01,0) [0|1] "NA" MCU
 SG_ OBJ_Camera_Source_4 : 3996|4@1+ (1,0) [0|15] "ENUM" MCU
 SG_ OBJ_Motion_Status_4 : 4000|3@1+ (1,0) [0|5] "ENUM" MCU
 SG_ OBJ_Motion_Orientation_4 : 4003|4@1+ (1,0) [0|13] "ENUM" MCU
 SG_ OBJ_Has_Cut_Lane_4 : 4007|1@1+ (1,0) [0|1] "bool" MCU
 SG_ OBJ_Has_Cut_Path_4 : 4008|1@1+ (1,0) [0|1] "bool" MCU
 SG_ OBJ_Brake_Light_4 : 4009|1@1+ (1,0) [0|1] "bool" MCU
 SG_ OBJ_Turn_Indicator_Right_4 : 4010|1@1+ (1,0) [0|1] "bool" MCU
 SG_ OBJ_Turn_Indicator_Left_4 : 4011|1@1+ (1,0) [0|1] "bool" MCU
 SG_ OBJ_Light_Indicator_Validity_4 : 4012|1@1+ (1,0) [0|1] "bool" MCU
 SG_ OBJ_Right_Out_Of_Image_4 : 4013|1@1+ (1,0) [0|1] "bool" MCU
 SG_ OBJ_Left_Out_Of_Image_4 : 4014|1@1+ (1,0) [0|1] "bool" MCU
 SG_ OBJ_Right_Out_Of_Image_V_4 : 4015|1@1+ (1,0) [0|1] "bool" MCU
 SG_ OBJ_Left_Out_Of_Image_V_4 : 4016|1@1+ (1,0) [0|1] "bool" MCU
 SG_ OBJ_Top_Out_Of_Image_4 : 4017|1@1+ (1,0) [0|1] "bool" MCU
 SG_ OBJ_Bottom_Out_Of_Image_4 : 4018|1@1+ (1,0) [0|1] "bool" MCU
 SG_ OBJ_Top_Out_Of_Image_V_4 : 4019|1@1+ (1,0) [0|1] "bool" MCU
 SG_ OBJ_Bottom_Out_Of_Image_V_4 : 4020|1@1+ (1,0) [0|1] "bool" MCU
 SG_ OBJ_Lane_Assignment_4 : 4021|3@1+ (1,0) [0|5] "ENUM" MCU
 SG_ OBJ_Lane_Assignment_V_4 : 4024|1@1+ (1,0) [0|1] "bool" MCU
 SG_ OBJ_Age_Seconds_4 : 4025|7@1+ (1,0) [0|100] "s" MCU
 SG_ OBJ_Age_Seconds_V_4 : 4032|1@1+ (1,0) [0|1] "bool" MCU
 SG_ OBJ_Width_4 : 4033|9@1+ (0.01,0) [0.4|2.95] "m" MCU
 SG_ OBJ_Width_V_4 : 4042|1@1+ (1,0) [0|1] "bool" MCU
 SG_ OBJ_Width_STD_4 : 4043|11@1+ (0.001,0) [0|2] "m" MCU
 SG_ OBJ_Width_STD_V_4 : 4054|1@1+ (1,0) [0|1] "bool" MCU
 SG_ OBJ_Length_4 : 4055|9@1+ (0.05,0) [1.2|21] "m" MCU
 SG_ OBJ_Length_V_4 : 4064|1@1+ (1,0) [0|1] "bool" MCU
 SG_ OBJ_Length_STD_4 : 4065|10@1+ (0.01,0) [0|10] "m" MCU
 SG_ OBJ_Length_STD_V_4 : 4075|1@1+ (1,0) [0|1] "bool" MCU
 SG_ OBJ_Radar_ID_4 : 4076|8@1+ (1,0) [0|255] "counter" MCU
 SG_ OBJ_Height_4 : 4084|9@1+ (0.01,0) [0|2.95] "m" MCU
 SG_ OBJ_Height_V_4 : 4093|1@1+ (1,0) [0|1] "bool" MCU
 SG_ Reserved_5_4 : 4094|2@1+ (1,0) [0|0] "NA" MCU
 SG_ OBJ_Height_STD_4 : 4096|11@1+ (0.001,0) [0|2] "m" MCU
 SG_ OBJ_Height_STD_V_4 : 4107|1@1+ (1,0) [0|1] "bool" MCU
 SG_ OBJ_Abs_Long_Velocity_4 : 4108|12@1+ (0.05,-100) [-100|100] "m_per_s" MCU
 SG_ OBJ_Abs_Long_Velocity_V_4 : 4120|1@1+ (1,0) [0|1] "bool" MCU
 SG_ Reserved_6_4 : 4121|7@1+ (1,0) [0|0] "NA" MCU
 SG_ OBJ_Abs_Long_Velocity_STD_4 : 4128|13@1+ (0.01,0) [0|65] "m_per_s" MCU
 SG_ OBJ_Abs_Long_Vel_STD_V_4 : 4141|1@1+ (1,0) [0|1] "bool" MCU
 SG_ OBJ_Abs_Lat_Velocity_4 : 4142|11@1+ (0.05,-50) [-50|50] "m_per_s" MCU
 SG_ OBJ_Abs_Lat_Velocity_V_4 : 4153|1@1+ (1,0) [0|1] "bool" MCU
 SG_ Reserved_7_4 : 4154|6@1+ (1,0) [0|0] "NA" MCU
 SG_ OBJ_Abs_Lat_Velocity_STD_4 : 4160|13@1+ (0.01,0) [0|50] "m_per_s" MCU
 SG_ OBJ_Abs_Lat_Vel_STD_V_4 : 4173|1@1+ (1,0) [0|1] "bool" MCU
 SG_ OBJ_Abs_Long_Acc_4 : 4174|9@1+ (0.05,-10) [-10|10] "m_per_s2" MCU
 SG_ OBJ_Abs_Long_Acc_V_4 : 4183|1@1+ (1,0) [0|1] "bool" MCU
 SG_ Reserved_8_4 : 4184|8@1+ (1,0) [0|0] "NA" MCU
 SG_ OBJ_Abs_Long_Acc_STD_4 : 4192|10@1+ (0.01,0) [0|7.3] "m_per_s2" MCU
 SG_ OBJ_Abs_Long_Acc_STD_V_4 : 4202|1@1+ (1,0) [0|1] "bool" MCU
 SG_ OBJ_Abs_Lat_Acc_4 : 4203|9@1+ (0.05,-10) [-10|10] "m_per_s2" MCU
 SG_ OBJ_Abs_Lat_Acc_V_4 : 4212|1@1+ (1,0) [0|1] "bool" MCU
 SG_ OBJ_Abs_Lat_Acc_STD_4 : 4213|10@1+ (0.01,0) [0|7.3] "m_per_s2" MCU
 SG_ OBJ_Abs_Lat_Acc_STD_V_4 : 4223|1@1+ (1,0) [0|1] "bool" MCU
 SG_ OBJ_Abs_Acceleration_4 : 4224|9@1+ (0.05,-12.7) [-12.7|12.7] "m_per_s2" MCU
 SG_ OBJ_Abs_Acceleration_V_4 : 4233|1@1+ (1,0) [0|1] "bool" MCU
 SG_ OBJ_Abs_Acc_STD_4 : 4234|10@1+ (0.01,0) [0|7.3] "m_per_s2" MCU
 SG_ OBJ_Abs_Acc_STD_V_4 : 4244|1@1+ (1,0) [0|1] "bool" MCU
 SG_ OBJ_Inv_TTC_4 : 4245|11@1+ (0.01,-8) [-8|8] "INV(s)" MCU
 SG_ OBJ_Inv_TTC_V_4 : 4256|1@1+ (1,0) [0|1] "bool" MCU
 SG_ OBJ_Inv_TTC_STD_4 : 4257|12@1+ (0.001,0) [0|4] "INV(s)" MCU
 SG_ OBJ_Inv_TTC_STD_V_4 : 4269|1@1+ (1,0) [0|1] "bool" MCU
 SG_ OBJ_Relative_Long_Acc_4 : 4270|10@1+ (0.05,-20) [-20|20] "m_per_s2" MCU
 SG_ OBJ_Relative_Long_Acc_V_4 : 4280|1@1+ (1,0) [0|1] "bool" MCU
 SG_ Reserved_9_4 : 4281|7@1+ (1,0) [0|0] "NA" MCU
 SG_ OBJ_Relative_Long_Acc_STD_4 : 4288|10@1+ (0.01,0) [0|7.3] "m_per_s2" MCU
 SG_ OBJ_Rel_Long_Acc_STD_V_4 : 4298|1@1+ (1,0) [0|1] "bool" MCU
 SG_ OBJ_Relative_Long_Velocity_4 : 4299|13@1+ (0.05,-120) [-120|130] "m_per_s" MCU
 SG_ OBJ_Relative_Long_Velocity_V_4 : 4312|1@1+ (1,0) [0|1] "bool" MCU
 SG_ Reserved_10_4 : 4313|7@1+ (1,0) [0|0] "NA" MCU
 SG_ OBJ_Relative_Long_Vel_STD_4 : 4320|14@1+ (0.01,0) [0|130] "m_per_s" MCU
 SG_ OBJ_Rel_Long_Vel_STD_V_4 : 4334|1@1+ (1,0) [0|1] "bool" MCU
 SG_ OBJ_Relative_Lat_Velocity_4 : 4335|11@1+ (0.05,-50) [-50|50] "m_per_s" MCU
 SG_ OBJ_Relative_Lat_Velocity_V_4 : 4346|1@1+ (1,0) [0|1] "bool" MCU
 SG_ Reserved_11_4 : 4347|5@1+ (1,0) [0|0] "NA" MCU
 SG_ OBJ_Relative_Lat_Velocity_STD_4 : 4352|13@1+ (0.01,0) [0|50] "m_per_s" MCU
 SG_ OBJ_Rel_Lat_Vel_STD_V_4 : 4365|1@1+ (1,0) [0|1] "bool" MCU
 SG_ OBJ_Long_Distance_4 : 4366|14@1+ (0.05,-200) [-200|500] "m" MCU
 SG_ OBJ_Long_Distance_V_4 : 4380|1@1+ (1,0) [0|1] "bool" MCU
 SG_ Reserved_12_4 : 4381|3@1+ (1,0) [0|0] "NA" MCU
 SG_ OBJ_Long_Distance_STD_4 : 4384|15@1+ (0.01,0) [0|250] "m" MCU
 SG_ OBJ_Long_Distance_STD_V_4 : 4399|1@1+ (1,0) [0|1] "bool" MCU
 SG_ OBJ_Lat_Distance_4 : 4400|12@1+ (0.05,-100) [-100|100] "m" MCU
 SG_ OBJ_Lat_Distance_V_4 : 4412|1@1+ (1,0) [0|1] "bool" MCU
 SG_ Reserved_13_4 : 4413|3@1+ (1,0) [0|0] "NA" MCU
 SG_ OBJ_Lat_Distance_STD_4 : 4416|14@1+ (0.01,0) [0|100] "m" MCU
 SG_ OBJ_Lat_Distance_STD_V_4 : 4430|1@1+ (1,0) [0|1] "bool" MCU
 SG_ OBJ_Absolute_Speed_4 : 4431|12@1+ (0.05,-65) [-65|65] "m_per_s" MCU
 SG_ OBJ_Absolute_Speed_V_4 : 4443|1@1+ (1,0) [0|1] "bool" MCU
 SG_ Reserved_14_4 : 4444|4@1+ (1,0) [0|0] "NA" MCU
 SG_ OBJ_Absolute_Speed_STD_4 : 4448|13@1+ (0.01,0) [0|65] "m_per_s" MCU
 SG_ OBJ_Absolute_Speed_STD_V_4 : 4461|1@1+ (1,0) [0|1] "bool" MCU
 SG_ OBJ_Heading_4 : 4462|10@1+ (0.01,-3.14) [-3.14|3.14] "rad" MCU
 SG_ OBJ_Heading_V_4 : 4472|1@1+ (1,0) [0|1] "bool" MCU
 SG_ Reserved_15_4 : 4473|7@1+ (1,0) [0|0] "NA" MCU
 SG_ OBJ_Heading_STD_4 : 4480|15@1+ (0.0001,0) [0|3.14] "rad" MCU
 SG_ OBJ_Heading_STD_V_4 : 4495|1@1+ (1,0) [0|1] "bool" MCU
 SG_ OBJ_Angle_Rate_STD_4 : 4496|15@1+ (0.0001,0) [0|2.2318] "RPS" MCU
 SG_ OBJ_Angle_Rate_STD_V_4 : 4511|1@1+ (1,0) [0|1] "bool" MCU
 SG_ OBJ_Angle_Rate_4 : 4512|12@1+ (0.002,-2.234) [-2.234|2.2318] "RPS" MCU
 SG_ OBJ_Angle_Rate_V_4 : 4524|1@1+ (1,0) [0|1] "bool" MCU
 SG_ OBJ_Angle_Right_4 : 4525|14@1+ (0.0002,-1.571) [-1.571|1.571] "rad" MCU
 SG_ OBJ_Angle_Right_V_4 : 4539|1@1+ (1,0) [0|1] "bool" MCU
 SG_ Reserved_16_4 : 4540|4@1+ (1,0) [0|0] "NA" MCU
 SG_ OBJ_Angle_Right_STD_4 : 4544|14@1+ (0.0001,0) [0|1.571] "rad" MCU
 SG_ OBJ_Angle_Right_STD_V_4 : 4558|1@1+ (1,0) [0|1] "bool" MCU
 SG_ OBJ_Angle_Left_4 : 4559|14@1+ (0.0002,-1.571) [-1.571|1.571] "rad" MCU
 SG_ OBJ_Angle_Left_V_4 : 4573|1@1+ (1,0) [0|1] "bool" MCU
 SG_ Reserved_17_4 : 4574|2@1+ (1,0) [0|0] "NA" MCU
 SG_ OBJ_Angle_Left_STD_4 : 4576|14@1+ (0.0001,0) [0|1.571] "rad" MCU
 SG_ OBJ_Angle_Left_STD_V_4 : 4590|1@1+ (1,0) [0|1] "bool" MCU
 SG_ OBJ_Angle_Side_4 : 4591|14@1+ (0.0002,-1.571) [-1.571|1.571] "rad" MCU
 SG_ OBJ_Angle_Side_V_4 : 4605|1@1+ (1,0) [0|1] "bool" MCU
 SG_ Reserved_18_4 : 4606|2@1+ (1,0) [0|0] "NA" MCU
 SG_ OBJ_Angle_Side_STD_4 : 4608|14@1+ (0.0001,0) [0|1.571] "rad" MCU
 SG_ OBJ_Angle_Side_STD_V_4 : 4622|1@1+ (1,0) [0|1] "bool" MCU
 SG_ OBJ_Angle_Mid_V_4 : 4623|1@1+ (1,0) [0|1] "bool" MCU
 SG_ OBJ_Angle_Mid_4 : 4624|14@1+ (0.0002,-1.571) [-1.571|1.571] "rad" MCU
 SG_ Reserved_19_4 : 4638|2@1+ (1,0) [0|0] "NA" MCU
 SG_ OBJ_Angle_Mid_STD_4 : 4640|14@1+ (0.0001,0) [0|1.571] "rad" MCU
 SG_ OBJ_Angle_Mid_STD_V_4 : 4654|1@1+ (1,0) [0|1] "bool" MCU
 SG_ OBJ_Angle_Bottom_V_4 : 4655|1@1+ (1,0) [0|1] "bool" MCU
 SG_ OBJ_Angle_Bottom_4 : 4656|14@1+ (0.0002,-1.571) [-1.571|1.571] "rad" MCU
 SG_ Reserved_20_4 : 4670|2@1+ (1,0) [0|0] "NA" MCU
 SG_ OBJ_Angle_Bottom_STD_4 : 4672|14@1+ (0.0001,0) [0|1.571] "rad" MCU
 SG_ OBJ_Angle_Bottom_STD_V_4 : 4686|1@1+ (1,0) [0|1] "bool" MCU
 SG_ OBJ_Visibility_Side_V_4 : 4687|1@1+ (1,0) [0|1] "bool" MCU
 SG_ OBJ_Visibility_Side_4 : 4688|2@1+ (1,0) [0|2] "ENUM" MCU
 SG_ OBJ_Is_In_Drivable_Area_4 : 4690|1@1+ (1,0) [0|1] "bool" MCU
 SG_ OBJ_Is_In_Drivable_Area_V_4 : 4691|1@1+ (1,0) [0|1] "bool" MCU
 SG_ OBJ_Is_VeryClose_V_4 : 4692|1@1+ (1,0) [0|1] "bool" MCU
 SG_ OBJ_Is_VeryClose_4 : 4693|1@1+ (1,0) [0|1] "bool" MCU
 SG_ OBJ_Buffer_C4_4 : 4694|2@1+ (1,0) [0|2] "NA" MCU
 SG_ OBJ_Buffer_C5_4 : 4696|2@1+ (1,0) [0|2] "NA" MCU
 SG_ OBJ_Buffer_C6_4 : 4698|2@1+ (1,0) [0|2] "NA" MCU
 SG_ OBJ_Buffer_C7_4 : 4700|2@1+ (1,0) [0|2] "NA" MCU
 SG_ Reserved_21_4 : 4702|2@1+ (1,0) [0|0] "NA" MCU
 SG_ OBJ_OverlapAngleEgoLaneR_4 : 4704|10@1+ (0.01,-3.14) [-3.14|3.14] "rad" MCU
 SG_ OBJ_OverlapAngleEgoLaneR_V_4 : 4714|1@1+ (1,0) [0|1] "bool" MCU
 SG_ OBJ_OverlapAngleEgoLaneL_4 : 4715|10@1+ (0.01,-3.14) [-3.14|3.14] "rad" MCU
 SG_ OBJ_OverlapAngleEgoLaneL_V_4 : 4725|1@1+ (1,0) [0|1] "bool" MCU
 SG_ OBJ_Is_EMERGENCY_VCL_4 : 4726|1@1+ (1,0) [0|1] "bool" MCU
 SG_ OBJ_EMERGENCY_LIGHT_COLOR_4 : 4727|4@1+ (1,0) [0|15] "BITWIZE" MCU
 SG_ OBJ_EMERGENCY_V_4 : 4731|1@1+ (1,0) [0|1] "bool" MCU
 SG_ Reserved_22_4 : 4732|4@1+ (1,0) [0|0] "NA" MCU
 SG_ OBJ_Angle_Top_4 : 4736|14@1+ (0.0002,0) [0|3.1415] "rad" MCU
 SG_ OBJ_Angle_Top_V_4 : 4750|1@1+ (1,0) [0|1] "bool" MCU
 SG_ OBJ_Angle_Top_STD_4 : 4751|15@1+ (0.0001,0) [0|3.1415] "rad" MCU
 SG_ OBJ_Angle_Top_STD_V_4 : 4766|1@1+ (1,0) [0|1] "bool" MCU
 SG_ OBJ_Buffer_C14_4 : 4767|1@1+ (1,0) [0|1] "NA" MCU
 SG_ OBJ_Buffer_C15_4 : 4768|1@1+ (1,0) [0|1] "NA" MCU
 SG_ OBJ_Buffer_C18_4 : 4769|2@1+ (1,0) [0|2] "NA" MCU
 SG_ OBJ_Buffer_C19_4 : 4771|1@1+ (1,0) [0|1] "NA" MCU
 SG_ Reserved_23_4 : 4772|28@1+ (1,0) [0|0] "NA" MCU
 SG_ OBJ_CRC_5 : 4800|32@1+ (1,0) [0|4294967295] "NA" MCU
 SG_ OBJ_ID_5 : 4832|8@1+ (1,0) [0|255] "counter" MCU
 SG_ OBJ_Existence_Probability_5 : 4840|8@1+ (0.01,0) [0|1] "NA" MCU
 SG_ OBJ_Fusion_Source_5 : 4848|16@1+ (1,0) [0|65535] "BITWIZE" MCU
 SG_ OBJ_Triggered_SDM_5 : 4864|2@1+ (1,0) [0|2] "ENUM" MCU
 SG_ OBJ_Motion_Category_5 : 4866|4@1+ (1,0) [0|13] "ENUM" MCU
 SG_ OBJ_Buffer_C0_5 : 4870|7@1+ (0.01,0) [0|1] "NA" MCU
 SG_ OBJ_Object_Age_5 : 4877|11@1+ (1,0) [0|2047] "frames" MCU
 SG_ OBJ_Measuring_Status_5 : 4888|3@1+ (1,0) [0|7] "BITWIZE" MCU
 SG_ OBJ_Object_Class_5 : 4891|4@1+ (1,0) [0|8] "ENUM" MCU
 SG_ Reserved_4_5 : 4895|1@1+ (1,0) [0|0] "NA" MCU
 SG_ OBJ_Class_Probability_5 : 4896|7@1+ (0.01,0) [0|1] "NA" MCU
 SG_ OBJ_Car_Probability_5 : 4903|7@1+ (0.01,0) [0|1] "NA" MCU
 SG_ OBJ_Truck_Probability_5 : 4910|7@1+ (0.01,0) [0|1] "NA" MCU
 SG_ OBJ_Bike_Probability_5 : 4917|7@1+ (0.01,0) [0|1] "NA" MCU
 SG_ OBJ_Camera_Source_5 : 4924|4@1+ (1,0) [0|15] "ENUM" MCU
 SG_ OBJ_Motion_Status_5 : 4928|3@1+ (1,0) [0|5] "ENUM" MCU
 SG_ OBJ_Motion_Orientation_5 : 4931|4@1+ (1,0) [0|13] "ENUM" MCU
 SG_ OBJ_Has_Cut_Lane_5 : 4935|1@1+ (1,0) [0|1] "bool" MCU
 SG_ OBJ_Has_Cut_Path_5 : 4936|1@1+ (1,0) [0|1] "bool" MCU
 SG_ OBJ_Brake_Light_5 : 4937|1@1+ (1,0) [0|1] "bool" MCU
 SG_ OBJ_Turn_Indicator_Right_5 : 4938|1@1+ (1,0) [0|1] "bool" MCU
 SG_ OBJ_Turn_Indicator_Left_5 : 4939|1@1+ (1,0) [0|1] "bool" MCU
 SG_ OBJ_Light_Indicator_Validity_5 : 4940|1@1+ (1,0) [0|1] "bool" MCU
 SG_ OBJ_Right_Out_Of_Image_5 : 4941|1@1+ (1,0) [0|1] "bool" MCU
 SG_ OBJ_Left_Out_Of_Image_5 : 4942|1@1+ (1,0) [0|1] "bool" MCU
 SG_ OBJ_Right_Out_Of_Image_V_5 : 4943|1@1+ (1,0) [0|1] "bool" MCU
 SG_ OBJ_Left_Out_Of_Image_V_5 : 4944|1@1+ (1,0) [0|1] "bool" MCU
 SG_ OBJ_Top_Out_Of_Image_5 : 4945|1@1+ (1,0) [0|1] "bool" MCU
 SG_ OBJ_Bottom_Out_Of_Image_5 : 4946|1@1+ (1,0) [0|1] "bool" MCU
 SG_ OBJ_Top_Out_Of_Image_V_5 : 4947|1@1+ (1,0) [0|1] "bool" MCU
 SG_ OBJ_Bottom_Out_Of_Image_V_5 : 4948|1@1+ (1,0) [0|1] "bool" MCU
 SG_ OBJ_Lane_Assignment_5 : 4949|3@1+ (1,0) [0|5] "ENUM" MCU
 SG_ OBJ_Lane_Assignment_V_5 : 4952|1@1+ (1,0) [0|1] "bool" MCU
 SG_ OBJ_Age_Seconds_5 : 4953|7@1+ (1,0) [0|100] "s" MCU
 SG_ OBJ_Age_Seconds_V_5 : 4960|1@1+ (1,0) [0|1] "bool" MCU
 SG_ OBJ_Width_5 : 4961|9@1+ (0.01,0) [0.4|2.95] "m" MCU
 SG_ OBJ_Width_V_5 : 4970|1@1+ (1,0) [0|1] "bool" MCU
 SG_ OBJ_Width_STD_5 : 4971|11@1+ (0.001,0) [0|2] "m" MCU
 SG_ OBJ_Width_STD_V_5 : 4982|1@1+ (1,0) [0|1] "bool" MCU
 SG_ OBJ_Length_5 : 4983|9@1+ (0.05,0) [1.2|21] "m" MCU
 SG_ OBJ_Length_V_5 : 4992|1@1+ (1,0) [0|1] "bool" MCU
 SG_ OBJ_Length_STD_5 : 4993|10@1+ (0.01,0) [0|10] "m" MCU
 SG_ OBJ_Length_STD_V_5 : 5003|1@1+ (1,0) [0|1] "bool" MCU
 SG_ OBJ_Radar_ID_5 : 5004|8@1+ (1,0) [0|255] "counter" MCU
 SG_ OBJ_Height_5 : 5012|9@1+ (0.01,0) [0|2.95] "m" MCU
 SG_ OBJ_Height_V_5 : 5021|1@1+ (1,0) [0|1] "bool" MCU
 SG_ Reserved_5_5 : 5022|2@1+ (1,0) [0|0] "NA" MCU
 SG_ OBJ_Height_STD_5 : 5024|11@1+ (0.001,0) [0|2] "m" MCU
 SG_ OBJ_Height_STD_V_5 : 5035|1@1+ (1,0) [0|1] "bool" MCU
 SG_ OBJ_Abs_Long_Velocity_5 : 5036|12@1+ (0.05,-100) [-100|100] "m_per_s" MCU
 SG_ OBJ_Abs_Long_Velocity_V_5 : 5048|1@1+ (1,0) [0|1] "bool" MCU
 SG_ Reserved_6_5 : 5049|7@1+ (1,0) [0|0] "NA" MCU
 SG_ OBJ_Abs_Long_Velocity_STD_5 : 5056|13@1+ (0.01,0) [0|65] "m_per_s" MCU
 SG_ OBJ_Abs_Long_Vel_STD_V_5 : 5069|1@1+ (1,0) [0|1] "bool" MCU
 SG_ OBJ_Abs_Lat_Velocity_5 : 5070|11@1+ (0.05,-50) [-50|50] "m_per_s" MCU
 SG_ OBJ_Abs_Lat_Velocity_V_5 : 5081|1@1+ (1,0) [0|1] "bool" MCU
 SG_ Reserved_7_5 : 5082|6@1+ (1,0) [0|0] "NA" MCU
 SG_ OBJ_Abs_Lat_Velocity_STD_5 : 5088|13@1+ (0.01,0) [0|50] "m_per_s" MCU
 SG_ OBJ_Abs_Lat_Vel_STD_V_5 : 5101|1@1+ (1,0) [0|1] "bool" MCU
 SG_ OBJ_Abs_Long_Acc_5 : 5102|9@1+ (0.05,-10) [-10|10] "m_per_s2" MCU
 SG_ OBJ_Abs_Long_Acc_V_5 : 5111|1@1+ (1,0) [0|1] "bool" MCU
 SG_ Reserved_8_5 : 5112|8@1+ (1,0) [0|0] "NA" MCU
 SG_ OBJ_Abs_Long_Acc_STD_5 : 5120|10@1+ (0.01,0) [0|7.3] "m_per_s2" MCU
 SG_ OBJ_Abs_Long_Acc_STD_V_5 : 5130|1@1+ (1,0) [0|1] "bool" MCU
 SG_ OBJ_Abs_Lat_Acc_5 : 5131|9@1+ (0.05,-10) [-10|10] "m_per_s2" MCU
 SG_ OBJ_Abs_Lat_Acc_V_5 : 5140|1@1+ (1,0) [0|1] "bool" MCU
 SG_ OBJ_Abs_Lat_Acc_STD_5 : 5141|10@1+ (0.01,0) [0|7.3] "m_per_s2" MCU
 SG_ OBJ_Abs_Lat_Acc_STD_V_5 : 5151|1@1+ (1,0) [0|1] "bool" MCU
 SG_ OBJ_Abs_Acceleration_5 : 5152|9@1+ (0.05,-12.7) [-12.7|12.7] "m_per_s2" MCU
 SG_ OBJ_Abs_Acceleration_V_5 : 5161|1@1+ (1,0) [0|1] "bool" MCU
 SG_ OBJ_Abs_Acc_STD_5 : 5162|10@1+ (0.01,0) [0|7.3] "m_per_s2" MCU
 SG_ OBJ_Abs_Acc_STD_V_5 : 5172|1@1+ (1,0) [0|1] "bool" MCU
 SG_ OBJ_Inv_TTC_5 : 5173|11@1+ (0.01,-8) [-8|8] "INV(s)" MCU
 SG_ OBJ_Inv_TTC_V_5 : 5184|1@1+ (1,0) [0|1] "bool" MCU
 SG_ OBJ_Inv_TTC_STD_5 : 5185|12@1+ (0.001,0) [0|4] "INV(s)" MCU
 SG_ OBJ_Inv_TTC_STD_V_5 : 5197|1@1+ (1,0) [0|1] "bool" MCU
 SG_ OBJ_Relative_Long_Acc_5 : 5198|10@1+ (0.05,-20) [-20|20] "m_per_s2" MCU
 SG_ OBJ_Relative_Long_Acc_V_5 : 5208|1@1+ (1,0) [0|1] "bool" MCU
 SG_ Reserved_9_5 : 5209|7@1+ (1,0) [0|0] "NA" MCU
 SG_ OBJ_Relative_Long_Acc_STD_5 : 5216|10@1+ (0.01,0) [0|7.3] "m_per_s2" MCU
 SG_ OBJ_Rel_Long_Acc_STD_V_5 : 5226|1@1+ (1,0) [0|1] "bool" MCU
 SG_ OBJ_Relative_Long_Velocity_5 : 5227|13@1+ (0.05,-120) [-120|130] "m_per_s" MCU
 SG_ OBJ_Relative_Long_Velocity_V_5 : 5240|1@1+ (1,0) [0|1] "bool" MCU
 SG_ Reserved_10_5 : 5241|7@1+ (1,0) [0|0] "NA" MCU
 SG_ OBJ_Relative_Long_Vel_STD_5 : 5248|14@1+ (0.01,0) [0|130] "m_per_s" MCU
 SG_ OBJ_Rel_Long_Vel_STD_V_5 : 5262|1@1+ (1,0) [0|1] "bool" MCU
 SG_ OBJ_Relative_Lat_Velocity_5 : 5263|11@1+ (0.05,-50) [-50|50] "m_per_s" MCU
 SG_ OBJ_Relative_Lat_Velocity_V_5 : 5274|1@1+ (1,0) [0|1] "bool" MCU
 SG_ Reserved_11_5 : 5275|5@1+ (1,0) [0|0] "NA" MCU
 SG_ OBJ_Relative_Lat_Velocity_STD_5 : 5280|13@1+ (0.01,0) [0|50] "m_per_s" MCU
 SG_ OBJ_Rel_Lat_Vel_STD_V_5 : 5293|1@1+ (1,0) [0|1] "bool" MCU
 SG_ OBJ_Long_Distance_5 : 5294|14@1+ (0.05,-200) [-200|500] "m" MCU
 SG_ OBJ_Long_Distance_V_5 : 5308|1@1+ (1,0) [0|1] "bool" MCU
 SG_ Reserved_12_5 : 5309|3@1+ (1,0) [0|0] "NA" MCU
 SG_ OBJ_Long_Distance_STD_5 : 5312|15@1+ (0.01,0) [0|250] "m" MCU
 SG_ OBJ_Long_Distance_STD_V_5 : 5327|1@1+ (1,0) [0|1] "bool" MCU
 SG_ OBJ_Lat_Distance_5 : 5328|12@1+ (0.05,-100) [-100|100] "m" MCU
 SG_ OBJ_Lat_Distance_V_5 : 5340|1@1+ (1,0) [0|1] "bool" MCU
 SG_ Reserved_13_5 : 5341|3@1+ (1,0) [0|0] "NA" MCU
 SG_ OBJ_Lat_Distance_STD_5 : 5344|14@1+ (0.01,0) [0|100] "m" MCU
 SG_ OBJ_Lat_Distance_STD_V_5 : 5358|1@1+ (1,0) [0|1] "bool" MCU
 SG_ OBJ_Absolute_Speed_5 : 5359|12@1+ (0.05,-65) [-65|65] "m_per_s" MCU
 SG_ OBJ_Absolute_Speed_V_5 : 5371|1@1+ (1,0) [0|1] "bool" MCU
 SG_ Reserved_14_5 : 5372|4@1+ (1,0) [0|0] "NA" MCU
 SG_ OBJ_Absolute_Speed_STD_5 : 5376|13@1+ (0.01,0) [0|65] "m_per_s" MCU
 SG_ OBJ_Absolute_Speed_STD_V_5 : 5389|1@1+ (1,0) [0|1] "bool" MCU
 SG_ OBJ_Heading_5 : 5390|10@1+ (0.01,-3.14) [-3.14|3.14] "rad" MCU
 SG_ OBJ_Heading_V_5 : 5400|1@1+ (1,0) [0|1] "bool" MCU
 SG_ Reserved_15_5 : 5401|7@1+ (1,0) [0|0] "NA" MCU
 SG_ OBJ_Heading_STD_5 : 5408|15@1+ (0.0001,0) [0|3.14] "rad" MCU
 SG_ OBJ_Heading_STD_V_5 : 5423|1@1+ (1,0) [0|1] "bool" MCU
 SG_ OBJ_Angle_Rate_STD_5 : 5424|15@1+ (0.0001,0) [0|2.2318] "RPS" MCU
 SG_ OBJ_Angle_Rate_STD_V_5 : 5439|1@1+ (1,0) [0|1] "bool" MCU
 SG_ OBJ_Angle_Rate_5 : 5440|12@1+ (0.002,-2.234) [-2.234|2.2318] "RPS" MCU
 SG_ OBJ_Angle_Rate_V_5 : 5452|1@1+ (1,0) [0|1] "bool" MCU
 SG_ OBJ_Angle_Right_5 : 5453|14@1+ (0.0002,-1.571) [-1.571|1.571] "rad" MCU
 SG_ OBJ_Angle_Right_V_5 : 5467|1@1+ (1,0) [0|1] "bool" MCU
 SG_ Reserved_16_5 : 5468|4@1+ (1,0) [0|0] "NA" MCU
 SG_ OBJ_Angle_Right_STD_5 : 5472|14@1+ (0.0001,0) [0|1.571] "rad" MCU
 SG_ OBJ_Angle_Right_STD_V_5 : 5486|1@1+ (1,0) [0|1] "bool" MCU
 SG_ OBJ_Angle_Left_5 : 5487|14@1+ (0.0002,-1.571) [-1.571|1.571] "rad" MCU
 SG_ OBJ_Angle_Left_V_5 : 5501|1@1+ (1,0) [0|1] "bool" MCU
 SG_ Reserved_17_5 : 5502|2@1+ (1,0) [0|0] "NA" MCU
 SG_ OBJ_Angle_Left_STD_5 : 5504|14@1+ (0.0001,0) [0|1.571] "rad" MCU

CM_ SG_ 154 OBJ_Zero_byte "in case set to FF message is not available.";
CM_ SG_ 154 OBJ_Header_CRC "Calculated over all header signals. From the signal after the CRC until the first signal in the elements OBJ_CRC_0  not including";
CM_ SG_ 154 OBJ_Protocol_Version "Denotes the protocol version";
CM_ SG_ 154 OBJ_Sync_ID "The ID of the Sync message, used to synchronize between signals in the system. Every new frame promotes the sync ID by one.";
CM_ SG_ 154 OBJ_VRU_Count "The number of recognized Vulnerable Road Users (pedestrians, bicycles) in the scene.";
CM_ SG_ 154 OBJ_VD_Count "The number of recognized vehicles in the scene.";
CM_ SG_ 154 OBJ_General_OBJ_Count "The number of recognized General Objects in the scene.";
CM_ SG_ 154 OBJ_Animal_Count "The number of recognized animals in the scene.";
CM_ SG_ 154 OBJ_VD_NIV_Left "The ID of the closet VD object to the left of the host.";
CM_ SG_ 154 OBJ_VD_NIV_Right "The ID of the closet VD object to the right of the host.";
CM_ SG_ 154 OBJ_VD_CIPV_ID "The Current In Path Vehicle (CIPV) object ID.";
CM_ SG_ 154 OBJ_VD_CIPV_Lost "Reports a CIPV loss that cannot be explained to initiate a take over request.   ";
CM_ SG_ 154 OBJ_VD_Allow_Acc "This signal is intended to suppress acceleration in stop and go ACC scenarios when we suspect something is in our way.  ";
CM_ SG_ 154 OBJ_Is_Blocked_Left "Indicates whether the left side is blocked for lane change.";
CM_ SG_ 154 OBJ_Is_Blocked_Right "Indicates whether the right side is blocked for lane change.";
CM_ SG_ 154 OBJ_CRC_0 "Calculated over all element signals. From the signal after the CRC until the first signal in the next elements OBJ_CRC_N+1  not including";
CM_ SG_ 154 OBJ_ID_0 "The detected object ID. Range is 1-255, while 0 indicates that the field in unfilled.";
CM_ SG_ 154 OBJ_Existence_Probability_0 "The existence probability of the reported object";
CM_ SG_ 154 OBJ_Fusion_Source_0 "sources ids used for fusion";
CM_ SG_ 154 OBJ_Triggered_SDM_0 "Indicates whether the object has trigered the SDM (Safety Diagnostic Manager) alert.";
CM_ SG_ 154 OBJ_Motion_Category_0 "Relevant for VD only. Full description of values can be found at the ACC guide.";
CM_ SG_ 154 OBJ_Object_Age_0 "The number of frames in which the object was recognized.";
CM_ SG_ 154 OBJ_Measuring_Status_0 "Measurment status. Old vs New marks if this is the first frame in which the object is reported. Predicted vs Measured marks if the report is raw or has been predicted forward in time using the measured dynamics and ego motion.";
CM_ SG_ 154 OBJ_Object_Class_0 "Indicates the object type. Uncertain is outputted in case the probability that a vehicle is a truck is very similar to the probability that it is a car. ";
CM_ SG_ 154 OBJ_Class_Probability_0 "The probability of this type classification.";
CM_ SG_ 154 OBJ_Car_Probability_0 "The probability the object is a car";
CM_ SG_ 154 OBJ_Truck_Probability_0 "The probability the object is a Truck";
CM_ SG_ 154 OBJ_Bike_Probability_0 "The probability the object is a Bike";
CM_ SG_ 154 OBJ_Camera_Source_0 "The camera in which this object was detected (best choice).";
CM_ SG_ 154 OBJ_Motion_Status_0 "MOVING - the object is moving STATIONARY - the object was never seen moving STOPPED -  the object was moving and has stopped MOVING_SLOWLY - the object is moving very slowly";
CM_ SG_ 154 OBJ_Motion_Orientation_0 "The direction of the targets heading compared to the host. ";
CM_ SG_ 154 OBJ_Has_Cut_Lane_0 "Indicates whether the object cut the host's (right or left) lane. In case there are no lanes, indicates whether the objects is at most 1 meters away from the host.";
CM_ SG_ 154 OBJ_Has_Cut_Path_0 "Indicates whether the object is in the host's path.";
CM_ SG_ 154 OBJ_Brake_Light_0 "Indication for brake lights ";
CM_ SG_ 154 OBJ_Turn_Indicator_Right_0 "Indication for blinking right light.";
CM_ SG_ 154 OBJ_Turn_Indicator_Left_0 "Indication for blinking left light ";
CM_ SG_ 154 OBJ_Light_Indicator_Validity_0 "Validator for light indicators";
CM_ SG_ 154 OBJ_Right_Out_Of_Image_0 "Indicates whether the measurment are predicted out of the right side of the image bounderies.";
CM_ SG_ 154 OBJ_Left_Out_Of_Image_0 "Indicates whether if measurment are predicted out of  the left side of the image bounderies";
CM_ SG_ 154 OBJ_Right_Out_Of_Image_V_0 "validator";
CM_ SG_ 154 OBJ_Left_Out_Of_Image_V_0 "validator";
CM_ SG_ 154 OBJ_Top_Out_Of_Image_0 "Indicates whether if measurment are predicted out of  the top of the image bounderies";
CM_ SG_ 154 OBJ_Bottom_Out_Of_Image_0 "Indicates whether if measurment are predicted out of  the bottom of the image bounderies";
CM_ SG_ 154 OBJ_Top_Out_Of_Image_V_0 "validator";
CM_ SG_ 154 OBJ_Bottom_Out_Of_Image_V_0 "validator";
CM_ SG_ 154 OBJ_Lane_Assignment_0 "The object's lane relative to the host lane.";
CM_ SG_ 154 OBJ_Lane_Assignment_V_0 "Validator for lane assignment";
CM_ SG_ 154 OBJ_Age_Seconds_0 "Time in seconds in which the object was recognized. ";
CM_ SG_ 154 OBJ_Age_Seconds_V_0 "Validator for object age";
CM_ SG_ 154 OBJ_Width_0 "The width of the target vehicle in the world (not to be mistaken with the width of the visible part of the vehicle).";
CM_ SG_ 154 OBJ_Width_V_0 "Validator for object width";
CM_ SG_ 154 OBJ_Width_STD_0 "Standard deviation for object width";
CM_ SG_ 154 OBJ_Width_STD_V_0 "Validator for the standard deviation of object width";
CM_ SG_ 154 OBJ_Length_0 "The length of the vehicle in the world. For crossing bicycles it gives the viewed length of the bicycle.";
CM_ SG_ 154 OBJ_Length_V_0 "Validator for object length.";
CM_ SG_ 154 OBJ_Length_STD_0 "Standard deviation for object length.";
CM_ SG_ 154 OBJ_Length_STD_V_0 "Validator for the standard deviation of object length.";
CM_ SG_ 154 OBJ_Radar_ID_0 "Radar Object ID of the Fused Object, Only relvant when OBJ_Fusion_Source is not Camera only";
CM_ SG_ 154 OBJ_Height_0 "The height of the object in the world. ";
CM_ SG_ 154 OBJ_Height_V_0 "Validator for object height.";
CM_ SG_ 154 OBJ_Height_STD_0 "Standard deviation for object height.";
CM_ SG_ 154 OBJ_Height_STD_V_0 "Validator for the standard deviation of object height.";
CM_ SG_ 154 OBJ_Abs_Long_Velocity_0 "Absolute longitudinal velocity.";
CM_ SG_ 154 OBJ_Abs_Long_Velocity_V_0 "Validator for absolute longitudinal velocity.";
CM_ SG_ 154 OBJ_Abs_Long_Velocity_STD_0 "Standard deviation of absolute longitudinal velocity.";
CM_ SG_ 154 OBJ_Abs_Long_Vel_STD_V_0 "Validator for the standard deviation of the absolute longitudinal velocity.";
CM_ SG_ 154 OBJ_Abs_Lat_Velocity_0 "The lateral ground speed of the object.";
CM_ SG_ 154 OBJ_Abs_Lat_Velocity_V_0 "Validator for the lateral ground speed of the object.";
CM_ SG_ 154 OBJ_Abs_Lat_Velocity_STD_0 "STD of the lateral ground speed of the object.";
CM_ SG_ 154 OBJ_Abs_Lat_Vel_STD_V_0 "Validator for the STD of the lateral ground speed of the object.";
CM_ SG_ 154 OBJ_Abs_Long_Acc_0 "The longitudinal ground acceleration of the object.";
CM_ SG_ 154 OBJ_Abs_Long_Acc_V_0 "Validator for the longitudinal ground acceleration of the object.";
CM_ SG_ 154 OBJ_Abs_Long_Acc_STD_0 "STD of the longitudinal ground acceleration of the object.";
CM_ SG_ 154 OBJ_Abs_Long_Acc_STD_V_0 "Validator for the STD of the longitudinal ground acceleration of the object.";
CM_ SG_ 154 OBJ_Abs_Lat_Acc_0 "The lateral ground acceleration of the object.";
CM_ SG_ 154 OBJ_Abs_Lat_Acc_V_0 "Validator for the lateral ground acceleration of the object.";
CM_ SG_ 154 OBJ_Abs_Lat_Acc_STD_0 "STD of the lateral ground acceleration of the object.";
CM_ SG_ 154 OBJ_Abs_Lat_Acc_STD_V_0 "Validator for the STD of the lateral ground acceleration of the object.";
CM_ SG_ 154 OBJ_Abs_Acceleration_0 "The absolute ground acceleration in the target's heading direction.";
CM_ SG_ 154 OBJ_Abs_Acceleration_V_0 "Validator for the absolute ground acceleration.";
CM_ SG_ 154 OBJ_Abs_Acc_STD_0 "STD of the absolute ground acceleration.";
CM_ SG_ 154 OBJ_Abs_Acc_STD_V_0 "Validator for the STD of the absolute ground acceleration.";
CM_ SG_ 154 OBJ_Inv_TTC_0 "Inverse TTC (time to collision).";
CM_ SG_ 154 OBJ_Inv_TTC_STD_0 "STD for inverse TTC .";
CM_ SG_ 154 OBJ_Inv_TTC_STD_V_0 "Validator for the STD for inverse TTC .";
CM_ SG_ 154 OBJ_Relative_Long_Acc_0 "The relative lateral ground acceleration of the object.";
CM_ SG_ 154 OBJ_Relative_Long_Acc_V_0 "Validator for the relative lateral ground acceleration of the object.";
CM_ SG_ 154 OBJ_Relative_Long_Acc_STD_0 "STD of the relative lateral ground acceleration of the object.";
CM_ SG_ 154 OBJ_Rel_Long_Acc_STD_V_0 "Validator for the STD of the relative lateral ground acceleration.";
CM_ SG_ 154 OBJ_Relative_Long_Velocity_0 "The relative longtitudinal speed between the target and ego vehicle. ";
CM_ SG_ 154 OBJ_Relative_Long_Velocity_V_0 "Validator for the relative longtitudinal speed.";
CM_ SG_ 154 OBJ_Relative_Long_Vel_STD_0 "STD of the relative longtitudinal speed.";
CM_ SG_ 154 OBJ_Rel_Long_Vel_STD_V_0 "Validator for the STD of the relative longtitudinal speed.";
CM_ SG_ 154 OBJ_Relative_Lat_Velocity_0 "The relative lateral speed between the target and ego vehicle. ";
CM_ SG_ 154 OBJ_Relative_Lat_Velocity_V_0 "Validator for the relative lateral speed. ";
CM_ SG_ 154 OBJ_Relative_Lat_Velocity_STD_0 "STD of the relative lateral speed. ";
CM_ SG_ 154 OBJ_Rel_Lat_Vel_STD_V_0 "Validator for the STD of the relative lateral speed. ";
CM_ SG_ 154 OBJ_Long_Distance_0 "The longitudinal distance to middle of the rear bumper (middle of the RL and RR corners) of the target.";
CM_ SG_ 154 OBJ_Long_Distance_V_0 "Validator of the longtitudinal distance field";
CM_ SG_ 154 OBJ_Long_Distance_STD_0 "STD of the  longtitudinal distance.";
CM_ SG_ 154 OBJ_Long_Distance_STD_V_0 "Validator for the STD of the  longtitudinal distance.";
CM_ SG_ 154 OBJ_Lat_Distance_0 "Lateral distance to the middle of the RL and RR corners.  ";
CM_ SG_ 154 OBJ_Lat_Distance_V_0 "Validator for the lateral distance of the object.";
CM_ SG_ 154 OBJ_Lat_Distance_STD_0 "STD of the lateral distance of the object.";
CM_ SG_ 154 OBJ_Lat_Distance_STD_V_0 "Validator for the STD of the lateral distance of the object.";
CM_ SG_ 154 OBJ_Absolute_Speed_0 "The absolute ground speed in the targets' heading direction.";
CM_ SG_ 154 OBJ_Absolute_Speed_V_0 "Validator for the absolute ground speed.";
CM_ SG_ 154 OBJ_Absolute_Speed_STD_0 "STD of the absolute ground speed.";
CM_ SG_ 154 OBJ_Absolute_Speed_STD_V_0 "Validator for the STD of the absolute ground speed.";
CM_ SG_ 154 OBJ_Heading_0 "The angle beetweenthe host longitudinal axis and target's heading (clockwise, e.g. PI/2 is a target crossing from left to right).";
CM_ SG_ 154 OBJ_Heading_V_0 "Validator for the object heading.";
CM_ SG_ 154 OBJ_Heading_STD_0 "STD of the object heading.";
CM_ SG_ 154 OBJ_Heading_STD_V_0 "Validator for the STD of the object heading.";
CM_ SG_ 154 OBJ_Angle_Rate_STD_0 "Standard deviation of the angular speed. (radians)";
CM_ SG_ 154 OBJ_Angle_Rate_STD_V_0 "Validator for the STD of the angular speed.";
CM_ SG_ 154 OBJ_Angle_Rate_0 "The momentary angular speed of the object. (radians)";
CM_ SG_ 154 OBJ_Angle_Rate_V_0 "Validator for the angular speed.";
CM_ SG_ 154 OBJ_Angle_Right_0 "The angle between the host longitudinal axis and the right side of the front / rear of the target (the visible one). The positive side is to the host's right.";
CM_ SG_ 154 OBJ_Angle_Right_V_0 "Validator for angleRight";
CM_ SG_ 154 OBJ_Angle_Right_STD_0 "Standard deviation of angleRight";
CM_ SG_ 154 OBJ_Angle_Right_STD_V_0 "Validator for the standard deviation of angleRight.";
CM_ SG_ 154 OBJ_Angle_Left_0 "The angle between the host longitudinal axis and the left side of the front / rear of the target (the visible one). The positive side is to the host's right.";
CM_ SG_ 154 OBJ_Angle_Left_V_0 "Validator for angleLeft.";
CM_ SG_ 154 OBJ_Angle_Left_STD_0 "Standard deviation of angleLeft.";
CM_ SG_ 154 OBJ_Angle_Left_STD_V_0 "Validator for the standard deviation of angleLeft.";
CM_ SG_ 154 OBJ_Angle_Side_0 "The angle between the host longitudinal axis and the far visible edge - the visible edge of the front / rear of the target that is not visible. Currently supported for vehicles only.";
CM_ SG_ 154 OBJ_Angle_Side_V_0 "Validator for angleSide.";
CM_ SG_ 154 OBJ_Angle_Side_STD_0 "Standard deviation of angleSide.";
CM_ SG_ 154 OBJ_Angle_Side_STD_V_0 "Validator for the STD of angleSide.";
CM_ SG_ 154 OBJ_Angle_Mid_V_0 "Validator for angleMid.";
CM_ SG_ 154 OBJ_Angle_Mid_0 "The angle between the host longitudinal axis and the middle of the front / rear of the target (the visible one). The positive side is to the host's right.";
CM_ SG_ 154 OBJ_Angle_Mid_STD_0 "Standard deviation of angleMid.";
CM_ SG_ 154 OBJ_Angle_Mid_STD_V_0 "Validator for the STD of angleMid.";
CM_ SG_ 154 OBJ_Angle_Bottom_V_0 "Validator for OBJAngle_Bottom. ";
CM_ SG_ 154 OBJ_Angle_Bottom_0 "The angle between the longitudinal axis and the Bottom of the front / rear of the target (the visible one). The positive side is to the host's bottom";
CM_ SG_ 154 OBJ_Angle_Bottom_STD_0 "STD for OBJAngle_Bottom. ";
CM_ SG_ 154 OBJ_Angle_Bottom_STD_V_0 "Validator for OBJAngle_Bottom_STD. ";
CM_ SG_ 154 OBJ_Visibility_Side_V_0 "Currently Supported for VD only";
CM_ SG_ 154 OBJ_Visibility_Side_0 "From what car  side is the object visible";
CM_ SG_ 154 OBJ_Is_In_Drivable_Area_0 "Indicates whether the target is in a driveable area.";
CM_ SG_ 154 OBJ_Is_In_Drivable_Area_V_0 "Validator for OBJ_Is_In_Drivable_Area.";
CM_ SG_ 154 OBJ_Is_VeryClose_V_0 "Validator for OBJ_Is_VeryClose. ";
CM_ SG_ 154 OBJ_Is_VeryClose_0 "Indicates whether the target is very close to the host such that it is hard to measure its distance. Currently relevant for peds only";
CM_ SG_ 154 OBJ_OverlapAngleEgoLaneR_0 "Lateral distance to the middle of the RL and RR corners.";
CM_ SG_ 154 OBJ_OverlapAngleEgoLaneR_V_0 "Validator for OBJ_OverlapAngleEgoLaneR";
CM_ SG_ 154 OBJ_OverlapAngleEgoLaneL_0 "Lateral distance to the middle of the RL and RR corners.  ";
CM_ SG_ 154 OBJ_OverlapAngleEgoLaneL_V_0 "Validator for OBJ_OverlapAngleEgoLaneL";
CM_ SG_ 154 OBJ_Is_EMERGENCY_VCL_0 "Is Object an Emergency Vehicle";
CM_ SG_ 154 OBJ_EMERGENCY_LIGHT_COLOR_0 "Emergency Color";
CM_ SG_ 154 OBJ_EMERGENCY_V_0 "Are OBJ_Is_EMERGENCY_VCL and OBJ_EMERGENCY_LIGHT_COLOR Valid";
CM_ SG_ 154 OBJ_Angle_Top_0 "From VD touching point on the ground till the roof of the car";
CM_ SG_ 154 OBJ_Angle_Top_V_0 "Validator for OBJ_Angle_Top ";
CM_ SG_ 154 OBJ_Angle_Top_STD_0 "STD for OBJ_Angle_Top";
CM_ SG_ 154 OBJ_Angle_Top_STD_V_0 "Validator for OBJ_Angle_Top_STD. ";
CM_ SG_ 154 OBJ_CRC_1 "Calculated over all element signals. From the signal after the CRC until the first signal in the next elements OBJ_CRC_N+1  not including";
CM_ SG_ 154 OBJ_ID_1 "The detected object ID. Range is 1-255, while 0 indicates that the field in unfilled.";
CM_ SG_ 154 OBJ_Existence_Probability_1 "The existence probability of the reported object";
CM_ SG_ 154 OBJ_Fusion_Source_1 "sources ids used for fusion";
CM_ SG_ 154 OBJ_Triggered_SDM_1 "Indicates whether the object has trigered the SDM (Safety Diagnostic Manager) alert.";
CM_ SG_ 154 OBJ_Motion_Category_1 "Relevant for VD only. Full description of values can be found at the ACC guide.";
CM_ SG_ 154 OBJ_Object_Age_1 "The number of frames in which the object was recognized.";
CM_ SG_ 154 OBJ_Measuring_Status_1 "Measurment status. Old vs New marks if this is the first frame in which the object is reported. Predicted vs Measured marks if the report is raw or has been predicted forward in time using the measured dynamics and ego motion.";
CM_ SG_ 154 OBJ_Object_Class_1 "Indicates the object type. Uncertain is outputted in case the probability that a vehicle is a truck is very similar to the probability that it is a car. ";
CM_ SG_ 154 OBJ_Class_Probability_1 "The probability of this type classification.";
CM_ SG_ 154 OBJ_Car_Probability_1 "The probability the object is a car";
CM_ SG_ 154 OBJ_Truck_Probability_1 "The probability the object is a Truck";
CM_ SG_ 154 OBJ_Bike_Probability_1 "The probability the object is a Bike";
CM_ SG_ 154 OBJ_Camera_Source_1 "The camera in which this object was detected (best choice).";
CM_ SG_ 154 OBJ_Motion_Status_1 "MOVING - the object is moving STATIONARY - the object was never seen moving STOPPED -  the object was moving and has stopped MOVING_SLOWLY - the object is moving very slowly";
CM_ SG_ 154 OBJ_Motion_Orientation_1 "The direction of the targets heading compared to the host. ";
CM_ SG_ 154 OBJ_Has_Cut_Lane_1 "Indicates whether the object cut the host's (right or left) lane. In case there are no lanes, indicates whether the objects is at most 1 meters away from the host.";
CM_ SG_ 154 OBJ_Has_Cut_Path_1 "Indicates whether the object is in the host's path.";
CM_ SG_ 154 OBJ_Brake_Light_1 "Indication for brake lights ";
CM_ SG_ 154 OBJ_Turn_Indicator_Right_1 "Indication for blinking right light.";
CM_ SG_ 154 OBJ_Turn_Indicator_Left_1 "Indication for blinking left light ";
CM_ SG_ 154 OBJ_Light_Indicator_Validity_1 "Validator for light indicators";
CM_ SG_ 154 OBJ_Right_Out_Of_Image_1 "Indicates whether the measurment are predicted out of the right side of the image bounderies.";
CM_ SG_ 154 OBJ_Left_Out_Of_Image_1 "Indicates whether if measurment are predicted out of  the left side of the image bounderies";
CM_ SG_ 154 OBJ_Right_Out_Of_Image_V_1 "validator";
CM_ SG_ 154 OBJ_Left_Out_Of_Image_V_1 "validator";
CM_ SG_ 154 OBJ_Top_Out_Of_Image_1 "Indicates whether if measurment are predicted out of  the top of the image bounderies";
CM_ SG_ 154 OBJ_Bottom_Out_Of_Image_1 "Indicates whether if measurment are predicted out of  the bottom of the image bounderies";
CM_ SG_ 154 OBJ_Top_Out_Of_Image_V_1 "validator";
CM_ SG_ 154 OBJ_Bottom_Out_Of_Image_V_1 "validator";
CM_ SG_ 154 OBJ_Lane_Assignment_1 "The object's lane relative to the host lane.";
CM_ SG_ 154 OBJ_Lane_Assignment_V_1 "Validator for lane assignment";
CM_ SG_ 154 OBJ_Age_Seconds_1 "Time in seconds in which the object was recognized. ";
CM_ SG_ 154 OBJ_Age_Seconds_V_1 "Validator for object age";
CM_ SG_ 154 OBJ_Width_1 "The width of the target vehicle in the world (not to be mistaken with the width of the visible part of the vehicle).";
CM_ SG_ 154 OBJ_Width_V_1 "Validator for object width";
CM_ SG_ 154 OBJ_Width_STD_1 "Standard deviation for object width";
CM_ SG_ 154 OBJ_Width_STD_V_1 "Validator for the standard deviation of object width";
CM_ SG_ 154 OBJ_Length_1 "The length of the vehicle in the world. For crossing bicycles it gives the viewed length of the bicycle.";
CM_ SG_ 154 OBJ_Length_V_1 "Validator for object length.";
CM_ SG_ 154 OBJ_Length_STD_1 "Standard deviation for object length.";
CM_ SG_ 154 OBJ_Length_STD_V_1 "Validator for the standard deviation of object length.";
CM_ SG_ 154 OBJ_Radar_ID_1 "Radar Object ID of the Fused Object, Only relvant when OBJ_Fusion_Source is not Camera only";
CM_ SG_ 154 OBJ_Height_1 "The height of the object in the world. ";
CM_ SG_ 154 OBJ_Height_V_1 "Validator for object height.";
CM_ SG_ 154 OBJ_Height_STD_1 "Standard deviation for object height.";
CM_ SG_ 154 OBJ_Height_STD_V_1 "Validator for the standard deviation of object height.";
CM_ SG_ 154 OBJ_Abs_Long_Velocity_1 "Absolute longitudinal velocity.";
CM_ SG_ 154 OBJ_Abs_Long_Velocity_V_1 "Validator for absolute longitudinal velocity.";
CM_ SG_ 154 OBJ_Abs_Long_Velocity_STD_1 "Standard deviation of absolute longitudinal velocity.";
CM_ SG_ 154 OBJ_Abs_Long_Vel_STD_V_1 "Validator for the standard deviation of the absolute longitudinal velocity.";
CM_ SG_ 154 OBJ_Abs_Lat_Velocity_1 "The lateral ground speed of the object.";
CM_ SG_ 154 OBJ_Abs_Lat_Velocity_V_1 "Validator for the lateral ground speed of the object.";
CM_ SG_ 154 OBJ_Abs_Lat_Velocity_STD_1 "STD of the lateral ground speed of the object.";
CM_ SG_ 154 OBJ_Abs_Lat_Vel_STD_V_1 "Validator for the STD of the lateral ground speed of the object.";
CM_ SG_ 154 OBJ_Abs_Long_Acc_1 "The longitudinal ground acceleration of the object.";
CM_ SG_ 154 OBJ_Abs_Long_Acc_V_1 "Validator for the longitudinal ground acceleration of the object.";
CM_ SG_ 154 OBJ_Abs_Long_Acc_STD_1 "STD of the longitudinal ground acceleration of the object.";
CM_ SG_ 154 OBJ_Abs_Long_Acc_STD_V_1 "Validator for the STD of the longitudinal ground acceleration of the object.";
CM_ SG_ 154 OBJ_Abs_Lat_Acc_1 "The lateral ground acceleration of the object.";
CM_ SG_ 154 OBJ_Abs_Lat_Acc_V_1 "Validator for the lateral ground acceleration of the object.";
CM_ SG_ 154 OBJ_Abs_Lat_Acc_STD_1 "STD of the lateral ground acceleration of the object.";
CM_ SG_ 154 OBJ_Abs_Lat_Acc_STD_V_1 "Validator for the STD of the lateral ground acceleration of the object.";
CM_ SG_ 154 OBJ_Abs_Acceleration_1 "The absolute ground acceleration in the target's heading direction.";
CM_ SG_ 154 OBJ_Abs_Acceleration_V_1 "Validator for the absolute ground acceleration.";
CM_ SG_ 154 OBJ_Abs_Acc_STD_1 "STD of the absolute ground acceleration.";
CM_ SG_ 154 OBJ_Abs_Acc_STD_V_1 "Validator for the STD of the absolute ground acceleration.";
CM_ SG_ 154 OBJ_Inv_TTC_1 "Inverse TTC (time to collision).";
CM_ SG_ 154 OBJ_Inv_TTC_STD_1 "STD for inverse TTC .";
CM_ SG_ 154 OBJ_Inv_TTC_STD_V_1 "Validator for the STD for inverse TTC .";
CM_ SG_ 154 OBJ_Relative_Long_Acc_1 "The relative lateral ground acceleration of the object.";
CM_ SG_ 154 OBJ_Relative_Long_Acc_V_1 "Validator for the relative lateral ground acceleration of the object.";
CM_ SG_ 154 OBJ_Relative_Long_Acc_STD_1 "STD of the relative lateral ground acceleration of the object.";
CM_ SG_ 154 OBJ_Rel_Long_Acc_STD_V_1 "Validator for the STD of the relative lateral ground acceleration.";
CM_ SG_ 154 OBJ_Relative_Long_Velocity_1 "The relative longtitudinal speed between the target and ego vehicle. ";
CM_ SG_ 154 OBJ_Relative_Long_Velocity_V_1 "Validator for the relative longtitudinal speed.";
CM_ SG_ 154 OBJ_Relative_Long_Vel_STD_1 "STD of the relative longtitudinal speed.";
CM_ SG_ 154 OBJ_Rel_Long_Vel_STD_V_1 "Validator for the STD of the relative longtitudinal speed.";
CM_ SG_ 154 OBJ_Relative_Lat_Velocity_1 "The relative lateral speed between the target and ego vehicle. ";
CM_ SG_ 154 OBJ_Relative_Lat_Velocity_V_1 "Validator for the relative lateral speed. ";
CM_ SG_ 154 OBJ_Relative_Lat_Velocity_STD_1 "STD of the relative lateral speed. ";
CM_ SG_ 154 OBJ_Rel_Lat_Vel_STD_V_1 "Validator for the STD of the relative lateral speed. ";
CM_ SG_ 154 OBJ_Long_Distance_1 "The longitudinal distance to middle of the rear bumper (middle of the RL and RR corners) of the target.";
CM_ SG_ 154 OBJ_Long_Distance_V_1 "Validator of the longtitudinal distance field";
CM_ SG_ 154 OBJ_Long_Distance_STD_1 "STD of the  longtitudinal distance.";
CM_ SG_ 154 OBJ_Long_Distance_STD_V_1 "Validator for the STD of the  longtitudinal distance.";
CM_ SG_ 154 OBJ_Lat_Distance_1 "Lateral distance to the middle of the RL and RR corners.  ";
CM_ SG_ 154 OBJ_Lat_Distance_V_1 "Validator for the lateral distance of the object.";
CM_ SG_ 154 OBJ_Lat_Distance_STD_1 "STD of the lateral distance of the object.";
CM_ SG_ 154 OBJ_Lat_Distance_STD_V_1 "Validator for the STD of the lateral distance of the object.";
CM_ SG_ 154 OBJ_Absolute_Speed_1 "The absolute ground speed in the targets' heading direction.";
CM_ SG_ 154 OBJ_Absolute_Speed_V_1 "Validator for the absolute ground speed.";
CM_ SG_ 154 OBJ_Absolute_Speed_STD_1 "STD of the absolute ground speed.";
CM_ SG_ 154 OBJ_Absolute_Speed_STD_V_1 "Validator for the STD of the absolute ground speed.";
CM_ SG_ 154 OBJ_Heading_1 "The angle beetweenthe host longitudinal axis and target's heading (clockwise, e.g. PI/2 is a target crossing from left to right).";
CM_ SG_ 154 OBJ_Heading_V_1 "Validator for the object heading.";
CM_ SG_ 154 OBJ_Heading_STD_1 "STD of the object heading.";
CM_ SG_ 154 OBJ_Heading_STD_V_1 "Validator for the STD of the object heading.";
CM_ SG_ 154 OBJ_Angle_Rate_STD_1 "Standard deviation of the angular speed. (radians)";
CM_ SG_ 154 OBJ_Angle_Rate_STD_V_1 "Validator for the STD of the angular speed.";
CM_ SG_ 154 OBJ_Angle_Rate_1 "The momentary angular speed of the object. (radians)";
CM_ SG_ 154 OBJ_Angle_Rate_V_1 "Validator for the angular speed.";
CM_ SG_ 154 OBJ_Angle_Right_1 "The angle between the host longitudinal axis and the right side of the front / rear of the target (the visible one). The positive side is to the host's right.";
CM_ SG_ 154 OBJ_Angle_Right_V_1 "Validator for angleRight";
CM_ SG_ 154 OBJ_Angle_Right_STD_1 "Standard deviation of angleRight";
CM_ SG_ 154 OBJ_Angle_Right_STD_V_1 "Validator for the standard deviation of angleRight.";
CM_ SG_ 154 OBJ_Angle_Left_1 "The angle between the host longitudinal axis and the left side of the front / rear of the target (the visible one). The positive side is to the host's right.";
CM_ SG_ 154 OBJ_Angle_Left_V_1 "Validator for angleLeft.";
CM_ SG_ 154 OBJ_Angle_Left_STD_1 "Standard deviation of angleLeft.";
CM_ SG_ 154 OBJ_Angle_Left_STD_V_1 "Validator for the standard deviation of angleLeft.";
CM_ SG_ 154 OBJ_Angle_Side_1 "The angle between the host longitudinal axis and the far visible edge - the visible edge of the front / rear of the target that is not visible. Currently supported for vehicles only.";
CM_ SG_ 154 OBJ_Angle_Side_V_1 "Validator for angleSide.";
CM_ SG_ 154 OBJ_Angle_Side_STD_1 "Standard deviation of angleSide.";
CM_ SG_ 154 OBJ_Angle_Side_STD_V_1 "Validator for the STD of angleSide.";
CM_ SG_ 154 OBJ_Angle_Mid_V_1 "Validator for angleMid.";
CM_ SG_ 154 OBJ_Angle_Mid_1 "The angle between the host longitudinal axis and the middle of the front / rear of the target (the visible one). The positive side is to the host's right.";
CM_ SG_ 154 OBJ_Angle_Mid_STD_1 "Standard deviation of angleMid.";
CM_ SG_ 154 OBJ_Angle_Mid_STD_V_1 "Validator for the STD of angleMid.";
CM_ SG_ 154 OBJ_Angle_Bottom_V_1 "Validator for OBJAngle_Bottom. ";
CM_ SG_ 154 OBJ_Angle_Bottom_1 "The angle between the longitudinal axis and the Bottom of the front / rear of the target (the visible one). The positive side is to the host's bottom";
CM_ SG_ 154 OBJ_Angle_Bottom_STD_1 "STD for OBJAngle_Bottom. ";
CM_ SG_ 154 OBJ_Angle_Bottom_STD_V_1 "Validator for OBJAngle_Bottom_STD. ";
CM_ SG_ 154 OBJ_Visibility_Side_V_1 "Currently Supported for VD only";
CM_ SG_ 154 OBJ_Visibility_Side_1 "From what car  side is the object visible";
CM_ SG_ 154 OBJ_Is_In_Drivable_Area_1 "Indicates whether the target is in a driveable area.";
CM_ SG_ 154 OBJ_Is_In_Drivable_Area_V_1 "Validator for OBJ_Is_In_Drivable_Area.";
CM_ SG_ 154 OBJ_Is_VeryClose_V_1 "Validator for OBJ_Is_VeryClose. ";
CM_ SG_ 154 OBJ_Is_VeryClose_1 "Indicates whether the target is very close to the host such that it is hard to measure its distance. Currently relevant for peds only";
CM_ SG_ 154 OBJ_OverlapAngleEgoLaneR_1 "Lateral distance to the middle of the RL and RR corners.";
CM_ SG_ 154 OBJ_OverlapAngleEgoLaneR_V_1 "Validator for OBJ_OverlapAngleEgoLaneR";
CM_ SG_ 154 OBJ_OverlapAngleEgoLaneL_1 "Lateral distance to the middle of the RL and RR corners.  ";
CM_ SG_ 154 OBJ_OverlapAngleEgoLaneL_V_1 "Validator for OBJ_OverlapAngleEgoLaneL";
CM_ SG_ 154 OBJ_Is_EMERGENCY_VCL_1 "Is Object an Emergency Vehicle";
CM_ SG_ 154 OBJ_EMERGENCY_LIGHT_COLOR_1 "Emergency Color";
CM_ SG_ 154 OBJ_EMERGENCY_V_1 "Are OBJ_Is_EMERGENCY_VCL and OBJ_EMERGENCY_LIGHT_COLOR Valid";
CM_ SG_ 154 OBJ_Angle_Top_1 "From VD touching point on the ground till the roof of the car";
CM_ SG_ 154 OBJ_Angle_Top_V_1 "Validator for OBJ_Angle_Top ";
CM_ SG_ 154 OBJ_Angle_Top_STD_1 "STD for OBJ_Angle_Top";
CM_ SG_ 154 OBJ_Angle_Top_STD_V_1 "Validator for OBJ_Angle_Top_STD. ";
CM_ SG_ 154 OBJ_CRC_2 "Calculated over all element signals. From the signal after the CRC until the first signal in the next elements OBJ_CRC_N+1  not including";
CM_ SG_ 154 OBJ_ID_2 "The detected object ID. Range is 1-255, while 0 indicates that the field in unfilled.";
CM_ SG_ 154 OBJ_Existence_Probability_2 "The existence probability of the reported object";
CM_ SG_ 154 OBJ_Fusion_Source_2 "sources ids used for fusion";
CM_ SG_ 154 OBJ_Triggered_SDM_2 "Indicates whether the object has trigered the SDM (Safety Diagnostic Manager) alert.";
CM_ SG_ 154 OBJ_Motion_Category_2 "Relevant for VD only. Full description of values can be found at the ACC guide.";
CM_ SG_ 154 OBJ_Object_Age_2 "The number of frames in which the object was recognized.";
CM_ SG_ 154 OBJ_Measuring_Status_2 "Measurment status. Old vs New marks if this is the first frame in which the object is reported. Predicted vs Measured marks if the report is raw or has been predicted forward in time using the measured dynamics and ego motion.";
CM_ SG_ 154 OBJ_Object_Class_2 "Indicates the object type. Uncertain is outputted in case the probability that a vehicle is a truck is very similar to the probability that it is a car. ";
CM_ SG_ 154 OBJ_Class_Probability_2 "The probability of this type classification.";
CM_ SG_ 154 OBJ_Car_Probability_2 "The probability the object is a car";
CM_ SG_ 154 OBJ_Truck_Probability_2 "The probability the object is a Truck";
CM_ SG_ 154 OBJ_Bike_Probability_2 "The probability the object is a Bike";
CM_ SG_ 154 OBJ_Camera_Source_2 "The camera in which this object was detected (best choice).";
CM_ SG_ 154 OBJ_Motion_Status_2 "MOVING - the object is moving STATIONARY - the object was never seen moving STOPPED -  the object was moving and has stopped MOVING_SLOWLY - the object is moving very slowly";
CM_ SG_ 154 OBJ_Motion_Orientation_2 "The direction of the targets heading compared to the host. ";
CM_ SG_ 154 OBJ_Has_Cut_Lane_2 "Indicates whether the object cut the host's (right or left) lane. In case there are no lanes, indicates whether the objects is at most 1 meters away from the host.";
CM_ SG_ 154 OBJ_Has_Cut_Path_2 "Indicates whether the object is in the host's path.";
CM_ SG_ 154 OBJ_Brake_Light_2 "Indication for brake lights ";
CM_ SG_ 154 OBJ_Turn_Indicator_Right_2 "Indication for blinking right light.";
CM_ SG_ 154 OBJ_Turn_Indicator_Left_2 "Indication for blinking left light ";
CM_ SG_ 154 OBJ_Light_Indicator_Validity_2 "Validator for light indicators";
CM_ SG_ 154 OBJ_Right_Out_Of_Image_2 "Indicates whether the measurment are predicted out of the right side of the image bounderies.";
CM_ SG_ 154 OBJ_Left_Out_Of_Image_2 "Indicates whether if measurment are predicted out of  the left side of the image bounderies";
CM_ SG_ 154 OBJ_Right_Out_Of_Image_V_2 "validator";
CM_ SG_ 154 OBJ_Left_Out_Of_Image_V_2 "validator";
CM_ SG_ 154 OBJ_Top_Out_Of_Image_2 "Indicates whether if measurment are predicted out of  the top of the image bounderies";
CM_ SG_ 154 OBJ_Bottom_Out_Of_Image_2 "Indicates whether if measurment are predicted out of  the bottom of the image bounderies";
CM_ SG_ 154 OBJ_Top_Out_Of_Image_V_2 "validator";
CM_ SG_ 154 OBJ_Bottom_Out_Of_Image_V_2 "validator";
CM_ SG_ 154 OBJ_Lane_Assignment_2 "The object's lane relative to the host lane.";
CM_ SG_ 154 OBJ_Lane_Assignment_V_2 "Validator for lane assignment";
CM_ SG_ 154 OBJ_Age_Seconds_2 "Time in seconds in which the object was recognized. ";
CM_ SG_ 154 OBJ_Age_Seconds_V_2 "Validator for object age";
CM_ SG_ 154 OBJ_Width_2 "The width of the target vehicle in the world (not to be mistaken with the width of the visible part of the vehicle).";
CM_ SG_ 154 OBJ_Width_V_2 "Validator for object width";
CM_ SG_ 154 OBJ_Width_STD_2 "Standard deviation for object width";
CM_ SG_ 154 OBJ_Width_STD_V_2 "Validator for the standard deviation of object width";
CM_ SG_ 154 OBJ_Length_2 "The length of the vehicle in the world. For crossing bicycles it gives the viewed length of the bicycle.";
CM_ SG_ 154 OBJ_Length_V_2 "Validator for object length.";
CM_ SG_ 154 OBJ_Length_STD_2 "Standard deviation for object length.";
CM_ SG_ 154 OBJ_Length_STD_V_2 "Validator for the standard deviation of object length.";
CM_ SG_ 154 OBJ_Radar_ID_2 "Radar Object ID of the Fused Object, Only relvant when OBJ_Fusion_Source is not Camera only";
CM_ SG_ 154 OBJ_Height_2 "The height of the object in the world. ";
CM_ SG_ 154 OBJ_Height_V_2 "Validator for object height.";
CM_ SG_ 154 OBJ_Height_STD_2 "Standard deviation for object height.";
CM_ SG_ 154 OBJ_Height_STD_V_2 "Validator for the standard deviation of object height.";
CM_ SG_ 154 OBJ_Abs_Long_Velocity_2 "Absolute longitudinal velocity.";
CM_ SG_ 154 OBJ_Abs_Long_Velocity_V_2 "Validator for absolute longitudinal velocity.";
CM_ SG_ 154 OBJ_Abs_Long_Velocity_STD_2 "Standard deviation of absolute longitudinal velocity.";
CM_ SG_ 154 OBJ_Abs_Long_Vel_STD_V_2 "Validator for the standard deviation of the absolute longitudinal velocity.";
CM_ SG_ 154 OBJ_Abs_Lat_Velocity_2 "The lateral ground speed of the object.";
CM_ SG_ 154 OBJ_Abs_Lat_Velocity_V_2 "Validator for the lateral ground speed of the object.";
CM_ SG_ 154 OBJ_Abs_Lat_Velocity_STD_2 "STD of the lateral ground speed of the object.";
CM_ SG_ 154 OBJ_Abs_Lat_Vel_STD_V_2 "Validator for the STD of the lateral ground speed of the object.";
CM_ SG_ 154 OBJ_Abs_Long_Acc_2 "The longitudinal ground acceleration of the object.";
CM_ SG_ 154 OBJ_Abs_Long_Acc_V_2 "Validator for the longitudinal ground acceleration of the object.";
CM_ SG_ 154 OBJ_Abs_Long_Acc_STD_2 "STD of the longitudinal ground acceleration of the object.";
CM_ SG_ 154 OBJ_Abs_Long_Acc_STD_V_2 "Validator for the STD of the longitudinal ground acceleration of the object.";
CM_ SG_ 154 OBJ_Abs_Lat_Acc_2 "The lateral ground acceleration of the object.";
CM_ SG_ 154 OBJ_Abs_Lat_Acc_V_2 "Validator for the lateral ground acceleration of the object.";
CM_ SG_ 154 OBJ_Abs_Lat_Acc_STD_2 "STD of the lateral ground acceleration of the object.";
CM_ SG_ 154 OBJ_Abs_Lat_Acc_STD_V_2 "Validator for the STD of the lateral ground acceleration of the object.";
CM_ SG_ 154 OBJ_Abs_Acceleration_2 "The absolute ground acceleration in the target's heading direction.";
CM_ SG_ 154 OBJ_Abs_Acceleration_V_2 "Validator for the absolute ground acceleration.";
CM_ SG_ 154 OBJ_Abs_Acc_STD_2 "STD of the absolute ground acceleration.";
CM_ SG_ 154 OBJ_Abs_Acc_STD_V_2 "Validator for the STD of the absolute ground acceleration.";
CM_ SG_ 154 OBJ_Inv_TTC_2 "Inverse TTC (time to collision).";
CM_ SG_ 154 OBJ_Inv_TTC_STD_2 "STD for inverse TTC .";
CM_ SG_ 154 OBJ_Inv_TTC_STD_V_2 "Validator for the STD for inverse TTC .";
CM_ SG_ 154 OBJ_Relative_Long_Acc_2 "The relative lateral ground acceleration of the object.";
CM_ SG_ 154 OBJ_Relative_Long_Acc_V_2 "Validator for the relative lateral ground acceleration of the object.";
CM_ SG_ 154 OBJ_Relative_Long_Acc_STD_2 "STD of the relative lateral ground acceleration of the object.";
CM_ SG_ 154 OBJ_Rel_Long_Acc_STD_V_2 "Validator for the STD of the relative lateral ground acceleration.";
CM_ SG_ 154 OBJ_Relative_Long_Velocity_2 "The relative longtitudinal speed between the target and ego vehicle. ";
CM_ SG_ 154 OBJ_Relative_Long_Velocity_V_2 "Validator for the relative longtitudinal speed.";
CM_ SG_ 154 OBJ_Relative_Long_Vel_STD_2 "STD of the relative longtitudinal speed.";
CM_ SG_ 154 OBJ_Rel_Long_Vel_STD_V_2 "Validator for the STD of the relative longtitudinal speed.";
CM_ SG_ 154 OBJ_Relative_Lat_Velocity_2 "The relative lateral speed between the target and ego vehicle. ";
CM_ SG_ 154 OBJ_Relative_Lat_Velocity_V_2 "Validator for the relative lateral speed. ";
CM_ SG_ 154 OBJ_Relative_Lat_Velocity_STD_2 "STD of the relative lateral speed. ";
CM_ SG_ 154 OBJ_Rel_Lat_Vel_STD_V_2 "Validator for the STD of the relative lateral speed. ";
CM_ SG_ 154 OBJ_Long_Distance_2 "The longitudinal distance to middle of the rear bumper (middle of the RL and RR corners) of the target.";
CM_ SG_ 154 OBJ_Long_Distance_V_2 "Validator of the longtitudinal distance field";
CM_ SG_ 154 OBJ_Long_Distance_STD_2 "STD of the  longtitudinal distance.";
CM_ SG_ 154 OBJ_Long_Distance_STD_V_2 "Validator for the STD of the  longtitudinal distance.";
CM_ SG_ 154 OBJ_Lat_Distance_2 "Lateral distance to the middle of the RL and RR corners.  ";
CM_ SG_ 154 OBJ_Lat_Distance_V_2 "Validator for the lateral distance of the object.";
CM_ SG_ 154 OBJ_Lat_Distance_STD_2 "STD of the lateral distance of the object.";
CM_ SG_ 154 OBJ_Lat_Distance_STD_V_2 "Validator for the STD of the lateral distance of the object.";
CM_ SG_ 154 OBJ_Absolute_Speed_2 "The absolute ground speed in the targets' heading direction.";
CM_ SG_ 154 OBJ_Absolute_Speed_V_2 "Validator for the absolute ground speed.";
CM_ SG_ 154 OBJ_Absolute_Speed_STD_2 "STD of the absolute ground speed.";
CM_ SG_ 154 OBJ_Absolute_Speed_STD_V_2 "Validator for the STD of the absolute ground speed.";
CM_ SG_ 154 OBJ_Heading_2 "The angle beetweenthe host longitudinal axis and target's heading (clockwise, e.g. PI/2 is a target crossing from left to right).";
CM_ SG_ 154 OBJ_Heading_V_2 "Validator for the object heading.";
CM_ SG_ 154 OBJ_Heading_STD_2 "STD of the object heading.";
CM_ SG_ 154 OBJ_Heading_STD_V_2 "Validator for the STD of the object heading.";
CM_ SG_ 154 OBJ_Angle_Rate_STD_2 "Standard deviation of the angular speed. (radians)";
CM_ SG_ 154 OBJ_Angle_Rate_STD_V_2 "Validator for the STD of the angular speed.";
CM_ SG_ 154 OBJ_Angle_Rate_2 "The momentary angular speed of the object. (radians)";
CM_ SG_ 154 OBJ_Angle_Rate_V_2 "Validator for the angular speed.";
CM_ SG_ 154 OBJ_Angle_Right_2 "The angle between the host longitudinal axis and the right side of the front / rear of the target (the visible one). The positive side is to the host's right.";
CM_ SG_ 154 OBJ_Angle_Right_V_2 "Validator for angleRight";
CM_ SG_ 154 OBJ_Angle_Right_STD_2 "Standard deviation of angleRight";
CM_ SG_ 154 OBJ_Angle_Right_STD_V_2 "Validator for the standard deviation of angleRight.";
CM_ SG_ 154 OBJ_Angle_Left_2 "The angle between the host longitudinal axis and the left side of the front / rear of the target (the visible one). The positive side is to the host's right.";
CM_ SG_ 154 OBJ_Angle_Left_V_2 "Validator for angleLeft.";
CM_ SG_ 154 OBJ_Angle_Left_STD_2 "Standard deviation of angleLeft.";
CM_ SG_ 154 OBJ_Angle_Left_STD_V_2 "Validator for the standard deviation of angleLeft.";
CM_ SG_ 154 OBJ_Angle_Side_2 "The angle between the host longitudinal axis and the far visible edge - the visible edge of the front / rear of the target that is not visible. Currently supported for vehicles only.";
CM_ SG_ 154 OBJ_Angle_Side_V_2 "Validator for angleSide.";
CM_ SG_ 154 OBJ_Angle_Side_STD_2 "Standard deviation of angleSide.";
CM_ SG_ 154 OBJ_Angle_Side_STD_V_2 "Validator for the STD of angleSide.";
CM_ SG_ 154 OBJ_Angle_Mid_V_2 "Validator for angleMid.";
CM_ SG_ 154 OBJ_Angle_Mid_2 "The angle between the host longitudinal axis and the middle of the front / rear of the target (the visible one). The positive side is to the host's right.";
CM_ SG_ 154 OBJ_Angle_Mid_STD_2 "Standard deviation of angleMid.";
CM_ SG_ 154 OBJ_Angle_Mid_STD_V_2 "Validator for the STD of angleMid.";
CM_ SG_ 154 OBJ_Angle_Bottom_V_2 "Validator for OBJAngle_Bottom. ";
CM_ SG_ 154 OBJ_Angle_Bottom_2 "The angle between the longitudinal axis and the Bottom of the front / rear of the target (the visible one). The positive side is to the host's bottom";
CM_ SG_ 154 OBJ_Angle_Bottom_STD_2 "STD for OBJAngle_Bottom. ";
CM_ SG_ 154 OBJ_Angle_Bottom_STD_V_2 "Validator for OBJAngle_Bottom_STD. ";
CM_ SG_ 154 OBJ_Visibility_Side_V_2 "Currently Supported for VD only";
CM_ SG_ 154 OBJ_Visibility_Side_2 "From what car  side is the object visible";
CM_ SG_ 154 OBJ_Is_In_Drivable_Area_2 "Indicates whether the target is in a driveable area.";
CM_ SG_ 154 OBJ_Is_In_Drivable_Area_V_2 "Validator for OBJ_Is_In_Drivable_Area.";
CM_ SG_ 154 OBJ_Is_VeryClose_V_2 "Validator for OBJ_Is_VeryClose. ";
CM_ SG_ 154 OBJ_Is_VeryClose_2 "Indicates whether the target is very close to the host such that it is hard to measure its distance. Currently relevant for peds only";
CM_ SG_ 154 OBJ_OverlapAngleEgoLaneR_2 "Lateral distance to the middle of the RL and RR corners.";
CM_ SG_ 154 OBJ_OverlapAngleEgoLaneR_V_2 "Validator for OBJ_OverlapAngleEgoLaneR";
CM_ SG_ 154 OBJ_OverlapAngleEgoLaneL_2 "Lateral distance to the middle of the RL and RR corners.  ";
CM_ SG_ 154 OBJ_OverlapAngleEgoLaneL_V_2 "Validator for OBJ_OverlapAngleEgoLaneL";
CM_ SG_ 154 OBJ_Is_EMERGENCY_VCL_2 "Is Object an Emergency Vehicle";
CM_ SG_ 154 OBJ_EMERGENCY_LIGHT_COLOR_2 "Emergency Color";
CM_ SG_ 154 OBJ_EMERGENCY_V_2 "Are OBJ_Is_EMERGENCY_VCL and OBJ_EMERGENCY_LIGHT_COLOR Valid";
CM_ SG_ 154 OBJ_Angle_Top_2 "From VD touching point on the ground till the roof of the car";
CM_ SG_ 154 OBJ_Angle_Top_V_2 "Validator for OBJ_Angle_Top ";
CM_ SG_ 154 OBJ_Angle_Top_STD_2 "STD for OBJ_Angle_Top";
CM_ SG_ 154 OBJ_Angle_Top_STD_V_2 "Validator for OBJ_Angle_Top_STD. ";
CM_ SG_ 154 OBJ_CRC_3 "Calculated over all element signals. From the signal after the CRC until the first signal in the next elements OBJ_CRC_N+1  not including";
CM_ SG_ 154 OBJ_ID_3 "The detected object ID. Range is 1-255, while 0 indicates that the field in unfilled.";
CM_ SG_ 154 OBJ_Existence_Probability_3 "The existence probability of the reported object";
CM_ SG_ 154 OBJ_Fusion_Source_3 "sources ids used for fusion";
CM_ SG_ 154 OBJ_Triggered_SDM_3 "Indicates whether the object has trigered the SDM (Safety Diagnostic Manager) alert.";
CM_ SG_ 154 OBJ_Motion_Category_3 "Relevant for VD only. Full description of values can be found at the ACC guide.";
CM_ SG_ 154 OBJ_Object_Age_3 "The number of frames in which the object was recognized.";
CM_ SG_ 154 OBJ_Measuring_Status_3 "Measurment status. Old vs New marks if this is the first frame in which the object is reported. Predicted vs Measured marks if the report is raw or has been predicted forward in time using the measured dynamics and ego motion.";
CM_ SG_ 154 OBJ_Object_Class_3 "Indicates the object type. Uncertain is outputted in case the probability that a vehicle is a truck is very similar to the probability that it is a car. ";
CM_ SG_ 154 OBJ_Class_Probability_3 "The probability of this type classification.";
CM_ SG_ 154 OBJ_Car_Probability_3 "The probability the object is a car";
CM_ SG_ 154 OBJ_Truck_Probability_3 "The probability the object is a Truck";
CM_ SG_ 154 OBJ_Bike_Probability_3 "The probability the object is a Bike";
CM_ SG_ 154 OBJ_Camera_Source_3 "The camera in which this object was detected (best choice).";
CM_ SG_ 154 OBJ_Motion_Status_3 "MOVING - the object is moving STATIONARY - the object was never seen moving STOPPED -  the object was moving and has stopped MOVING_SLOWLY - the object is moving very slowly";
CM_ SG_ 154 OBJ_Motion_Orientation_3 "The direction of the targets heading compared to the host. ";
CM_ SG_ 154 OBJ_Has_Cut_Lane_3 "Indicates whether the object cut the host's (right or left) lane. In case there are no lanes, indicates whether the objects is at most 1 meters away from the host.";
CM_ SG_ 154 OBJ_Has_Cut_Path_3 "Indicates whether the object is in the host's path.";
CM_ SG_ 154 OBJ_Brake_Light_3 "Indication for brake lights ";
CM_ SG_ 154 OBJ_Turn_Indicator_Right_3 "Indication for blinking right light.";
CM_ SG_ 154 OBJ_Turn_Indicator_Left_3 "Indication for blinking left light ";
CM_ SG_ 154 OBJ_Light_Indicator_Validity_3 "Validator for light indicators";
CM_ SG_ 154 OBJ_Right_Out_Of_Image_3 "Indicates whether the measurment are predicted out of the right side of the image bounderies.";
CM_ SG_ 154 OBJ_Left_Out_Of_Image_3 "Indicates whether if measurment are predicted out of  the left side of the image bounderies";
CM_ SG_ 154 OBJ_Right_Out_Of_Image_V_3 "validator";
CM_ SG_ 154 OBJ_Left_Out_Of_Image_V_3 "validator";
CM_ SG_ 154 OBJ_Top_Out_Of_Image_3 "Indicates whether if measurment are predicted out of  the top of the image bounderies";
CM_ SG_ 154 OBJ_Bottom_Out_Of_Image_3 "Indicates whether if measurment are predicted out of  the bottom of the image bounderies";
CM_ SG_ 154 OBJ_Top_Out_Of_Image_V_3 "validator";
CM_ SG_ 154 OBJ_Bottom_Out_Of_Image_V_3 "validator";
CM_ SG_ 154 OBJ_Lane_Assignment_3 "The object's lane relative to the host lane.";
CM_ SG_ 154 OBJ_Lane_Assignment_V_3 "Validator for lane assignment";
CM_ SG_ 154 OBJ_Age_Seconds_3 "Time in seconds in which the object was recognized. ";
CM_ SG_ 154 OBJ_Age_Seconds_V_3 "Validator for object age";
CM_ SG_ 154 OBJ_Width_3 "The width of the target vehicle in the world (not to be mistaken with the width of the visible part of the vehicle).";
CM_ SG_ 154 OBJ_Width_V_3 "Validator for object width";
CM_ SG_ 154 OBJ_Width_STD_3 "Standard deviation for object width";
CM_ SG_ 154 OBJ_Width_STD_V_3 "Validator for the standard deviation of object width";
CM_ SG_ 154 OBJ_Length_3 "The length of the vehicle in the world. For crossing bicycles it gives the viewed length of the bicycle.";
CM_ SG_ 154 OBJ_Length_V_3 "Validator for object length.";
CM_ SG_ 154 OBJ_Length_STD_3 "Standard deviation for object length.";
CM_ SG_ 154 OBJ_Length_STD_V_3 "Validator for the standard deviation of object length.";
CM_ SG_ 154 OBJ_Radar_ID_3 "Radar Object ID of the Fused Object, Only relvant when OBJ_Fusion_Source is not Camera only";
CM_ SG_ 154 OBJ_Height_3 "The height of the object in the world. ";
CM_ SG_ 154 OBJ_Height_V_3 "Validator for object height.";
CM_ SG_ 154 OBJ_Height_STD_3 "Standard deviation for object height.";
CM_ SG_ 154 OBJ_Height_STD_V_3 "Validator for the standard deviation of object height.";
CM_ SG_ 154 OBJ_Abs_Long_Velocity_3 "Absolute longitudinal velocity.";
CM_ SG_ 154 OBJ_Abs_Long_Velocity_V_3 "Validator for absolute longitudinal velocity.";
CM_ SG_ 154 OBJ_Abs_Long_Velocity_STD_3 "Standard deviation of absolute longitudinal velocity.";
CM_ SG_ 154 OBJ_Abs_Long_Vel_STD_V_3 "Validator for the standard deviation of the absolute longitudinal velocity.";
CM_ SG_ 154 OBJ_Abs_Lat_Velocity_3 "The lateral ground speed of the object.";
CM_ SG_ 154 OBJ_Abs_Lat_Velocity_V_3 "Validator for the lateral ground speed of the object.";
CM_ SG_ 154 OBJ_Abs_Lat_Velocity_STD_3 "STD of the lateral ground speed of the object.";
CM_ SG_ 154 OBJ_Abs_Lat_Vel_STD_V_3 "Validator for the STD of the lateral ground speed of the object.";
CM_ SG_ 154 OBJ_Abs_Long_Acc_3 "The longitudinal ground acceleration of the object.";
CM_ SG_ 154 OBJ_Abs_Long_Acc_V_3 "Validator for the longitudinal ground acceleration of the object.";
CM_ SG_ 154 OBJ_Abs_Long_Acc_STD_3 "STD of the longitudinal ground acceleration of the object.";
CM_ SG_ 154 OBJ_Abs_Long_Acc_STD_V_3 "Validator for the STD of the longitudinal ground acceleration of the object.";
CM_ SG_ 154 OBJ_Abs_Lat_Acc_3 "The lateral ground acceleration of the object.";
CM_ SG_ 154 OBJ_Abs_Lat_Acc_V_3 "Validator for the lateral ground acceleration of the object.";
CM_ SG_ 154 OBJ_Abs_Lat_Acc_STD_3 "STD of the lateral ground acceleration of the object.";
CM_ SG_ 154 OBJ_Abs_Lat_Acc_STD_V_3 "Validator for the STD of the lateral ground acceleration of the object.";
CM_ SG_ 154 OBJ_Abs_Acceleration_3 "The absolute ground acceleration in the target's heading direction.";
CM_ SG_ 154 OBJ_Abs_Acceleration_V_3 "Validator for the absolute ground acceleration.";
CM_ SG_ 154 OBJ_Abs_Acc_STD_3 "STD of the absolute ground acceleration.";
CM_ SG_ 154 OBJ_Abs_Acc_STD_V_3 "Validator for the STD of the absolute ground acceleration.";
CM_ SG_ 154 OBJ_Inv_TTC_3 "Inverse TTC (time to collision).";
CM_ SG_ 154 OBJ_Inv_TTC_STD_3 "STD for inverse TTC .";
CM_ SG_ 154 OBJ_Inv_TTC_STD_V_3 "Validator for the STD for inverse TTC .";
CM_ SG_ 154 OBJ_Relative_Long_Acc_3 "The relative lateral ground acceleration of the object.";
CM_ SG_ 154 OBJ_Relative_Long_Acc_V_3 "Validator for the relative lateral ground acceleration of the object.";
CM_ SG_ 154 OBJ_Relative_Long_Acc_STD_3 "STD of the relative lateral ground acceleration of the object.";
CM_ SG_ 154 OBJ_Rel_Long_Acc_STD_V_3 "Validator for the STD of the relative lateral ground acceleration.";
CM_ SG_ 154 OBJ_Relative_Long_Velocity_3 "The relative longtitudinal speed between the target and ego vehicle. ";
CM_ SG_ 154 OBJ_Relative_Long_Velocity_V_3 "Validator for the relative longtitudinal speed.";
CM_ SG_ 154 OBJ_Relative_Long_Vel_STD_3 "STD of the relative longtitudinal speed.";
CM_ SG_ 154 OBJ_Rel_Long_Vel_STD_V_3 "Validator for the STD of the relative longtitudinal speed.";
CM_ SG_ 154 OBJ_Relative_Lat_Velocity_3 "The relative lateral speed between the target and ego vehicle. ";
CM_ SG_ 154 OBJ_Relative_Lat_Velocity_V_3 "Validator for the relative lateral speed. ";
CM_ SG_ 154 OBJ_Relative_Lat_Velocity_STD_3 "STD of the relative lateral speed. ";
CM_ SG_ 154 OBJ_Rel_Lat_Vel_STD_V_3 "Validator for the STD of the relative lateral speed. ";
CM_ SG_ 154 OBJ_Long_Distance_3 "The longitudinal distance to middle of the rear bumper (middle of the RL and RR corners) of the target.";
CM_ SG_ 154 OBJ_Long_Distance_V_3 "Validator of the longtitudinal distance field";
CM_ SG_ 154 OBJ_Long_Distance_STD_3 "STD of the  longtitudinal distance.";
CM_ SG_ 154 OBJ_Long_Distance_STD_V_3 "Validator for the STD of the  longtitudinal distance.";
CM_ SG_ 154 OBJ_Lat_Distance_3 "Lateral distance to the middle of the RL and RR corners.  ";
CM_ SG_ 154 OBJ_Lat_Distance_V_3 "Validator for the lateral distance of the object.";
CM_ SG_ 154 OBJ_Lat_Distance_STD_3 "STD of the lateral distance of the object.";
CM_ SG_ 154 OBJ_Lat_Distance_STD_V_3 "Validator for the STD of the lateral distance of the object.";
CM_ SG_ 154 OBJ_Absolute_Speed_3 "The absolute ground speed in the targets' heading direction.";
CM_ SG_ 154 OBJ_Absolute_Speed_V_3 "Validator for the absolute ground speed.";
CM_ SG_ 154 OBJ_Absolute_Speed_STD_3 "STD of the absolute ground speed.";
CM_ SG_ 154 OBJ_Absolute_Speed_STD_V_3 "Validator for the STD of the absolute ground speed.";
CM_ SG_ 154 OBJ_Heading_3 "The angle beetweenthe host longitudinal axis and target's heading (clockwise, e.g. PI/2 is a target crossing from left to right).";
CM_ SG_ 154 OBJ_Heading_V_3 "Validator for the object heading.";
CM_ SG_ 154 OBJ_Heading_STD_3 "STD of the object heading.";
CM_ SG_ 154 OBJ_Heading_STD_V_3 "Validator for the STD of the object heading.";
CM_ SG_ 154 OBJ_Angle_Rate_STD_3 "Standard deviation of the angular speed. (radians)";
CM_ SG_ 154 OBJ_Angle_Rate_STD_V_3 "Validator for the STD of the angular speed.";
CM_ SG_ 154 OBJ_Angle_Rate_3 "The momentary angular speed of the object. (radians)";
CM_ SG_ 154 OBJ_Angle_Rate_V_3 "Validator for the angular speed.";
CM_ SG_ 154 OBJ_Angle_Right_3 "The angle between the host longitudinal axis and the right side of the front / rear of the target (the visible one). The positive side is to the host's right.";
CM_ SG_ 154 OBJ_Angle_Right_V_3 "Validator for angleRight";
CM_ SG_ 154 OBJ_Angle_Right_STD_3 "Standard deviation of angleRight";
CM_ SG_ 154 OBJ_Angle_Right_STD_V_3 "Validator for the standard deviation of angleRight.";
CM_ SG_ 154 OBJ_Angle_Left_3 "The angle between the host longitudinal axis and the left side of the front / rear of the target (the visible one). The positive side is to the host's right.";
CM_ SG_ 154 OBJ_Angle_Left_V_3 "Validator for angleLeft.";
CM_ SG_ 154 OBJ_Angle_Left_STD_3 "Standard deviation of angleLeft.";
CM_ SG_ 154 OBJ_Angle_Left_STD_V_3 "Validator for the standard deviation of angleLeft.";
CM_ SG_ 154 OBJ_Angle_Side_3 "The angle between the host longitudinal axis and the far visible edge - the visible edge of the front / rear of the target that is not visible. Currently supported for vehicles only.";
CM_ SG_ 154 OBJ_Angle_Side_V_3 "Validator for angleSide.";
CM_ SG_ 154 OBJ_Angle_Side_STD_3 "Standard deviation of angleSide.";
CM_ SG_ 154 OBJ_Angle_Side_STD_V_3 "Validator for the STD of angleSide.";
CM_ SG_ 154 OBJ_Angle_Mid_V_3 "Validator for angleMid.";
CM_ SG_ 154 OBJ_Angle_Mid_3 "The angle between the host longitudinal axis and the middle of the front / rear of the target (the visible one). The positive side is to the host's right.";
CM_ SG_ 154 OBJ_Angle_Mid_STD_3 "Standard deviation of angleMid.";
CM_ SG_ 154 OBJ_Angle_Mid_STD_V_3 "Validator for the STD of angleMid.";
CM_ SG_ 154 OBJ_Angle_Bottom_V_3 "Validator for OBJAngle_Bottom. ";
CM_ SG_ 154 OBJ_Angle_Bottom_3 "The angle between the longitudinal axis and the Bottom of the front / rear of the target (the visible one). The positive side is to the host's bottom";
CM_ SG_ 154 OBJ_Angle_Bottom_STD_3 "STD for OBJAngle_Bottom. ";
CM_ SG_ 154 OBJ_Angle_Bottom_STD_V_3 "Validator for OBJAngle_Bottom_STD. ";
CM_ SG_ 154 OBJ_Visibility_Side_V_3 "Currently Supported for VD only";
CM_ SG_ 154 OBJ_Visibility_Side_3 "From what car  side is the object visible";
CM_ SG_ 154 OBJ_Is_In_Drivable_Area_3 "Indicates whether the target is in a driveable area.";
CM_ SG_ 154 OBJ_Is_In_Drivable_Area_V_3 "Validator for OBJ_Is_In_Drivable_Area.";
CM_ SG_ 154 OBJ_Is_VeryClose_V_3 "Validator for OBJ_Is_VeryClose. ";
CM_ SG_ 154 OBJ_Is_VeryClose_3 "Indicates whether the target is very close to the host such that it is hard to measure its distance. Currently relevant for peds only";
CM_ SG_ 154 OBJ_OverlapAngleEgoLaneR_3 "Lateral distance to the middle of the RL and RR corners.";
CM_ SG_ 154 OBJ_OverlapAngleEgoLaneR_V_3 "Validator for OBJ_OverlapAngleEgoLaneR";
CM_ SG_ 154 OBJ_OverlapAngleEgoLaneL_3 "Lateral distance to the middle of the RL and RR corners.  ";
CM_ SG_ 154 OBJ_OverlapAngleEgoLaneL_V_3 "Validator for OBJ_OverlapAngleEgoLaneL";
CM_ SG_ 154 OBJ_Is_EMERGENCY_VCL_3 "Is Object an Emergency Vehicle";
CM_ SG_ 154 OBJ_EMERGENCY_LIGHT_COLOR_3 "Emergency Color";
CM_ SG_ 154 OBJ_EMERGENCY_V_3 "Are OBJ_Is_EMERGENCY_VCL and OBJ_EMERGENCY_LIGHT_COLOR Valid";
CM_ SG_ 154 OBJ_Angle_Top_3 "From VD touching point on the ground till the roof of the car";
CM_ SG_ 154 OBJ_Angle_Top_V_3 "Validator for OBJ_Angle_Top ";
CM_ SG_ 154 OBJ_Angle_Top_STD_3 "STD for OBJ_Angle_Top";
CM_ SG_ 154 OBJ_Angle_Top_STD_V_3 "Validator for OBJ_Angle_Top_STD. ";
CM_ SG_ 154 OBJ_CRC_4 "Calculated over all element signals. From the signal after the CRC until the first signal in the next elements OBJ_CRC_N+1  not including";
CM_ SG_ 154 OBJ_ID_4 "The detected object ID. Range is 1-255, while 0 indicates that the field in unfilled.";
CM_ SG_ 154 OBJ_Existence_Probability_4 "The existence probability of the reported object";
CM_ SG_ 154 OBJ_Fusion_Source_4 "sources ids used for fusion";
CM_ SG_ 154 OBJ_Triggered_SDM_4 "Indicates whether the object has trigered the SDM (Safety Diagnostic Manager) alert.";
CM_ SG_ 154 OBJ_Motion_Category_4 "Relevant for VD only. Full description of values can be found at the ACC guide.";
CM_ SG_ 154 OBJ_Object_Age_4 "The number of frames in which the object was recognized.";
CM_ SG_ 154 OBJ_Measuring_Status_4 "Measurment status. Old vs New marks if this is the first frame in which the object is reported. Predicted vs Measured marks if the report is raw or has been predicted forward in time using the measured dynamics and ego motion.";
CM_ SG_ 154 OBJ_Object_Class_4 "Indicates the object type. Uncertain is outputted in case the probability that a vehicle is a truck is very similar to the probability that it is a car. ";
CM_ SG_ 154 OBJ_Class_Probability_4 "The probability of this type classification.";
CM_ SG_ 154 OBJ_Car_Probability_4 "The probability the object is a car";
CM_ SG_ 154 OBJ_Truck_Probability_4 "The probability the object is a Truck";
CM_ SG_ 154 OBJ_Bike_Probability_4 "The probability the object is a Bike";
CM_ SG_ 154 OBJ_Camera_Source_4 "The camera in which this object was detected (best choice).";
CM_ SG_ 154 OBJ_Motion_Status_4 "MOVING - the object is moving STATIONARY - the object was never seen moving STOPPED -  the object was moving and has stopped MOVING_SLOWLY - the object is moving very slowly";
CM_ SG_ 154 OBJ_Motion_Orientation_4 "The direction of the targets heading compared to the host. ";
CM_ SG_ 154 OBJ_Has_Cut_Lane_4 "Indicates whether the object cut the host's (right or left) lane. In case there are no lanes, indicates whether the objects is at most 1 meters away from the host.";
CM_ SG_ 154 OBJ_Has_Cut_Path_4 "Indicates whether the object is in the host's path.";
CM_ SG_ 154 OBJ_Brake_Light_4 "Indication for brake lights ";
CM_ SG_ 154 OBJ_Turn_Indicator_Right_4 "Indication for blinking right light.";
CM_ SG_ 154 OBJ_Turn_Indicator_Left_4 "Indication for blinking left light ";
CM_ SG_ 154 OBJ_Light_Indicator_Validity_4 "Validator for light indicators";
CM_ SG_ 154 OBJ_Right_Out_Of_Image_4 "Indicates whether the measurment are predicted out of the right side of the image bounderies.";
CM_ SG_ 154 OBJ_Left_Out_Of_Image_4 "Indicates whether if measurment are predicted out of  the left side of the image bounderies";
CM_ SG_ 154 OBJ_Right_Out_Of_Image_V_4 "validator";
CM_ SG_ 154 OBJ_Left_Out_Of_Image_V_4 "validator";
CM_ SG_ 154 OBJ_Top_Out_Of_Image_4 "Indicates whether if measurment are predicted out of  the top of the image bounderies";
CM_ SG_ 154 OBJ_Bottom_Out_Of_Image_4 "Indicates whether if measurment are predicted out of  the bottom of the image bounderies";
CM_ SG_ 154 OBJ_Top_Out_Of_Image_V_4 "validator";
CM_ SG_ 154 OBJ_Bottom_Out_Of_Image_V_4 "validator";
CM_ SG_ 154 OBJ_Lane_Assignment_4 "The object's lane relative to the host lane.";
CM_ SG_ 154 OBJ_Lane_Assignment_V_4 "Validator for lane assignment";
CM_ SG_ 154 OBJ_Age_Seconds_4 "Time in seconds in which the object was recognized. ";
CM_ SG_ 154 OBJ_Age_Seconds_V_4 "Validator for object age";
CM_ SG_ 154 OBJ_Width_4 "The width of the target vehicle in the world (not to be mistaken with the width of the visible part of the vehicle).";
CM_ SG_ 154 OBJ_Width_V_4 "Validator for object width";
CM_ SG_ 154 OBJ_Width_STD_4 "Standard deviation for object width";
CM_ SG_ 154 OBJ_Width_STD_V_4 "Validator for the standard deviation of object width";
CM_ SG_ 154 OBJ_Length_4 "The length of the vehicle in the world. For crossing bicycles it gives the viewed length of the bicycle.";
CM_ SG_ 154 OBJ_Length_V_4 "Validator for object length.";
CM_ SG_ 154 OBJ_Length_STD_4 "Standard deviation for object length.";
CM_ SG_ 154 OBJ_Length_STD_V_4 "Validator for the standard deviation of object length.";
CM_ SG_ 154 OBJ_Radar_ID_4 "Radar Object ID of the Fused Object, Only relvant when OBJ_Fusion_Source is not Camera only";
CM_ SG_ 154 OBJ_Height_4 "The height of the object in the world. ";
CM_ SG_ 154 OBJ_Height_V_4 "Validator for object height.";
CM_ SG_ 154 OBJ_Height_STD_4 "Standard deviation for object height.";
CM_ SG_ 154 OBJ_Height_STD_V_4 "Validator for the standard deviation of object height.";
CM_ SG_ 154 OBJ_Abs_Long_Velocity_4 "Absolute longitudinal velocity.";
CM_ SG_ 154 OBJ_Abs_Long_Velocity_V_4 "Validator for absolute longitudinal velocity.";
CM_ SG_ 154 OBJ_Abs_Long_Velocity_STD_4 "Standard deviation of absolute longitudinal velocity.";
CM_ SG_ 154 OBJ_Abs_Long_Vel_STD_V_4 "Validator for the standard deviation of the absolute longitudinal velocity.";
CM_ SG_ 154 OBJ_Abs_Lat_Velocity_4 "The lateral ground speed of the object.";
CM_ SG_ 154 OBJ_Abs_Lat_Velocity_V_4 "Validator for the lateral ground speed of the object.";
CM_ SG_ 154 OBJ_Abs_Lat_Velocity_STD_4 "STD of the lateral ground speed of the object.";
CM_ SG_ 154 OBJ_Abs_Lat_Vel_STD_V_4 "Validator for the STD of the lateral ground speed of the object.";
CM_ SG_ 154 OBJ_Abs_Long_Acc_4 "The longitudinal ground acceleration of the object.";
CM_ SG_ 154 OBJ_Abs_Long_Acc_V_4 "Validator for the longitudinal ground acceleration of the object.";
CM_ SG_ 154 OBJ_Abs_Long_Acc_STD_4 "STD of the longitudinal ground acceleration of the object.";
CM_ SG_ 154 OBJ_Abs_Long_Acc_STD_V_4 "Validator for the STD of the longitudinal ground acceleration of the object.";
CM_ SG_ 154 OBJ_Abs_Lat_Acc_4 "The lateral ground acceleration of the object.";
CM_ SG_ 154 OBJ_Abs_Lat_Acc_V_4 "Validator for the lateral ground acceleration of the object.";
CM_ SG_ 154 OBJ_Abs_Lat_Acc_STD_4 "STD of the lateral ground acceleration of the object.";
CM_ SG_ 154 OBJ_Abs_Lat_Acc_STD_V_4 "Validator for the STD of the lateral ground acceleration of the object.";
CM_ SG_ 154 OBJ_Abs_Acceleration_4 "The absolute ground acceleration in the target's heading direction.";
CM_ SG_ 154 OBJ_Abs_Acceleration_V_4 "Validator for the absolute ground acceleration.";
CM_ SG_ 154 OBJ_Abs_Acc_STD_4 "STD of the absolute ground acceleration.";
CM_ SG_ 154 OBJ_Abs_Acc_STD_V_4 "Validator for the STD of the absolute ground acceleration.";
CM_ SG_ 154 OBJ_Inv_TTC_4 "Inverse TTC (time to collision).";
CM_ SG_ 154 OBJ_Inv_TTC_STD_4 "STD for inverse TTC .";
CM_ SG_ 154 OBJ_Inv_TTC_STD_V_4 "Validator for the STD for inverse TTC .";
CM_ SG_ 154 OBJ_Relative_Long_Acc_4 "The relative lateral ground acceleration of the object.";
CM_ SG_ 154 OBJ_Relative_Long_Acc_V_4 "Validator for the relative lateral ground acceleration of the object.";
CM_ SG_ 154 OBJ_Relative_Long_Acc_STD_4 "STD of the relative lateral ground acceleration of the object.";
CM_ SG_ 154 OBJ_Rel_Long_Acc_STD_V_4 "Validator for the STD of the relative lateral ground acceleration.";
CM_ SG_ 154 OBJ_Relative_Long_Velocity_4 "The relative longtitudinal speed between the target and ego vehicle. ";
CM_ SG_ 154 OBJ_Relative_Long_Velocity_V_4 "Validator for the relative longtitudinal speed.";
CM_ SG_ 154 OBJ_Relative_Long_Vel_STD_4 "STD of the relative longtitudinal speed.";
CM_ SG_ 154 OBJ_Rel_Long_Vel_STD_V_4 "Validator for the STD of the relative longtitudinal speed.";
CM_ SG_ 154 OBJ_Relative_Lat_Velocity_4 "The relative lateral speed between the target and ego vehicle. ";
CM_ SG_ 154 OBJ_Relative_Lat_Velocity_V_4 "Validator for the relative lateral speed. ";
CM_ SG_ 154 OBJ_Relative_Lat_Velocity_STD_4 "STD of the relative lateral speed. ";
CM_ SG_ 154 OBJ_Rel_Lat_Vel_STD_V_4 "Validator for the STD of the relative lateral speed. ";
CM_ SG_ 154 OBJ_Long_Distance_4 "The longitudinal distance to middle of the rear bumper (middle of the RL and RR corners) of the target.";
CM_ SG_ 154 OBJ_Long_Distance_V_4 "Validator of the longtitudinal distance field";
CM_ SG_ 154 OBJ_Long_Distance_STD_4 "STD of the  longtitudinal distance.";
CM_ SG_ 154 OBJ_Long_Distance_STD_V_4 "Validator for the STD of the  longtitudinal distance.";
CM_ SG_ 154 OBJ_Lat_Distance_4 "Lateral distance to the middle of the RL and RR corners.  ";
CM_ SG_ 154 OBJ_Lat_Distance_V_4 "Validator for the lateral distance of the object.";
CM_ SG_ 154 OBJ_Lat_Distance_STD_4 "STD of the lateral distance of the object.";
CM_ SG_ 154 OBJ_Lat_Distance_STD_V_4 "Validator for the STD of the lateral distance of the object.";
CM_ SG_ 154 OBJ_Absolute_Speed_4 "The absolute ground speed in the targets' heading direction.";
CM_ SG_ 154 OBJ_Absolute_Speed_V_4 "Validator for the absolute ground speed.";
CM_ SG_ 154 OBJ_Absolute_Speed_STD_4 "STD of the absolute ground speed.";
CM_ SG_ 154 OBJ_Absolute_Speed_STD_V_4 "Validator for the STD of the absolute ground speed.";
CM_ SG_ 154 OBJ_Heading_4 "The angle beetweenthe host longitudinal axis and target's heading (clockwise, e.g. PI/2 is a target crossing from left to right).";
CM_ SG_ 154 OBJ_Heading_V_4 "Validator for the object heading.";
CM_ SG_ 154 OBJ_Heading_STD_4 "STD of the object heading.";
CM_ SG_ 154 OBJ_Heading_STD_V_4 "Validator for the STD of the object heading.";
CM_ SG_ 154 OBJ_Angle_Rate_STD_4 "Standard deviation of the angular speed. (radians)";
CM_ SG_ 154 OBJ_Angle_Rate_STD_V_4 "Validator for the STD of the angular speed.";
CM_ SG_ 154 OBJ_Angle_Rate_4 "The momentary angular speed of the object. (radians)";
CM_ SG_ 154 OBJ_Angle_Rate_V_4 "Validator for the angular speed.";
CM_ SG_ 154 OBJ_Angle_Right_4 "The angle between the host longitudinal axis and the right side of the front / rear of the target (the visible one). The positive side is to the host's right.";
CM_ SG_ 154 OBJ_Angle_Right_V_4 "Validator for angleRight";
CM_ SG_ 154 OBJ_Angle_Right_STD_4 "Standard deviation of angleRight";
CM_ SG_ 154 OBJ_Angle_Right_STD_V_4 "Validator for the standard deviation of angleRight.";
CM_ SG_ 154 OBJ_Angle_Left_4 "The angle between the host longitudinal axis and the left side of the front / rear of the target (the visible one). The positive side is to the host's right.";
CM_ SG_ 154 OBJ_Angle_Left_V_4 "Validator for angleLeft.";
CM_ SG_ 154 OBJ_Angle_Left_STD_4 "Standard deviation of angleLeft.";
CM_ SG_ 154 OBJ_Angle_Left_STD_V_4 "Validator for the standard deviation of angleLeft.";
CM_ SG_ 154 OBJ_Angle_Side_4 "The angle between the host longitudinal axis and the far visible edge - the visible edge of the front / rear of the target that is not visible. Currently supported for vehicles only.";
CM_ SG_ 154 OBJ_Angle_Side_V_4 "Validator for angleSide.";
CM_ SG_ 154 OBJ_Angle_Side_STD_4 "Standard deviation of angleSide.";
CM_ SG_ 154 OBJ_Angle_Side_STD_V_4 "Validator for the STD of angleSide.";
CM_ SG_ 154 OBJ_Angle_Mid_V_4 "Validator for angleMid.";
CM_ SG_ 154 OBJ_Angle_Mid_4 "The angle between the host longitudinal axis and the middle of the front / rear of the target (the visible one). The positive side is to the host's right.";
CM_ SG_ 154 OBJ_Angle_Mid_STD_4 "Standard deviation of angleMid.";
CM_ SG_ 154 OBJ_Angle_Mid_STD_V_4 "Validator for the STD of angleMid.";
CM_ SG_ 154 OBJ_Angle_Bottom_V_4 "Validator for OBJAngle_Bottom. ";
CM_ SG_ 154 OBJ_Angle_Bottom_4 "The angle between the longitudinal axis and the Bottom of the front / rear of the target (the visible one). The positive side is to the host's bottom";
CM_ SG_ 154 OBJ_Angle_Bottom_STD_4 "STD for OBJAngle_Bottom. ";
CM_ SG_ 154 OBJ_Angle_Bottom_STD_V_4 "Validator for OBJAngle_Bottom_STD. ";
CM_ SG_ 154 OBJ_Visibility_Side_V_4 "Currently Supported for VD only";
CM_ SG_ 154 OBJ_Visibility_Side_4 "From what car  side is the object visible";
CM_ SG_ 154 OBJ_Is_In_Drivable_Area_4 "Indicates whether the target is in a driveable area.";
CM_ SG_ 154 OBJ_Is_In_Drivable_Area_V_4 "Validator for OBJ_Is_In_Drivable_Area.";
CM_ SG_ 154 OBJ_Is_VeryClose_V_4 "Validator for OBJ_Is_VeryClose. ";
CM_ SG_ 154 OBJ_Is_VeryClose_4 "Indicates whether the target is very close to the host such that it is hard to measure its distance. Currently relevant for peds only";
CM_ SG_ 154 OBJ_OverlapAngleEgoLaneR_4 "Lateral distance to the middle of the RL and RR corners.";
CM_ SG_ 154 OBJ_OverlapAngleEgoLaneR_V_4 "Validator for OBJ_OverlapAngleEgoLaneR";
CM_ SG_ 154 OBJ_OverlapAngleEgoLaneL_4 "Lateral distance to the middle of the RL and RR corners.  ";
CM_ SG_ 154 OBJ_OverlapAngleEgoLaneL_V_4 "Validator for OBJ_OverlapAngleEgoLaneL";
CM_ SG_ 154 OBJ_Is_EMERGENCY_VCL_4 "Is Object an Emergency Vehicle";
CM_ SG_ 154 OBJ_EMERGENCY_LIGHT_COLOR_4 "Emergency Color";
CM_ SG_ 154 OBJ_EMERGENCY_V_4 "Are OBJ_Is_EMERGENCY_VCL and OBJ_EMERGENCY_LIGHT_COLOR Valid";
CM_ SG_ 154 OBJ_Angle_Top_4 "From VD touching point on the ground till the roof of the car";
CM_ SG_ 154 OBJ_Angle_Top_V_4 "Validator for OBJ_Angle_Top ";
CM_ SG_ 154 OBJ_Angle_Top_STD_4 "STD for OBJ_Angle_Top";
CM_ SG_ 154 OBJ_Angle_Top_STD_V_4 "Validator for OBJ_Angle_Top_STD. ";
CM_ SG_ 154 OBJ_CRC_5 "Calculated over all element signals. From the signal after the CRC until the first signal in the next elements OBJ_CRC_N+1  not including";
CM_ SG_ 154 OBJ_ID_5 "The detected object ID. Range is 1-255, while 0 indicates that the field in unfilled.";
CM_ SG_ 154 OBJ_Existence_Probability_5 "The existence probability of the reported object";
CM_ SG_ 154 OBJ_Fusion_Source_5 "sources ids used for fusion";
CM_ SG_ 154 OBJ_Triggered_SDM_5 "Indicates whether the object has trigered the SDM (Safety Diagnostic Manager) alert.";
CM_ SG_ 154 OBJ_Motion_Category_5 "Relevant for VD only. Full description of values can be found at the ACC guide.";
CM_ SG_ 154 OBJ_Object_Age_5 "The number of frames in which the object was recognized.";
CM_ SG_ 154 OBJ_Measuring_Status_5 "Measurment status. Old vs New marks if this is the first frame in which the object is reported. Predicted vs Measured marks if the report is raw or has been predicted forward in time using the measured dynamics and ego motion.";
CM_ SG_ 154 OBJ_Object_Class_5 "Indicates the object type. Uncertain is outputted in case the probability that a vehicle is a truck is very similar to the probability that it is a car. ";
CM_ SG_ 154 OBJ_Class_Probability_5 "The probability of this type classification.";
CM_ SG_ 154 OBJ_Car_Probability_5 "The probability the object is a car";
CM_ SG_ 154 OBJ_Truck_Probability_5 "The probability the object is a Truck";
CM_ SG_ 154 OBJ_Bike_Probability_5 "The probability the object is a Bike";
CM_ SG_ 154 OBJ_Camera_Source_5 "The camera in which this object was detected (best choice).";
CM_ SG_ 154 OBJ_Motion_Status_5 "MOVING - the object is moving STATIONARY - the object was never seen moving STOPPED -  the object was moving and has stopped MOVING_SLOWLY - the object is moving very slowly";
CM_ SG_ 154 OBJ_Motion_Orientation_5 "The direction of the targets heading compared to the host. ";
CM_ SG_ 154 OBJ_Has_Cut_Lane_5 "Indicates whether the object cut the host's (right or left) lane. In case there are no lanes, indicates whether the objects is at most 1 meters away from the host.";
CM_ SG_ 154 OBJ_Has_Cut_Path_5 "Indicates whether the object is in the host's path.";
CM_ SG_ 154 OBJ_Brake_Light_5 "Indication for brake lights ";
CM_ SG_ 154 OBJ_Turn_Indicator_Right_5 "Indication for blinking right light.";
CM_ SG_ 154 OBJ_Turn_Indicator_Left_5 "Indication for blinking left light ";
CM_ SG_ 154 OBJ_Light_Indicator_Validity_5 "Validator for light indicators";
CM_ SG_ 154 OBJ_Right_Out_Of_Image_5 "Indicates whether the measurment are predicted out of the right side of the image bounderies.";
CM_ SG_ 154 OBJ_Left_Out_Of_Image_5 "Indicates whether if measurment are predicted out of  the left side of the image bounderies";
CM_ SG_ 154 OBJ_Right_Out_Of_Image_V_5 "validator";
CM_ SG_ 154 OBJ_Left_Out_Of_Image_V_5 "validator";
CM_ SG_ 154 OBJ_Top_Out_Of_Image_5 "Indicates whether if measurment are predicted out of  the top of the image bounderies";
CM_ SG_ 154 OBJ_Bottom_Out_Of_Image_5 "Indicates whether if measurment are predicted out of  the bottom of the image bounderies";
CM_ SG_ 154 OBJ_Top_Out_Of_Image_V_5 "validator";
CM_ SG_ 154 OBJ_Bottom_Out_Of_Image_V_5 "validator";
CM_ SG_ 154 OBJ_Lane_Assignment_5 "The object's lane relative to the host lane.";
CM_ SG_ 154 OBJ_Lane_Assignment_V_5 "Validator for lane assignment";
CM_ SG_ 154 OBJ_Age_Seconds_5 "Time in seconds in which the object was recognized. ";
CM_ SG_ 154 OBJ_Age_Seconds_V_5 "Validator for object age";
CM_ SG_ 154 OBJ_Width_5 "The width of the target vehicle in the world (not to be mistaken with the width of the visible part of the vehicle).";
CM_ SG_ 154 OBJ_Width_V_5 "Validator for object width";
CM_ SG_ 154 OBJ_Width_STD_5 "Standard deviation for object width";
CM_ SG_ 154 OBJ_Width_STD_V_5 "Validator for the standard deviation of object width";
CM_ SG_ 154 OBJ_Length_5 "The length of the vehicle in the world. For crossing bicycles it gives the viewed length of the bicycle.";
CM_ SG_ 154 OBJ_Length_V_5 "Validator for object length.";
CM_ SG_ 154 OBJ_Length_STD_5 "Standard deviation for object length.";
CM_ SG_ 154 OBJ_Length_STD_V_5 "Validator for the standard deviation of object length.";
CM_ SG_ 154 OBJ_Radar_ID_5 "Radar Object ID of the Fused Object, Only relvant when OBJ_Fusion_Source is not Camera only";
CM_ SG_ 154 OBJ_Height_5 "The height of the object in the world. ";
CM_ SG_ 154 OBJ_Height_V_5 "Validator for object height.";
CM_ SG_ 154 OBJ_Height_STD_5 "Standard deviation for object height.";
CM_ SG_ 154 OBJ_Height_STD_V_5 "Validator for the standard deviation of object height.";
CM_ SG_ 154 OBJ_Abs_Long_Velocity_5 "Absolute longitudinal velocity.";
CM_ SG_ 154 OBJ_Abs_Long_Velocity_V_5 "Validator for absolute longitudinal velocity.";
CM_ SG_ 154 OBJ_Abs_Long_Velocity_STD_5 "Standard deviation of absolute longitudinal velocity.";
CM_ SG_ 154 OBJ_Abs_Long_Vel_STD_V_5 "Validator for the standard deviation of the absolute longitudinal velocity.";
CM_ SG_ 154 OBJ_Abs_Lat_Velocity_5 "The lateral ground speed of the object.";
CM_ SG_ 154 OBJ_Abs_Lat_Velocity_V_5 "Validator for the lateral ground speed of the object.";
CM_ SG_ 154 OBJ_Abs_Lat_Velocity_STD_5 "STD of the lateral ground speed of the object.";
CM_ SG_ 154 OBJ_Abs_Lat_Vel_STD_V_5 "Validator for the STD of the lateral ground speed of the object.";
CM_ SG_ 154 OBJ_Abs_Long_Acc_5 "The longitudinal ground acceleration of the object.";
CM_ SG_ 154 OBJ_Abs_Long_Acc_V_5 "Validator for the longitudinal ground acceleration of the object.";
CM_ SG_ 154 OBJ_Abs_Long_Acc_STD_5 "STD of the longitudinal ground acceleration of the object.";
CM_ SG_ 154 OBJ_Abs_Long_Acc_STD_V_5 "Validator for the STD of the longitudinal ground acceleration of the object.";
CM_ SG_ 154 OBJ_Abs_Lat_Acc_5 "The lateral ground acceleration of the object.";
CM_ SG_ 154 OBJ_Abs_Lat_Acc_V_5 "Validator for the lateral ground acceleration of the object.";
CM_ SG_ 154 OBJ_Abs_Lat_Acc_STD_5 "STD of the lateral ground acceleration of the object.";
CM_ SG_ 154 OBJ_Abs_Lat_Acc_STD_V_5 "Validator for the STD of the lateral ground acceleration of the object.";
CM_ SG_ 154 OBJ_Abs_Acceleration_5 "The absolute ground acceleration in the target's heading direction.";
CM_ SG_ 154 OBJ_Abs_Acceleration_V_5 "Validator for the absolute ground acceleration.";
CM_ SG_ 154 OBJ_Abs_Acc_STD_5 "STD of the absolute ground acceleration.";
CM_ SG_ 154 OBJ_Abs_Acc_STD_V_5 "Validator for the STD of the absolute ground acceleration.";
CM_ SG_ 154 OBJ_Inv_TTC_5 "Inverse TTC (time to collision).";
CM_ SG_ 154 OBJ_Inv_TTC_STD_5 "STD for inverse TTC .";
CM_ SG_ 154 OBJ_Inv_TTC_STD_V_5 "Validator for the STD for inverse TTC .";
CM_ SG_ 154 OBJ_Relative_Long_Acc_5 "The relative lateral ground acceleration of the object.";
CM_ SG_ 154 OBJ_Relative_Long_Acc_V_5 "Validator for the relative lateral ground acceleration of the object.";
CM_ SG_ 154 OBJ_Relative_Long_Acc_STD_5 "STD of the relative lateral ground acceleration of the object.";
CM_ SG_ 154 OBJ_Rel_Long_Acc_STD_V_5 "Validator for the STD of the relative lateral ground acceleration.";
CM_ SG_ 154 OBJ_Relative_Long_Velocity_5 "The relative longtitudinal speed between the target and ego vehicle. ";
CM_ SG_ 154 OBJ_Relative_Long_Velocity_V_5 "Validator for the relative longtitudinal speed.";
CM_ SG_ 154 OBJ_Relative_Long_Vel_STD_5 "STD of the relative longtitudinal speed.";
CM_ SG_ 154 OBJ_Rel_Long_Vel_STD_V_5 "Validator for the STD of the relative longtitudinal speed.";
CM_ SG_ 154 OBJ_Relative_Lat_Velocity_5 "The relative lateral speed between the target and ego vehicle. ";
CM_ SG_ 154 OBJ_Relative_Lat_Velocity_V_5 "Validator for the relative lateral speed. ";
CM_ SG_ 154 OBJ_Relative_Lat_Velocity_STD_5 "STD of the relative lateral speed. ";
CM_ SG_ 154 OBJ_Rel_Lat_Vel_STD_V_5 "Validator for the STD of the relative lateral speed. ";
CM_ SG_ 154 OBJ_Long_Distance_5 "The longitudinal distance to middle of the rear bumper (middle of the RL and RR corners) of the target.";
CM_ SG_ 154 OBJ_Long_Distance_V_5 "Validator of the longtitudinal distance field";
CM_ SG_ 154 OBJ_Long_Distance_STD_5 "STD of the  longtitudinal distance.";
CM_ SG_ 154 OBJ_Long_Distance_STD_V_5 "Validator for the STD of the  longtitudinal distance.";
CM_ SG_ 154 OBJ_Lat_Distance_5 "Lateral distance to the middle of the RL and RR corners.  ";
CM_ SG_ 154 OBJ_Lat_Distance_V_5 "Validator for the lateral distance of the object.";
CM_ SG_ 154 OBJ_Lat_Distance_STD_5 "STD of the lateral distance of the object.";
CM_ SG_ 154 OBJ_Lat_Distance_STD_V_5 "Validator for the STD of the lateral distance of the object.";
CM_ SG_ 154 OBJ_Absolute_Speed_5 "The absolute ground speed in the targets' heading direction.";
CM_ SG_ 154 OBJ_Absolute_Speed_V_5 "Validator for the absolute ground speed.";
CM_ SG_ 154 OBJ_Absolute_Speed_STD_5 "STD of the absolute ground speed.";
CM_ SG_ 154 OBJ_Absolute_Speed_STD_V_5 "Validator for the STD of the absolute ground speed.";
CM_ SG_ 154 OBJ_Heading_5 "The angle beetweenthe host longitudinal axis and target's heading (clockwise, e.g. PI/2 is a target crossing from left to right).";
CM_ SG_ 154 OBJ_Heading_V_5 "Validator for the object heading.";
CM_ SG_ 154 OBJ_Heading_STD_5 "STD of the object heading.";
CM_ SG_ 154 OBJ_Heading_STD_V_5 "Validator for the STD of the object heading.";
CM_ SG_ 154 OBJ_Angle_Rate_STD_5 "Standard deviation of the angular speed. (radians)";
CM_ SG_ 154 OBJ_Angle_Rate_STD_V_5 "Validator for the STD of the angular speed.";
CM_ SG_ 154 OBJ_Angle_Rate_5 "The momentary angular speed of the object. (radians)";
CM_ SG_ 154 OBJ_Angle_Rate_V_5 "Validator for the angular speed.";
CM_ SG_ 154 OBJ_Angle_Right_5 "The angle between the host longitudinal axis and the right side of the front / rear of the target (the visible one). The positive side is to the host's right.";
CM_ SG_ 154 OBJ_Angle_Right_V_5 "Validator for angleRight";
CM_ SG_ 154 OBJ_Angle_Right_STD_5 "Standard deviation of angleRight";
CM_ SG_ 154 OBJ_Angle_Right_STD_V_5 "Validator for the standard deviation of angleRight.";
CM_ SG_ 154 OBJ_Angle_Left_5 "The angle between the host longitudinal axis and the left side of the front / rear of the target (the visible one). The positive side is to the host's right.";
CM_ SG_ 154 OBJ_Angle_Left_V_5 "Validator for angleLeft.";
CM_ SG_ 154 OBJ_Angle_Left_STD_5 "Standard deviation of angleLeft.";

BA_DEF_  "BusType" STRING ;
BA_DEF_ SG_  "GenSigStartValue" INT 0 0;
BA_DEF_DEF_  "GenSigStartValue" 0;
BA_DEF_DEF_  "BusType" "Ethernet";

BA_ "GenSigStartValue" SG_ 154 OBJ_Protocol_Version 14;
BA_ "GenSigStartValue" SG_ 154 OBJ_Width_0 40;
BA_ "GenSigStartValue" SG_ 154 OBJ_Length_0 24;
BA_ "GenSigStartValue" SG_ 154 OBJ_Width_1 40;
BA_ "GenSigStartValue" SG_ 154 OBJ_Length_1 24;
BA_ "GenSigStartValue" SG_ 154 OBJ_Width_2 40;
BA_ "GenSigStartValue" SG_ 154 OBJ_Length_2 24;
BA_ "GenSigStartValue" SG_ 154 OBJ_Width_3 40;
BA_ "GenSigStartValue" SG_ 154 OBJ_Length_3 24;
BA_ "GenSigStartValue" SG_ 154 OBJ_Width_4 40;
BA_ "GenSigStartValue" SG_ 154 OBJ_Length_4 24;
BA_ "GenSigStartValue" SG_ 154 OBJ_Width_5 40;
BA_ "GenSigStartValue" SG_ 154 OBJ_Length_5 24;

VAL_ 154 OBJ_VD_CIPV_Lost 2 "LOST_TARGET_FOV_IN" 1 "LOST_TARGET_FOV_OUT" 0 "NO_LOSS" ;
VAL_ 154 OBJ_VD_Allow_Acc 2 "FREE_SPACE_UNKNOWN" 1 "SPACE_NOT_FREE" 0 "FREE_SPACE" ;
VAL_ 154 OBJ_Is_Blocked_Left 1 "TRUE" 0 "FALSE" ;
VAL_ 154 OBJ_Is_Blocked_Right 1 "TRUE" 0 "FALSE" ;
VAL_ 154 OBJ_Fusion_Source_0 2 "(BIT_2)RADAR2" 1 "(BIT_1)RADAR1" 0 "(BIT_0)CAMERA" ;
VAL_ 154 OBJ_Triggered_SDM_0 2 "NOT_TRIGGERED" 1 "TRIGGERED" 0 "NOT_AVAILABLE" ;
VAL_ 154 OBJ_Motion_Category_0 13 "ONCOMING" 12 "PRECEEDING" 11 "MOVING" 10 "RTAP" 9 "LTAP" 8 "CROSSING" 7 "MOVING_OUT" 6 "MOVING_IN" 5 "CLOSE_CUT_IN" 4 "PASSING_OUT" 3 "PASSING_IN" 2 "PASSING" 1 "UNDEFINED" 0 "UNFILLED" ;
VAL_ 154 OBJ_Measuring_Status_0 2 "(BIT_2)NOT_VALID_OR_VALID" 1 "(BIT_1)PREDICTED_OR_MEASURED" 0 "(BIT_0)OLD_OR_NEW" ;
VAL_ 154 OBJ_Object_Class_0 8 "UNCERTAIN_VCL" 7 "ANIMAL" 6 "GENERAL_OBJECT" 5 "PEDESTRIAN" 4 "BICYCLE" 3 "MOTORBIKE" 2 "TRUCK" 1 "CAR" 0 "UNFILLED" ;
VAL_ 154 OBJ_Camera_Source_0 11 "PARKING_RIGHT" 10 "PARKING_LEFT" 9 "PARKING_REAR" 8 "PARKING_FRONT" 7 "FRONT_CORNER_RIGHT" 6 "FRONT_CORNER_LEFT" 5 "REAR_CORNER_RIGHT" 4 "REAR_CORNER_LEFT" 3 "REAR" 2 "FRONT_FISHEYE" 1 "FRONT_NARROW" 0 "FRONT_MAIN" ;
VAL_ 154 OBJ_Motion_Status_0 5 "MOVING_SLOWLY" 4 "STOPPED" 3 "STATIONARY" 2 "MOVING" 1 "UNKNOWN" 0 "INVALID" ;
VAL_ 154 OBJ_Motion_Orientation_0 13 "INVALID" 12 "NORTH" 11 "NORTH_WEST" 9 "WEST" 7 "SOUTH_WEST" 6 "SOUTH" 5 "SOUTH_EAST" 3 "EAST" 1 "NORTH_EAST" 0 "UNKNOWN" ;
VAL_ 154 OBJ_Has_Cut_Lane_0 1 "TRUE" 0 "FALSE" ;
VAL_ 154 OBJ_Has_Cut_Path_0 1 "TRUE" 0 "FALSE" ;
VAL_ 154 OBJ_Brake_Light_0 1 "TRUE" 0 "FALSE" ;
VAL_ 154 OBJ_Turn_Indicator_Right_0 1 "TRUE" 0 "FALSE" ;
VAL_ 154 OBJ_Turn_Indicator_Left_0 1 "TRUE" 0 "FALSE" ;
VAL_ 154 OBJ_Light_Indicator_Validity_0 1 "TRUE" 0 "FALSE" ;
VAL_ 154 OBJ_Right_Out_Of_Image_0 1 "TRUE" 0 "FALSE" ;
VAL_ 154 OBJ_Left_Out_Of_Image_0 1 "TRUE" 0 "FALSE" ;
VAL_ 154 OBJ_Right_Out_Of_Image_V_0 1 "TRUE" 0 "FALSE" ;
VAL_ 154 OBJ_Left_Out_Of_Image_V_0 1 "TRUE" 0 "FALSE" ;
VAL_ 154 OBJ_Top_Out_Of_Image_0 1 "TRUE" 0 "FALSE" ;
VAL_ 154 OBJ_Bottom_Out_Of_Image_0 1 "TRUE" 0 "FALSE" ;
VAL_ 154 OBJ_Top_Out_Of_Image_V_0 1 "VALID" 0 "INVALID" ;
VAL_ 154 OBJ_Bottom_Out_Of_Image_V_0 1 "VALID" 0 "INVALID" ;
VAL_ 154 OBJ_Lane_Assignment_0 5 "RIGHT_RIGHT" 4 "RIGHT" 3 "HOST" 2 "LEFT" 1 "LEFT_LEFT" 0 "UNKNOWN" ;
VAL_ 154 OBJ_Lane_Assignment_V_0 1 "VALID" 0 "INVALID" ;
VAL_ 154 OBJ_Age_Seconds_V_0 1 "VALID" 0 "INVALID" ;
VAL_ 154 OBJ_Width_V_0 1 "VALID" 0 "INVALID" ;
VAL_ 154 OBJ_Width_STD_V_0 1 "VALID" 0 "INVALID" ;
VAL_ 154 OBJ_Length_V_0 1 "VALID" 0 "INVALID" ;
VAL_ 154 OBJ_Length_STD_V_0 1 "VALID" 0 "INVALID" ;
VAL_ 154 OBJ_Height_V_0 1 "VALID" 0 "INVALID" ;
VAL_ 154 OBJ_Height_STD_V_0 1 "VALID" 0 "INVALID" ;
VAL_ 154 OBJ_Abs_Long_Velocity_V_0 1 "VALID" 0 "INVALID" ;
VAL_ 154 OBJ_Abs_Long_Vel_STD_V_0 1 "VALID" 0 "INVALID" ;
VAL_ 154 OBJ_Abs_Lat_Velocity_V_0 1 "VALID" 0 "INVALID" ;
VAL_ 154 OBJ_Abs_Lat_Vel_STD_V_0 1 "VALID" 0 "INVALID" ;
VAL_ 154 OBJ_Abs_Long_Acc_V_0 1 "VALID" 0 "INVALID" ;
VAL_ 154 OBJ_Abs_Long_Acc_STD_V_0 1 "VALID" 0 "INVALID" ;
VAL_ 154 OBJ_Abs_Lat_Acc_V_0 1 "VALID" 0 "INVALID" ;
VAL_ 154 OBJ_Abs_Lat_Acc_STD_V_0 1 "VALID" 0 "INVALID" ;
VAL_ 154 OBJ_Abs_Acceleration_V_0 1 "VALID" 0 "INVALID" ;
VAL_ 154 OBJ_Abs_Acc_STD_V_0 1 "VALID" 0 "INVALID" ;
VAL_ 154 OBJ_Inv_TTC_V_0 1 "VALID" 0 "INVALID" ;
VAL_ 154 OBJ_Inv_TTC_STD_V_0 1 "VALID" 0 "INVALID" ;
VAL_ 154 OBJ_Relative_Long_Acc_V_0 1 "VALID" 0 "INVALID" ;
VAL_ 154 OBJ_Rel_Long_Acc_STD_V_0 1 "VALID" 0 "INVALID" ;
VAL_ 154 OBJ_Relative_Long_Velocity_V_0 1 "VALID" 0 "INVALID" ;
VAL_ 154 OBJ_Rel_Long_Vel_STD_V_0 1 "VALID" 0 "INVALID" ;
VAL_ 154 OBJ_Relative_Lat_Velocity_V_0 1 "VALID" 0 "INVALID" ;
VAL_ 154 OBJ_Rel_Lat_Vel_STD_V_0 1 "VALID" 0 "INVALID" ;
VAL_ 154 OBJ_Long_Distance_V_0 1 "VALID" 0 "INVALID" ;
VAL_ 154 OBJ_Long_Distance_STD_V_0 1 "VALID" 0 "INVALID" ;
VAL_ 154 OBJ_Lat_Distance_V_0 1 "VALID" 0 "INVALID" ;
VAL_ 154 OBJ_Lat_Distance_STD_V_0 1 "VALID" 0 "INVALID" ;
VAL_ 154 OBJ_Absolute_Speed_V_0 1 "VALID" 0 "INVALID" ;
VAL_ 154 OBJ_Absolute_Speed_STD_V_0 1 "VALID" 0 "INVALID" ;
VAL_ 154 OBJ_Heading_V_0 1 "VALID" 0 "INVALID" ;
VAL_ 154 OBJ_Heading_STD_V_0 1 "VALID" 0 "INVALID" ;
VAL_ 154 OBJ_Angle_Rate_STD_V_0 1 "VALID" 0 "INVALID" ;
VAL_ 154 OBJ_Angle_Rate_V_0 1 "VALID" 0 "INVALID" ;
VAL_ 154 OBJ_Angle_Right_V_0 1 "VALID" 0 "INVALID" ;
VAL_ 154 OBJ_Angle_Right_STD_V_0 1 "VALID" 0 "INVALID" ;
VAL_ 154 OBJ_Angle_Left_V_0 1 "VALID" 0 "INVALID" ;
VAL_ 154 OBJ_Angle_Left_STD_V_0 1 "VALID" 0 "INVALID" ;
VAL_ 154 OBJ_Angle_Side_V_0 1 "VALID" 0 "INVALID" ;
VAL_ 154 OBJ_Angle_Side_STD_V_0 1 "VALID" 0 "INVALID" ;
VAL_ 154 OBJ_Angle_Mid_V_0 1 "VALID" 0 "INVALID" ;
VAL_ 154 OBJ_Angle_Mid_STD_V_0 1 "VALID" 0 "INVALID" ;
VAL_ 154 OBJ_Angle_Bottom_V_0 1 "VALID" 0 "INVALID" ;
VAL_ 154 OBJ_Angle_Bottom_STD_V_0 1 "VALID" 0 "INVALID" ;
VAL_ 154 OBJ_Visibility_Side_V_0 1 "VALID" 0 "INVALID" ;
VAL_ 154 OBJ_Visibility_Side_0 2 "REAR" 1 "FRONT" 0 "NOT_VISIBLE" ;
VAL_ 154 OBJ_Is_In_Drivable_Area_0 1 "TRUE" 0 "FALSE" ;
VAL_ 154 OBJ_Is_In_Drivable_Area_V_0 1 "VALID" 0 "INVALID" ;
VAL_ 154 OBJ_Is_VeryClose_V_0 1 "VALID" 0 "INVALID" ;
VAL_ 154 OBJ_Is_VeryClose_0 1 "TRUE" 0 "FALSE" ;
VAL_ 154 OBJ_OverlapAngleEgoLaneR_V_0 1 "VALID" 0 "INVALID" ;
VAL_ 154 OBJ_OverlapAngleEgoLaneL_V_0 1 "VALID" 0 "INVALID" ;
VAL_ 154 OBJ_Is_EMERGENCY_VCL_0 1 "TRUE" 0 "FALSE" ;
VAL_ 154 OBJ_EMERGENCY_LIGHT_COLOR_0 3 "(1000)ORANGE" 2 "(0100)BLUE" 1 "(0010)RED" 0 "(0001)OTHER" ;
VAL_ 154 OBJ_EMERGENCY_V_0 1 "TRUE" 0 "FALSE" ;
VAL_ 154 OBJ_Angle_Top_V_0 1 "VALID" 0 "INVALID" ;
VAL_ 154 OBJ_Angle_Top_STD_V_0 1 "VALID" 0 "INVALID" ;
VAL_ 154 OBJ_Fusion_Source_1 2 "(BIT_2)RADAR2" 1 "(BIT_1)RADAR1" 0 "(BIT_0)CAMERA" ;
VAL_ 154 OBJ_Triggered_SDM_1 2 "NOT_TRIGGERED" 1 "TRIGGERED" 0 "NOT_AVAILABLE" ;
VAL_ 154 OBJ_Motion_Category_1 13 "ONCOMING" 12 "PRECEEDING" 11 "MOVING" 10 "RTAP" 9 "LTAP" 8 "CROSSING" 7 "MOVING_OUT" 6 "MOVING_IN" 5 "CLOSE_CUT_IN" 4 "PASSING_OUT" 3 "PASSING_IN" 2 "PASSING" 1 "UNDEFINED" 0 "UNFILLED" ;
VAL_ 154 OBJ_Measuring_Status_1 2 "(BIT_2)NOT_VALID_OR_VALID" 1 "(BIT_1)PREDICTED_OR_MEASURED" 0 "(BIT_0)OLD_OR_NEW" ;
VAL_ 154 OBJ_Object_Class_1 8 "UNCERTAIN_VCL" 7 "ANIMAL" 6 "GENERAL_OBJECT" 5 "PEDESTRIAN" 4 "BICYCLE" 3 "MOTORBIKE" 2 "TRUCK" 1 "CAR" 0 "UNFILLED" ;
VAL_ 154 OBJ_Camera_Source_1 11 "PARKING_RIGHT" 10 "PARKING_LEFT" 9 "PARKING_REAR" 8 "PARKING_FRONT" 7 "FRONT_CORNER_RIGHT" 6 "FRONT_CORNER_LEFT" 5 "REAR_CORNER_RIGHT" 4 "REAR_CORNER_LEFT" 3 "REAR" 2 "FRONT_FISHEYE" 1 "FRONT_NARROW" 0 "FRONT_MAIN" ;
VAL_ 154 OBJ_Motion_Status_1 5 "MOVING_SLOWLY" 4 "STOPPED" 3 "STATIONARY" 2 "MOVING" 1 "UNKNOWN" 0 "INVALID" ;
VAL_ 154 OBJ_Motion_Orientation_1 13 "INVALID" 12 "NORTH" 11 "NORTH_WEST" 9 "WEST" 7 "SOUTH_WEST" 6 "SOUTH" 5 "SOUTH_EAST" 3 "EAST" 1 "NORTH_EAST" 0 "UNKNOWN" ;
VAL_ 154 OBJ_Has_Cut_Lane_1 1 "TRUE" 0 "FALSE" ;
VAL_ 154 OBJ_Has_Cut_Path_1 1 "TRUE" 0 "FALSE" ;
VAL_ 154 OBJ_Brake_Light_1 1 "TRUE" 0 "FALSE" ;
VAL_ 154 OBJ_Turn_Indicator_Right_1 1 "TRUE" 0 "FALSE" ;
VAL_ 154 OBJ_Turn_Indicator_Left_1 1 "TRUE" 0 "FALSE" ;
VAL_ 154 OBJ_Light_Indicator_Validity_1 1 "TRUE" 0 "FALSE" ;
VAL_ 154 OBJ_Right_Out_Of_Image_1 1 "TRUE" 0 "FALSE" ;
VAL_ 154 OBJ_Left_Out_Of_Image_1 1 "TRUE" 0 "FALSE" ;
VAL_ 154 OBJ_Right_Out_Of_Image_V_1 1 "TRUE" 0 "FALSE" ;
VAL_ 154 OBJ_Left_Out_Of_Image_V_1 1 "TRUE" 0 "FALSE" ;
VAL_ 154 OBJ_Top_Out_Of_Image_1 1 "TRUE" 0 "FALSE" ;
VAL_ 154 OBJ_Bottom_Out_Of_Image_1 1 "TRUE" 0 "FALSE" ;
VAL_ 154 OBJ_Top_Out_Of_Image_V_1 1 "VALID" 0 "INVALID" ;
VAL_ 154 OBJ_Bottom_Out_Of_Image_V_1 1 "VALID" 0 "INVALID" ;
VAL_ 154 OBJ_Lane_Assignment_1 5 "RIGHT_RIGHT" 4 "RIGHT" 3 "HOST" 2 "LEFT" 1 "LEFT_LEFT" 0 "UNKNOWN" ;
VAL_ 154 OBJ_Lane_Assignment_V_1 1 "VALID" 0 "INVALID" ;
VAL_ 154 OBJ_Age_Seconds_V_1 1 "VALID" 0 "INVALID" ;
VAL_ 154 OBJ_Width_V_1 1 "VALID" 0 "INVALID" ;
VAL_ 154 OBJ_Width_STD_V_1 1 "VALID" 0 "INVALID" ;
VAL_ 154 OBJ_Length_V_1 1 "VALID" 0 "INVALID" ;
VAL_ 154 OBJ_Length_STD_V_1 1 "VALID" 0 "INVALID" ;
VAL_ 154 OBJ_Height_V_1 1 "VALID" 0 "INVALID" ;
VAL_ 154 OBJ_Height_STD_V_1 1 "VALID" 0 "INVALID" ;
VAL_ 154 OBJ_Abs_Long_Velocity_V_1 1 "VALID" 0 "INVALID" ;
VAL_ 154 OBJ_Abs_Long_Vel_STD_V_1 1 "VALID" 0 "INVALID" ;
VAL_ 154 OBJ_Abs_Lat_Velocity_V_1 1 "VALID" 0 "INVALID" ;
VAL_ 154 OBJ_Abs_Lat_Vel_STD_V_1 1 "VALID" 0 "INVALID" ;
VAL_ 154 OBJ_Abs_Long_Acc_V_1 1 "VALID" 0 "INVALID" ;
VAL_ 154 OBJ_Abs_Long_Acc_STD_V_1 1 "VALID" 0 "INVALID" ;
VAL_ 154 OBJ_Abs_Lat_Acc_V_1 1 "VALID" 0 "INVALID" ;
VAL_ 154 OBJ_Abs_Lat_Acc_STD_V_1 1 "VALID" 0 "INVALID" ;
VAL_ 154 OBJ_Abs_Acceleration_V_1 1 "VALID" 0 "INVALID" ;
VAL_ 154 OBJ_Abs_Acc_STD_V_1 1 "VALID" 0 "INVALID" ;
VAL_ 154 OBJ_Inv_TTC_V_1 1 "VALID" 0 "INVALID" ;
VAL_ 154 OBJ_Inv_TTC_STD_V_1 1 "VALID" 0 "INVALID" ;
VAL_ 154 OBJ_Relative_Long_Acc_V_1 1 "VALID" 0 "INVALID" ;
VAL_ 154 OBJ_Rel_Long_Acc_STD_V_1 1 "VALID" 0 "INVALID" ;
VAL_ 154 OBJ_Relative_Long_Velocity_V_1 1 "VALID" 0 "INVALID" ;
VAL_ 154 OBJ_Rel_Long_Vel_STD_V_1 1 "VALID" 0 "INVALID" ;
VAL_ 154 OBJ_Relative_Lat_Velocity_V_1 1 "VALID" 0 "INVALID" ;
VAL_ 154 OBJ_Rel_Lat_Vel_STD_V_1 1 "VALID" 0 "INVALID" ;
VAL_ 154 OBJ_Long_Distance_V_1 1 "VALID" 0 "INVALID" ;
VAL_ 154 OBJ_Long_Distance_STD_V_1 1 "VALID" 0 "INVALID" ;
VAL_ 154 OBJ_Lat_Distance_V_1 1 "VALID" 0 "INVALID" ;
VAL_ 154 OBJ_Lat_Distance_STD_V_1 1 "VALID" 0 "INVALID" ;
VAL_ 154 OBJ_Absolute_Speed_V_1 1 "VALID" 0 "INVALID" ;
VAL_ 154 OBJ_Absolute_Speed_STD_V_1 1 "VALID" 0 "INVALID" ;
VAL_ 154 OBJ_Heading_V_1 1 "VALID" 0 "INVALID" ;
VAL_ 154 OBJ_Heading_STD_V_1 1 "VALID" 0 "INVALID" ;
VAL_ 154 OBJ_Angle_Rate_STD_V_1 1 "VALID" 0 "INVALID" ;
VAL_ 154 OBJ_Angle_Rate_V_1 1 "VALID" 0 "INVALID" ;
VAL_ 154 OBJ_Angle_Right_V_1 1 "VALID" 0 "INVALID" ;
VAL_ 154 OBJ_Angle_Right_STD_V_1 1 "VALID" 0 "INVALID" ;
VAL_ 154 OBJ_Angle_Left_V_1 1 "VALID" 0 "INVALID" ;
VAL_ 154 OBJ_Angle_Left_STD_V_1 1 "VALID" 0 "INVALID" ;
VAL_ 154 OBJ_Angle_Side_V_1 1 "VALID" 0 "INVALID" ;
VAL_ 154 OBJ_Angle_Side_STD_V_1 1 "VALID" 0 "INVALID" ;
VAL_ 154 OBJ_Angle_Mid_V_1 1 "VALID" 0 "INVALID" ;
VAL_ 154 OBJ_Angle_Mid_STD_V_1 1 "VALID" 0 "INVALID" ;
VAL_ 154 OBJ_Angle_Bottom_V_1 1 "VALID" 0 "INVALID" ;
VAL_ 154 OBJ_Angle_Bottom_STD_V_1 1 "VALID" 0 "INVALID" ;
VAL_ 154 OBJ_Visibility_Side_V_1 1 "VALID" 0 "INVALID" ;
VAL_ 154 OBJ_Visibility_Side_1 2 "REAR" 1 "FRONT" 0 "NOT_VISIBLE" ;
VAL_ 154 OBJ_Is_In_Drivable_Area_1 1 "TRUE" 0 "FALSE" ;
VAL_ 154 OBJ_Is_In_Drivable_Area_V_1 1 "VALID" 0 "INVALID" ;
VAL_ 154 OBJ_Is_VeryClose_V_1 1 "VALID" 0 "INVALID" ;
VAL_ 154 OBJ_Is_VeryClose_1 1 "TRUE" 0 "FALSE" ;
VAL_ 154 OBJ_OverlapAngleEgoLaneR_V_1 1 "VALID" 0 "INVALID" ;
VAL_ 154 OBJ_OverlapAngleEgoLaneL_V_1 1 "VALID" 0 "INVALID" ;
VAL_ 154 OBJ_Is_EMERGENCY_VCL_1 1 "TRUE" 0 "FALSE" ;
VAL_ 154 OBJ_EMERGENCY_LIGHT_COLOR_1 3 "(1000)ORANGE" 2 "(0100)BLUE" 1 "(0010)RED" 0 "(0001)OTHER" ;
VAL_ 154 OBJ_EMERGENCY_V_1 1 "TRUE" 0 "FALSE" ;
VAL_ 154 OBJ_Angle_Top_V_1 1 "VALID" 0 "INVALID" ;
VAL_ 154 OBJ_Angle_Top_STD_V_1 1 "VALID" 0 "INVALID" ;
VAL_ 154 OBJ_Fusion_Source_2 2 "(BIT_2)RADAR2" 1 "(BIT_1)RADAR1" 0 "(BIT_0)CAMERA" ;
VAL_ 154 OBJ_Triggered_SDM_2 2 "NOT_TRIGGERED" 1 "TRIGGERED" 0 "NOT_AVAILABLE" ;
VAL_ 154 OBJ_Motion_Category_2 13 "ONCOMING" 12 "PRECEEDING" 11 "MOVING" 10 "RTAP" 9 "LTAP" 8 "CROSSING" 7 "MOVING_OUT" 6 "MOVING_IN" 5 "CLOSE_CUT_IN" 4 "PASSING_OUT" 3 "PASSING_IN" 2 "PASSING" 1 "UNDEFINED" 0 "UNFILLED" ;
VAL_ 154 OBJ_Measuring_Status_2 2 "(BIT_2)NOT_VALID_OR_VALID" 1 "(BIT_1)PREDICTED_OR_MEASURED" 0 "(BIT_0)OLD_OR_NEW" ;
VAL_ 154 OBJ_Object_Class_2 8 "UNCERTAIN_VCL" 7 "ANIMAL" 6 "GENERAL_OBJECT" 5 "PEDESTRIAN" 4 "BICYCLE" 3 "MOTORBIKE" 2 "TRUCK" 1 "CAR" 0 "UNFILLED" ;
VAL_ 154 OBJ_Camera_Source_2 11 "PARKING_RIGHT" 10 "PARKING_LEFT" 9 "PARKING_REAR" 8 "PARKING_FRONT" 7 "FRONT_CORNER_RIGHT" 6 "FRONT_CORNER_LEFT" 5 "REAR_CORNER_RIGHT" 4 "REAR_CORNER_LEFT" 3 "REAR" 2 "FRONT_FISHEYE" 1 "FRONT_NARROW" 0 "FRONT_MAIN" ;
VAL_ 154 OBJ_Motion_Status_2 5 "MOVING_SLOWLY" 4 "STOPPED" 3 "STATIONARY" 2 "MOVING" 1 "UNKNOWN" 0 "INVALID" ;
VAL_ 154 OBJ_Motion_Orientation_2 13 "INVALID" 12 "NORTH" 11 "NORTH_WEST" 9 "WEST" 7 "SOUTH_WEST" 6 "SOUTH" 5 "SOUTH_EAST" 3 "EAST" 1 "NORTH_EAST" 0 "UNKNOWN" ;
VAL_ 154 OBJ_Has_Cut_Lane_2 1 "TRUE" 0 "FALSE" ;
VAL_ 154 OBJ_Has_Cut_Path_2 1 "TRUE" 0 "FALSE" ;
VAL_ 154 OBJ_Brake_Light_2 1 "TRUE" 0 "FALSE" ;
VAL_ 154 OBJ_Turn_Indicator_Right_2 1 "TRUE" 0 "FALSE" ;
VAL_ 154 OBJ_Turn_Indicator_Left_2 1 "TRUE" 0 "FALSE" ;
VAL_ 154 OBJ_Light_Indicator_Validity_2 1 "TRUE" 0 "FALSE" ;
VAL_ 154 OBJ_Right_Out_Of_Image_2 1 "TRUE" 0 "FALSE" ;
VAL_ 154 OBJ_Left_Out_Of_Image_2 1 "TRUE" 0 "FALSE" ;
VAL_ 154 OBJ_Right_Out_Of_Image_V_2 1 "TRUE" 0 "FALSE" ;
VAL_ 154 OBJ_Left_Out_Of_Image_V_2 1 "TRUE" 0 "FALSE" ;
VAL_ 154 OBJ_Top_Out_Of_Image_2 1 "TRUE" 0 "FALSE" ;
VAL_ 154 OBJ_Bottom_Out_Of_Image_2 1 "TRUE" 0 "FALSE" ;
VAL_ 154 OBJ_Top_Out_Of_Image_V_2 1 "VALID" 0 "INVALID" ;
VAL_ 154 OBJ_Bottom_Out_Of_Image_V_2 1 "VALID" 0 "INVALID" ;
VAL_ 154 OBJ_Lane_Assignment_2 5 "RIGHT_RIGHT" 4 "RIGHT" 3 "HOST" 2 "LEFT" 1 "LEFT_LEFT" 0 "UNKNOWN" ;
VAL_ 154 OBJ_Lane_Assignment_V_2 1 "VALID" 0 "INVALID" ;
VAL_ 154 OBJ_Age_Seconds_V_2 1 "VALID" 0 "INVALID" ;
VAL_ 154 OBJ_Width_V_2 1 "VALID" 0 "INVALID" ;
VAL_ 154 OBJ_Width_STD_V_2 1 "VALID" 0 "INVALID" ;
VAL_ 154 OBJ_Length_V_2 1 "VALID" 0 "INVALID" ;
VAL_ 154 OBJ_Length_STD_V_2 1 "VALID" 0 "INVALID" ;
VAL_ 154 OBJ_Height_V_2 1 "VALID" 0 "INVALID" ;
VAL_ 154 OBJ_Height_STD_V_2 1 "VALID" 0 "INVALID" ;
VAL_ 154 OBJ_Abs_Long_Velocity_V_2 1 "VALID" 0 "INVALID" ;
VAL_ 154 OBJ_Abs_Long_Vel_STD_V_2 1 "VALID" 0 "INVALID" ;
VAL_ 154 OBJ_Abs_Lat_Velocity_V_2 1 "VALID" 0 "INVALID" ;
VAL_ 154 OBJ_Abs_Lat_Vel_STD_V_2 1 "VALID" 0 "INVALID" ;
VAL_ 154 OBJ_Abs_Long_Acc_V_2 1 "VALID" 0 "INVALID" ;
VAL_ 154 OBJ_Abs_Long_Acc_STD_V_2 1 "VALID" 0 "INVALID" ;
VAL_ 154 OBJ_Abs_Lat_Acc_V_2 1 "VALID" 0 "INVALID" ;
VAL_ 154 OBJ_Abs_Lat_Acc_STD_V_2 1 "VALID" 0 "INVALID" ;
VAL_ 154 OBJ_Abs_Acceleration_V_2 1 "VALID" 0 "INVALID" ;
VAL_ 154 OBJ_Abs_Acc_STD_V_2 1 "VALID" 0 "INVALID" ;
VAL_ 154 OBJ_Inv_TTC_V_2 1 "VALID" 0 "INVALID" ;
VAL_ 154 OBJ_Inv_TTC_STD_V_2 1 "VALID" 0 "INVALID" ;
VAL_ 154 OBJ_Relative_Long_Acc_V_2 1 "VALID" 0 "INVALID" ;
VAL_ 154 OBJ_Rel_Long_Acc_STD_V_2 1 "VALID" 0 "INVALID" ;
VAL_ 154 OBJ_Relative_Long_Velocity_V_2 1 "VALID" 0 "INVALID" ;
VAL_ 154 OBJ_Rel_Long_Vel_STD_V_2 1 "VALID" 0 "INVALID" ;
VAL_ 154 OBJ_Relative_Lat_Velocity_V_2 1 "VALID" 0 "INVALID" ;
VAL_ 154 OBJ_Rel_Lat_Vel_STD_V_2 1 "VALID" 0 "INVALID" ;
VAL_ 154 OBJ_Long_Distance_V_2 1 "VALID" 0 "INVALID" ;
VAL_ 154 OBJ_Long_Distance_STD_V_2 1 "VALID" 0 "INVALID" ;
VAL_ 154 OBJ_Lat_Distance_V_2 1 "VALID" 0 "INVALID" ;
VAL_ 154 OBJ_Lat_Distance_STD_V_2 1 "VALID" 0 "INVALID" ;
VAL_ 154 OBJ_Absolute_Speed_V_2 1 "VALID" 0 "INVALID" ;
VAL_ 154 OBJ_Absolute_Speed_STD_V_2 1 "VALID" 0 "INVALID" ;
VAL_ 154 OBJ_Heading_V_2 1 "VALID" 0 "INVALID" ;
VAL_ 154 OBJ_Heading_STD_V_2 1 "VALID" 0 "INVALID" ;
VAL_ 154 OBJ_Angle_Rate_STD_V_2 1 "VALID" 0 "INVALID" ;
VAL_ 154 OBJ_Angle_Rate_V_2 1 "VALID" 0 "INVALID" ;
VAL_ 154 OBJ_Angle_Right_V_2 1 "VALID" 0 "INVALID" ;
VAL_ 154 OBJ_Angle_Right_STD_V_2 1 "VALID" 0 "INVALID" ;
VAL_ 154 OBJ_Angle_Left_V_2 1 "VALID" 0 "INVALID" ;
VAL_ 154 OBJ_Angle_Left_STD_V_2 1 "VALID" 0 "INVALID" ;
VAL_ 154 OBJ_Angle_Side_V_2 1 "VALID" 0 "INVALID" ;
VAL_ 154 OBJ_Angle_Side_STD_V_2 1 "VALID" 0 "INVALID" ;
VAL_ 154 OBJ_Angle_Mid_V_2 1 "VALID" 0 "INVALID" ;
VAL_ 154 OBJ_Angle_Mid_STD_V_2 1 "VALID" 0 "INVALID" ;
VAL_ 154 OBJ_Angle_Bottom_V_2 1 "VALID" 0 "INVALID" ;
VAL_ 154 OBJ_Angle_Bottom_STD_V_2 1 "VALID" 0 "INVALID" ;
VAL_ 154 OBJ_Visibility_Side_V_2 1 "VALID" 0 "INVALID" ;
VAL_ 154 OBJ_Visibility_Side_2 2 "REAR" 1 "FRONT" 0 "NOT_VISIBLE" ;
VAL_ 154 OBJ_Is_In_Drivable_Area_2 1 "TRUE" 0 "FALSE" ;
VAL_ 154 OBJ_Is_In_Drivable_Area_V_2 1 "VALID" 0 "INVALID" ;
VAL_ 154 OBJ_Is_VeryClose_V_2 1 "VALID" 0 "INVALID" ;
VAL_ 154 OBJ_Is_VeryClose_2 1 "TRUE" 0 "FALSE" ;
VAL_ 154 OBJ_OverlapAngleEgoLaneR_V_2 1 "VALID" 0 "INVALID" ;
VAL_ 154 OBJ_OverlapAngleEgoLaneL_V_2 1 "VALID" 0 "INVALID" ;
VAL_ 154 OBJ_Is_EMERGENCY_VCL_2 1 "TRUE" 0 "FALSE" ;
VAL_ 154 OBJ_EMERGENCY_LIGHT_COLOR_2 3 "(1000)ORANGE" 2 "(0100)BLUE" 1 "(0010)RED" 0 "(0001)OTHER" ;
VAL_ 154 OBJ_EMERGENCY_V_2 1 "TRUE" 0 "FALSE" ;
VAL_ 154 OBJ_Angle_Top_V_2 1 "VALID" 0 "INVALID" ;
VAL_ 154 OBJ_Angle_Top_STD_V_2 1 "VALID" 0 "INVALID" ;
VAL_ 154 OBJ_Fusion_Source_3 2 "(BIT_2)RADAR2" 1 "(BIT_1)RADAR1" 0 "(BIT_0)CAMERA" ;
VAL_ 154 OBJ_Triggered_SDM_3 2 "NOT_TRIGGERED" 1 "TRIGGERED" 0 "NOT_AVAILABLE" ;
VAL_ 154 OBJ_Motion_Category_3 13 "ONCOMING" 12 "PRECEEDING" 11 "MOVING" 10 "RTAP" 9 "LTAP" 8 "CROSSING" 7 "MOVING_OUT" 6 "MOVING_IN" 5 "CLOSE_CUT_IN" 4 "PASSING_OUT" 3 "PASSING_IN" 2 "PASSING" 1 "UNDEFINED" 0 "UNFILLED" ;
VAL_ 154 OBJ_Measuring_Status_3 2 "(BIT_2)NOT_VALID_OR_VALID" 1 "(BIT_1)PREDICTED_OR_MEASURED" 0 "(BIT_0)OLD_OR_NEW" ;
VAL_ 154 OBJ_Object_Class_3 8 "UNCERTAIN_VCL" 7 "ANIMAL" 6 "GENERAL_OBJECT" 5 "PEDESTRIAN" 4 "BICYCLE" 3 "MOTORBIKE" 2 "TRUCK" 1 "CAR" 0 "UNFILLED" ;
VAL_ 154 OBJ_Camera_Source_3 11 "PARKING_RIGHT" 10 "PARKING_LEFT" 9 "PARKING_REAR" 8 "PARKING_FRONT" 7 "FRONT_CORNER_RIGHT" 6 "FRONT_CORNER_LEFT" 5 "REAR_CORNER_RIGHT" 4 "REAR_CORNER_LEFT" 3 "REAR" 2 "FRONT_FISHEYE" 1 "FRONT_NARROW" 0 "FRONT_MAIN" ;
VAL_ 154 OBJ_Motion_Status_3 5 "MOVING_SLOWLY" 4 "STOPPED" 3 "STATIONARY" 2 "MOVING" 1 "UNKNOWN" 0 "INVALID" ;
VAL_ 154 OBJ_Motion_Orientation_3 13 "INVALID" 12 "NORTH" 11 "NORTH_WEST" 9 "WEST" 7 "SOUTH_WEST" 6 "SOUTH" 5 "SOUTH_EAST" 3 "EAST" 1 "NORTH_EAST" 0 "UNKNOWN" ;
VAL_ 154 OBJ_Has_Cut_Lane_3 1 "TRUE" 0 "FALSE" ;
VAL_ 154 OBJ_Has_Cut_Path_3 1 "TRUE" 0 "FALSE" ;
VAL_ 154 OBJ_Brake_Light_3 1 "TRUE" 0 "FALSE" ;
VAL_ 154 OBJ_Turn_Indicator_Right_3 1 "TRUE" 0 "FALSE" ;
VAL_ 154 OBJ_Turn_Indicator_Left_3 1 "TRUE" 0 "FALSE" ;
VAL_ 154 OBJ_Light_Indicator_Validity_3 1 "TRUE" 0 "FALSE" ;
VAL_ 154 OBJ_Right_Out_Of_Image_3 1 "TRUE" 0 "FALSE" ;
VAL_ 154 OBJ_Left_Out_Of_Image_3 1 "TRUE" 0 "FALSE" ;
VAL_ 154 OBJ_Right_Out_Of_Image_V_3 1 "TRUE" 0 "FALSE" ;
VAL_ 154 OBJ_Left_Out_Of_Image_V_3 1 "TRUE" 0 "FALSE" ;
VAL_ 154 OBJ_Top_Out_Of_Image_3 1 "TRUE" 0 "FALSE" ;
VAL_ 154 OBJ_Bottom_Out_Of_Image_3 1 "TRUE" 0 "FALSE" ;
VAL_ 154 OBJ_Top_Out_Of_Image_V_3 1 "VALID" 0 "INVALID" ;
VAL_ 154 OBJ_Bottom_Out_Of_Image_V_3 1 "VALID" 0 "INVALID" ;
VAL_ 154 OBJ_Lane_Assignment_3 5 "RIGHT_RIGHT" 4 "RIGHT" 3 "HOST" 2 "LEFT" 1 "LEFT_LEFT" 0 "UNKNOWN" ;
VAL_ 154 OBJ_Lane_Assignment_V_3 1 "VALID" 0 "INVALID" ;
VAL_ 154 OBJ_Age_Seconds_V_3 1 "VALID" 0 "INVALID" ;
VAL_ 154 OBJ_Width_V_3 1 "VALID" 0 "INVALID" ;
VAL_ 154 OBJ_Width_STD_V_3 1 "VALID" 0 "INVALID" ;
VAL_ 154 OBJ_Length_V_3 1 "VALID" 0 "INVALID" ;
VAL_ 154 OBJ_Length_STD_V_3 1 "VALID" 0 "INVALID" ;
VAL_ 154 OBJ_Height_V_3 1 "VALID" 0 "INVALID" ;
VAL_ 154 OBJ_Height_STD_V_3 1 "VALID" 0 "INVALID" ;
VAL_ 154 OBJ_Abs_Long_Velocity_V_3 1 "VALID" 0 "INVALID" ;
VAL_ 154 OBJ_Abs_Long_Vel_STD_V_3 1 "VALID" 0 "INVALID" ;
VAL_ 154 OBJ_Abs_Lat_Velocity_V_3 1 "VALID" 0 "INVALID" ;
VAL_ 154 OBJ_Abs_Lat_Vel_STD_V_3 1 "VALID" 0 "INVALID" ;
VAL_ 154 OBJ_Abs_Long_Acc_V_3 1 "VALID" 0 "INVALID" ;
VAL_ 154 OBJ_Abs_Long_Acc_STD_V_3 1 "VALID" 0 "INVALID" ;
VAL_ 154 OBJ_Abs_Lat_Acc_V_3 1 "VALID" 0 "INVALID" ;
VAL_ 154 OBJ_Abs_Lat_Acc_STD_V_3 1 "VALID" 0 "INVALID" ;
VAL_ 154 OBJ_Abs_Acceleration_V_3 1 "VALID" 0 "INVALID" ;
VAL_ 154 OBJ_Abs_Acc_STD_V_3 1 "VALID" 0 "INVALID" ;
VAL_ 154 OBJ_Inv_TTC_V_3 1 "VALID" 0 "INVALID" ;
VAL_ 154 OBJ_Inv_TTC_STD_V_3 1 "VALID" 0 "INVALID" ;
VAL_ 154 OBJ_Relative_Long_Acc_V_3 1 "VALID" 0 "INVALID" ;
VAL_ 154 OBJ_Rel_Long_Acc_STD_V_3 1 "VALID" 0 "INVALID" ;
VAL_ 154 OBJ_Relative_Long_Velocity_V_3 1 "VALID" 0 "INVALID" ;
VAL_ 154 OBJ_Rel_Long_Vel_STD_V_3 1 "VALID" 0 "INVALID" ;
VAL_ 154 OBJ_Relative_Lat_Velocity_V_3 1 "VALID" 0 "INVALID" ;
VAL_ 154 OBJ_Rel_Lat_Vel_STD_V_3 1 "VALID" 0 "INVALID" ;
VAL_ 154 OBJ_Long_Distance_V_3 1 "VALID" 0 "INVALID" ;
VAL_ 154 OBJ_Long_Distance_STD_V_3 1 "VALID" 0 "INVALID" ;
VAL_ 154 OBJ_Lat_Distance_V_3 1 "VALID" 0 "INVALID" ;
VAL_ 154 OBJ_Lat_Distance_STD_V_3 1 "VALID" 0 "INVALID" ;
VAL_ 154 OBJ_Absolute_Speed_V_3 1 "VALID" 0 "INVALID" ;
VAL_ 154 OBJ_Absolute_Speed_STD_V_3 1 "VALID" 0 "INVALID" ;
VAL_ 154 OBJ_Heading_V_3 1 "VALID" 0 "INVALID" ;
VAL_ 154 OBJ_Heading_STD_V_3 1 "VALID" 0 "INVALID" ;
VAL_ 154 OBJ_Angle_Rate_STD_V_3 1 "VALID" 0 "INVALID" ;
VAL_ 154 OBJ_Angle_Rate_V_3 1 "VALID" 0 "INVALID" ;
VAL_ 154 OBJ_Angle_Right_V_3 1 "VALID" 0 "INVALID" ;
VAL_ 154 OBJ_Angle_Right_STD_V_3 1 "VALID" 0 "INVALID" ;
VAL_ 154 OBJ_Angle_Left_V_3 1 "VALID" 0 "INVALID" ;
VAL_ 154 OBJ_Angle_Left_STD_V_3 1 "VALID" 0 "INVALID" ;
VAL_ 154 OBJ_Angle_Side_V_3 1 "VALID" 0 "INVALID" ;
VAL_ 154 OBJ_Angle_Side_STD_V_3 1 "VALID" 0 "INVALID" ;
VAL_ 154 OBJ_Angle_Mid_V_3 1 "VALID" 0 "INVALID" ;
VAL_ 154 OBJ_Angle_Mid_STD_V_3 1 "VALID" 0 "INVALID" ;
VAL_ 154 OBJ_Angle_Bottom_V_3 1 "VALID" 0 "INVALID" ;
VAL_ 154 OBJ_Angle_Bottom_STD_V_3 1 "VALID" 0 "INVALID" ;
VAL_ 154 OBJ_Visibility_Side_V_3 1 "VALID" 0 "INVALID" ;
VAL_ 154 OBJ_Visibility_Side_3 2 "REAR" 1 "FRONT" 0 "NOT_VISIBLE" ;
VAL_ 154 OBJ_Is_In_Drivable_Area_3 1 "TRUE" 0 "FALSE" ;
VAL_ 154 OBJ_Is_In_Drivable_Area_V_3 1 "VALID" 0 "INVALID" ;
VAL_ 154 OBJ_Is_VeryClose_V_3 1 "VALID" 0 "INVALID" ;
VAL_ 154 OBJ_Is_VeryClose_3 1 "TRUE" 0 "FALSE" ;
VAL_ 154 OBJ_OverlapAngleEgoLaneR_V_3 1 "VALID" 0 "INVALID" ;
VAL_ 154 OBJ_OverlapAngleEgoLaneL_V_3 1 "VALID" 0 "INVALID" ;
VAL_ 154 OBJ_Is_EMERGENCY_VCL_3 1 "TRUE" 0 "FALSE" ;
VAL_ 154 OBJ_EMERGENCY_LIGHT_COLOR_3 3 "(1000)ORANGE" 2 "(0100)BLUE" 1 "(0010)RED" 0 "(0001)OTHER" ;
VAL_ 154 OBJ_EMERGENCY_V_3 1 "TRUE" 0 "FALSE" ;
VAL_ 154 OBJ_Angle_Top_V_3 1 "VALID" 0 "INVALID" ;
VAL_ 154 OBJ_Angle_Top_STD_V_3 1 "VALID" 0 "INVALID" ;
VAL_ 154 OBJ_Fusion_Source_4 2 "(BIT_2)RADAR2" 1 "(BIT_1)RADAR1" 0 "(BIT_0)CAMERA" ;
VAL_ 154 OBJ_Triggered_SDM_4 2 "NOT_TRIGGERED" 1 "TRIGGERED" 0 "NOT_AVAILABLE" ;
VAL_ 154 OBJ_Motion_Category_4 13 "ONCOMING" 12 "PRECEEDING" 11 "MOVING" 10 "RTAP" 9 "LTAP" 8 "CROSSING" 7 "MOVING_OUT" 6 "MOVING_IN" 5 "CLOSE_CUT_IN" 4 "PASSING_OUT" 3 "PASSING_IN" 2 "PASSING" 1 "UNDEFINED" 0 "UNFILLED" ;
VAL_ 154 OBJ_Measuring_Status_4 2 "(BIT_2)NOT_VALID_OR_VALID" 1 "(BIT_1)PREDICTED_OR_MEASURED" 0 "(BIT_0)OLD_OR_NEW" ;
VAL_ 154 OBJ_Object_Class_4 8 "UNCERTAIN_VCL" 7 "ANIMAL" 6 "GENERAL_OBJECT" 5 "PEDESTRIAN" 4 "BICYCLE" 3 "MOTORBIKE" 2 "TRUCK" 1 "CAR" 0 "UNFILLED" ;
VAL_ 154 OBJ_Camera_Source_4 11 "PARKING_RIGHT" 10 "PARKING_LEFT" 9 "PARKING_REAR" 8 "PARKING_FRONT" 7 "FRONT_CORNER_RIGHT" 6 "FRONT_CORNER_LEFT" 5 "REAR_CORNER_RIGHT" 4 "REAR_CORNER_LEFT" 3 "REAR" 2 "FRONT_FISHEYE" 1 "FRONT_NARROW" 0 "FRONT_MAIN" ;
VAL_ 154 OBJ_Motion_Status_4 5 "MOVING_SLOWLY" 4 "STOPPED" 3 "STATIONARY" 2 "MOVING" 1 "UNKNOWN" 0 "INVALID" ;
VAL_ 154 OBJ_Motion_Orientation_4 13 "INVALID" 12 "NORTH" 11 "NORTH_WEST" 9 "WEST" 7 "SOUTH_WEST" 6 "SOUTH" 5 "SOUTH_EAST" 3 "EAST" 1 "NORTH_EAST" 0 "UNKNOWN" ;
VAL_ 154 OBJ_Has_Cut_Lane_4 1 "TRUE" 0 "FALSE" ;
VAL_ 154 OBJ_Has_Cut_Path_4 1 "TRUE" 0 "FALSE" ;
VAL_ 154 OBJ_Brake_Light_4 1 "TRUE" 0 "FALSE" ;
VAL_ 154 OBJ_Turn_Indicator_Right_4 1 "TRUE" 0 "FALSE" ;
VAL_ 154 OBJ_Turn_Indicator_Left_4 1 "TRUE" 0 "FALSE" ;
VAL_ 154 OBJ_Light_Indicator_Validity_4 1 "TRUE" 0 "FALSE" ;
VAL_ 154 OBJ_Right_Out_Of_Image_4 1 "TRUE" 0 "FALSE" ;
VAL_ 154 OBJ_Left_Out_Of_Image_4 1 "TRUE" 0 "FALSE" ;
VAL_ 154 OBJ_Right_Out_Of_Image_V_4 1 "TRUE" 0 "FALSE" ;
VAL_ 154 OBJ_Left_Out_Of_Image_V_4 1 "TRUE" 0 "FALSE" ;
VAL_ 154 OBJ_Top_Out_Of_Image_4 1 "TRUE" 0 "FALSE" ;
VAL_ 154 OBJ_Bottom_Out_Of_Image_4 1 "TRUE" 0 "FALSE" ;
VAL_ 154 OBJ_Top_Out_Of_Image_V_4 1 "VALID" 0 "INVALID" ;
VAL_ 154 OBJ_Bottom_Out_Of_Image_V_4 1 "VALID" 0 "INVALID" ;
VAL_ 154 OBJ_Lane_Assignment_4 5 "RIGHT_RIGHT" 4 "RIGHT" 3 "HOST" 2 "LEFT" 1 "LEFT_LEFT" 0 "UNKNOWN" ;
VAL_ 154 OBJ_Lane_Assignment_V_4 1 "VALID" 0 "INVALID" ;
VAL_ 154 OBJ_Age_Seconds_V_4 1 "VALID" 0 "INVALID" ;
VAL_ 154 OBJ_Width_V_4 1 "VALID" 0 "INVALID" ;
VAL_ 154 OBJ_Width_STD_V_4 1 "VALID" 0 "INVALID" ;
VAL_ 154 OBJ_Length_V_4 1 "VALID" 0 "INVALID" ;
VAL_ 154 OBJ_Length_STD_V_4 1 "VALID" 0 "INVALID" ;
VAL_ 154 OBJ_Height_V_4 1 "VALID" 0 "INVALID" ;
VAL_ 154 OBJ_Height_STD_V_4 1 "VALID" 0 "INVALID" ;
VAL_ 154 OBJ_Abs_Long_Velocity_V_4 1 "VALID" 0 "INVALID" ;
VAL_ 154 OBJ_Abs_Long_Vel_STD_V_4 1 "VALID" 0 "INVALID" ;
VAL_ 154 OBJ_Abs_Lat_Velocity_V_4 1 "VALID" 0 "INVALID" ;
VAL_ 154 OBJ_Abs_Lat_Vel_STD_V_4 1 "VALID" 0 "INVALID" ;
VAL_ 154 OBJ_Abs_Long_Acc_V_4 1 "VALID" 0 "INVALID" ;
VAL_ 154 OBJ_Abs_Long_Acc_STD_V_4 1 "VALID" 0 "INVALID" ;
VAL_ 154 OBJ_Abs_Lat_Acc_V_4 1 "VALID" 0 "INVALID" ;
VAL_ 154 OBJ_Abs_Lat_Acc_STD_V_4 1 "VALID" 0 "INVALID" ;
VAL_ 154 OBJ_Abs_Acceleration_V_4 1 "VALID" 0 "INVALID" ;
VAL_ 154 OBJ_Abs_Acc_STD_V_4 1 "VALID" 0 "INVALID" ;
VAL_ 154 OBJ_Inv_TTC_V_4 1 "VALID" 0 "INVALID" ;
VAL_ 154 OBJ_Inv_TTC_STD_V_4 1 "VALID" 0 "INVALID" ;
VAL_ 154 OBJ_Relative_Long_Acc_V_4 1 "VALID" 0 "INVALID" ;
VAL_ 154 OBJ_Rel_Long_Acc_STD_V_4 1 "VALID" 0 "INVALID" ;
VAL_ 154 OBJ_Relative_Long_Velocity_V_4 1 "VALID" 0 "INVALID" ;
VAL_ 154 OBJ_Rel_Long_Vel_STD_V_4 1 "VALID" 0 "INVALID" ;
VAL_ 154 OBJ_Relative_Lat_Velocity_V_4 1 "VALID" 0 "INVALID" ;
VAL_ 154 OBJ_Rel_Lat_Vel_STD_V_4 1 "VALID" 0 "INVALID" ;
VAL_ 154 OBJ_Long_Distance_V_4 1 "VALID" 0 "INVALID" ;
VAL_ 154 OBJ_Long_Distance_STD_V_4 1 "VALID" 0 "INVALID" ;
VAL_ 154 OBJ_Lat_Distance_V_4 1 "VALID" 0 "INVALID" ;
VAL_ 154 OBJ_Lat_Distance_STD_V_4 1 "VALID" 0 "INVALID" ;
VAL_ 154 OBJ_Absolute_Speed_V_4 1 "VALID" 0 "INVALID" ;
VAL_ 154 OBJ_Absolute_Speed_STD_V_4 1 "VALID" 0 "INVALID" ;
VAL_ 154 OBJ_Heading_V_4 1 "VALID" 0 "INVALID" ;
VAL_ 154 OBJ_Heading_STD_V_4 1 "VALID" 0 "INVALID" ;
VAL_ 154 OBJ_Angle_Rate_STD_V_4 1 "VALID" 0 "INVALID" ;
VAL_ 154 OBJ_Angle_Rate_V_4 1 "VALID" 0 "INVALID" ;
VAL_ 154 OBJ_Angle_Right_V_4 1 "VALID" 0 "INVALID" ;
VAL_ 154 OBJ_Angle_Right_STD_V_4 1 "VALID" 0 "INVALID" ;
VAL_ 154 OBJ_Angle_Left_V_4 1 "VALID" 0 "INVALID" ;
VAL_ 154 OBJ_Angle_Left_STD_V_4 1 "VALID" 0 "INVALID" ;
VAL_ 154 OBJ_Angle_Side_V_4 1 "VALID" 0 "INVALID" ;
VAL_ 154 OBJ_Angle_Side_STD_V_4 1 "VALID" 0 "INVALID" ;
VAL_ 154 OBJ_Angle_Mid_V_4 1 "VALID" 0 "INVALID" ;
VAL_ 154 OBJ_Angle_Mid_STD_V_4 1 "VALID" 0 "INVALID" ;
VAL_ 154 OBJ_Angle_Bottom_V_4 1 "VALID" 0 "INVALID" ;
VAL_ 154 OBJ_Angle_Bottom_STD_V_4 1 "VALID" 0 "INVALID" ;
VAL_ 154 OBJ_Visibility_Side_V_4 1 "VALID" 0 "INVALID" ;
VAL_ 154 OBJ_Visibility_Side_4 2 "REAR" 1 "FRONT" 0 "NOT_VISIBLE" ;
VAL_ 154 OBJ_Is_In_Drivable_Area_4 1 "TRUE" 0 "FALSE" ;
VAL_ 154 OBJ_Is_In_Drivable_Area_V_4 1 "VALID" 0 "INVALID" ;
VAL_ 154 OBJ_Is_VeryClose_V_4 1 "VALID" 0 "INVALID" ;
VAL_ 154 OBJ_Is_VeryClose_4 1 "TRUE" 0 "FALSE" ;
VAL_ 154 OBJ_OverlapAngleEgoLaneR_V_4 1 "VALID" 0 "INVALID" ;
VAL_ 154 OBJ_OverlapAngleEgoLaneL_V_4 1 "VALID" 0 "INVALID" ;
VAL_ 154 OBJ_Is_EMERGENCY_VCL_4 1 "TRUE" 0 "FALSE" ;
VAL_ 154 OBJ_EMERGENCY_LIGHT_COLOR_4 3 "(1000)ORANGE" 2 "(0100)BLUE" 1 "(0010)RED" 0 "(0001)OTHER" ;
VAL_ 154 OBJ_EMERGENCY_V_4 1 "TRUE" 0 "FALSE" ;
VAL_ 154 OBJ_Angle_Top_V_4 1 "VALID" 0 "INVALID" ;
VAL_ 154 OBJ_Angle_Top_STD_V_4 1 "VALID" 0 "INVALID" ;
VAL_ 154 OBJ_Fusion_Source_5 2 "(BIT_2)RADAR2" 1 "(BIT_1)RADAR1" 0 "(BIT_0)CAMERA" ;
VAL_ 154 OBJ_Triggered_SDM_5 2 "NOT_TRIGGERED" 1 "TRIGGERED" 0 "NOT_AVAILABLE" ;
VAL_ 154 OBJ_Motion_Category_5 13 "ONCOMING" 12 "PRECEEDING" 11 "MOVING" 10 "RTAP" 9 "LTAP" 8 "CROSSING" 7 "MOVING_OUT" 6 "MOVING_IN" 5 "CLOSE_CUT_IN" 4 "PASSING_OUT" 3 "PASSING_IN" 2 "PASSING" 1 "UNDEFINED" 0 "UNFILLED" ;
VAL_ 154 OBJ_Measuring_Status_5 2 "(BIT_2)NOT_VALID_OR_VALID" 1 "(BIT_1)PREDICTED_OR_MEASURED" 0 "(BIT_0)OLD_OR_NEW" ;
VAL_ 154 OBJ_Object_Class_5 8 "UNCERTAIN_VCL" 7 "ANIMAL" 6 "GENERAL_OBJECT" 5 "PEDESTRIAN" 4 "BICYCLE" 3 "MOTORBIKE" 2 "TRUCK" 1 "CAR" 0 "UNFILLED" ;
VAL_ 154 OBJ_Camera_Source_5 11 "PARKING_RIGHT" 10 "PARKING_LEFT" 9 "PARKING_REAR" 8 "PARKING_FRONT" 7 "FRONT_CORNER_RIGHT" 6 "FRONT_CORNER_LEFT" 5 "REAR_CORNER_RIGHT" 4 "REAR_CORNER_LEFT" 3 "REAR" 2 "FRONT_FISHEYE" 1 "FRONT_NARROW" 0 "FRONT_MAIN" ;
VAL_ 154 OBJ_Motion_Status_5 5 "MOVING_SLOWLY" 4 "STOPPED" 3 "STATIONARY" 2 "MOVING" 1 "UNKNOWN" 0 "INVALID" ;
VAL_ 154 OBJ_Motion_Orientation_5 13 "INVALID" 12 "NORTH" 11 "NORTH_WEST" 9 "WEST" 7 "SOUTH_WEST" 6 "SOUTH" 5 "SOUTH_EAST" 3 "EAST" 1 "NORTH_EAST" 0 "UNKNOWN" ;
VAL_ 154 OBJ_Has_Cut_Lane_5 1 "TRUE" 0 "FALSE" ;
VAL_ 154 OBJ_Has_Cut_Path_5 1 "TRUE" 0 "FALSE" ;
VAL_ 154 OBJ_Brake_Light_5 1 "TRUE" 0 "FALSE" ;
VAL_ 154 OBJ_Turn_Indicator_Right_5 1 "TRUE" 0 "FALSE" ;
VAL_ 154 OBJ_Turn_Indicator_Left_5 1 "TRUE" 0 "FALSE" ;
VAL_ 154 OBJ_Light_Indicator_Validity_5 1 "TRUE" 0 "FALSE" ;
VAL_ 154 OBJ_Right_Out_Of_Image_5 1 "TRUE" 0 "FALSE" ;
VAL_ 154 OBJ_Left_Out_Of_Image_5 1 "TRUE" 0 "FALSE" ;
VAL_ 154 OBJ_Right_Out_Of_Image_V_5 1 "TRUE" 0 "FALSE" ;
VAL_ 154 OBJ_Left_Out_Of_Image_V_5 1 "TRUE" 0 "FALSE" ;
VAL_ 154 OBJ_Top_Out_Of_Image_5 1 "TRUE" 0 "FALSE" ;
VAL_ 154 OBJ_Bottom_Out_Of_Image_5 1 "TRUE" 0 "FALSE" ;
VAL_ 154 OBJ_Top_Out_Of_Image_V_5 1 "VALID" 0 "INVALID" ;
VAL_ 154 OBJ_Bottom_Out_Of_Image_V_5 1 "VALID" 0 "INVALID" ;
VAL_ 154 OBJ_Lane_Assignment_5 5 "RIGHT_RIGHT" 4 "RIGHT" 3 "HOST" 2 "LEFT" 1 "LEFT_LEFT" 0 "UNKNOWN" ;
VAL_ 154 OBJ_Lane_Assignment_V_5 1 "VALID" 0 "INVALID" ;
VAL_ 154 OBJ_Age_Seconds_V_5 1 "VALID" 0 "INVALID" ;
VAL_ 154 OBJ_Width_V_5 1 "VALID" 0 "INVALID" ;
VAL_ 154 OBJ_Width_STD_V_5 1 "VALID" 0 "INVALID" ;
VAL_ 154 OBJ_Length_V_5 1 "VALID" 0 "INVALID" ;
VAL_ 154 OBJ_Length_STD_V_5 1 "VALID" 0 "INVALID" ;
VAL_ 154 OBJ_Height_V_5 1 "VALID" 0 "INVALID" ;
VAL_ 154 OBJ_Height_STD_V_5 1 "VALID" 0 "INVALID" ;
VAL_ 154 OBJ_Abs_Long_Velocity_V_5 1 "VALID" 0 "INVALID" ;
VAL_ 154 OBJ_Abs_Long_Vel_STD_V_5 1 "VALID" 0 "INVALID" ;
VAL_ 154 OBJ_Abs_Lat_Velocity_V_5 1 "VALID" 0 "INVALID" ;
VAL_ 154 OBJ_Abs_Lat_Vel_STD_V_5 1 "VALID" 0 "INVALID" ;
VAL_ 154 OBJ_Abs_Long_Acc_V_5 1 "VALID" 0 "INVALID" ;
VAL_ 154 OBJ_Abs_Long_Acc_STD_V_5 1 "VALID" 0 "INVALID" ;
VAL_ 154 OBJ_Abs_Lat_Acc_V_5 1 "VALID" 0 "INVALID" ;
VAL_ 154 OBJ_Abs_Lat_Acc_STD_V_5 1 "VALID" 0 "INVALID" ;
VAL_ 154 OBJ_Abs_Acceleration_V_5 1 "VALID" 0 "INVALID" ;
VAL_ 154 OBJ_Abs_Acc_STD_V_5 1 "VALID" 0 "INVALID" ;
VAL_ 154 OBJ_Inv_TTC_V_5 1 "VALID" 0 "INVALID" ;
VAL_ 154 OBJ_Inv_TTC_STD_V_5 1 "VALID" 0 "INVALID" ;
VAL_ 154 OBJ_Relative_Long_Acc_V_5 1 "VALID" 0 "INVALID" ;
VAL_ 154 OBJ_Rel_Long_Acc_STD_V_5 1 "VALID" 0 "INVALID" ;
VAL_ 154 OBJ_Relative_Long_Velocity_V_5 1 "VALID" 0 "INVALID" ;
VAL_ 154 OBJ_Rel_Long_Vel_STD_V_5 1 "VALID" 0 "INVALID" ;
VAL_ 154 OBJ_Relative_Lat_Velocity_V_5 1 "VALID" 0 "INVALID" ;
VAL_ 154 OBJ_Rel_Lat_Vel_STD_V_5 1 "VALID" 0 "INVALID" ;
VAL_ 154 OBJ_Long_Distance_V_5 1 "VALID" 0 "INVALID" ;
VAL_ 154 OBJ_Long_Distance_STD_V_5 1 "VALID" 0 "INVALID" ;
VAL_ 154 OBJ_Lat_Distance_V_5 1 "VALID" 0 "INVALID" ;
VAL_ 154 OBJ_Lat_Distance_STD_V_5 1 "VALID" 0 "INVALID" ;
VAL_ 154 OBJ_Absolute_Speed_V_5 1 "VALID" 0 "INVALID" ;
VAL_ 154 OBJ_Absolute_Speed_STD_V_5 1 "VALID" 0 "INVALID" ;
VAL_ 154 OBJ_Heading_V_5 1 "VALID" 0 "INVALID" ;
VAL_ 154 OBJ_Heading_STD_V_5 1 "VALID" 0 "INVALID" ;
VAL_ 154 OBJ_Angle_Rate_STD_V_5 1 "VALID" 0 "INVALID" ;
VAL_ 154 OBJ_Angle_Rate_V_5 1 "VALID" 0 "INVALID" ;
VAL_ 154 OBJ_Angle_Right_V_5 1 "VALID" 0 "INVALID" ;
VAL_ 154 OBJ_Angle_Right_STD_V_5 1 "VALID" 0 "INVALID" ;
VAL_ 154 OBJ_Angle_Left_V_5 1 "VALID" 0 "INVALID" ;
