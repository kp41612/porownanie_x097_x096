VERSION "14"
// BundelVersion=v4.20.10_RC1
NS_ :

BS_:

BU_: EyeQ4 MCU

BO_ 154 Core_Objects_protocol: 4660 EyeQ4
 SG_ OBJ_Absolute_Speed_STD_34 : 32288|13@1+ (0.01,0) [0|65] "m_per_s" MCU
 SG_ OBJ_Absolute_Speed_STD_V_34 : 32301|1@1+ (1,0) [0|1] "bool" MCU
 SG_ OBJ_Heading_34 : 32302|10@1+ (0.01,-3.14) [-3.14|3.14] "rad" MCU
 SG_ OBJ_Heading_V_34 : 32312|1@1+ (1,0) [0|1] "bool" MCU
 SG_ Reserved_15_34 : 32313|7@1+ (1,0) [0|0] "NA" MCU
 SG_ OBJ_Heading_STD_34 : 32320|15@1+ (0.0001,0) [0|3.14] "rad" MCU
 SG_ OBJ_Heading_STD_V_34 : 32335|1@1+ (1,0) [0|1] "bool" MCU
 SG_ OBJ_Angle_Rate_STD_34 : 32336|15@1+ (0.0001,0) [0|2.2318] "RPS" MCU
 SG_ OBJ_Angle_Rate_STD_V_34 : 32351|1@1+ (1,0) [0|1] "bool" MCU
 SG_ OBJ_Angle_Rate_34 : 32352|12@1+ (0.002,-2.234) [-2.234|2.2318] "RPS" MCU
 SG_ OBJ_Angle_Rate_V_34 : 32364|1@1+ (1,0) [0|1] "bool" MCU
 SG_ OBJ_Angle_Right_34 : 32365|14@1+ (0.0002,-1.571) [-1.571|1.571] "rad" MCU
 SG_ OBJ_Angle_Right_V_34 : 32379|1@1+ (1,0) [0|1] "bool" MCU
 SG_ Reserved_16_34 : 32380|4@1+ (1,0) [0|0] "NA" MCU
 SG_ OBJ_Angle_Right_STD_34 : 32384|14@1+ (0.0001,0) [0|1.571] "rad" MCU
 SG_ OBJ_Angle_Right_STD_V_34 : 32398|1@1+ (1,0) [0|1] "bool" MCU
 SG_ OBJ_Angle_Left_34 : 32399|14@1+ (0.0002,-1.571) [-1.571|1.571] "rad" MCU
 SG_ OBJ_Angle_Left_V_34 : 32413|1@1+ (1,0) [0|1] "bool" MCU
 SG_ Reserved_17_34 : 32414|2@1+ (1,0) [0|0] "NA" MCU
 SG_ OBJ_Angle_Left_STD_34 : 32416|14@1+ (0.0001,0) [0|1.571] "rad" MCU
 SG_ OBJ_Angle_Left_STD_V_34 : 32430|1@1+ (1,0) [0|1] "bool" MCU
 SG_ OBJ_Angle_Side_34 : 32431|14@1+ (0.0002,-1.571) [-1.571|1.571] "rad" MCU
 SG_ OBJ_Angle_Side_V_34 : 32445|1@1+ (1,0) [0|1] "bool" MCU
 SG_ Reserved_18_34 : 32446|2@1+ (1,0) [0|0] "NA" MCU
 SG_ OBJ_Angle_Side_STD_34 : 32448|14@1+ (0.0001,0) [0|1.571] "rad" MCU
 SG_ OBJ_Angle_Side_STD_V_34 : 32462|1@1+ (1,0) [0|1] "bool" MCU
 SG_ OBJ_Angle_Mid_V_34 : 32463|1@1+ (1,0) [0|1] "bool" MCU
 SG_ OBJ_Angle_Mid_34 : 32464|14@1+ (0.0002,-1.571) [-1.571|1.571] "rad" MCU
 SG_ Reserved_19_34 : 32478|2@1+ (1,0) [0|0] "NA" MCU
 SG_ OBJ_Angle_Mid_STD_34 : 32480|14@1+ (0.0001,0) [0|1.571] "rad" MCU
 SG_ OBJ_Angle_Mid_STD_V_34 : 32494|1@1+ (1,0) [0|1] "bool" MCU
 SG_ OBJ_Angle_Bottom_V_34 : 32495|1@1+ (1,0) [0|1] "bool" MCU
 SG_ OBJ_Angle_Bottom_34 : 32496|14@1+ (0.0002,-1.571) [-1.571|1.571] "rad" MCU
 SG_ Reserved_20_34 : 32510|2@1+ (1,0) [0|0] "NA" MCU
 SG_ OBJ_Angle_Bottom_STD_34 : 32512|14@1+ (0.0001,0) [0|1.571] "rad" MCU
 SG_ OBJ_Angle_Bottom_STD_V_34 : 32526|1@1+ (1,0) [0|1] "bool" MCU
 SG_ OBJ_Visibility_Side_V_34 : 32527|1@1+ (1,0) [0|1] "bool" MCU
 SG_ OBJ_Visibility_Side_34 : 32528|2@1+ (1,0) [0|2] "ENUM" MCU
 SG_ OBJ_Is_In_Drivable_Area_34 : 32530|1@1+ (1,0) [0|1] "bool" MCU
 SG_ OBJ_Is_In_Drivable_Area_V_34 : 32531|1@1+ (1,0) [0|1] "bool" MCU
 SG_ OBJ_Is_VeryClose_V_34 : 32532|1@1+ (1,0) [0|1] "bool" MCU
 SG_ OBJ_Is_VeryClose_34 : 32533|1@1+ (1,0) [0|1] "bool" MCU
 SG_ OBJ_Buffer_C4_34 : 32534|2@1+ (1,0) [0|2] "NA" MCU
 SG_ OBJ_Buffer_C5_34 : 32536|2@1+ (1,0) [0|2] "NA" MCU
 SG_ OBJ_Buffer_C6_34 : 32538|2@1+ (1,0) [0|2] "NA" MCU
 SG_ OBJ_Buffer_C7_34 : 32540|2@1+ (1,0) [0|2] "NA" MCU
 SG_ Reserved_21_34 : 32542|2@1+ (1,0) [0|0] "NA" MCU
 SG_ OBJ_OverlapAngleEgoLaneR_34 : 32544|10@1+ (0.01,-3.14) [-3.14|3.14] "rad" MCU
 SG_ OBJ_OverlapAngleEgoLaneR_V_34 : 32554|1@1+ (1,0) [0|1] "bool" MCU
 SG_ OBJ_OverlapAngleEgoLaneL_34 : 32555|10@1+ (0.01,-3.14) [-3.14|3.14] "rad" MCU
 SG_ OBJ_OverlapAngleEgoLaneL_V_34 : 32565|1@1+ (1,0) [0|1] "bool" MCU
 SG_ OBJ_Is_EMERGENCY_VCL_34 : 32566|1@1+ (1,0) [0|1] "bool" MCU
 SG_ OBJ_EMERGENCY_LIGHT_COLOR_34 : 32567|4@1+ (1,0) [0|15] "BITWIZE" MCU
 SG_ OBJ_EMERGENCY_V_34 : 32571|1@1+ (1,0) [0|1] "bool" MCU
 SG_ Reserved_22_34 : 32572|4@1+ (1,0) [0|0] "NA" MCU
 SG_ OBJ_Angle_Top_34 : 32576|14@1+ (0.0002,0) [0|3.1415] "rad" MCU
 SG_ OBJ_Angle_Top_V_34 : 32590|1@1+ (1,0) [0|1] "bool" MCU
 SG_ OBJ_Angle_Top_STD_34 : 32591|15@1+ (0.0001,0) [0|3.1415] "rad" MCU
 SG_ OBJ_Angle_Top_STD_V_34 : 32606|1@1+ (1,0) [0|1] "bool" MCU
 SG_ OBJ_Buffer_C14_34 : 32607|1@1+ (1,0) [0|1] "NA" MCU
 SG_ OBJ_Buffer_C15_34 : 32608|1@1+ (1,0) [0|1] "NA" MCU
 SG_ OBJ_Buffer_C18_34 : 32609|2@1+ (1,0) [0|2] "NA" MCU
 SG_ OBJ_Buffer_C19_34 : 32611|1@1+ (1,0) [0|1] "NA" MCU
 SG_ Reserved_23_34 : 32612|28@1+ (1,0) [0|0] "NA" MCU
 SG_ OBJ_CRC_35 : 32640|32@1+ (1,0) [0|4294967295] "NA" MCU
 SG_ OBJ_ID_35 : 32672|8@1+ (1,0) [0|255] "counter" MCU
 SG_ OBJ_Existence_Probability_35 : 32680|8@1+ (0.01,0) [0|1] "NA" MCU
 SG_ OBJ_Fusion_Source_35 : 32688|16@1+ (1,0) [0|65535] "BITWIZE" MCU
 SG_ OBJ_Triggered_SDM_35 : 32704|2@1+ (1,0) [0|2] "ENUM" MCU
 SG_ OBJ_Motion_Category_35 : 32706|4@1+ (1,0) [0|13] "ENUM" MCU
 SG_ OBJ_Buffer_C0_35 : 32710|7@1+ (0.01,0) [0|1] "NA" MCU
 SG_ OBJ_Object_Age_35 : 32717|11@1+ (1,0) [0|2047] "frames" MCU
 SG_ OBJ_Measuring_Status_35 : 32728|3@1+ (1,0) [0|7] "BITWIZE" MCU
 SG_ OBJ_Object_Class_35 : 32731|4@1+ (1,0) [0|8] "ENUM" MCU
 SG_ Reserved_4_35 : 32735|1@1+ (1,0) [0|0] "NA" MCU
 SG_ OBJ_Class_Probability_35 : 32736|7@1+ (0.01,0) [0|1] "NA" MCU
 SG_ OBJ_Car_Probability_35 : 32743|7@1+ (0.01,0) [0|1] "NA" MCU
 SG_ OBJ_Truck_Probability_35 : 32750|7@1+ (0.01,0) [0|1] "NA" MCU
 SG_ OBJ_Bike_Probability_35 : 32757|7@1+ (0.01,0) [0|1] "NA" MCU
 SG_ OBJ_Camera_Source_35 : 32764|4@1+ (1,0) [0|15] "ENUM" MCU
 SG_ OBJ_Motion_Status_35 : 32768|3@1+ (1,0) [0|5] "ENUM" MCU
 SG_ OBJ_Motion_Orientation_35 : 32771|4@1+ (1,0) [0|13] "ENUM" MCU
 SG_ OBJ_Has_Cut_Lane_35 : 32775|1@1+ (1,0) [0|1] "bool" MCU
 SG_ OBJ_Has_Cut_Path_35 : 32776|1@1+ (1,0) [0|1] "bool" MCU
 SG_ OBJ_Brake_Light_35 : 32777|1@1+ (1,0) [0|1] "bool" MCU
 SG_ OBJ_Turn_Indicator_Right_35 : 32778|1@1+ (1,0) [0|1] "bool" MCU
 SG_ OBJ_Turn_Indicator_Left_35 : 32779|1@1+ (1,0) [0|1] "bool" MCU
 SG_ OBJ_Light_Indicator_Validity_35 : 32780|1@1+ (1,0) [0|1] "bool" MCU
 SG_ OBJ_Right_Out_Of_Image_35 : 32781|1@1+ (1,0) [0|1] "bool" MCU
 SG_ OBJ_Left_Out_Of_Image_35 : 32782|1@1+ (1,0) [0|1] "bool" MCU
 SG_ OBJ_Right_Out_Of_Image_V_35 : 32783|1@1+ (1,0) [0|1] "bool" MCU
 SG_ OBJ_Left_Out_Of_Image_V_35 : 32784|1@1+ (1,0) [0|1] "bool" MCU
 SG_ OBJ_Top_Out_Of_Image_35 : 32785|1@1+ (1,0) [0|1] "bool" MCU
 SG_ OBJ_Bottom_Out_Of_Image_35 : 32786|1@1+ (1,0) [0|1] "bool" MCU
 SG_ OBJ_Top_Out_Of_Image_V_35 : 32787|1@1+ (1,0) [0|1] "bool" MCU
 SG_ OBJ_Bottom_Out_Of_Image_V_35 : 32788|1@1+ (1,0) [0|1] "bool" MCU
 SG_ OBJ_Lane_Assignment_35 : 32789|3@1+ (1,0) [0|5] "ENUM" MCU
 SG_ OBJ_Lane_Assignment_V_35 : 32792|1@1+ (1,0) [0|1] "bool" MCU
 SG_ OBJ_Age_Seconds_35 : 32793|7@1+ (1,0) [0|100] "s" MCU
 SG_ OBJ_Age_Seconds_V_35 : 32800|1@1+ (1,0) [0|1] "bool" MCU
 SG_ OBJ_Width_35 : 32801|9@1+ (0.01,0) [0.4|2.95] "m" MCU
 SG_ OBJ_Width_V_35 : 32810|1@1+ (1,0) [0|1] "bool" MCU
 SG_ OBJ_Width_STD_35 : 32811|11@1+ (0.001,0) [0|2] "m" MCU
 SG_ OBJ_Width_STD_V_35 : 32822|1@1+ (1,0) [0|1] "bool" MCU
 SG_ OBJ_Length_35 : 32823|9@1+ (0.05,0) [1.2|21] "m" MCU
 SG_ OBJ_Length_V_35 : 32832|1@1+ (1,0) [0|1] "bool" MCU
 SG_ OBJ_Length_STD_35 : 32833|10@1+ (0.01,0) [0|10] "m" MCU
 SG_ OBJ_Length_STD_V_35 : 32843|1@1+ (1,0) [0|1] "bool" MCU
 SG_ OBJ_Radar_ID_35 : 32844|8@1+ (1,0) [0|255] "counter" MCU
 SG_ OBJ_Height_35 : 32852|9@1+ (0.01,0) [0|2.95] "m" MCU
 SG_ OBJ_Height_V_35 : 32861|1@1+ (1,0) [0|1] "bool" MCU
 SG_ Reserved_5_35 : 32862|2@1+ (1,0) [0|0] "NA" MCU
 SG_ OBJ_Height_STD_35 : 32864|11@1+ (0.001,0) [0|2] "m" MCU
 SG_ OBJ_Height_STD_V_35 : 32875|1@1+ (1,0) [0|1] "bool" MCU
 SG_ OBJ_Abs_Long_Velocity_35 : 32876|12@1+ (0.05,-100) [-100|100] "m_per_s" MCU
 SG_ OBJ_Abs_Long_Velocity_V_35 : 32888|1@1+ (1,0) [0|1] "bool" MCU
 SG_ Reserved_6_35 : 32889|7@1+ (1,0) [0|0] "NA" MCU
 SG_ OBJ_Abs_Long_Velocity_STD_35 : 32896|13@1+ (0.01,0) [0|65] "m_per_s" MCU
 SG_ OBJ_Abs_Long_Vel_STD_V_35 : 32909|1@1+ (1,0) [0|1] "bool" MCU
 SG_ OBJ_Abs_Lat_Velocity_35 : 32910|11@1+ (0.05,-50) [-50|50] "m_per_s" MCU
 SG_ OBJ_Abs_Lat_Velocity_V_35 : 32921|1@1+ (1,0) [0|1] "bool" MCU
 SG_ Reserved_7_35 : 32922|6@1+ (1,0) [0|0] "NA" MCU
 SG_ OBJ_Abs_Lat_Velocity_STD_35 : 32928|13@1+ (0.01,0) [0|50] "m_per_s" MCU
 SG_ OBJ_Abs_Lat_Vel_STD_V_35 : 32941|1@1+ (1,0) [0|1] "bool" MCU
 SG_ OBJ_Abs_Long_Acc_35 : 32942|9@1+ (0.05,-10) [-10|10] "m_per_s2" MCU
 SG_ OBJ_Abs_Long_Acc_V_35 : 32951|1@1+ (1,0) [0|1] "bool" MCU
 SG_ Reserved_8_35 : 32952|8@1+ (1,0) [0|0] "NA" MCU
 SG_ OBJ_Abs_Long_Acc_STD_35 : 32960|10@1+ (0.01,0) [0|7.3] "m_per_s2" MCU
 SG_ OBJ_Abs_Long_Acc_STD_V_35 : 32970|1@1+ (1,0) [0|1] "bool" MCU
 SG_ OBJ_Abs_Lat_Acc_35 : 32971|9@1+ (0.05,-10) [-10|10] "m_per_s2" MCU
 SG_ OBJ_Abs_Lat_Acc_V_35 : 32980|1@1+ (1,0) [0|1] "bool" MCU
 SG_ OBJ_Abs_Lat_Acc_STD_35 : 32981|10@1+ (0.01,0) [0|7.3] "m_per_s2" MCU
 SG_ OBJ_Abs_Lat_Acc_STD_V_35 : 32991|1@1+ (1,0) [0|1] "bool" MCU
 SG_ OBJ_Abs_Acceleration_35 : 32992|9@1+ (0.05,-12.7) [-12.7|12.7] "m_per_s2" MCU
 SG_ OBJ_Abs_Acceleration_V_35 : 33001|1@1+ (1,0) [0|1] "bool" MCU
 SG_ OBJ_Abs_Acc_STD_35 : 33002|10@1+ (0.01,0) [0|7.3] "m_per_s2" MCU
 SG_ OBJ_Abs_Acc_STD_V_35 : 33012|1@1+ (1,0) [0|1] "bool" MCU
 SG_ OBJ_Inv_TTC_35 : 33013|11@1+ (0.01,-8) [-8|8] "INV(s)" MCU
 SG_ OBJ_Inv_TTC_V_35 : 33024|1@1+ (1,0) [0|1] "bool" MCU
 SG_ OBJ_Inv_TTC_STD_35 : 33025|12@1+ (0.001,0) [0|4] "INV(s)" MCU
 SG_ OBJ_Inv_TTC_STD_V_35 : 33037|1@1+ (1,0) [0|1] "bool" MCU
 SG_ OBJ_Relative_Long_Acc_35 : 33038|10@1+ (0.05,-20) [-20|20] "m_per_s2" MCU
 SG_ OBJ_Relative_Long_Acc_V_35 : 33048|1@1+ (1,0) [0|1] "bool" MCU
 SG_ Reserved_9_35 : 33049|7@1+ (1,0) [0|0] "NA" MCU
 SG_ OBJ_Relative_Long_Acc_STD_35 : 33056|10@1+ (0.01,0) [0|7.3] "m_per_s2" MCU
 SG_ OBJ_Rel_Long_Acc_STD_V_35 : 33066|1@1+ (1,0) [0|1] "bool" MCU
 SG_ OBJ_Relative_Long_Velocity_35 : 33067|13@1+ (0.05,-120) [-120|130] "m_per_s" MCU
 SG_ OBJ_Relative_Long_Velocity_V_35 : 33080|1@1+ (1,0) [0|1] "bool" MCU
 SG_ Reserved_10_35 : 33081|7@1+ (1,0) [0|0] "NA" MCU
 SG_ OBJ_Relative_Long_Vel_STD_35 : 33088|14@1+ (0.01,0) [0|130] "m_per_s" MCU
 SG_ OBJ_Rel_Long_Vel_STD_V_35 : 33102|1@1+ (1,0) [0|1] "bool" MCU
 SG_ OBJ_Relative_Lat_Velocity_35 : 33103|11@1+ (0.05,-50) [-50|50] "m_per_s" MCU
 SG_ OBJ_Relative_Lat_Velocity_V_35 : 33114|1@1+ (1,0) [0|1] "bool" MCU
 SG_ Reserved_11_35 : 33115|5@1+ (1,0) [0|0] "NA" MCU
 SG_ OBJ_Relative_Lat_Velocity_STD_35 : 33120|13@1+ (0.01,0) [0|50] "m_per_s" MCU
 SG_ OBJ_Rel_Lat_Vel_STD_V_35 : 33133|1@1+ (1,0) [0|1] "bool" MCU
 SG_ OBJ_Long_Distance_35 : 33134|14@1+ (0.05,-200) [-200|500] "m" MCU
 SG_ OBJ_Long_Distance_V_35 : 33148|1@1+ (1,0) [0|1] "bool" MCU
 SG_ Reserved_12_35 : 33149|3@1+ (1,0) [0|0] "NA" MCU
 SG_ OBJ_Long_Distance_STD_35 : 33152|15@1+ (0.01,0) [0|250] "m" MCU
 SG_ OBJ_Long_Distance_STD_V_35 : 33167|1@1+ (1,0) [0|1] "bool" MCU
 SG_ OBJ_Lat_Distance_35 : 33168|12@1+ (0.05,-100) [-100|100] "m" MCU
 SG_ OBJ_Lat_Distance_V_35 : 33180|1@1+ (1,0) [0|1] "bool" MCU
 SG_ Reserved_13_35 : 33181|3@1+ (1,0) [0|0] "NA" MCU
 SG_ OBJ_Lat_Distance_STD_35 : 33184|14@1+ (0.01,0) [0|100] "m" MCU
 SG_ OBJ_Lat_Distance_STD_V_35 : 33198|1@1+ (1,0) [0|1] "bool" MCU
 SG_ OBJ_Absolute_Speed_35 : 33199|12@1+ (0.05,-65) [-65|65] "m_per_s" MCU
 SG_ OBJ_Absolute_Speed_V_35 : 33211|1@1+ (1,0) [0|1] "bool" MCU
 SG_ Reserved_14_35 : 33212|4@1+ (1,0) [0|0] "NA" MCU
 SG_ OBJ_Absolute_Speed_STD_35 : 33216|13@1+ (0.01,0) [0|65] "m_per_s" MCU
 SG_ OBJ_Absolute_Speed_STD_V_35 : 33229|1@1+ (1,0) [0|1] "bool" MCU
 SG_ OBJ_Heading_35 : 33230|10@1+ (0.01,-3.14) [-3.14|3.14] "rad" MCU
 SG_ OBJ_Heading_V_35 : 33240|1@1+ (1,0) [0|1] "bool" MCU
 SG_ Reserved_15_35 : 33241|7@1+ (1,0) [0|0] "NA" MCU
 SG_ OBJ_Heading_STD_35 : 33248|15@1+ (0.0001,0) [0|3.14] "rad" MCU
 SG_ OBJ_Heading_STD_V_35 : 33263|1@1+ (1,0) [0|1] "bool" MCU
 SG_ OBJ_Angle_Rate_STD_35 : 33264|15@1+ (0.0001,0) [0|2.2318] "RPS" MCU
 SG_ OBJ_Angle_Rate_STD_V_35 : 33279|1@1+ (1,0) [0|1] "bool" MCU
 SG_ OBJ_Angle_Rate_35 : 33280|12@1+ (0.002,-2.234) [-2.234|2.2318] "RPS" MCU
 SG_ OBJ_Angle_Rate_V_35 : 33292|1@1+ (1,0) [0|1] "bool" MCU
 SG_ OBJ_Angle_Right_35 : 33293|14@1+ (0.0002,-1.571) [-1.571|1.571] "rad" MCU
 SG_ OBJ_Angle_Right_V_35 : 33307|1@1+ (1,0) [0|1] "bool" MCU
 SG_ Reserved_16_35 : 33308|4@1+ (1,0) [0|0] "NA" MCU
 SG_ OBJ_Angle_Right_STD_35 : 33312|14@1+ (0.0001,0) [0|1.571] "rad" MCU
 SG_ OBJ_Angle_Right_STD_V_35 : 33326|1@1+ (1,0) [0|1] "bool" MCU
 SG_ OBJ_Angle_Left_35 : 33327|14@1+ (0.0002,-1.571) [-1.571|1.571] "rad" MCU
 SG_ OBJ_Angle_Left_V_35 : 33341|1@1+ (1,0) [0|1] "bool" MCU
 SG_ Reserved_17_35 : 33342|2@1+ (1,0) [0|0] "NA" MCU
 SG_ OBJ_Angle_Left_STD_35 : 33344|14@1+ (0.0001,0) [0|1.571] "rad" MCU
 SG_ OBJ_Angle_Left_STD_V_35 : 33358|1@1+ (1,0) [0|1] "bool" MCU
 SG_ OBJ_Angle_Side_35 : 33359|14@1+ (0.0002,-1.571) [-1.571|1.571] "rad" MCU
 SG_ OBJ_Angle_Side_V_35 : 33373|1@1+ (1,0) [0|1] "bool" MCU
 SG_ Reserved_18_35 : 33374|2@1+ (1,0) [0|0] "NA" MCU
 SG_ OBJ_Angle_Side_STD_35 : 33376|14@1+ (0.0001,0) [0|1.571] "rad" MCU
 SG_ OBJ_Angle_Side_STD_V_35 : 33390|1@1+ (1,0) [0|1] "bool" MCU
 SG_ OBJ_Angle_Mid_V_35 : 33391|1@1+ (1,0) [0|1] "bool" MCU
 SG_ OBJ_Angle_Mid_35 : 33392|14@1+ (0.0002,-1.571) [-1.571|1.571] "rad" MCU
 SG_ Reserved_19_35 : 33406|2@1+ (1,0) [0|0] "NA" MCU
 SG_ OBJ_Angle_Mid_STD_35 : 33408|14@1+ (0.0001,0) [0|1.571] "rad" MCU
 SG_ OBJ_Angle_Mid_STD_V_35 : 33422|1@1+ (1,0) [0|1] "bool" MCU
 SG_ OBJ_Angle_Bottom_V_35 : 33423|1@1+ (1,0) [0|1] "bool" MCU
 SG_ OBJ_Angle_Bottom_35 : 33424|14@1+ (0.0002,-1.571) [-1.571|1.571] "rad" MCU
 SG_ Reserved_20_35 : 33438|2@1+ (1,0) [0|0] "NA" MCU
 SG_ OBJ_Angle_Bottom_STD_35 : 33440|14@1+ (0.0001,0) [0|1.571] "rad" MCU
 SG_ OBJ_Angle_Bottom_STD_V_35 : 33454|1@1+ (1,0) [0|1] "bool" MCU
 SG_ OBJ_Visibility_Side_V_35 : 33455|1@1+ (1,0) [0|1] "bool" MCU
 SG_ OBJ_Visibility_Side_35 : 33456|2@1+ (1,0) [0|2] "ENUM" MCU
 SG_ OBJ_Is_In_Drivable_Area_35 : 33458|1@1+ (1,0) [0|1] "bool" MCU
 SG_ OBJ_Is_In_Drivable_Area_V_35 : 33459|1@1+ (1,0) [0|1] "bool" MCU
 SG_ OBJ_Is_VeryClose_V_35 : 33460|1@1+ (1,0) [0|1] "bool" MCU
 SG_ OBJ_Is_VeryClose_35 : 33461|1@1+ (1,0) [0|1] "bool" MCU
 SG_ OBJ_Buffer_C4_35 : 33462|2@1+ (1,0) [0|2] "NA" MCU
 SG_ OBJ_Buffer_C5_35 : 33464|2@1+ (1,0) [0|2] "NA" MCU
 SG_ OBJ_Buffer_C6_35 : 33466|2@1+ (1,0) [0|2] "NA" MCU
 SG_ OBJ_Buffer_C7_35 : 33468|2@1+ (1,0) [0|2] "NA" MCU
 SG_ Reserved_21_35 : 33470|2@1+ (1,0) [0|0] "NA" MCU
 SG_ OBJ_OverlapAngleEgoLaneR_35 : 33472|10@1+ (0.01,-3.14) [-3.14|3.14] "rad" MCU
 SG_ OBJ_OverlapAngleEgoLaneR_V_35 : 33482|1@1+ (1,0) [0|1] "bool" MCU
 SG_ OBJ_OverlapAngleEgoLaneL_35 : 33483|10@1+ (0.01,-3.14) [-3.14|3.14] "rad" MCU
 SG_ OBJ_OverlapAngleEgoLaneL_V_35 : 33493|1@1+ (1,0) [0|1] "bool" MCU
 SG_ OBJ_Is_EMERGENCY_VCL_35 : 33494|1@1+ (1,0) [0|1] "bool" MCU
 SG_ OBJ_EMERGENCY_LIGHT_COLOR_35 : 33495|4@1+ (1,0) [0|15] "BITWIZE" MCU
 SG_ OBJ_EMERGENCY_V_35 : 33499|1@1+ (1,0) [0|1] "bool" MCU
 SG_ Reserved_22_35 : 33500|4@1+ (1,0) [0|0] "NA" MCU
 SG_ OBJ_Angle_Top_35 : 33504|14@1+ (0.0002,0) [0|3.1415] "rad" MCU
 SG_ OBJ_Angle_Top_V_35 : 33518|1@1+ (1,0) [0|1] "bool" MCU
 SG_ OBJ_Angle_Top_STD_35 : 33519|15@1+ (0.0001,0) [0|3.1415] "rad" MCU
 SG_ OBJ_Angle_Top_STD_V_35 : 33534|1@1+ (1,0) [0|1] "bool" MCU
 SG_ OBJ_Buffer_C14_35 : 33535|1@1+ (1,0) [0|1] "NA" MCU
 SG_ OBJ_Buffer_C15_35 : 33536|1@1+ (1,0) [0|1] "NA" MCU
 SG_ OBJ_Buffer_C18_35 : 33537|2@1+ (1,0) [0|2] "NA" MCU
 SG_ OBJ_Buffer_C19_35 : 33539|1@1+ (1,0) [0|1] "NA" MCU
 SG_ Reserved_23_35 : 33540|28@1+ (1,0) [0|0] "NA" MCU
 SG_ OBJ_CRC_36 : 33568|32@1+ (1,0) [0|4294967295] "NA" MCU
 SG_ OBJ_ID_36 : 33600|8@1+ (1,0) [0|255] "counter" MCU
 SG_ OBJ_Existence_Probability_36 : 33608|8@1+ (0.01,0) [0|1] "NA" MCU
 SG_ OBJ_Fusion_Source_36 : 33616|16@1+ (1,0) [0|65535] "BITWIZE" MCU
 SG_ OBJ_Triggered_SDM_36 : 33632|2@1+ (1,0) [0|2] "ENUM" MCU
 SG_ OBJ_Motion_Category_36 : 33634|4@1+ (1,0) [0|13] "ENUM" MCU
 SG_ OBJ_Buffer_C0_36 : 33638|7@1+ (0.01,0) [0|1] "NA" MCU
 SG_ OBJ_Object_Age_36 : 33645|11@1+ (1,0) [0|2047] "frames" MCU
 SG_ OBJ_Measuring_Status_36 : 33656|3@1+ (1,0) [0|7] "BITWIZE" MCU
 SG_ OBJ_Object_Class_36 : 33659|4@1+ (1,0) [0|8] "ENUM" MCU
 SG_ Reserved_4_36 : 33663|1@1+ (1,0) [0|0] "NA" MCU
 SG_ OBJ_Class_Probability_36 : 33664|7@1+ (0.01,0) [0|1] "NA" MCU
 SG_ OBJ_Car_Probability_36 : 33671|7@1+ (0.01,0) [0|1] "NA" MCU
 SG_ OBJ_Truck_Probability_36 : 33678|7@1+ (0.01,0) [0|1] "NA" MCU
 SG_ OBJ_Bike_Probability_36 : 33685|7@1+ (0.01,0) [0|1] "NA" MCU
 SG_ OBJ_Camera_Source_36 : 33692|4@1+ (1,0) [0|15] "ENUM" MCU
 SG_ OBJ_Motion_Status_36 : 33696|3@1+ (1,0) [0|5] "ENUM" MCU
 SG_ OBJ_Motion_Orientation_36 : 33699|4@1+ (1,0) [0|13] "ENUM" MCU
 SG_ OBJ_Has_Cut_Lane_36 : 33703|1@1+ (1,0) [0|1] "bool" MCU
 SG_ OBJ_Has_Cut_Path_36 : 33704|1@1+ (1,0) [0|1] "bool" MCU
 SG_ OBJ_Brake_Light_36 : 33705|1@1+ (1,0) [0|1] "bool" MCU
 SG_ OBJ_Turn_Indicator_Right_36 : 33706|1@1+ (1,0) [0|1] "bool" MCU
 SG_ OBJ_Turn_Indicator_Left_36 : 33707|1@1+ (1,0) [0|1] "bool" MCU
 SG_ OBJ_Light_Indicator_Validity_36 : 33708|1@1+ (1,0) [0|1] "bool" MCU
 SG_ OBJ_Right_Out_Of_Image_36 : 33709|1@1+ (1,0) [0|1] "bool" MCU
 SG_ OBJ_Left_Out_Of_Image_36 : 33710|1@1+ (1,0) [0|1] "bool" MCU
 SG_ OBJ_Right_Out_Of_Image_V_36 : 33711|1@1+ (1,0) [0|1] "bool" MCU
 SG_ OBJ_Left_Out_Of_Image_V_36 : 33712|1@1+ (1,0) [0|1] "bool" MCU
 SG_ OBJ_Top_Out_Of_Image_36 : 33713|1@1+ (1,0) [0|1] "bool" MCU
 SG_ OBJ_Bottom_Out_Of_Image_36 : 33714|1@1+ (1,0) [0|1] "bool" MCU
 SG_ OBJ_Top_Out_Of_Image_V_36 : 33715|1@1+ (1,0) [0|1] "bool" MCU
 SG_ OBJ_Bottom_Out_Of_Image_V_36 : 33716|1@1+ (1,0) [0|1] "bool" MCU
 SG_ OBJ_Lane_Assignment_36 : 33717|3@1+ (1,0) [0|5] "ENUM" MCU
 SG_ OBJ_Lane_Assignment_V_36 : 33720|1@1+ (1,0) [0|1] "bool" MCU
 SG_ OBJ_Age_Seconds_36 : 33721|7@1+ (1,0) [0|100] "s" MCU
 SG_ OBJ_Age_Seconds_V_36 : 33728|1@1+ (1,0) [0|1] "bool" MCU
 SG_ OBJ_Width_36 : 33729|9@1+ (0.01,0) [0.4|2.95] "m" MCU
 SG_ OBJ_Width_V_36 : 33738|1@1+ (1,0) [0|1] "bool" MCU
 SG_ OBJ_Width_STD_36 : 33739|11@1+ (0.001,0) [0|2] "m" MCU
 SG_ OBJ_Width_STD_V_36 : 33750|1@1+ (1,0) [0|1] "bool" MCU
 SG_ OBJ_Length_36 : 33751|9@1+ (0.05,0) [1.2|21] "m" MCU
 SG_ OBJ_Length_V_36 : 33760|1@1+ (1,0) [0|1] "bool" MCU
 SG_ OBJ_Length_STD_36 : 33761|10@1+ (0.01,0) [0|10] "m" MCU
 SG_ OBJ_Length_STD_V_36 : 33771|1@1+ (1,0) [0|1] "bool" MCU
 SG_ OBJ_Radar_ID_36 : 33772|8@1+ (1,0) [0|255] "counter" MCU
 SG_ OBJ_Height_36 : 33780|9@1+ (0.01,0) [0|2.95] "m" MCU
 SG_ OBJ_Height_V_36 : 33789|1@1+ (1,0) [0|1] "bool" MCU
 SG_ Reserved_5_36 : 33790|2@1+ (1,0) [0|0] "NA" MCU
 SG_ OBJ_Height_STD_36 : 33792|11@1+ (0.001,0) [0|2] "m" MCU
 SG_ OBJ_Height_STD_V_36 : 33803|1@1+ (1,0) [0|1] "bool" MCU
 SG_ OBJ_Abs_Long_Velocity_36 : 33804|12@1+ (0.05,-100) [-100|100] "m_per_s" MCU
 SG_ OBJ_Abs_Long_Velocity_V_36 : 33816|1@1+ (1,0) [0|1] "bool" MCU
 SG_ Reserved_6_36 : 33817|7@1+ (1,0) [0|0] "NA" MCU
 SG_ OBJ_Abs_Long_Velocity_STD_36 : 33824|13@1+ (0.01,0) [0|65] "m_per_s" MCU
 SG_ OBJ_Abs_Long_Vel_STD_V_36 : 33837|1@1+ (1,0) [0|1] "bool" MCU
 SG_ OBJ_Abs_Lat_Velocity_36 : 33838|11@1+ (0.05,-50) [-50|50] "m_per_s" MCU
 SG_ OBJ_Abs_Lat_Velocity_V_36 : 33849|1@1+ (1,0) [0|1] "bool" MCU
 SG_ Reserved_7_36 : 33850|6@1+ (1,0) [0|0] "NA" MCU
 SG_ OBJ_Abs_Lat_Velocity_STD_36 : 33856|13@1+ (0.01,0) [0|50] "m_per_s" MCU
 SG_ OBJ_Abs_Lat_Vel_STD_V_36 : 33869|1@1+ (1,0) [0|1] "bool" MCU
 SG_ OBJ_Abs_Long_Acc_36 : 33870|9@1+ (0.05,-10) [-10|10] "m_per_s2" MCU
 SG_ OBJ_Abs_Long_Acc_V_36 : 33879|1@1+ (1,0) [0|1] "bool" MCU
 SG_ Reserved_8_36 : 33880|8@1+ (1,0) [0|0] "NA" MCU
 SG_ OBJ_Abs_Long_Acc_STD_36 : 33888|10@1+ (0.01,0) [0|7.3] "m_per_s2" MCU
 SG_ OBJ_Abs_Long_Acc_STD_V_36 : 33898|1@1+ (1,0) [0|1] "bool" MCU
 SG_ OBJ_Abs_Lat_Acc_36 : 33899|9@1+ (0.05,-10) [-10|10] "m_per_s2" MCU
 SG_ OBJ_Abs_Lat_Acc_V_36 : 33908|1@1+ (1,0) [0|1] "bool" MCU
 SG_ OBJ_Abs_Lat_Acc_STD_36 : 33909|10@1+ (0.01,0) [0|7.3] "m_per_s2" MCU
 SG_ OBJ_Abs_Lat_Acc_STD_V_36 : 33919|1@1+ (1,0) [0|1] "bool" MCU
 SG_ OBJ_Abs_Acceleration_36 : 33920|9@1+ (0.05,-12.7) [-12.7|12.7] "m_per_s2" MCU
 SG_ OBJ_Abs_Acceleration_V_36 : 33929|1@1+ (1,0) [0|1] "bool" MCU
 SG_ OBJ_Abs_Acc_STD_36 : 33930|10@1+ (0.01,0) [0|7.3] "m_per_s2" MCU
 SG_ OBJ_Abs_Acc_STD_V_36 : 33940|1@1+ (1,0) [0|1] "bool" MCU
 SG_ OBJ_Inv_TTC_36 : 33941|11@1+ (0.01,-8) [-8|8] "INV(s)" MCU
 SG_ OBJ_Inv_TTC_V_36 : 33952|1@1+ (1,0) [0|1] "bool" MCU
 SG_ OBJ_Inv_TTC_STD_36 : 33953|12@1+ (0.001,0) [0|4] "INV(s)" MCU
 SG_ OBJ_Inv_TTC_STD_V_36 : 33965|1@1+ (1,0) [0|1] "bool" MCU
 SG_ OBJ_Relative_Long_Acc_36 : 33966|10@1+ (0.05,-20) [-20|20] "m_per_s2" MCU
 SG_ OBJ_Relative_Long_Acc_V_36 : 33976|1@1+ (1,0) [0|1] "bool" MCU
 SG_ Reserved_9_36 : 33977|7@1+ (1,0) [0|0] "NA" MCU
 SG_ OBJ_Relative_Long_Acc_STD_36 : 33984|10@1+ (0.01,0) [0|7.3] "m_per_s2" MCU
 SG_ OBJ_Rel_Long_Acc_STD_V_36 : 33994|1@1+ (1,0) [0|1] "bool" MCU
 SG_ OBJ_Relative_Long_Velocity_36 : 33995|13@1+ (0.05,-120) [-120|130] "m_per_s" MCU
 SG_ OBJ_Relative_Long_Velocity_V_36 : 34008|1@1+ (1,0) [0|1] "bool" MCU
 SG_ Reserved_10_36 : 34009|7@1+ (1,0) [0|0] "NA" MCU
 SG_ OBJ_Relative_Long_Vel_STD_36 : 34016|14@1+ (0.01,0) [0|130] "m_per_s" MCU
 SG_ OBJ_Rel_Long_Vel_STD_V_36 : 34030|1@1+ (1,0) [0|1] "bool" MCU
 SG_ OBJ_Relative_Lat_Velocity_36 : 34031|11@1+ (0.05,-50) [-50|50] "m_per_s" MCU
 SG_ OBJ_Relative_Lat_Velocity_V_36 : 34042|1@1+ (1,0) [0|1] "bool" MCU
 SG_ Reserved_11_36 : 34043|5@1+ (1,0) [0|0] "NA" MCU
 SG_ OBJ_Relative_Lat_Velocity_STD_36 : 34048|13@1+ (0.01,0) [0|50] "m_per_s" MCU
 SG_ OBJ_Rel_Lat_Vel_STD_V_36 : 34061|1@1+ (1,0) [0|1] "bool" MCU
 SG_ OBJ_Long_Distance_36 : 34062|14@1+ (0.05,-200) [-200|500] "m" MCU
 SG_ OBJ_Long_Distance_V_36 : 34076|1@1+ (1,0) [0|1] "bool" MCU
 SG_ Reserved_12_36 : 34077|3@1+ (1,0) [0|0] "NA" MCU
 SG_ OBJ_Long_Distance_STD_36 : 34080|15@1+ (0.01,0) [0|250] "m" MCU
 SG_ OBJ_Long_Distance_STD_V_36 : 34095|1@1+ (1,0) [0|1] "bool" MCU
 SG_ OBJ_Lat_Distance_36 : 34096|12@1+ (0.05,-100) [-100|100] "m" MCU
 SG_ OBJ_Lat_Distance_V_36 : 34108|1@1+ (1,0) [0|1] "bool" MCU
 SG_ Reserved_13_36 : 34109|3@1+ (1,0) [0|0] "NA" MCU
 SG_ OBJ_Lat_Distance_STD_36 : 34112|14@1+ (0.01,0) [0|100] "m" MCU
 SG_ OBJ_Lat_Distance_STD_V_36 : 34126|1@1+ (1,0) [0|1] "bool" MCU
 SG_ OBJ_Absolute_Speed_36 : 34127|12@1+ (0.05,-65) [-65|65] "m_per_s" MCU
 SG_ OBJ_Absolute_Speed_V_36 : 34139|1@1+ (1,0) [0|1] "bool" MCU
 SG_ Reserved_14_36 : 34140|4@1+ (1,0) [0|0] "NA" MCU
 SG_ OBJ_Absolute_Speed_STD_36 : 34144|13@1+ (0.01,0) [0|65] "m_per_s" MCU
 SG_ OBJ_Absolute_Speed_STD_V_36 : 34157|1@1+ (1,0) [0|1] "bool" MCU
 SG_ OBJ_Heading_36 : 34158|10@1+ (0.01,-3.14) [-3.14|3.14] "rad" MCU
 SG_ OBJ_Heading_V_36 : 34168|1@1+ (1,0) [0|1] "bool" MCU
 SG_ Reserved_15_36 : 34169|7@1+ (1,0) [0|0] "NA" MCU
 SG_ OBJ_Heading_STD_36 : 34176|15@1+ (0.0001,0) [0|3.14] "rad" MCU
 SG_ OBJ_Heading_STD_V_36 : 34191|1@1+ (1,0) [0|1] "bool" MCU
 SG_ OBJ_Angle_Rate_STD_36 : 34192|15@1+ (0.0001,0) [0|2.2318] "RPS" MCU
 SG_ OBJ_Angle_Rate_STD_V_36 : 34207|1@1+ (1,0) [0|1] "bool" MCU
 SG_ OBJ_Angle_Rate_36 : 34208|12@1+ (0.002,-2.234) [-2.234|2.2318] "RPS" MCU
 SG_ OBJ_Angle_Rate_V_36 : 34220|1@1+ (1,0) [0|1] "bool" MCU
 SG_ OBJ_Angle_Right_36 : 34221|14@1+ (0.0002,-1.571) [-1.571|1.571] "rad" MCU
 SG_ OBJ_Angle_Right_V_36 : 34235|1@1+ (1,0) [0|1] "bool" MCU
 SG_ Reserved_16_36 : 34236|4@1+ (1,0) [0|0] "NA" MCU
 SG_ OBJ_Angle_Right_STD_36 : 34240|14@1+ (0.0001,0) [0|1.571] "rad" MCU
 SG_ OBJ_Angle_Right_STD_V_36 : 34254|1@1+ (1,0) [0|1] "bool" MCU
 SG_ OBJ_Angle_Left_36 : 34255|14@1+ (0.0002,-1.571) [-1.571|1.571] "rad" MCU
 SG_ OBJ_Angle_Left_V_36 : 34269|1@1+ (1,0) [0|1] "bool" MCU
 SG_ Reserved_17_36 : 34270|2@1+ (1,0) [0|0] "NA" MCU
 SG_ OBJ_Angle_Left_STD_36 : 34272|14@1+ (0.0001,0) [0|1.571] "rad" MCU
 SG_ OBJ_Angle_Left_STD_V_36 : 34286|1@1+ (1,0) [0|1] "bool" MCU
 SG_ OBJ_Angle_Side_36 : 34287|14@1+ (0.0002,-1.571) [-1.571|1.571] "rad" MCU
 SG_ OBJ_Angle_Side_V_36 : 34301|1@1+ (1,0) [0|1] "bool" MCU
 SG_ Reserved_18_36 : 34302|2@1+ (1,0) [0|0] "NA" MCU
 SG_ OBJ_Angle_Side_STD_36 : 34304|14@1+ (0.0001,0) [0|1.571] "rad" MCU
 SG_ OBJ_Angle_Side_STD_V_36 : 34318|1@1+ (1,0) [0|1] "bool" MCU
 SG_ OBJ_Angle_Mid_V_36 : 34319|1@1+ (1,0) [0|1] "bool" MCU
 SG_ OBJ_Angle_Mid_36 : 34320|14@1+ (0.0002,-1.571) [-1.571|1.571] "rad" MCU
 SG_ Reserved_19_36 : 34334|2@1+ (1,0) [0|0] "NA" MCU
 SG_ OBJ_Angle_Mid_STD_36 : 34336|14@1+ (0.0001,0) [0|1.571] "rad" MCU
 SG_ OBJ_Angle_Mid_STD_V_36 : 34350|1@1+ (1,0) [0|1] "bool" MCU
 SG_ OBJ_Angle_Bottom_V_36 : 34351|1@1+ (1,0) [0|1] "bool" MCU
 SG_ OBJ_Angle_Bottom_36 : 34352|14@1+ (0.0002,-1.571) [-1.571|1.571] "rad" MCU
 SG_ Reserved_20_36 : 34366|2@1+ (1,0) [0|0] "NA" MCU
 SG_ OBJ_Angle_Bottom_STD_36 : 34368|14@1+ (0.0001,0) [0|1.571] "rad" MCU
 SG_ OBJ_Angle_Bottom_STD_V_36 : 34382|1@1+ (1,0) [0|1] "bool" MCU
 SG_ OBJ_Visibility_Side_V_36 : 34383|1@1+ (1,0) [0|1] "bool" MCU
 SG_ OBJ_Visibility_Side_36 : 34384|2@1+ (1,0) [0|2] "ENUM" MCU
 SG_ OBJ_Is_In_Drivable_Area_36 : 34386|1@1+ (1,0) [0|1] "bool" MCU
 SG_ OBJ_Is_In_Drivable_Area_V_36 : 34387|1@1+ (1,0) [0|1] "bool" MCU
 SG_ OBJ_Is_VeryClose_V_36 : 34388|1@1+ (1,0) [0|1] "bool" MCU
 SG_ OBJ_Is_VeryClose_36 : 34389|1@1+ (1,0) [0|1] "bool" MCU
 SG_ OBJ_Buffer_C4_36 : 34390|2@1+ (1,0) [0|2] "NA" MCU
 SG_ OBJ_Buffer_C5_36 : 34392|2@1+ (1,0) [0|2] "NA" MCU
 SG_ OBJ_Buffer_C6_36 : 34394|2@1+ (1,0) [0|2] "NA" MCU
 SG_ OBJ_Buffer_C7_36 : 34396|2@1+ (1,0) [0|2] "NA" MCU
 SG_ Reserved_21_36 : 34398|2@1+ (1,0) [0|0] "NA" MCU
 SG_ OBJ_OverlapAngleEgoLaneR_36 : 34400|10@1+ (0.01,-3.14) [-3.14|3.14] "rad" MCU
 SG_ OBJ_OverlapAngleEgoLaneR_V_36 : 34410|1@1+ (1,0) [0|1] "bool" MCU
 SG_ OBJ_OverlapAngleEgoLaneL_36 : 34411|10@1+ (0.01,-3.14) [-3.14|3.14] "rad" MCU
 SG_ OBJ_OverlapAngleEgoLaneL_V_36 : 34421|1@1+ (1,0) [0|1] "bool" MCU
 SG_ OBJ_Is_EMERGENCY_VCL_36 : 34422|1@1+ (1,0) [0|1] "bool" MCU
 SG_ OBJ_EMERGENCY_LIGHT_COLOR_36 : 34423|4@1+ (1,0) [0|15] "BITWIZE" MCU
 SG_ OBJ_EMERGENCY_V_36 : 34427|1@1+ (1,0) [0|1] "bool" MCU
 SG_ Reserved_22_36 : 34428|4@1+ (1,0) [0|0] "NA" MCU
 SG_ OBJ_Angle_Top_36 : 34432|14@1+ (0.0002,0) [0|3.1415] "rad" MCU
 SG_ OBJ_Angle_Top_V_36 : 34446|1@1+ (1,0) [0|1] "bool" MCU
 SG_ OBJ_Angle_Top_STD_36 : 34447|15@1+ (0.0001,0) [0|3.1415] "rad" MCU
 SG_ OBJ_Angle_Top_STD_V_36 : 34462|1@1+ (1,0) [0|1] "bool" MCU
 SG_ OBJ_Buffer_C14_36 : 34463|1@1+ (1,0) [0|1] "NA" MCU
 SG_ OBJ_Buffer_C15_36 : 34464|1@1+ (1,0) [0|1] "NA" MCU
 SG_ OBJ_Buffer_C18_36 : 34465|2@1+ (1,0) [0|2] "NA" MCU
 SG_ OBJ_Buffer_C19_36 : 34467|1@1+ (1,0) [0|1] "NA" MCU
 SG_ Reserved_23_36 : 34468|28@1+ (1,0) [0|0] "NA" MCU
 SG_ OBJ_CRC_37 : 34496|32@1+ (1,0) [0|4294967295] "NA" MCU
 SG_ OBJ_ID_37 : 34528|8@1+ (1,0) [0|255] "counter" MCU
 SG_ OBJ_Existence_Probability_37 : 34536|8@1+ (0.01,0) [0|1] "NA" MCU
 SG_ OBJ_Fusion_Source_37 : 34544|16@1+ (1,0) [0|65535] "BITWIZE" MCU
 SG_ OBJ_Triggered_SDM_37 : 34560|2@1+ (1,0) [0|2] "ENUM" MCU
 SG_ OBJ_Motion_Category_37 : 34562|4@1+ (1,0) [0|13] "ENUM" MCU
 SG_ OBJ_Buffer_C0_37 : 34566|7@1+ (0.01,0) [0|1] "NA" MCU
 SG_ OBJ_Object_Age_37 : 34573|11@1+ (1,0) [0|2047] "frames" MCU
 SG_ OBJ_Measuring_Status_37 : 34584|3@1+ (1,0) [0|7] "BITWIZE" MCU
 SG_ OBJ_Object_Class_37 : 34587|4@1+ (1,0) [0|8] "ENUM" MCU
 SG_ Reserved_4_37 : 34591|1@1+ (1,0) [0|0] "NA" MCU
 SG_ OBJ_Class_Probability_37 : 34592|7@1+ (0.01,0) [0|1] "NA" MCU
 SG_ OBJ_Car_Probability_37 : 34599|7@1+ (0.01,0) [0|1] "NA" MCU
 SG_ OBJ_Truck_Probability_37 : 34606|7@1+ (0.01,0) [0|1] "NA" MCU
 SG_ OBJ_Bike_Probability_37 : 34613|7@1+ (0.01,0) [0|1] "NA" MCU
 SG_ OBJ_Camera_Source_37 : 34620|4@1+ (1,0) [0|15] "ENUM" MCU
 SG_ OBJ_Motion_Status_37 : 34624|3@1+ (1,0) [0|5] "ENUM" MCU
 SG_ OBJ_Motion_Orientation_37 : 34627|4@1+ (1,0) [0|13] "ENUM" MCU
 SG_ OBJ_Has_Cut_Lane_37 : 34631|1@1+ (1,0) [0|1] "bool" MCU
 SG_ OBJ_Has_Cut_Path_37 : 34632|1@1+ (1,0) [0|1] "bool" MCU
 SG_ OBJ_Brake_Light_37 : 34633|1@1+ (1,0) [0|1] "bool" MCU
 SG_ OBJ_Turn_Indicator_Right_37 : 34634|1@1+ (1,0) [0|1] "bool" MCU
 SG_ OBJ_Turn_Indicator_Left_37 : 34635|1@1+ (1,0) [0|1] "bool" MCU
 SG_ OBJ_Light_Indicator_Validity_37 : 34636|1@1+ (1,0) [0|1] "bool" MCU
 SG_ OBJ_Right_Out_Of_Image_37 : 34637|1@1+ (1,0) [0|1] "bool" MCU
 SG_ OBJ_Left_Out_Of_Image_37 : 34638|1@1+ (1,0) [0|1] "bool" MCU
 SG_ OBJ_Right_Out_Of_Image_V_37 : 34639|1@1+ (1,0) [0|1] "bool" MCU
 SG_ OBJ_Left_Out_Of_Image_V_37 : 34640|1@1+ (1,0) [0|1] "bool" MCU
 SG_ OBJ_Top_Out_Of_Image_37 : 34641|1@1+ (1,0) [0|1] "bool" MCU
 SG_ OBJ_Bottom_Out_Of_Image_37 : 34642|1@1+ (1,0) [0|1] "bool" MCU
 SG_ OBJ_Top_Out_Of_Image_V_37 : 34643|1@1+ (1,0) [0|1] "bool" MCU
 SG_ OBJ_Bottom_Out_Of_Image_V_37 : 34644|1@1+ (1,0) [0|1] "bool" MCU
 SG_ OBJ_Lane_Assignment_37 : 34645|3@1+ (1,0) [0|5] "ENUM" MCU
 SG_ OBJ_Lane_Assignment_V_37 : 34648|1@1+ (1,0) [0|1] "bool" MCU
 SG_ OBJ_Age_Seconds_37 : 34649|7@1+ (1,0) [0|100] "s" MCU
 SG_ OBJ_Age_Seconds_V_37 : 34656|1@1+ (1,0) [0|1] "bool" MCU
 SG_ OBJ_Width_37 : 34657|9@1+ (0.01,0) [0.4|2.95] "m" MCU
 SG_ OBJ_Width_V_37 : 34666|1@1+ (1,0) [0|1] "bool" MCU
 SG_ OBJ_Width_STD_37 : 34667|11@1+ (0.001,0) [0|2] "m" MCU
 SG_ OBJ_Width_STD_V_37 : 34678|1@1+ (1,0) [0|1] "bool" MCU
 SG_ OBJ_Length_37 : 34679|9@1+ (0.05,0) [1.2|21] "m" MCU
 SG_ OBJ_Length_V_37 : 34688|1@1+ (1,0) [0|1] "bool" MCU
 SG_ OBJ_Length_STD_37 : 34689|10@1+ (0.01,0) [0|10] "m" MCU
 SG_ OBJ_Length_STD_V_37 : 34699|1@1+ (1,0) [0|1] "bool" MCU
 SG_ OBJ_Radar_ID_37 : 34700|8@1+ (1,0) [0|255] "counter" MCU
 SG_ OBJ_Height_37 : 34708|9@1+ (0.01,0) [0|2.95] "m" MCU
 SG_ OBJ_Height_V_37 : 34717|1@1+ (1,0) [0|1] "bool" MCU
 SG_ Reserved_5_37 : 34718|2@1+ (1,0) [0|0] "NA" MCU
 SG_ OBJ_Height_STD_37 : 34720|11@1+ (0.001,0) [0|2] "m" MCU
 SG_ OBJ_Height_STD_V_37 : 34731|1@1+ (1,0) [0|1] "bool" MCU
 SG_ OBJ_Abs_Long_Velocity_37 : 34732|12@1+ (0.05,-100) [-100|100] "m_per_s" MCU
 SG_ OBJ_Abs_Long_Velocity_V_37 : 34744|1@1+ (1,0) [0|1] "bool" MCU
 SG_ Reserved_6_37 : 34745|7@1+ (1,0) [0|0] "NA" MCU
 SG_ OBJ_Abs_Long_Velocity_STD_37 : 34752|13@1+ (0.01,0) [0|65] "m_per_s" MCU
 SG_ OBJ_Abs_Long_Vel_STD_V_37 : 34765|1@1+ (1,0) [0|1] "bool" MCU
 SG_ OBJ_Abs_Lat_Velocity_37 : 34766|11@1+ (0.05,-50) [-50|50] "m_per_s" MCU
 SG_ OBJ_Abs_Lat_Velocity_V_37 : 34777|1@1+ (1,0) [0|1] "bool" MCU
 SG_ Reserved_7_37 : 34778|6@1+ (1,0) [0|0] "NA" MCU
 SG_ OBJ_Abs_Lat_Velocity_STD_37 : 34784|13@1+ (0.01,0) [0|50] "m_per_s" MCU
 SG_ OBJ_Abs_Lat_Vel_STD_V_37 : 34797|1@1+ (1,0) [0|1] "bool" MCU
 SG_ OBJ_Abs_Long_Acc_37 : 34798|9@1+ (0.05,-10) [-10|10] "m_per_s2" MCU
 SG_ OBJ_Abs_Long_Acc_V_37 : 34807|1@1+ (1,0) [0|1] "bool" MCU
 SG_ Reserved_8_37 : 34808|8@1+ (1,0) [0|0] "NA" MCU
 SG_ OBJ_Abs_Long_Acc_STD_37 : 34816|10@1+ (0.01,0) [0|7.3] "m_per_s2" MCU
 SG_ OBJ_Abs_Long_Acc_STD_V_37 : 34826|1@1+ (1,0) [0|1] "bool" MCU
 SG_ OBJ_Abs_Lat_Acc_37 : 34827|9@1+ (0.05,-10) [-10|10] "m_per_s2" MCU
 SG_ OBJ_Abs_Lat_Acc_V_37 : 34836|1@1+ (1,0) [0|1] "bool" MCU
 SG_ OBJ_Abs_Lat_Acc_STD_37 : 34837|10@1+ (0.01,0) [0|7.3] "m_per_s2" MCU
 SG_ OBJ_Abs_Lat_Acc_STD_V_37 : 34847|1@1+ (1,0) [0|1] "bool" MCU
 SG_ OBJ_Abs_Acceleration_37 : 34848|9@1+ (0.05,-12.7) [-12.7|12.7] "m_per_s2" MCU
 SG_ OBJ_Abs_Acceleration_V_37 : 34857|1@1+ (1,0) [0|1] "bool" MCU
 SG_ OBJ_Abs_Acc_STD_37 : 34858|10@1+ (0.01,0) [0|7.3] "m_per_s2" MCU
 SG_ OBJ_Abs_Acc_STD_V_37 : 34868|1@1+ (1,0) [0|1] "bool" MCU
 SG_ OBJ_Inv_TTC_37 : 34869|11@1+ (0.01,-8) [-8|8] "INV(s)" MCU
 SG_ OBJ_Inv_TTC_V_37 : 34880|1@1+ (1,0) [0|1] "bool" MCU
 SG_ OBJ_Inv_TTC_STD_37 : 34881|12@1+ (0.001,0) [0|4] "INV(s)" MCU
 SG_ OBJ_Inv_TTC_STD_V_37 : 34893|1@1+ (1,0) [0|1] "bool" MCU
 SG_ OBJ_Relative_Long_Acc_37 : 34894|10@1+ (0.05,-20) [-20|20] "m_per_s2" MCU
 SG_ OBJ_Relative_Long_Acc_V_37 : 34904|1@1+ (1,0) [0|1] "bool" MCU
 SG_ Reserved_9_37 : 34905|7@1+ (1,0) [0|0] "NA" MCU
 SG_ OBJ_Relative_Long_Acc_STD_37 : 34912|10@1+ (0.01,0) [0|7.3] "m_per_s2" MCU
 SG_ OBJ_Rel_Long_Acc_STD_V_37 : 34922|1@1+ (1,0) [0|1] "bool" MCU
 SG_ OBJ_Relative_Long_Velocity_37 : 34923|13@1+ (0.05,-120) [-120|130] "m_per_s" MCU
 SG_ OBJ_Relative_Long_Velocity_V_37 : 34936|1@1+ (1,0) [0|1] "bool" MCU
 SG_ Reserved_10_37 : 34937|7@1+ (1,0) [0|0] "NA" MCU
 SG_ OBJ_Relative_Long_Vel_STD_37 : 34944|14@1+ (0.01,0) [0|130] "m_per_s" MCU
 SG_ OBJ_Rel_Long_Vel_STD_V_37 : 34958|1@1+ (1,0) [0|1] "bool" MCU
 SG_ OBJ_Relative_Lat_Velocity_37 : 34959|11@1+ (0.05,-50) [-50|50] "m_per_s" MCU
 SG_ OBJ_Relative_Lat_Velocity_V_37 : 34970|1@1+ (1,0) [0|1] "bool" MCU
 SG_ Reserved_11_37 : 34971|5@1+ (1,0) [0|0] "NA" MCU
 SG_ OBJ_Relative_Lat_Velocity_STD_37 : 34976|13@1+ (0.01,0) [0|50] "m_per_s" MCU
 SG_ OBJ_Rel_Lat_Vel_STD_V_37 : 34989|1@1+ (1,0) [0|1] "bool" MCU
 SG_ OBJ_Long_Distance_37 : 34990|14@1+ (0.05,-200) [-200|500] "m" MCU
 SG_ OBJ_Long_Distance_V_37 : 35004|1@1+ (1,0) [0|1] "bool" MCU
 SG_ Reserved_12_37 : 35005|3@1+ (1,0) [0|0] "NA" MCU
 SG_ OBJ_Long_Distance_STD_37 : 35008|15@1+ (0.01,0) [0|250] "m" MCU
 SG_ OBJ_Long_Distance_STD_V_37 : 35023|1@1+ (1,0) [0|1] "bool" MCU
 SG_ OBJ_Lat_Distance_37 : 35024|12@1+ (0.05,-100) [-100|100] "m" MCU
 SG_ OBJ_Lat_Distance_V_37 : 35036|1@1+ (1,0) [0|1] "bool" MCU
 SG_ Reserved_13_37 : 35037|3@1+ (1,0) [0|0] "NA" MCU
 SG_ OBJ_Lat_Distance_STD_37 : 35040|14@1+ (0.01,0) [0|100] "m" MCU
 SG_ OBJ_Lat_Distance_STD_V_37 : 35054|1@1+ (1,0) [0|1] "bool" MCU
 SG_ OBJ_Absolute_Speed_37 : 35055|12@1+ (0.05,-65) [-65|65] "m_per_s" MCU
 SG_ OBJ_Absolute_Speed_V_37 : 35067|1@1+ (1,0) [0|1] "bool" MCU
 SG_ Reserved_14_37 : 35068|4@1+ (1,0) [0|0] "NA" MCU
 SG_ OBJ_Absolute_Speed_STD_37 : 35072|13@1+ (0.01,0) [0|65] "m_per_s" MCU
 SG_ OBJ_Absolute_Speed_STD_V_37 : 35085|1@1+ (1,0) [0|1] "bool" MCU
 SG_ OBJ_Heading_37 : 35086|10@1+ (0.01,-3.14) [-3.14|3.14] "rad" MCU
 SG_ OBJ_Heading_V_37 : 35096|1@1+ (1,0) [0|1] "bool" MCU
 SG_ Reserved_15_37 : 35097|7@1+ (1,0) [0|0] "NA" MCU
 SG_ OBJ_Heading_STD_37 : 35104|15@1+ (0.0001,0) [0|3.14] "rad" MCU
 SG_ OBJ_Heading_STD_V_37 : 35119|1@1+ (1,0) [0|1] "bool" MCU
 SG_ OBJ_Angle_Rate_STD_37 : 35120|15@1+ (0.0001,0) [0|2.2318] "RPS" MCU
 SG_ OBJ_Angle_Rate_STD_V_37 : 35135|1@1+ (1,0) [0|1] "bool" MCU
 SG_ OBJ_Angle_Rate_37 : 35136|12@1+ (0.002,-2.234) [-2.234|2.2318] "RPS" MCU
 SG_ OBJ_Angle_Rate_V_37 : 35148|1@1+ (1,0) [0|1] "bool" MCU
 SG_ OBJ_Angle_Right_37 : 35149|14@1+ (0.0002,-1.571) [-1.571|1.571] "rad" MCU
 SG_ OBJ_Angle_Right_V_37 : 35163|1@1+ (1,0) [0|1] "bool" MCU
 SG_ Reserved_16_37 : 35164|4@1+ (1,0) [0|0] "NA" MCU
 SG_ OBJ_Angle_Right_STD_37 : 35168|14@1+ (0.0001,0) [0|1.571] "rad" MCU
 SG_ OBJ_Angle_Right_STD_V_37 : 35182|1@1+ (1,0) [0|1] "bool" MCU
 SG_ OBJ_Angle_Left_37 : 35183|14@1+ (0.0002,-1.571) [-1.571|1.571] "rad" MCU
 SG_ OBJ_Angle_Left_V_37 : 35197|1@1+ (1,0) [0|1] "bool" MCU
 SG_ Reserved_17_37 : 35198|2@1+ (1,0) [0|0] "NA" MCU
 SG_ OBJ_Angle_Left_STD_37 : 35200|14@1+ (0.0001,0) [0|1.571] "rad" MCU
 SG_ OBJ_Angle_Left_STD_V_37 : 35214|1@1+ (1,0) [0|1] "bool" MCU
 SG_ OBJ_Angle_Side_37 : 35215|14@1+ (0.0002,-1.571) [-1.571|1.571] "rad" MCU
 SG_ OBJ_Angle_Side_V_37 : 35229|1@1+ (1,0) [0|1] "bool" MCU
 SG_ Reserved_18_37 : 35230|2@1+ (1,0) [0|0] "NA" MCU
 SG_ OBJ_Angle_Side_STD_37 : 35232|14@1+ (0.0001,0) [0|1.571] "rad" MCU
 SG_ OBJ_Angle_Side_STD_V_37 : 35246|1@1+ (1,0) [0|1] "bool" MCU
 SG_ OBJ_Angle_Mid_V_37 : 35247|1@1+ (1,0) [0|1] "bool" MCU
 SG_ OBJ_Angle_Mid_37 : 35248|14@1+ (0.0002,-1.571) [-1.571|1.571] "rad" MCU
 SG_ Reserved_19_37 : 35262|2@1+ (1,0) [0|0] "NA" MCU
 SG_ OBJ_Angle_Mid_STD_37 : 35264|14@1+ (0.0001,0) [0|1.571] "rad" MCU
 SG_ OBJ_Angle_Mid_STD_V_37 : 35278|1@1+ (1,0) [0|1] "bool" MCU
 SG_ OBJ_Angle_Bottom_V_37 : 35279|1@1+ (1,0) [0|1] "bool" MCU
 SG_ OBJ_Angle_Bottom_37 : 35280|14@1+ (0.0002,-1.571) [-1.571|1.571] "rad" MCU
 SG_ Reserved_20_37 : 35294|2@1+ (1,0) [0|0] "NA" MCU
 SG_ OBJ_Angle_Bottom_STD_37 : 35296|14@1+ (0.0001,0) [0|1.571] "rad" MCU
 SG_ OBJ_Angle_Bottom_STD_V_37 : 35310|1@1+ (1,0) [0|1] "bool" MCU
 SG_ OBJ_Visibility_Side_V_37 : 35311|1@1+ (1,0) [0|1] "bool" MCU
 SG_ OBJ_Visibility_Side_37 : 35312|2@1+ (1,0) [0|2] "ENUM" MCU
 SG_ OBJ_Is_In_Drivable_Area_37 : 35314|1@1+ (1,0) [0|1] "bool" MCU
 SG_ OBJ_Is_In_Drivable_Area_V_37 : 35315|1@1+ (1,0) [0|1] "bool" MCU
 SG_ OBJ_Is_VeryClose_V_37 : 35316|1@1+ (1,0) [0|1] "bool" MCU
 SG_ OBJ_Is_VeryClose_37 : 35317|1@1+ (1,0) [0|1] "bool" MCU
 SG_ OBJ_Buffer_C4_37 : 35318|2@1+ (1,0) [0|2] "NA" MCU
 SG_ OBJ_Buffer_C5_37 : 35320|2@1+ (1,0) [0|2] "NA" MCU
 SG_ OBJ_Buffer_C6_37 : 35322|2@1+ (1,0) [0|2] "NA" MCU
 SG_ OBJ_Buffer_C7_37 : 35324|2@1+ (1,0) [0|2] "NA" MCU
 SG_ Reserved_21_37 : 35326|2@1+ (1,0) [0|0] "NA" MCU
 SG_ OBJ_OverlapAngleEgoLaneR_37 : 35328|10@1+ (0.01,-3.14) [-3.14|3.14] "rad" MCU
 SG_ OBJ_OverlapAngleEgoLaneR_V_37 : 35338|1@1+ (1,0) [0|1] "bool" MCU
 SG_ OBJ_OverlapAngleEgoLaneL_37 : 35339|10@1+ (0.01,-3.14) [-3.14|3.14] "rad" MCU
 SG_ OBJ_OverlapAngleEgoLaneL_V_37 : 35349|1@1+ (1,0) [0|1] "bool" MCU
 SG_ OBJ_Is_EMERGENCY_VCL_37 : 35350|1@1+ (1,0) [0|1] "bool" MCU
 SG_ OBJ_EMERGENCY_LIGHT_COLOR_37 : 35351|4@1+ (1,0) [0|15] "BITWIZE" MCU
 SG_ OBJ_EMERGENCY_V_37 : 35355|1@1+ (1,0) [0|1] "bool" MCU
 SG_ Reserved_22_37 : 35356|4@1+ (1,0) [0|0] "NA" MCU
 SG_ OBJ_Angle_Top_37 : 35360|14@1+ (0.0002,0) [0|3.1415] "rad" MCU
 SG_ OBJ_Angle_Top_V_37 : 35374|1@1+ (1,0) [0|1] "bool" MCU
 SG_ OBJ_Angle_Top_STD_37 : 35375|15@1+ (0.0001,0) [0|3.1415] "rad" MCU
 SG_ OBJ_Angle_Top_STD_V_37 : 35390|1@1+ (1,0) [0|1] "bool" MCU
 SG_ OBJ_Buffer_C14_37 : 35391|1@1+ (1,0) [0|1] "NA" MCU
 SG_ OBJ_Buffer_C15_37 : 35392|1@1+ (1,0) [0|1] "NA" MCU
 SG_ OBJ_Buffer_C18_37 : 35393|2@1+ (1,0) [0|2] "NA" MCU
 SG_ OBJ_Buffer_C19_37 : 35395|1@1+ (1,0) [0|1] "NA" MCU
 SG_ Reserved_23_37 : 35396|28@1+ (1,0) [0|0] "NA" MCU
 SG_ OBJ_CRC_38 : 35424|32@1+ (1,0) [0|4294967295] "NA" MCU
 SG_ OBJ_ID_38 : 35456|8@1+ (1,0) [0|255] "counter" MCU
 SG_ OBJ_Existence_Probability_38 : 35464|8@1+ (0.01,0) [0|1] "NA" MCU
 SG_ OBJ_Fusion_Source_38 : 35472|16@1+ (1,0) [0|65535] "BITWIZE" MCU
 SG_ OBJ_Triggered_SDM_38 : 35488|2@1+ (1,0) [0|2] "ENUM" MCU
 SG_ OBJ_Motion_Category_38 : 35490|4@1+ (1,0) [0|13] "ENUM" MCU
 SG_ OBJ_Buffer_C0_38 : 35494|7@1+ (0.01,0) [0|1] "NA" MCU
 SG_ OBJ_Object_Age_38 : 35501|11@1+ (1,0) [0|2047] "frames" MCU
 SG_ OBJ_Measuring_Status_38 : 35512|3@1+ (1,0) [0|7] "BITWIZE" MCU
 SG_ OBJ_Object_Class_38 : 35515|4@1+ (1,0) [0|8] "ENUM" MCU
 SG_ Reserved_4_38 : 35519|1@1+ (1,0) [0|0] "NA" MCU
 SG_ OBJ_Class_Probability_38 : 35520|7@1+ (0.01,0) [0|1] "NA" MCU
 SG_ OBJ_Car_Probability_38 : 35527|7@1+ (0.01,0) [0|1] "NA" MCU
 SG_ OBJ_Truck_Probability_38 : 35534|7@1+ (0.01,0) [0|1] "NA" MCU
 SG_ OBJ_Bike_Probability_38 : 35541|7@1+ (0.01,0) [0|1] "NA" MCU
 SG_ OBJ_Camera_Source_38 : 35548|4@1+ (1,0) [0|15] "ENUM" MCU
 SG_ OBJ_Motion_Status_38 : 35552|3@1+ (1,0) [0|5] "ENUM" MCU
 SG_ OBJ_Motion_Orientation_38 : 35555|4@1+ (1,0) [0|13] "ENUM" MCU
 SG_ OBJ_Has_Cut_Lane_38 : 35559|1@1+ (1,0) [0|1] "bool" MCU
 SG_ OBJ_Has_Cut_Path_38 : 35560|1@1+ (1,0) [0|1] "bool" MCU
 SG_ OBJ_Brake_Light_38 : 35561|1@1+ (1,0) [0|1] "bool" MCU
 SG_ OBJ_Turn_Indicator_Right_38 : 35562|1@1+ (1,0) [0|1] "bool" MCU
 SG_ OBJ_Turn_Indicator_Left_38 : 35563|1@1+ (1,0) [0|1] "bool" MCU
 SG_ OBJ_Light_Indicator_Validity_38 : 35564|1@1+ (1,0) [0|1] "bool" MCU
 SG_ OBJ_Right_Out_Of_Image_38 : 35565|1@1+ (1,0) [0|1] "bool" MCU
 SG_ OBJ_Left_Out_Of_Image_38 : 35566|1@1+ (1,0) [0|1] "bool" MCU
 SG_ OBJ_Right_Out_Of_Image_V_38 : 35567|1@1+ (1,0) [0|1] "bool" MCU
 SG_ OBJ_Left_Out_Of_Image_V_38 : 35568|1@1+ (1,0) [0|1] "bool" MCU
 SG_ OBJ_Top_Out_Of_Image_38 : 35569|1@1+ (1,0) [0|1] "bool" MCU
 SG_ OBJ_Bottom_Out_Of_Image_38 : 35570|1@1+ (1,0) [0|1] "bool" MCU
 SG_ OBJ_Top_Out_Of_Image_V_38 : 35571|1@1+ (1,0) [0|1] "bool" MCU
 SG_ OBJ_Bottom_Out_Of_Image_V_38 : 35572|1@1+ (1,0) [0|1] "bool" MCU
 SG_ OBJ_Lane_Assignment_38 : 35573|3@1+ (1,0) [0|5] "ENUM" MCU
 SG_ OBJ_Lane_Assignment_V_38 : 35576|1@1+ (1,0) [0|1] "bool" MCU
 SG_ OBJ_Age_Seconds_38 : 35577|7@1+ (1,0) [0|100] "s" MCU
 SG_ OBJ_Age_Seconds_V_38 : 35584|1@1+ (1,0) [0|1] "bool" MCU
 SG_ OBJ_Width_38 : 35585|9@1+ (0.01,0) [0.4|2.95] "m" MCU
 SG_ OBJ_Width_V_38 : 35594|1@1+ (1,0) [0|1] "bool" MCU
 SG_ OBJ_Width_STD_38 : 35595|11@1+ (0.001,0) [0|2] "m" MCU
 SG_ OBJ_Width_STD_V_38 : 35606|1@1+ (1,0) [0|1] "bool" MCU
 SG_ OBJ_Length_38 : 35607|9@1+ (0.05,0) [1.2|21] "m" MCU
 SG_ OBJ_Length_V_38 : 35616|1@1+ (1,0) [0|1] "bool" MCU
 SG_ OBJ_Length_STD_38 : 35617|10@1+ (0.01,0) [0|10] "m" MCU
 SG_ OBJ_Length_STD_V_38 : 35627|1@1+ (1,0) [0|1] "bool" MCU
 SG_ OBJ_Radar_ID_38 : 35628|8@1+ (1,0) [0|255] "counter" MCU
 SG_ OBJ_Height_38 : 35636|9@1+ (0.01,0) [0|2.95] "m" MCU
 SG_ OBJ_Height_V_38 : 35645|1@1+ (1,0) [0|1] "bool" MCU
 SG_ Reserved_5_38 : 35646|2@1+ (1,0) [0|0] "NA" MCU
 SG_ OBJ_Height_STD_38 : 35648|11@1+ (0.001,0) [0|2] "m" MCU
 SG_ OBJ_Height_STD_V_38 : 35659|1@1+ (1,0) [0|1] "bool" MCU
 SG_ OBJ_Abs_Long_Velocity_38 : 35660|12@1+ (0.05,-100) [-100|100] "m_per_s" MCU
 SG_ OBJ_Abs_Long_Velocity_V_38 : 35672|1@1+ (1,0) [0|1] "bool" MCU
 SG_ Reserved_6_38 : 35673|7@1+ (1,0) [0|0] "NA" MCU
 SG_ OBJ_Abs_Long_Velocity_STD_38 : 35680|13@1+ (0.01,0) [0|65] "m_per_s" MCU
 SG_ OBJ_Abs_Long_Vel_STD_V_38 : 35693|1@1+ (1,0) [0|1] "bool" MCU
 SG_ OBJ_Abs_Lat_Velocity_38 : 35694|11@1+ (0.05,-50) [-50|50] "m_per_s" MCU
 SG_ OBJ_Abs_Lat_Velocity_V_38 : 35705|1@1+ (1,0) [0|1] "bool" MCU
 SG_ Reserved_7_38 : 35706|6@1+ (1,0) [0|0] "NA" MCU
 SG_ OBJ_Abs_Lat_Velocity_STD_38 : 35712|13@1+ (0.01,0) [0|50] "m_per_s" MCU
 SG_ OBJ_Abs_Lat_Vel_STD_V_38 : 35725|1@1+ (1,0) [0|1] "bool" MCU
 SG_ OBJ_Abs_Long_Acc_38 : 35726|9@1+ (0.05,-10) [-10|10] "m_per_s2" MCU
 SG_ OBJ_Abs_Long_Acc_V_38 : 35735|1@1+ (1,0) [0|1] "bool" MCU
 SG_ Reserved_8_38 : 35736|8@1+ (1,0) [0|0] "NA" MCU
 SG_ OBJ_Abs_Long_Acc_STD_38 : 35744|10@1+ (0.01,0) [0|7.3] "m_per_s2" MCU
 SG_ OBJ_Abs_Long_Acc_STD_V_38 : 35754|1@1+ (1,0) [0|1] "bool" MCU
 SG_ OBJ_Abs_Lat_Acc_38 : 35755|9@1+ (0.05,-10) [-10|10] "m_per_s2" MCU
 SG_ OBJ_Abs_Lat_Acc_V_38 : 35764|1@1+ (1,0) [0|1] "bool" MCU
 SG_ OBJ_Abs_Lat_Acc_STD_38 : 35765|10@1+ (0.01,0) [0|7.3] "m_per_s2" MCU
 SG_ OBJ_Abs_Lat_Acc_STD_V_38 : 35775|1@1+ (1,0) [0|1] "bool" MCU
 SG_ OBJ_Abs_Acceleration_38 : 35776|9@1+ (0.05,-12.7) [-12.7|12.7] "m_per_s2" MCU
 SG_ OBJ_Abs_Acceleration_V_38 : 35785|1@1+ (1,0) [0|1] "bool" MCU
 SG_ OBJ_Abs_Acc_STD_38 : 35786|10@1+ (0.01,0) [0|7.3] "m_per_s2" MCU
 SG_ OBJ_Abs_Acc_STD_V_38 : 35796|1@1+ (1,0) [0|1] "bool" MCU
 SG_ OBJ_Inv_TTC_38 : 35797|11@1+ (0.01,-8) [-8|8] "INV(s)" MCU
 SG_ OBJ_Inv_TTC_V_38 : 35808|1@1+ (1,0) [0|1] "bool" MCU
 SG_ OBJ_Inv_TTC_STD_38 : 35809|12@1+ (0.001,0) [0|4] "INV(s)" MCU
 SG_ OBJ_Inv_TTC_STD_V_38 : 35821|1@1+ (1,0) [0|1] "bool" MCU
 SG_ OBJ_Relative_Long_Acc_38 : 35822|10@1+ (0.05,-20) [-20|20] "m_per_s2" MCU
 SG_ OBJ_Relative_Long_Acc_V_38 : 35832|1@1+ (1,0) [0|1] "bool" MCU
 SG_ Reserved_9_38 : 35833|7@1+ (1,0) [0|0] "NA" MCU
 SG_ OBJ_Relative_Long_Acc_STD_38 : 35840|10@1+ (0.01,0) [0|7.3] "m_per_s2" MCU
 SG_ OBJ_Rel_Long_Acc_STD_V_38 : 35850|1@1+ (1,0) [0|1] "bool" MCU
 SG_ OBJ_Relative_Long_Velocity_38 : 35851|13@1+ (0.05,-120) [-120|130] "m_per_s" MCU
 SG_ OBJ_Relative_Long_Velocity_V_38 : 35864|1@1+ (1,0) [0|1] "bool" MCU
 SG_ Reserved_10_38 : 35865|7@1+ (1,0) [0|0] "NA" MCU
 SG_ OBJ_Relative_Long_Vel_STD_38 : 35872|14@1+ (0.01,0) [0|130] "m_per_s" MCU
 SG_ OBJ_Rel_Long_Vel_STD_V_38 : 35886|1@1+ (1,0) [0|1] "bool" MCU
 SG_ OBJ_Relative_Lat_Velocity_38 : 35887|11@1+ (0.05,-50) [-50|50] "m_per_s" MCU
 SG_ OBJ_Relative_Lat_Velocity_V_38 : 35898|1@1+ (1,0) [0|1] "bool" MCU
 SG_ Reserved_11_38 : 35899|5@1+ (1,0) [0|0] "NA" MCU
 SG_ OBJ_Relative_Lat_Velocity_STD_38 : 35904|13@1+ (0.01,0) [0|50] "m_per_s" MCU
 SG_ OBJ_Rel_Lat_Vel_STD_V_38 : 35917|1@1+ (1,0) [0|1] "bool" MCU
 SG_ OBJ_Long_Distance_38 : 35918|14@1+ (0.05,-200) [-200|500] "m" MCU
 SG_ OBJ_Long_Distance_V_38 : 35932|1@1+ (1,0) [0|1] "bool" MCU
 SG_ Reserved_12_38 : 35933|3@1+ (1,0) [0|0] "NA" MCU
 SG_ OBJ_Long_Distance_STD_38 : 35936|15@1+ (0.01,0) [0|250] "m" MCU
 SG_ OBJ_Long_Distance_STD_V_38 : 35951|1@1+ (1,0) [0|1] "bool" MCU
 SG_ OBJ_Lat_Distance_38 : 35952|12@1+ (0.05,-100) [-100|100] "m" MCU
 SG_ OBJ_Lat_Distance_V_38 : 35964|1@1+ (1,0) [0|1] "bool" MCU
 SG_ Reserved_13_38 : 35965|3@1+ (1,0) [0|0] "NA" MCU
 SG_ OBJ_Lat_Distance_STD_38 : 35968|14@1+ (0.01,0) [0|100] "m" MCU
 SG_ OBJ_Lat_Distance_STD_V_38 : 35982|1@1+ (1,0) [0|1] "bool" MCU
 SG_ OBJ_Absolute_Speed_38 : 35983|12@1+ (0.05,-65) [-65|65] "m_per_s" MCU
 SG_ OBJ_Absolute_Speed_V_38 : 35995|1@1+ (1,0) [0|1] "bool" MCU
 SG_ Reserved_14_38 : 35996|4@1+ (1,0) [0|0] "NA" MCU
 SG_ OBJ_Absolute_Speed_STD_38 : 36000|13@1+ (0.01,0) [0|65] "m_per_s" MCU
 SG_ OBJ_Absolute_Speed_STD_V_38 : 36013|1@1+ (1,0) [0|1] "bool" MCU
 SG_ OBJ_Heading_38 : 36014|10@1+ (0.01,-3.14) [-3.14|3.14] "rad" MCU
 SG_ OBJ_Heading_V_38 : 36024|1@1+ (1,0) [0|1] "bool" MCU
 SG_ Reserved_15_38 : 36025|7@1+ (1,0) [0|0] "NA" MCU
 SG_ OBJ_Heading_STD_38 : 36032|15@1+ (0.0001,0) [0|3.14] "rad" MCU
 SG_ OBJ_Heading_STD_V_38 : 36047|1@1+ (1,0) [0|1] "bool" MCU
 SG_ OBJ_Angle_Rate_STD_38 : 36048|15@1+ (0.0001,0) [0|2.2318] "RPS" MCU
 SG_ OBJ_Angle_Rate_STD_V_38 : 36063|1@1+ (1,0) [0|1] "bool" MCU
 SG_ OBJ_Angle_Rate_38 : 36064|12@1+ (0.002,-2.234) [-2.234|2.2318] "RPS" MCU
 SG_ OBJ_Angle_Rate_V_38 : 36076|1@1+ (1,0) [0|1] "bool" MCU
 SG_ OBJ_Angle_Right_38 : 36077|14@1+ (0.0002,-1.571) [-1.571|1.571] "rad" MCU
 SG_ OBJ_Angle_Right_V_38 : 36091|1@1+ (1,0) [0|1] "bool" MCU
 SG_ Reserved_16_38 : 36092|4@1+ (1,0) [0|0] "NA" MCU
 SG_ OBJ_Angle_Right_STD_38 : 36096|14@1+ (0.0001,0) [0|1.571] "rad" MCU
 SG_ OBJ_Angle_Right_STD_V_38 : 36110|1@1+ (1,0) [0|1] "bool" MCU
 SG_ OBJ_Angle_Left_38 : 36111|14@1+ (0.0002,-1.571) [-1.571|1.571] "rad" MCU
 SG_ OBJ_Angle_Left_V_38 : 36125|1@1+ (1,0) [0|1] "bool" MCU
 SG_ Reserved_17_38 : 36126|2@1+ (1,0) [0|0] "NA" MCU
 SG_ OBJ_Angle_Left_STD_38 : 36128|14@1+ (0.0001,0) [0|1.571] "rad" MCU
 SG_ OBJ_Angle_Left_STD_V_38 : 36142|1@1+ (1,0) [0|1] "bool" MCU
 SG_ OBJ_Angle_Side_38 : 36143|14@1+ (0.0002,-1.571) [-1.571|1.571] "rad" MCU
 SG_ OBJ_Angle_Side_V_38 : 36157|1@1+ (1,0) [0|1] "bool" MCU
 SG_ Reserved_18_38 : 36158|2@1+ (1,0) [0|0] "NA" MCU
 SG_ OBJ_Angle_Side_STD_38 : 36160|14@1+ (0.0001,0) [0|1.571] "rad" MCU
 SG_ OBJ_Angle_Side_STD_V_38 : 36174|1@1+ (1,0) [0|1] "bool" MCU
 SG_ OBJ_Angle_Mid_V_38 : 36175|1@1+ (1,0) [0|1] "bool" MCU
 SG_ OBJ_Angle_Mid_38 : 36176|14@1+ (0.0002,-1.571) [-1.571|1.571] "rad" MCU
 SG_ Reserved_19_38 : 36190|2@1+ (1,0) [0|0] "NA" MCU
 SG_ OBJ_Angle_Mid_STD_38 : 36192|14@1+ (0.0001,0) [0|1.571] "rad" MCU
 SG_ OBJ_Angle_Mid_STD_V_38 : 36206|1@1+ (1,0) [0|1] "bool" MCU
 SG_ OBJ_Angle_Bottom_V_38 : 36207|1@1+ (1,0) [0|1] "bool" MCU
 SG_ OBJ_Angle_Bottom_38 : 36208|14@1+ (0.0002,-1.571) [-1.571|1.571] "rad" MCU
 SG_ Reserved_20_38 : 36222|2@1+ (1,0) [0|0] "NA" MCU
 SG_ OBJ_Angle_Bottom_STD_38 : 36224|14@1+ (0.0001,0) [0|1.571] "rad" MCU
 SG_ OBJ_Angle_Bottom_STD_V_38 : 36238|1@1+ (1,0) [0|1] "bool" MCU
 SG_ OBJ_Visibility_Side_V_38 : 36239|1@1+ (1,0) [0|1] "bool" MCU
 SG_ OBJ_Visibility_Side_38 : 36240|2@1+ (1,0) [0|2] "ENUM" MCU
 SG_ OBJ_Is_In_Drivable_Area_38 : 36242|1@1+ (1,0) [0|1] "bool" MCU
 SG_ OBJ_Is_In_Drivable_Area_V_38 : 36243|1@1+ (1,0) [0|1] "bool" MCU
 SG_ OBJ_Is_VeryClose_V_38 : 36244|1@1+ (1,0) [0|1] "bool" MCU
 SG_ OBJ_Is_VeryClose_38 : 36245|1@1+ (1,0) [0|1] "bool" MCU
 SG_ OBJ_Buffer_C4_38 : 36246|2@1+ (1,0) [0|2] "NA" MCU
 SG_ OBJ_Buffer_C5_38 : 36248|2@1+ (1,0) [0|2] "NA" MCU
 SG_ OBJ_Buffer_C6_38 : 36250|2@1+ (1,0) [0|2] "NA" MCU
 SG_ OBJ_Buffer_C7_38 : 36252|2@1+ (1,0) [0|2] "NA" MCU
 SG_ Reserved_21_38 : 36254|2@1+ (1,0) [0|0] "NA" MCU
 SG_ OBJ_OverlapAngleEgoLaneR_38 : 36256|10@1+ (0.01,-3.14) [-3.14|3.14] "rad" MCU
 SG_ OBJ_OverlapAngleEgoLaneR_V_38 : 36266|1@1+ (1,0) [0|1] "bool" MCU
 SG_ OBJ_OverlapAngleEgoLaneL_38 : 36267|10@1+ (0.01,-3.14) [-3.14|3.14] "rad" MCU
 SG_ OBJ_OverlapAngleEgoLaneL_V_38 : 36277|1@1+ (1,0) [0|1] "bool" MCU
 SG_ OBJ_Is_EMERGENCY_VCL_38 : 36278|1@1+ (1,0) [0|1] "bool" MCU
 SG_ OBJ_EMERGENCY_LIGHT_COLOR_38 : 36279|4@1+ (1,0) [0|15] "BITWIZE" MCU
 SG_ OBJ_EMERGENCY_V_38 : 36283|1@1+ (1,0) [0|1] "bool" MCU
 SG_ Reserved_22_38 : 36284|4@1+ (1,0) [0|0] "NA" MCU
 SG_ OBJ_Angle_Top_38 : 36288|14@1+ (0.0002,0) [0|3.1415] "rad" MCU
 SG_ OBJ_Angle_Top_V_38 : 36302|1@1+ (1,0) [0|1] "bool" MCU
 SG_ OBJ_Angle_Top_STD_38 : 36303|15@1+ (0.0001,0) [0|3.1415] "rad" MCU
 SG_ OBJ_Angle_Top_STD_V_38 : 36318|1@1+ (1,0) [0|1] "bool" MCU
 SG_ OBJ_Buffer_C14_38 : 36319|1@1+ (1,0) [0|1] "NA" MCU
 SG_ OBJ_Buffer_C15_38 : 36320|1@1+ (1,0) [0|1] "NA" MCU
 SG_ OBJ_Buffer_C18_38 : 36321|2@1+ (1,0) [0|2] "NA" MCU
 SG_ OBJ_Buffer_C19_38 : 36323|1@1+ (1,0) [0|1] "NA" MCU
 SG_ Reserved_23_38 : 36324|28@1+ (1,0) [0|0] "NA" MCU
 SG_ OBJ_CRC_39 : 36352|32@1+ (1,0) [0|4294967295] "NA" MCU
 SG_ OBJ_ID_39 : 36384|8@1+ (1,0) [0|255] "counter" MCU
 SG_ OBJ_Existence_Probability_39 : 36392|8@1+ (0.01,0) [0|1] "NA" MCU
 SG_ OBJ_Fusion_Source_39 : 36400|16@1+ (1,0) [0|65535] "BITWIZE" MCU
 SG_ OBJ_Triggered_SDM_39 : 36416|2@1+ (1,0) [0|2] "ENUM" MCU
 SG_ OBJ_Motion_Category_39 : 36418|4@1+ (1,0) [0|13] "ENUM" MCU
 SG_ OBJ_Buffer_C0_39 : 36422|7@1+ (0.01,0) [0|1] "NA" MCU
 SG_ OBJ_Object_Age_39 : 36429|11@1+ (1,0) [0|2047] "frames" MCU
 SG_ OBJ_Measuring_Status_39 : 36440|3@1+ (1,0) [0|7] "BITWIZE" MCU
 SG_ OBJ_Object_Class_39 : 36443|4@1+ (1,0) [0|8] "ENUM" MCU
 SG_ Reserved_4_39 : 36447|1@1+ (1,0) [0|0] "NA" MCU
 SG_ OBJ_Class_Probability_39 : 36448|7@1+ (0.01,0) [0|1] "NA" MCU
 SG_ OBJ_Car_Probability_39 : 36455|7@1+ (0.01,0) [0|1] "NA" MCU
 SG_ OBJ_Truck_Probability_39 : 36462|7@1+ (0.01,0) [0|1] "NA" MCU
 SG_ OBJ_Bike_Probability_39 : 36469|7@1+ (0.01,0) [0|1] "NA" MCU
 SG_ OBJ_Camera_Source_39 : 36476|4@1+ (1,0) [0|15] "ENUM" MCU
 SG_ OBJ_Motion_Status_39 : 36480|3@1+ (1,0) [0|5] "ENUM" MCU
 SG_ OBJ_Motion_Orientation_39 : 36483|4@1+ (1,0) [0|13] "ENUM" MCU
 SG_ OBJ_Has_Cut_Lane_39 : 36487|1@1+ (1,0) [0|1] "bool" MCU
 SG_ OBJ_Has_Cut_Path_39 : 36488|1@1+ (1,0) [0|1] "bool" MCU
 SG_ OBJ_Brake_Light_39 : 36489|1@1+ (1,0) [0|1] "bool" MCU
 SG_ OBJ_Turn_Indicator_Right_39 : 36490|1@1+ (1,0) [0|1] "bool" MCU
 SG_ OBJ_Turn_Indicator_Left_39 : 36491|1@1+ (1,0) [0|1] "bool" MCU
 SG_ OBJ_Light_Indicator_Validity_39 : 36492|1@1+ (1,0) [0|1] "bool" MCU
 SG_ OBJ_Right_Out_Of_Image_39 : 36493|1@1+ (1,0) [0|1] "bool" MCU
 SG_ OBJ_Left_Out_Of_Image_39 : 36494|1@1+ (1,0) [0|1] "bool" MCU
 SG_ OBJ_Right_Out_Of_Image_V_39 : 36495|1@1+ (1,0) [0|1] "bool" MCU
 SG_ OBJ_Left_Out_Of_Image_V_39 : 36496|1@1+ (1,0) [0|1] "bool" MCU
 SG_ OBJ_Top_Out_Of_Image_39 : 36497|1@1+ (1,0) [0|1] "bool" MCU
 SG_ OBJ_Bottom_Out_Of_Image_39 : 36498|1@1+ (1,0) [0|1] "bool" MCU
 SG_ OBJ_Top_Out_Of_Image_V_39 : 36499|1@1+ (1,0) [0|1] "bool" MCU
 SG_ OBJ_Bottom_Out_Of_Image_V_39 : 36500|1@1+ (1,0) [0|1] "bool" MCU
 SG_ OBJ_Lane_Assignment_39 : 36501|3@1+ (1,0) [0|5] "ENUM" MCU
 SG_ OBJ_Lane_Assignment_V_39 : 36504|1@1+ (1,0) [0|1] "bool" MCU
 SG_ OBJ_Age_Seconds_39 : 36505|7@1+ (1,0) [0|100] "s" MCU
 SG_ OBJ_Age_Seconds_V_39 : 36512|1@1+ (1,0) [0|1] "bool" MCU
 SG_ OBJ_Width_39 : 36513|9@1+ (0.01,0) [0.4|2.95] "m" MCU
 SG_ OBJ_Width_V_39 : 36522|1@1+ (1,0) [0|1] "bool" MCU
 SG_ OBJ_Width_STD_39 : 36523|11@1+ (0.001,0) [0|2] "m" MCU
 SG_ OBJ_Width_STD_V_39 : 36534|1@1+ (1,0) [0|1] "bool" MCU
 SG_ OBJ_Length_39 : 36535|9@1+ (0.05,0) [1.2|21] "m" MCU
 SG_ OBJ_Length_V_39 : 36544|1@1+ (1,0) [0|1] "bool" MCU
 SG_ OBJ_Length_STD_39 : 36545|10@1+ (0.01,0) [0|10] "m" MCU
 SG_ OBJ_Length_STD_V_39 : 36555|1@1+ (1,0) [0|1] "bool" MCU
 SG_ OBJ_Radar_ID_39 : 36556|8@1+ (1,0) [0|255] "counter" MCU
 SG_ OBJ_Height_39 : 36564|9@1+ (0.01,0) [0|2.95] "m" MCU
 SG_ OBJ_Height_V_39 : 36573|1@1+ (1,0) [0|1] "bool" MCU
 SG_ Reserved_5_39 : 36574|2@1+ (1,0) [0|0] "NA" MCU
 SG_ OBJ_Height_STD_39 : 36576|11@1+ (0.001,0) [0|2] "m" MCU
 SG_ OBJ_Height_STD_V_39 : 36587|1@1+ (1,0) [0|1] "bool" MCU
 SG_ OBJ_Abs_Long_Velocity_39 : 36588|12@1+ (0.05,-100) [-100|100] "m_per_s" MCU
 SG_ OBJ_Abs_Long_Velocity_V_39 : 36600|1@1+ (1,0) [0|1] "bool" MCU
 SG_ Reserved_6_39 : 36601|7@1+ (1,0) [0|0] "NA" MCU
 SG_ OBJ_Abs_Long_Velocity_STD_39 : 36608|13@1+ (0.01,0) [0|65] "m_per_s" MCU
 SG_ OBJ_Abs_Long_Vel_STD_V_39 : 36621|1@1+ (1,0) [0|1] "bool" MCU
 SG_ OBJ_Abs_Lat_Velocity_39 : 36622|11@1+ (0.05,-50) [-50|50] "m_per_s" MCU
 SG_ OBJ_Abs_Lat_Velocity_V_39 : 36633|1@1+ (1,0) [0|1] "bool" MCU
 SG_ Reserved_7_39 : 36634|6@1+ (1,0) [0|0] "NA" MCU
 SG_ OBJ_Abs_Lat_Velocity_STD_39 : 36640|13@1+ (0.01,0) [0|50] "m_per_s" MCU
 SG_ OBJ_Abs_Lat_Vel_STD_V_39 : 36653|1@1+ (1,0) [0|1] "bool" MCU
 SG_ OBJ_Abs_Long_Acc_39 : 36654|9@1+ (0.05,-10) [-10|10] "m_per_s2" MCU
 SG_ OBJ_Abs_Long_Acc_V_39 : 36663|1@1+ (1,0) [0|1] "bool" MCU
 SG_ Reserved_8_39 : 36664|8@1+ (1,0) [0|0] "NA" MCU
 SG_ OBJ_Abs_Long_Acc_STD_39 : 36672|10@1+ (0.01,0) [0|7.3] "m_per_s2" MCU
 SG_ OBJ_Abs_Long_Acc_STD_V_39 : 36682|1@1+ (1,0) [0|1] "bool" MCU
 SG_ OBJ_Abs_Lat_Acc_39 : 36683|9@1+ (0.05,-10) [-10|10] "m_per_s2" MCU
 SG_ OBJ_Abs_Lat_Acc_V_39 : 36692|1@1+ (1,0) [0|1] "bool" MCU
 SG_ OBJ_Abs_Lat_Acc_STD_39 : 36693|10@1+ (0.01,0) [0|7.3] "m_per_s2" MCU
 SG_ OBJ_Abs_Lat_Acc_STD_V_39 : 36703|1@1+ (1,0) [0|1] "bool" MCU
 SG_ OBJ_Abs_Acceleration_39 : 36704|9@1+ (0.05,-12.7) [-12.7|12.7] "m_per_s2" MCU
 SG_ OBJ_Abs_Acceleration_V_39 : 36713|1@1+ (1,0) [0|1] "bool" MCU
 SG_ OBJ_Abs_Acc_STD_39 : 36714|10@1+ (0.01,0) [0|7.3] "m_per_s2" MCU
 SG_ OBJ_Abs_Acc_STD_V_39 : 36724|1@1+ (1,0) [0|1] "bool" MCU
 SG_ OBJ_Inv_TTC_39 : 36725|11@1+ (0.01,-8) [-8|8] "INV(s)" MCU
 SG_ OBJ_Inv_TTC_V_39 : 36736|1@1+ (1,0) [0|1] "bool" MCU
 SG_ OBJ_Inv_TTC_STD_39 : 36737|12@1+ (0.001,0) [0|4] "INV(s)" MCU
 SG_ OBJ_Inv_TTC_STD_V_39 : 36749|1@1+ (1,0) [0|1] "bool" MCU
 SG_ OBJ_Relative_Long_Acc_39 : 36750|10@1+ (0.05,-20) [-20|20] "m_per_s2" MCU
 SG_ OBJ_Relative_Long_Acc_V_39 : 36760|1@1+ (1,0) [0|1] "bool" MCU
 SG_ Reserved_9_39 : 36761|7@1+ (1,0) [0|0] "NA" MCU
 SG_ OBJ_Relative_Long_Acc_STD_39 : 36768|10@1+ (0.01,0) [0|7.3] "m_per_s2" MCU
 SG_ OBJ_Rel_Long_Acc_STD_V_39 : 36778|1@1+ (1,0) [0|1] "bool" MCU
 SG_ OBJ_Relative_Long_Velocity_39 : 36779|13@1+ (0.05,-120) [-120|130] "m_per_s" MCU
 SG_ OBJ_Relative_Long_Velocity_V_39 : 36792|1@1+ (1,0) [0|1] "bool" MCU
 SG_ Reserved_10_39 : 36793|7@1+ (1,0) [0|0] "NA" MCU
 SG_ OBJ_Relative_Long_Vel_STD_39 : 36800|14@1+ (0.01,0) [0|130] "m_per_s" MCU
 SG_ OBJ_Rel_Long_Vel_STD_V_39 : 36814|1@1+ (1,0) [0|1] "bool" MCU
 SG_ OBJ_Relative_Lat_Velocity_39 : 36815|11@1+ (0.05,-50) [-50|50] "m_per_s" MCU
 SG_ OBJ_Relative_Lat_Velocity_V_39 : 36826|1@1+ (1,0) [0|1] "bool" MCU
 SG_ Reserved_11_39 : 36827|5@1+ (1,0) [0|0] "NA" MCU
 SG_ OBJ_Relative_Lat_Velocity_STD_39 : 36832|13@1+ (0.01,0) [0|50] "m_per_s" MCU
 SG_ OBJ_Rel_Lat_Vel_STD_V_39 : 36845|1@1+ (1,0) [0|1] "bool" MCU
 SG_ OBJ_Long_Distance_39 : 36846|14@1+ (0.05,-200) [-200|500] "m" MCU
 SG_ OBJ_Long_Distance_V_39 : 36860|1@1+ (1,0) [0|1] "bool" MCU
 SG_ Reserved_12_39 : 36861|3@1+ (1,0) [0|0] "NA" MCU
 SG_ OBJ_Long_Distance_STD_39 : 36864|15@1+ (0.01,0) [0|250] "m" MCU
 SG_ OBJ_Long_Distance_STD_V_39 : 36879|1@1+ (1,0) [0|1] "bool" MCU
 SG_ OBJ_Lat_Distance_39 : 36880|12@1+ (0.05,-100) [-100|100] "m" MCU
 SG_ OBJ_Lat_Distance_V_39 : 36892|1@1+ (1,0) [0|1] "bool" MCU
 SG_ Reserved_13_39 : 36893|3@1+ (1,0) [0|0] "NA" MCU
 SG_ OBJ_Lat_Distance_STD_39 : 36896|14@1+ (0.01,0) [0|100] "m" MCU
 SG_ OBJ_Lat_Distance_STD_V_39 : 36910|1@1+ (1,0) [0|1] "bool" MCU
 SG_ OBJ_Absolute_Speed_39 : 36911|12@1+ (0.05,-65) [-65|65] "m_per_s" MCU
 SG_ OBJ_Absolute_Speed_V_39 : 36923|1@1+ (1,0) [0|1] "bool" MCU
 SG_ Reserved_14_39 : 36924|4@1+ (1,0) [0|0] "NA" MCU
 SG_ OBJ_Absolute_Speed_STD_39 : 36928|13@1+ (0.01,0) [0|65] "m_per_s" MCU
 SG_ OBJ_Absolute_Speed_STD_V_39 : 36941|1@1+ (1,0) [0|1] "bool" MCU
 SG_ OBJ_Heading_39 : 36942|10@1+ (0.01,-3.14) [-3.14|3.14] "rad" MCU
 SG_ OBJ_Heading_V_39 : 36952|1@1+ (1,0) [0|1] "bool" MCU
 SG_ Reserved_15_39 : 36953|7@1+ (1,0) [0|0] "NA" MCU
 SG_ OBJ_Heading_STD_39 : 36960|15@1+ (0.0001,0) [0|3.14] "rad" MCU
 SG_ OBJ_Heading_STD_V_39 : 36975|1@1+ (1,0) [0|1] "bool" MCU
 SG_ OBJ_Angle_Rate_STD_39 : 36976|15@1+ (0.0001,0) [0|2.2318] "RPS" MCU
 SG_ OBJ_Angle_Rate_STD_V_39 : 36991|1@1+ (1,0) [0|1] "bool" MCU
 SG_ OBJ_Angle_Rate_39 : 36992|12@1+ (0.002,-2.234) [-2.234|2.2318] "RPS" MCU
 SG_ OBJ_Angle_Rate_V_39 : 37004|1@1+ (1,0) [0|1] "bool" MCU
 SG_ OBJ_Angle_Right_39 : 37005|14@1+ (0.0002,-1.571) [-1.571|1.571] "rad" MCU
 SG_ OBJ_Angle_Right_V_39 : 37019|1@1+ (1,0) [0|1] "bool" MCU
 SG_ Reserved_16_39 : 37020|4@1+ (1,0) [0|0] "NA" MCU
 SG_ OBJ_Angle_Right_STD_39 : 37024|14@1+ (0.0001,0) [0|1.571] "rad" MCU
 SG_ OBJ_Angle_Right_STD_V_39 : 37038|1@1+ (1,0) [0|1] "bool" MCU
 SG_ OBJ_Angle_Left_39 : 37039|14@1+ (0.0002,-1.571) [-1.571|1.571] "rad" MCU
 SG_ OBJ_Angle_Left_V_39 : 37053|1@1+ (1,0) [0|1] "bool" MCU
 SG_ Reserved_17_39 : 37054|2@1+ (1,0) [0|0] "NA" MCU
 SG_ OBJ_Angle_Left_STD_39 : 37056|14@1+ (0.0001,0) [0|1.571] "rad" MCU
 SG_ OBJ_Angle_Left_STD_V_39 : 37070|1@1+ (1,0) [0|1] "bool" MCU
 SG_ OBJ_Angle_Side_39 : 37071|14@1+ (0.0002,-1.571) [-1.571|1.571] "rad" MCU
 SG_ OBJ_Angle_Side_V_39 : 37085|1@1+ (1,0) [0|1] "bool" MCU
 SG_ Reserved_18_39 : 37086|2@1+ (1,0) [0|0] "NA" MCU
 SG_ OBJ_Angle_Side_STD_39 : 37088|14@1+ (0.0001,0) [0|1.571] "rad" MCU
 SG_ OBJ_Angle_Side_STD_V_39 : 37102|1@1+ (1,0) [0|1] "bool" MCU
 SG_ OBJ_Angle_Mid_V_39 : 37103|1@1+ (1,0) [0|1] "bool" MCU
 SG_ OBJ_Angle_Mid_39 : 37104|14@1+ (0.0002,-1.571) [-1.571|1.571] "rad" MCU
 SG_ Reserved_19_39 : 37118|2@1+ (1,0) [0|0] "NA" MCU
 SG_ OBJ_Angle_Mid_STD_39 : 37120|14@1+ (0.0001,0) [0|1.571] "rad" MCU
 SG_ OBJ_Angle_Mid_STD_V_39 : 37134|1@1+ (1,0) [0|1] "bool" MCU
 SG_ OBJ_Angle_Bottom_V_39 : 37135|1@1+ (1,0) [0|1] "bool" MCU
 SG_ OBJ_Angle_Bottom_39 : 37136|14@1+ (0.0002,-1.571) [-1.571|1.571] "rad" MCU
 SG_ Reserved_20_39 : 37150|2@1+ (1,0) [0|0] "NA" MCU
 SG_ OBJ_Angle_Bottom_STD_39 : 37152|14@1+ (0.0001,0) [0|1.571] "rad" MCU
 SG_ OBJ_Angle_Bottom_STD_V_39 : 37166|1@1+ (1,0) [0|1] "bool" MCU
 SG_ OBJ_Visibility_Side_V_39 : 37167|1@1+ (1,0) [0|1] "bool" MCU
 SG_ OBJ_Visibility_Side_39 : 37168|2@1+ (1,0) [0|2] "ENUM" MCU
 SG_ OBJ_Is_In_Drivable_Area_39 : 37170|1@1+ (1,0) [0|1] "bool" MCU
 SG_ OBJ_Is_In_Drivable_Area_V_39 : 37171|1@1+ (1,0) [0|1] "bool" MCU
 SG_ OBJ_Is_VeryClose_V_39 : 37172|1@1+ (1,0) [0|1] "bool" MCU
 SG_ OBJ_Is_VeryClose_39 : 37173|1@1+ (1,0) [0|1] "bool" MCU
 SG_ OBJ_Buffer_C4_39 : 37174|2@1+ (1,0) [0|2] "NA" MCU
 SG_ OBJ_Buffer_C5_39 : 37176|2@1+ (1,0) [0|2] "NA" MCU
 SG_ OBJ_Buffer_C6_39 : 37178|2@1+ (1,0) [0|2] "NA" MCU
 SG_ OBJ_Buffer_C7_39 : 37180|2@1+ (1,0) [0|2] "NA" MCU
 SG_ Reserved_21_39 : 37182|2@1+ (1,0) [0|0] "NA" MCU
 SG_ OBJ_OverlapAngleEgoLaneR_39 : 37184|10@1+ (0.01,-3.14) [-3.14|3.14] "rad" MCU
 SG_ OBJ_OverlapAngleEgoLaneR_V_39 : 37194|1@1+ (1,0) [0|1] "bool" MCU
 SG_ OBJ_OverlapAngleEgoLaneL_39 : 37195|10@1+ (0.01,-3.14) [-3.14|3.14] "rad" MCU
 SG_ OBJ_OverlapAngleEgoLaneL_V_39 : 37205|1@1+ (1,0) [0|1] "bool" MCU
 SG_ OBJ_Is_EMERGENCY_VCL_39 : 37206|1@1+ (1,0) [0|1] "bool" MCU
 SG_ OBJ_EMERGENCY_LIGHT_COLOR_39 : 37207|4@1+ (1,0) [0|15] "BITWIZE" MCU
 SG_ OBJ_EMERGENCY_V_39 : 37211|1@1+ (1,0) [0|1] "bool" MCU
 SG_ Reserved_22_39 : 37212|4@1+ (1,0) [0|0] "NA" MCU
 SG_ OBJ_Angle_Top_39 : 37216|14@1+ (0.0002,0) [0|3.1415] "rad" MCU
 SG_ OBJ_Angle_Top_V_39 : 37230|1@1+ (1,0) [0|1] "bool" MCU
 SG_ OBJ_Angle_Top_STD_39 : 37231|15@1+ (0.0001,0) [0|3.1415] "rad" MCU
 SG_ OBJ_Angle_Top_STD_V_39 : 37246|1@1+ (1,0) [0|1] "bool" MCU
 SG_ OBJ_Buffer_C14_39 : 37247|1@1+ (1,0) [0|1] "NA" MCU
 SG_ OBJ_Buffer_C15_39 : 37248|1@1+ (1,0) [0|1] "NA" MCU
 SG_ OBJ_Buffer_C18_39 : 37249|2@1+ (1,0) [0|2] "NA" MCU
 SG_ OBJ_Buffer_C19_39 : 37251|1@1+ (1,0) [0|1] "NA" MCU
 SG_ Reserved_23_39 : 37252|28@1+ (1,0) [0|0] "NA" MCU

CM_ SG_ 154 OBJ_Absolute_Speed_STD_34 "STD of the absolute ground speed.";
CM_ SG_ 154 OBJ_Absolute_Speed_STD_V_34 "Validator for the STD of the absolute ground speed.";
CM_ SG_ 154 OBJ_Heading_34 "The angle beetweenthe host longitudinal axis and target's heading (clockwise, e.g. PI/2 is a target crossing from left to right).";
CM_ SG_ 154 OBJ_Heading_V_34 "Validator for the object heading.";
CM_ SG_ 154 OBJ_Heading_STD_34 "STD of the object heading.";
CM_ SG_ 154 OBJ_Heading_STD_V_34 "Validator for the STD of the object heading.";
CM_ SG_ 154 OBJ_Angle_Rate_STD_34 "Standard deviation of the angular speed. (radians)";
CM_ SG_ 154 OBJ_Angle_Rate_STD_V_34 "Validator for the STD of the angular speed.";
CM_ SG_ 154 OBJ_Angle_Rate_34 "The momentary angular speed of the object. (radians)";
CM_ SG_ 154 OBJ_Angle_Rate_V_34 "Validator for the angular speed.";
CM_ SG_ 154 OBJ_Angle_Right_34 "The angle between the host longitudinal axis and the right side of the front / rear of the target (the visible one). The positive side is to the host's right.";
CM_ SG_ 154 OBJ_Angle_Right_V_34 "Validator for angleRight";
CM_ SG_ 154 OBJ_Angle_Right_STD_34 "Standard deviation of angleRight";
CM_ SG_ 154 OBJ_Angle_Right_STD_V_34 "Validator for the standard deviation of angleRight.";
CM_ SG_ 154 OBJ_Angle_Left_34 "The angle between the host longitudinal axis and the left side of the front / rear of the target (the visible one). The positive side is to the host's right.";
CM_ SG_ 154 OBJ_Angle_Left_V_34 "Validator for angleLeft.";
CM_ SG_ 154 OBJ_Angle_Left_STD_34 "Standard deviation of angleLeft.";
CM_ SG_ 154 OBJ_Angle_Left_STD_V_34 "Validator for the standard deviation of angleLeft.";
CM_ SG_ 154 OBJ_Angle_Side_34 "The angle between the host longitudinal axis and the far visible edge - the visible edge of the front / rear of the target that is not visible. Currently supported for vehicles only.";
CM_ SG_ 154 OBJ_Angle_Side_V_34 "Validator for angleSide.";
CM_ SG_ 154 OBJ_Angle_Side_STD_34 "Standard deviation of angleSide.";
CM_ SG_ 154 OBJ_Angle_Side_STD_V_34 "Validator for the STD of angleSide.";
CM_ SG_ 154 OBJ_Angle_Mid_V_34 "Validator for angleMid.";
CM_ SG_ 154 OBJ_Angle_Mid_34 "The angle between the host longitudinal axis and the middle of the front / rear of the target (the visible one). The positive side is to the host's right.";
CM_ SG_ 154 OBJ_Angle_Mid_STD_34 "Standard deviation of angleMid.";
CM_ SG_ 154 OBJ_Angle_Mid_STD_V_34 "Validator for the STD of angleMid.";
CM_ SG_ 154 OBJ_Angle_Bottom_V_34 "Validator for OBJAngle_Bottom. ";
CM_ SG_ 154 OBJ_Angle_Bottom_34 "The angle between the longitudinal axis and the Bottom of the front / rear of the target (the visible one). The positive side is to the host's bottom";
CM_ SG_ 154 OBJ_Angle_Bottom_STD_34 "STD for OBJAngle_Bottom. ";
CM_ SG_ 154 OBJ_Angle_Bottom_STD_V_34 "Validator for OBJAngle_Bottom_STD. ";
CM_ SG_ 154 OBJ_Visibility_Side_V_34 "Currently Supported for VD only";
CM_ SG_ 154 OBJ_Visibility_Side_34 "From what car  side is the object visible";
CM_ SG_ 154 OBJ_Is_In_Drivable_Area_34 "Indicates whether the target is in a driveable area.";
CM_ SG_ 154 OBJ_Is_In_Drivable_Area_V_34 "Validator for OBJ_Is_In_Drivable_Area.";
CM_ SG_ 154 OBJ_Is_VeryClose_V_34 "Validator for OBJ_Is_VeryClose. ";
CM_ SG_ 154 OBJ_Is_VeryClose_34 "Indicates whether the target is very close to the host such that it is hard to measure its distance. Currently relevant for peds only";
CM_ SG_ 154 OBJ_OverlapAngleEgoLaneR_34 "Lateral distance to the middle of the RL and RR corners.";
CM_ SG_ 154 OBJ_OverlapAngleEgoLaneR_V_34 "Validator for OBJ_OverlapAngleEgoLaneR";
CM_ SG_ 154 OBJ_OverlapAngleEgoLaneL_34 "Lateral distance to the middle of the RL and RR corners.  ";
CM_ SG_ 154 OBJ_OverlapAngleEgoLaneL_V_34 "Validator for OBJ_OverlapAngleEgoLaneL";
CM_ SG_ 154 OBJ_Is_EMERGENCY_VCL_34 "Is Object an Emergency Vehicle";
CM_ SG_ 154 OBJ_EMERGENCY_LIGHT_COLOR_34 "Emergency Color";
CM_ SG_ 154 OBJ_EMERGENCY_V_34 "Are OBJ_Is_EMERGENCY_VCL and OBJ_EMERGENCY_LIGHT_COLOR Valid";
CM_ SG_ 154 OBJ_Angle_Top_34 "From VD touching point on the ground till the roof of the car";
CM_ SG_ 154 OBJ_Angle_Top_V_34 "Validator for OBJ_Angle_Top ";
CM_ SG_ 154 OBJ_Angle_Top_STD_34 "STD for OBJ_Angle_Top";
CM_ SG_ 154 OBJ_Angle_Top_STD_V_34 "Validator for OBJ_Angle_Top_STD. ";
CM_ SG_ 154 OBJ_CRC_35 "Calculated over all element signals. From the signal after the CRC until the first signal in the next elements OBJ_CRC_N+1  not including";
CM_ SG_ 154 OBJ_ID_35 "The detected object ID. Range is 1-255, while 0 indicates that the field in unfilled.";
CM_ SG_ 154 OBJ_Existence_Probability_35 "The existence probability of the reported object";
CM_ SG_ 154 OBJ_Fusion_Source_35 "sources ids used for fusion";
CM_ SG_ 154 OBJ_Triggered_SDM_35 "Indicates whether the object has trigered the SDM (Safety Diagnostic Manager) alert.";
CM_ SG_ 154 OBJ_Motion_Category_35 "Relevant for VD only. Full description of values can be found at the ACC guide.";
CM_ SG_ 154 OBJ_Object_Age_35 "The number of frames in which the object was recognized.";
CM_ SG_ 154 OBJ_Measuring_Status_35 "Measurment status. Old vs New marks if this is the first frame in which the object is reported. Predicted vs Measured marks if the report is raw or has been predicted forward in time using the measured dynamics and ego motion.";
CM_ SG_ 154 OBJ_Object_Class_35 "Indicates the object type. Uncertain is outputted in case the probability that a vehicle is a truck is very similar to the probability that it is a car. ";
CM_ SG_ 154 OBJ_Class_Probability_35 "The probability of this type classification.";
CM_ SG_ 154 OBJ_Car_Probability_35 "The probability the object is a car";
CM_ SG_ 154 OBJ_Truck_Probability_35 "The probability the object is a Truck";
CM_ SG_ 154 OBJ_Bike_Probability_35 "The probability the object is a Bike";
CM_ SG_ 154 OBJ_Camera_Source_35 "The camera in which this object was detected (best choice).";
CM_ SG_ 154 OBJ_Motion_Status_35 "MOVING - the object is moving STATIONARY - the object was never seen moving STOPPED -  the object was moving and has stopped MOVING_SLOWLY - the object is moving very slowly";
CM_ SG_ 154 OBJ_Motion_Orientation_35 "The direction of the targets heading compared to the host. ";
CM_ SG_ 154 OBJ_Has_Cut_Lane_35 "Indicates whether the object cut the host's (right or left) lane. In case there are no lanes, indicates whether the objects is at most 1 meters away from the host.";
CM_ SG_ 154 OBJ_Has_Cut_Path_35 "Indicates whether the object is in the host's path.";
CM_ SG_ 154 OBJ_Brake_Light_35 "Indication for brake lights ";
CM_ SG_ 154 OBJ_Turn_Indicator_Right_35 "Indication for blinking right light.";
CM_ SG_ 154 OBJ_Turn_Indicator_Left_35 "Indication for blinking left light ";
CM_ SG_ 154 OBJ_Light_Indicator_Validity_35 "Validator for light indicators";
CM_ SG_ 154 OBJ_Right_Out_Of_Image_35 "Indicates whether the measurment are predicted out of the right side of the image bounderies.";
CM_ SG_ 154 OBJ_Left_Out_Of_Image_35 "Indicates whether if measurment are predicted out of  the left side of the image bounderies";
CM_ SG_ 154 OBJ_Right_Out_Of_Image_V_35 "validator";
CM_ SG_ 154 OBJ_Left_Out_Of_Image_V_35 "validator";
CM_ SG_ 154 OBJ_Top_Out_Of_Image_35 "Indicates whether if measurment are predicted out of  the top of the image bounderies";
CM_ SG_ 154 OBJ_Bottom_Out_Of_Image_35 "Indicates whether if measurment are predicted out of  the bottom of the image bounderies";
CM_ SG_ 154 OBJ_Top_Out_Of_Image_V_35 "validator";
CM_ SG_ 154 OBJ_Bottom_Out_Of_Image_V_35 "validator";
CM_ SG_ 154 OBJ_Lane_Assignment_35 "The object's lane relative to the host lane.";
CM_ SG_ 154 OBJ_Lane_Assignment_V_35 "Validator for lane assignment";
CM_ SG_ 154 OBJ_Age_Seconds_35 "Time in seconds in which the object was recognized. ";
CM_ SG_ 154 OBJ_Age_Seconds_V_35 "Validator for object age";
CM_ SG_ 154 OBJ_Width_35 "The width of the target vehicle in the world (not to be mistaken with the width of the visible part of the vehicle).";
CM_ SG_ 154 OBJ_Width_V_35 "Validator for object width";
CM_ SG_ 154 OBJ_Width_STD_35 "Standard deviation for object width";
CM_ SG_ 154 OBJ_Width_STD_V_35 "Validator for the standard deviation of object width";
CM_ SG_ 154 OBJ_Length_35 "The length of the vehicle in the world. For crossing bicycles it gives the viewed length of the bicycle.";
CM_ SG_ 154 OBJ_Length_V_35 "Validator for object length.";
CM_ SG_ 154 OBJ_Length_STD_35 "Standard deviation for object length.";
CM_ SG_ 154 OBJ_Length_STD_V_35 "Validator for the standard deviation of object length.";
CM_ SG_ 154 OBJ_Radar_ID_35 "Radar Object ID of the Fused Object, Only relvant when OBJ_Fusion_Source is not Camera only";
CM_ SG_ 154 OBJ_Height_35 "The height of the object in the world. ";
CM_ SG_ 154 OBJ_Height_V_35 "Validator for object height.";
CM_ SG_ 154 OBJ_Height_STD_35 "Standard deviation for object height.";
CM_ SG_ 154 OBJ_Height_STD_V_35 "Validator for the standard deviation of object height.";
CM_ SG_ 154 OBJ_Abs_Long_Velocity_35 "Absolute longitudinal velocity.";
CM_ SG_ 154 OBJ_Abs_Long_Velocity_V_35 "Validator for absolute longitudinal velocity.";
CM_ SG_ 154 OBJ_Abs_Long_Velocity_STD_35 "Standard deviation of absolute longitudinal velocity.";
CM_ SG_ 154 OBJ_Abs_Long_Vel_STD_V_35 "Validator for the standard deviation of the absolute longitudinal velocity.";
CM_ SG_ 154 OBJ_Abs_Lat_Velocity_35 "The lateral ground speed of the object.";
CM_ SG_ 154 OBJ_Abs_Lat_Velocity_V_35 "Validator for the lateral ground speed of the object.";
CM_ SG_ 154 OBJ_Abs_Lat_Velocity_STD_35 "STD of the lateral ground speed of the object.";
CM_ SG_ 154 OBJ_Abs_Lat_Vel_STD_V_35 "Validator for the STD of the lateral ground speed of the object.";
CM_ SG_ 154 OBJ_Abs_Long_Acc_35 "The longitudinal ground acceleration of the object.";
CM_ SG_ 154 OBJ_Abs_Long_Acc_V_35 "Validator for the longitudinal ground acceleration of the object.";
CM_ SG_ 154 OBJ_Abs_Long_Acc_STD_35 "STD of the longitudinal ground acceleration of the object.";
CM_ SG_ 154 OBJ_Abs_Long_Acc_STD_V_35 "Validator for the STD of the longitudinal ground acceleration of the object.";
CM_ SG_ 154 OBJ_Abs_Lat_Acc_35 "The lateral ground acceleration of the object.";
CM_ SG_ 154 OBJ_Abs_Lat_Acc_V_35 "Validator for the lateral ground acceleration of the object.";
CM_ SG_ 154 OBJ_Abs_Lat_Acc_STD_35 "STD of the lateral ground acceleration of the object.";
CM_ SG_ 154 OBJ_Abs_Lat_Acc_STD_V_35 "Validator for the STD of the lateral ground acceleration of the object.";
CM_ SG_ 154 OBJ_Abs_Acceleration_35 "The absolute ground acceleration in the target's heading direction.";
CM_ SG_ 154 OBJ_Abs_Acceleration_V_35 "Validator for the absolute ground acceleration.";
CM_ SG_ 154 OBJ_Abs_Acc_STD_35 "STD of the absolute ground acceleration.";
CM_ SG_ 154 OBJ_Abs_Acc_STD_V_35 "Validator for the STD of the absolute ground acceleration.";
CM_ SG_ 154 OBJ_Inv_TTC_35 "Inverse TTC (time to collision).";
CM_ SG_ 154 OBJ_Inv_TTC_STD_35 "STD for inverse TTC .";
CM_ SG_ 154 OBJ_Inv_TTC_STD_V_35 "Validator for the STD for inverse TTC .";
CM_ SG_ 154 OBJ_Relative_Long_Acc_35 "The relative lateral ground acceleration of the object.";
CM_ SG_ 154 OBJ_Relative_Long_Acc_V_35 "Validator for the relative lateral ground acceleration of the object.";
CM_ SG_ 154 OBJ_Relative_Long_Acc_STD_35 "STD of the relative lateral ground acceleration of the object.";
CM_ SG_ 154 OBJ_Rel_Long_Acc_STD_V_35 "Validator for the STD of the relative lateral ground acceleration.";
CM_ SG_ 154 OBJ_Relative_Long_Velocity_35 "The relative longtitudinal speed between the target and ego vehicle. ";
CM_ SG_ 154 OBJ_Relative_Long_Velocity_V_35 "Validator for the relative longtitudinal speed.";
CM_ SG_ 154 OBJ_Relative_Long_Vel_STD_35 "STD of the relative longtitudinal speed.";
CM_ SG_ 154 OBJ_Rel_Long_Vel_STD_V_35 "Validator for the STD of the relative longtitudinal speed.";
CM_ SG_ 154 OBJ_Relative_Lat_Velocity_35 "The relative lateral speed between the target and ego vehicle. ";
CM_ SG_ 154 OBJ_Relative_Lat_Velocity_V_35 "Validator for the relative lateral speed. ";
CM_ SG_ 154 OBJ_Relative_Lat_Velocity_STD_35 "STD of the relative lateral speed. ";
CM_ SG_ 154 OBJ_Rel_Lat_Vel_STD_V_35 "Validator for the STD of the relative lateral speed. ";
CM_ SG_ 154 OBJ_Long_Distance_35 "The longitudinal distance to middle of the rear bumper (middle of the RL and RR corners) of the target.";
CM_ SG_ 154 OBJ_Long_Distance_V_35 "Validator of the longtitudinal distance field";
CM_ SG_ 154 OBJ_Long_Distance_STD_35 "STD of the  longtitudinal distance.";
CM_ SG_ 154 OBJ_Long_Distance_STD_V_35 "Validator for the STD of the  longtitudinal distance.";
CM_ SG_ 154 OBJ_Lat_Distance_35 "Lateral distance to the middle of the RL and RR corners.  ";
CM_ SG_ 154 OBJ_Lat_Distance_V_35 "Validator for the lateral distance of the object.";
CM_ SG_ 154 OBJ_Lat_Distance_STD_35 "STD of the lateral distance of the object.";
CM_ SG_ 154 OBJ_Lat_Distance_STD_V_35 "Validator for the STD of the lateral distance of the object.";
CM_ SG_ 154 OBJ_Absolute_Speed_35 "The absolute ground speed in the targets' heading direction.";
CM_ SG_ 154 OBJ_Absolute_Speed_V_35 "Validator for the absolute ground speed.";
CM_ SG_ 154 OBJ_Absolute_Speed_STD_35 "STD of the absolute ground speed.";
CM_ SG_ 154 OBJ_Absolute_Speed_STD_V_35 "Validator for the STD of the absolute ground speed.";
CM_ SG_ 154 OBJ_Heading_35 "The angle beetweenthe host longitudinal axis and target's heading (clockwise, e.g. PI/2 is a target crossing from left to right).";
CM_ SG_ 154 OBJ_Heading_V_35 "Validator for the object heading.";
CM_ SG_ 154 OBJ_Heading_STD_35 "STD of the object heading.";
CM_ SG_ 154 OBJ_Heading_STD_V_35 "Validator for the STD of the object heading.";
CM_ SG_ 154 OBJ_Angle_Rate_STD_35 "Standard deviation of the angular speed. (radians)";
CM_ SG_ 154 OBJ_Angle_Rate_STD_V_35 "Validator for the STD of the angular speed.";
CM_ SG_ 154 OBJ_Angle_Rate_35 "The momentary angular speed of the object. (radians)";
CM_ SG_ 154 OBJ_Angle_Rate_V_35 "Validator for the angular speed.";
CM_ SG_ 154 OBJ_Angle_Right_35 "The angle between the host longitudinal axis and the right side of the front / rear of the target (the visible one). The positive side is to the host's right.";
CM_ SG_ 154 OBJ_Angle_Right_V_35 "Validator for angleRight";
CM_ SG_ 154 OBJ_Angle_Right_STD_35 "Standard deviation of angleRight";
CM_ SG_ 154 OBJ_Angle_Right_STD_V_35 "Validator for the standard deviation of angleRight.";
CM_ SG_ 154 OBJ_Angle_Left_35 "The angle between the host longitudinal axis and the left side of the front / rear of the target (the visible one). The positive side is to the host's right.";
CM_ SG_ 154 OBJ_Angle_Left_V_35 "Validator for angleLeft.";
CM_ SG_ 154 OBJ_Angle_Left_STD_35 "Standard deviation of angleLeft.";
CM_ SG_ 154 OBJ_Angle_Left_STD_V_35 "Validator for the standard deviation of angleLeft.";
CM_ SG_ 154 OBJ_Angle_Side_35 "The angle between the host longitudinal axis and the far visible edge - the visible edge of the front / rear of the target that is not visible. Currently supported for vehicles only.";
CM_ SG_ 154 OBJ_Angle_Side_V_35 "Validator for angleSide.";
CM_ SG_ 154 OBJ_Angle_Side_STD_35 "Standard deviation of angleSide.";
CM_ SG_ 154 OBJ_Angle_Side_STD_V_35 "Validator for the STD of angleSide.";
CM_ SG_ 154 OBJ_Angle_Mid_V_35 "Validator for angleMid.";
CM_ SG_ 154 OBJ_Angle_Mid_35 "The angle between the host longitudinal axis and the middle of the front / rear of the target (the visible one). The positive side is to the host's right.";
CM_ SG_ 154 OBJ_Angle_Mid_STD_35 "Standard deviation of angleMid.";
CM_ SG_ 154 OBJ_Angle_Mid_STD_V_35 "Validator for the STD of angleMid.";
CM_ SG_ 154 OBJ_Angle_Bottom_V_35 "Validator for OBJAngle_Bottom. ";
CM_ SG_ 154 OBJ_Angle_Bottom_35 "The angle between the longitudinal axis and the Bottom of the front / rear of the target (the visible one). The positive side is to the host's bottom";
CM_ SG_ 154 OBJ_Angle_Bottom_STD_35 "STD for OBJAngle_Bottom. ";
CM_ SG_ 154 OBJ_Angle_Bottom_STD_V_35 "Validator for OBJAngle_Bottom_STD. ";
CM_ SG_ 154 OBJ_Visibility_Side_V_35 "Currently Supported for VD only";
CM_ SG_ 154 OBJ_Visibility_Side_35 "From what car  side is the object visible";
CM_ SG_ 154 OBJ_Is_In_Drivable_Area_35 "Indicates whether the target is in a driveable area.";
CM_ SG_ 154 OBJ_Is_In_Drivable_Area_V_35 "Validator for OBJ_Is_In_Drivable_Area.";
CM_ SG_ 154 OBJ_Is_VeryClose_V_35 "Validator for OBJ_Is_VeryClose. ";
CM_ SG_ 154 OBJ_Is_VeryClose_35 "Indicates whether the target is very close to the host such that it is hard to measure its distance. Currently relevant for peds only";
CM_ SG_ 154 OBJ_OverlapAngleEgoLaneR_35 "Lateral distance to the middle of the RL and RR corners.";
CM_ SG_ 154 OBJ_OverlapAngleEgoLaneR_V_35 "Validator for OBJ_OverlapAngleEgoLaneR";
CM_ SG_ 154 OBJ_OverlapAngleEgoLaneL_35 "Lateral distance to the middle of the RL and RR corners.  ";
CM_ SG_ 154 OBJ_OverlapAngleEgoLaneL_V_35 "Validator for OBJ_OverlapAngleEgoLaneL";
CM_ SG_ 154 OBJ_Is_EMERGENCY_VCL_35 "Is Object an Emergency Vehicle";
CM_ SG_ 154 OBJ_EMERGENCY_LIGHT_COLOR_35 "Emergency Color";
CM_ SG_ 154 OBJ_EMERGENCY_V_35 "Are OBJ_Is_EMERGENCY_VCL and OBJ_EMERGENCY_LIGHT_COLOR Valid";
CM_ SG_ 154 OBJ_Angle_Top_35 "From VD touching point on the ground till the roof of the car";
CM_ SG_ 154 OBJ_Angle_Top_V_35 "Validator for OBJ_Angle_Top ";
CM_ SG_ 154 OBJ_Angle_Top_STD_35 "STD for OBJ_Angle_Top";
CM_ SG_ 154 OBJ_Angle_Top_STD_V_35 "Validator for OBJ_Angle_Top_STD. ";
CM_ SG_ 154 OBJ_CRC_36 "Calculated over all element signals. From the signal after the CRC until the first signal in the next elements OBJ_CRC_N+1  not including";
CM_ SG_ 154 OBJ_ID_36 "The detected object ID. Range is 1-255, while 0 indicates that the field in unfilled.";
CM_ SG_ 154 OBJ_Existence_Probability_36 "The existence probability of the reported object";
CM_ SG_ 154 OBJ_Fusion_Source_36 "sources ids used for fusion";
CM_ SG_ 154 OBJ_Triggered_SDM_36 "Indicates whether the object has trigered the SDM (Safety Diagnostic Manager) alert.";
CM_ SG_ 154 OBJ_Motion_Category_36 "Relevant for VD only. Full description of values can be found at the ACC guide.";
CM_ SG_ 154 OBJ_Object_Age_36 "The number of frames in which the object was recognized.";
CM_ SG_ 154 OBJ_Measuring_Status_36 "Measurment status. Old vs New marks if this is the first frame in which the object is reported. Predicted vs Measured marks if the report is raw or has been predicted forward in time using the measured dynamics and ego motion.";
CM_ SG_ 154 OBJ_Object_Class_36 "Indicates the object type. Uncertain is outputted in case the probability that a vehicle is a truck is very similar to the probability that it is a car. ";
CM_ SG_ 154 OBJ_Class_Probability_36 "The probability of this type classification.";
CM_ SG_ 154 OBJ_Car_Probability_36 "The probability the object is a car";
CM_ SG_ 154 OBJ_Truck_Probability_36 "The probability the object is a Truck";
CM_ SG_ 154 OBJ_Bike_Probability_36 "The probability the object is a Bike";
CM_ SG_ 154 OBJ_Camera_Source_36 "The camera in which this object was detected (best choice).";
CM_ SG_ 154 OBJ_Motion_Status_36 "MOVING - the object is moving STATIONARY - the object was never seen moving STOPPED -  the object was moving and has stopped MOVING_SLOWLY - the object is moving very slowly";
CM_ SG_ 154 OBJ_Motion_Orientation_36 "The direction of the targets heading compared to the host. ";
CM_ SG_ 154 OBJ_Has_Cut_Lane_36 "Indicates whether the object cut the host's (right or left) lane. In case there are no lanes, indicates whether the objects is at most 1 meters away from the host.";
CM_ SG_ 154 OBJ_Has_Cut_Path_36 "Indicates whether the object is in the host's path.";
CM_ SG_ 154 OBJ_Brake_Light_36 "Indication for brake lights ";
CM_ SG_ 154 OBJ_Turn_Indicator_Right_36 "Indication for blinking right light.";
CM_ SG_ 154 OBJ_Turn_Indicator_Left_36 "Indication for blinking left light ";
CM_ SG_ 154 OBJ_Light_Indicator_Validity_36 "Validator for light indicators";
CM_ SG_ 154 OBJ_Right_Out_Of_Image_36 "Indicates whether the measurment are predicted out of the right side of the image bounderies.";
CM_ SG_ 154 OBJ_Left_Out_Of_Image_36 "Indicates whether if measurment are predicted out of  the left side of the image bounderies";
CM_ SG_ 154 OBJ_Right_Out_Of_Image_V_36 "validator";
CM_ SG_ 154 OBJ_Left_Out_Of_Image_V_36 "validator";
CM_ SG_ 154 OBJ_Top_Out_Of_Image_36 "Indicates whether if measurment are predicted out of  the top of the image bounderies";
CM_ SG_ 154 OBJ_Bottom_Out_Of_Image_36 "Indicates whether if measurment are predicted out of  the bottom of the image bounderies";
CM_ SG_ 154 OBJ_Top_Out_Of_Image_V_36 "validator";
CM_ SG_ 154 OBJ_Bottom_Out_Of_Image_V_36 "validator";
CM_ SG_ 154 OBJ_Lane_Assignment_36 "The object's lane relative to the host lane.";
CM_ SG_ 154 OBJ_Lane_Assignment_V_36 "Validator for lane assignment";
CM_ SG_ 154 OBJ_Age_Seconds_36 "Time in seconds in which the object was recognized. ";
CM_ SG_ 154 OBJ_Age_Seconds_V_36 "Validator for object age";
CM_ SG_ 154 OBJ_Width_36 "The width of the target vehicle in the world (not to be mistaken with the width of the visible part of the vehicle).";
CM_ SG_ 154 OBJ_Width_V_36 "Validator for object width";
CM_ SG_ 154 OBJ_Width_STD_36 "Standard deviation for object width";
CM_ SG_ 154 OBJ_Width_STD_V_36 "Validator for the standard deviation of object width";
CM_ SG_ 154 OBJ_Length_36 "The length of the vehicle in the world. For crossing bicycles it gives the viewed length of the bicycle.";
CM_ SG_ 154 OBJ_Length_V_36 "Validator for object length.";
CM_ SG_ 154 OBJ_Length_STD_36 "Standard deviation for object length.";
CM_ SG_ 154 OBJ_Length_STD_V_36 "Validator for the standard deviation of object length.";
CM_ SG_ 154 OBJ_Radar_ID_36 "Radar Object ID of the Fused Object, Only relvant when OBJ_Fusion_Source is not Camera only";
CM_ SG_ 154 OBJ_Height_36 "The height of the object in the world. ";
CM_ SG_ 154 OBJ_Height_V_36 "Validator for object height.";
CM_ SG_ 154 OBJ_Height_STD_36 "Standard deviation for object height.";
CM_ SG_ 154 OBJ_Height_STD_V_36 "Validator for the standard deviation of object height.";
CM_ SG_ 154 OBJ_Abs_Long_Velocity_36 "Absolute longitudinal velocity.";
CM_ SG_ 154 OBJ_Abs_Long_Velocity_V_36 "Validator for absolute longitudinal velocity.";
CM_ SG_ 154 OBJ_Abs_Long_Velocity_STD_36 "Standard deviation of absolute longitudinal velocity.";
CM_ SG_ 154 OBJ_Abs_Long_Vel_STD_V_36 "Validator for the standard deviation of the absolute longitudinal velocity.";
CM_ SG_ 154 OBJ_Abs_Lat_Velocity_36 "The lateral ground speed of the object.";
CM_ SG_ 154 OBJ_Abs_Lat_Velocity_V_36 "Validator for the lateral ground speed of the object.";
CM_ SG_ 154 OBJ_Abs_Lat_Velocity_STD_36 "STD of the lateral ground speed of the object.";
CM_ SG_ 154 OBJ_Abs_Lat_Vel_STD_V_36 "Validator for the STD of the lateral ground speed of the object.";
CM_ SG_ 154 OBJ_Abs_Long_Acc_36 "The longitudinal ground acceleration of the object.";
CM_ SG_ 154 OBJ_Abs_Long_Acc_V_36 "Validator for the longitudinal ground acceleration of the object.";
CM_ SG_ 154 OBJ_Abs_Long_Acc_STD_36 "STD of the longitudinal ground acceleration of the object.";
CM_ SG_ 154 OBJ_Abs_Long_Acc_STD_V_36 "Validator for the STD of the longitudinal ground acceleration of the object.";
CM_ SG_ 154 OBJ_Abs_Lat_Acc_36 "The lateral ground acceleration of the object.";
CM_ SG_ 154 OBJ_Abs_Lat_Acc_V_36 "Validator for the lateral ground acceleration of the object.";
CM_ SG_ 154 OBJ_Abs_Lat_Acc_STD_36 "STD of the lateral ground acceleration of the object.";
CM_ SG_ 154 OBJ_Abs_Lat_Acc_STD_V_36 "Validator for the STD of the lateral ground acceleration of the object.";
CM_ SG_ 154 OBJ_Abs_Acceleration_36 "The absolute ground acceleration in the target's heading direction.";
CM_ SG_ 154 OBJ_Abs_Acceleration_V_36 "Validator for the absolute ground acceleration.";
CM_ SG_ 154 OBJ_Abs_Acc_STD_36 "STD of the absolute ground acceleration.";
CM_ SG_ 154 OBJ_Abs_Acc_STD_V_36 "Validator for the STD of the absolute ground acceleration.";
CM_ SG_ 154 OBJ_Inv_TTC_36 "Inverse TTC (time to collision).";
CM_ SG_ 154 OBJ_Inv_TTC_STD_36 "STD for inverse TTC .";
CM_ SG_ 154 OBJ_Inv_TTC_STD_V_36 "Validator for the STD for inverse TTC .";
CM_ SG_ 154 OBJ_Relative_Long_Acc_36 "The relative lateral ground acceleration of the object.";
CM_ SG_ 154 OBJ_Relative_Long_Acc_V_36 "Validator for the relative lateral ground acceleration of the object.";
CM_ SG_ 154 OBJ_Relative_Long_Acc_STD_36 "STD of the relative lateral ground acceleration of the object.";
CM_ SG_ 154 OBJ_Rel_Long_Acc_STD_V_36 "Validator for the STD of the relative lateral ground acceleration.";
CM_ SG_ 154 OBJ_Relative_Long_Velocity_36 "The relative longtitudinal speed between the target and ego vehicle. ";
CM_ SG_ 154 OBJ_Relative_Long_Velocity_V_36 "Validator for the relative longtitudinal speed.";
CM_ SG_ 154 OBJ_Relative_Long_Vel_STD_36 "STD of the relative longtitudinal speed.";
CM_ SG_ 154 OBJ_Rel_Long_Vel_STD_V_36 "Validator for the STD of the relative longtitudinal speed.";
CM_ SG_ 154 OBJ_Relative_Lat_Velocity_36 "The relative lateral speed between the target and ego vehicle. ";
CM_ SG_ 154 OBJ_Relative_Lat_Velocity_V_36 "Validator for the relative lateral speed. ";
CM_ SG_ 154 OBJ_Relative_Lat_Velocity_STD_36 "STD of the relative lateral speed. ";
CM_ SG_ 154 OBJ_Rel_Lat_Vel_STD_V_36 "Validator for the STD of the relative lateral speed. ";
CM_ SG_ 154 OBJ_Long_Distance_36 "The longitudinal distance to middle of the rear bumper (middle of the RL and RR corners) of the target.";
CM_ SG_ 154 OBJ_Long_Distance_V_36 "Validator of the longtitudinal distance field";
CM_ SG_ 154 OBJ_Long_Distance_STD_36 "STD of the  longtitudinal distance.";
CM_ SG_ 154 OBJ_Long_Distance_STD_V_36 "Validator for the STD of the  longtitudinal distance.";
CM_ SG_ 154 OBJ_Lat_Distance_36 "Lateral distance to the middle of the RL and RR corners.  ";
CM_ SG_ 154 OBJ_Lat_Distance_V_36 "Validator for the lateral distance of the object.";
CM_ SG_ 154 OBJ_Lat_Distance_STD_36 "STD of the lateral distance of the object.";
CM_ SG_ 154 OBJ_Lat_Distance_STD_V_36 "Validator for the STD of the lateral distance of the object.";
CM_ SG_ 154 OBJ_Absolute_Speed_36 "The absolute ground speed in the targets' heading direction.";
CM_ SG_ 154 OBJ_Absolute_Speed_V_36 "Validator for the absolute ground speed.";
CM_ SG_ 154 OBJ_Absolute_Speed_STD_36 "STD of the absolute ground speed.";
CM_ SG_ 154 OBJ_Absolute_Speed_STD_V_36 "Validator for the STD of the absolute ground speed.";
CM_ SG_ 154 OBJ_Heading_36 "The angle beetweenthe host longitudinal axis and target's heading (clockwise, e.g. PI/2 is a target crossing from left to right).";
CM_ SG_ 154 OBJ_Heading_V_36 "Validator for the object heading.";
CM_ SG_ 154 OBJ_Heading_STD_36 "STD of the object heading.";
CM_ SG_ 154 OBJ_Heading_STD_V_36 "Validator for the STD of the object heading.";
CM_ SG_ 154 OBJ_Angle_Rate_STD_36 "Standard deviation of the angular speed. (radians)";
CM_ SG_ 154 OBJ_Angle_Rate_STD_V_36 "Validator for the STD of the angular speed.";
CM_ SG_ 154 OBJ_Angle_Rate_36 "The momentary angular speed of the object. (radians)";
CM_ SG_ 154 OBJ_Angle_Rate_V_36 "Validator for the angular speed.";
CM_ SG_ 154 OBJ_Angle_Right_36 "The angle between the host longitudinal axis and the right side of the front / rear of the target (the visible one). The positive side is to the host's right.";
CM_ SG_ 154 OBJ_Angle_Right_V_36 "Validator for angleRight";
CM_ SG_ 154 OBJ_Angle_Right_STD_36 "Standard deviation of angleRight";
CM_ SG_ 154 OBJ_Angle_Right_STD_V_36 "Validator for the standard deviation of angleRight.";
CM_ SG_ 154 OBJ_Angle_Left_36 "The angle between the host longitudinal axis and the left side of the front / rear of the target (the visible one). The positive side is to the host's right.";
CM_ SG_ 154 OBJ_Angle_Left_V_36 "Validator for angleLeft.";
CM_ SG_ 154 OBJ_Angle_Left_STD_36 "Standard deviation of angleLeft.";
CM_ SG_ 154 OBJ_Angle_Left_STD_V_36 "Validator for the standard deviation of angleLeft.";
CM_ SG_ 154 OBJ_Angle_Side_36 "The angle between the host longitudinal axis and the far visible edge - the visible edge of the front / rear of the target that is not visible. Currently supported for vehicles only.";
CM_ SG_ 154 OBJ_Angle_Side_V_36 "Validator for angleSide.";
CM_ SG_ 154 OBJ_Angle_Side_STD_36 "Standard deviation of angleSide.";
CM_ SG_ 154 OBJ_Angle_Side_STD_V_36 "Validator for the STD of angleSide.";
CM_ SG_ 154 OBJ_Angle_Mid_V_36 "Validator for angleMid.";
CM_ SG_ 154 OBJ_Angle_Mid_36 "The angle between the host longitudinal axis and the middle of the front / rear of the target (the visible one). The positive side is to the host's right.";
CM_ SG_ 154 OBJ_Angle_Mid_STD_36 "Standard deviation of angleMid.";
CM_ SG_ 154 OBJ_Angle_Mid_STD_V_36 "Validator for the STD of angleMid.";
CM_ SG_ 154 OBJ_Angle_Bottom_V_36 "Validator for OBJAngle_Bottom. ";
CM_ SG_ 154 OBJ_Angle_Bottom_36 "The angle between the longitudinal axis and the Bottom of the front / rear of the target (the visible one). The positive side is to the host's bottom";
CM_ SG_ 154 OBJ_Angle_Bottom_STD_36 "STD for OBJAngle_Bottom. ";
CM_ SG_ 154 OBJ_Angle_Bottom_STD_V_36 "Validator for OBJAngle_Bottom_STD. ";
CM_ SG_ 154 OBJ_Visibility_Side_V_36 "Currently Supported for VD only";
CM_ SG_ 154 OBJ_Visibility_Side_36 "From what car  side is the object visible";
CM_ SG_ 154 OBJ_Is_In_Drivable_Area_36 "Indicates whether the target is in a driveable area.";
CM_ SG_ 154 OBJ_Is_In_Drivable_Area_V_36 "Validator for OBJ_Is_In_Drivable_Area.";
CM_ SG_ 154 OBJ_Is_VeryClose_V_36 "Validator for OBJ_Is_VeryClose. ";
CM_ SG_ 154 OBJ_Is_VeryClose_36 "Indicates whether the target is very close to the host such that it is hard to measure its distance. Currently relevant for peds only";
CM_ SG_ 154 OBJ_OverlapAngleEgoLaneR_36 "Lateral distance to the middle of the RL and RR corners.";
CM_ SG_ 154 OBJ_OverlapAngleEgoLaneR_V_36 "Validator for OBJ_OverlapAngleEgoLaneR";
CM_ SG_ 154 OBJ_OverlapAngleEgoLaneL_36 "Lateral distance to the middle of the RL and RR corners.  ";
CM_ SG_ 154 OBJ_OverlapAngleEgoLaneL_V_36 "Validator for OBJ_OverlapAngleEgoLaneL";
CM_ SG_ 154 OBJ_Is_EMERGENCY_VCL_36 "Is Object an Emergency Vehicle";
CM_ SG_ 154 OBJ_EMERGENCY_LIGHT_COLOR_36 "Emergency Color";
CM_ SG_ 154 OBJ_EMERGENCY_V_36 "Are OBJ_Is_EMERGENCY_VCL and OBJ_EMERGENCY_LIGHT_COLOR Valid";
CM_ SG_ 154 OBJ_Angle_Top_36 "From VD touching point on the ground till the roof of the car";
CM_ SG_ 154 OBJ_Angle_Top_V_36 "Validator for OBJ_Angle_Top ";
CM_ SG_ 154 OBJ_Angle_Top_STD_36 "STD for OBJ_Angle_Top";
CM_ SG_ 154 OBJ_Angle_Top_STD_V_36 "Validator for OBJ_Angle_Top_STD. ";
CM_ SG_ 154 OBJ_CRC_37 "Calculated over all element signals. From the signal after the CRC until the first signal in the next elements OBJ_CRC_N+1  not including";
CM_ SG_ 154 OBJ_ID_37 "The detected object ID. Range is 1-255, while 0 indicates that the field in unfilled.";
CM_ SG_ 154 OBJ_Existence_Probability_37 "The existence probability of the reported object";
CM_ SG_ 154 OBJ_Fusion_Source_37 "sources ids used for fusion";
CM_ SG_ 154 OBJ_Triggered_SDM_37 "Indicates whether the object has trigered the SDM (Safety Diagnostic Manager) alert.";
CM_ SG_ 154 OBJ_Motion_Category_37 "Relevant for VD only. Full description of values can be found at the ACC guide.";
CM_ SG_ 154 OBJ_Object_Age_37 "The number of frames in which the object was recognized.";
CM_ SG_ 154 OBJ_Measuring_Status_37 "Measurment status. Old vs New marks if this is the first frame in which the object is reported. Predicted vs Measured marks if the report is raw or has been predicted forward in time using the measured dynamics and ego motion.";
CM_ SG_ 154 OBJ_Object_Class_37 "Indicates the object type. Uncertain is outputted in case the probability that a vehicle is a truck is very similar to the probability that it is a car. ";
CM_ SG_ 154 OBJ_Class_Probability_37 "The probability of this type classification.";
CM_ SG_ 154 OBJ_Car_Probability_37 "The probability the object is a car";
CM_ SG_ 154 OBJ_Truck_Probability_37 "The probability the object is a Truck";
CM_ SG_ 154 OBJ_Bike_Probability_37 "The probability the object is a Bike";
CM_ SG_ 154 OBJ_Camera_Source_37 "The camera in which this object was detected (best choice).";
CM_ SG_ 154 OBJ_Motion_Status_37 "MOVING - the object is moving STATIONARY - the object was never seen moving STOPPED -  the object was moving and has stopped MOVING_SLOWLY - the object is moving very slowly";
CM_ SG_ 154 OBJ_Motion_Orientation_37 "The direction of the targets heading compared to the host. ";
CM_ SG_ 154 OBJ_Has_Cut_Lane_37 "Indicates whether the object cut the host's (right or left) lane. In case there are no lanes, indicates whether the objects is at most 1 meters away from the host.";
CM_ SG_ 154 OBJ_Has_Cut_Path_37 "Indicates whether the object is in the host's path.";
CM_ SG_ 154 OBJ_Brake_Light_37 "Indication for brake lights ";
CM_ SG_ 154 OBJ_Turn_Indicator_Right_37 "Indication for blinking right light.";
CM_ SG_ 154 OBJ_Turn_Indicator_Left_37 "Indication for blinking left light ";
CM_ SG_ 154 OBJ_Light_Indicator_Validity_37 "Validator for light indicators";
CM_ SG_ 154 OBJ_Right_Out_Of_Image_37 "Indicates whether the measurment are predicted out of the right side of the image bounderies.";
CM_ SG_ 154 OBJ_Left_Out_Of_Image_37 "Indicates whether if measurment are predicted out of  the left side of the image bounderies";
CM_ SG_ 154 OBJ_Right_Out_Of_Image_V_37 "validator";
CM_ SG_ 154 OBJ_Left_Out_Of_Image_V_37 "validator";
CM_ SG_ 154 OBJ_Top_Out_Of_Image_37 "Indicates whether if measurment are predicted out of  the top of the image bounderies";
CM_ SG_ 154 OBJ_Bottom_Out_Of_Image_37 "Indicates whether if measurment are predicted out of  the bottom of the image bounderies";
CM_ SG_ 154 OBJ_Top_Out_Of_Image_V_37 "validator";
CM_ SG_ 154 OBJ_Bottom_Out_Of_Image_V_37 "validator";
CM_ SG_ 154 OBJ_Lane_Assignment_37 "The object's lane relative to the host lane.";
CM_ SG_ 154 OBJ_Lane_Assignment_V_37 "Validator for lane assignment";
CM_ SG_ 154 OBJ_Age_Seconds_37 "Time in seconds in which the object was recognized. ";
CM_ SG_ 154 OBJ_Age_Seconds_V_37 "Validator for object age";
CM_ SG_ 154 OBJ_Width_37 "The width of the target vehicle in the world (not to be mistaken with the width of the visible part of the vehicle).";
CM_ SG_ 154 OBJ_Width_V_37 "Validator for object width";
CM_ SG_ 154 OBJ_Width_STD_37 "Standard deviation for object width";
CM_ SG_ 154 OBJ_Width_STD_V_37 "Validator for the standard deviation of object width";
CM_ SG_ 154 OBJ_Length_37 "The length of the vehicle in the world. For crossing bicycles it gives the viewed length of the bicycle.";
CM_ SG_ 154 OBJ_Length_V_37 "Validator for object length.";
CM_ SG_ 154 OBJ_Length_STD_37 "Standard deviation for object length.";
CM_ SG_ 154 OBJ_Length_STD_V_37 "Validator for the standard deviation of object length.";
CM_ SG_ 154 OBJ_Radar_ID_37 "Radar Object ID of the Fused Object, Only relvant when OBJ_Fusion_Source is not Camera only";
CM_ SG_ 154 OBJ_Height_37 "The height of the object in the world. ";
CM_ SG_ 154 OBJ_Height_V_37 "Validator for object height.";
CM_ SG_ 154 OBJ_Height_STD_37 "Standard deviation for object height.";
CM_ SG_ 154 OBJ_Height_STD_V_37 "Validator for the standard deviation of object height.";
CM_ SG_ 154 OBJ_Abs_Long_Velocity_37 "Absolute longitudinal velocity.";
CM_ SG_ 154 OBJ_Abs_Long_Velocity_V_37 "Validator for absolute longitudinal velocity.";
CM_ SG_ 154 OBJ_Abs_Long_Velocity_STD_37 "Standard deviation of absolute longitudinal velocity.";
CM_ SG_ 154 OBJ_Abs_Long_Vel_STD_V_37 "Validator for the standard deviation of the absolute longitudinal velocity.";
CM_ SG_ 154 OBJ_Abs_Lat_Velocity_37 "The lateral ground speed of the object.";
CM_ SG_ 154 OBJ_Abs_Lat_Velocity_V_37 "Validator for the lateral ground speed of the object.";
CM_ SG_ 154 OBJ_Abs_Lat_Velocity_STD_37 "STD of the lateral ground speed of the object.";
CM_ SG_ 154 OBJ_Abs_Lat_Vel_STD_V_37 "Validator for the STD of the lateral ground speed of the object.";
CM_ SG_ 154 OBJ_Abs_Long_Acc_37 "The longitudinal ground acceleration of the object.";
CM_ SG_ 154 OBJ_Abs_Long_Acc_V_37 "Validator for the longitudinal ground acceleration of the object.";
CM_ SG_ 154 OBJ_Abs_Long_Acc_STD_37 "STD of the longitudinal ground acceleration of the object.";
CM_ SG_ 154 OBJ_Abs_Long_Acc_STD_V_37 "Validator for the STD of the longitudinal ground acceleration of the object.";
CM_ SG_ 154 OBJ_Abs_Lat_Acc_37 "The lateral ground acceleration of the object.";
CM_ SG_ 154 OBJ_Abs_Lat_Acc_V_37 "Validator for the lateral ground acceleration of the object.";
CM_ SG_ 154 OBJ_Abs_Lat_Acc_STD_37 "STD of the lateral ground acceleration of the object.";
CM_ SG_ 154 OBJ_Abs_Lat_Acc_STD_V_37 "Validator for the STD of the lateral ground acceleration of the object.";
CM_ SG_ 154 OBJ_Abs_Acceleration_37 "The absolute ground acceleration in the target's heading direction.";
CM_ SG_ 154 OBJ_Abs_Acceleration_V_37 "Validator for the absolute ground acceleration.";
CM_ SG_ 154 OBJ_Abs_Acc_STD_37 "STD of the absolute ground acceleration.";
CM_ SG_ 154 OBJ_Abs_Acc_STD_V_37 "Validator for the STD of the absolute ground acceleration.";
CM_ SG_ 154 OBJ_Inv_TTC_37 "Inverse TTC (time to collision).";
CM_ SG_ 154 OBJ_Inv_TTC_STD_37 "STD for inverse TTC .";
CM_ SG_ 154 OBJ_Inv_TTC_STD_V_37 "Validator for the STD for inverse TTC .";
CM_ SG_ 154 OBJ_Relative_Long_Acc_37 "The relative lateral ground acceleration of the object.";
CM_ SG_ 154 OBJ_Relative_Long_Acc_V_37 "Validator for the relative lateral ground acceleration of the object.";
CM_ SG_ 154 OBJ_Relative_Long_Acc_STD_37 "STD of the relative lateral ground acceleration of the object.";
CM_ SG_ 154 OBJ_Rel_Long_Acc_STD_V_37 "Validator for the STD of the relative lateral ground acceleration.";
CM_ SG_ 154 OBJ_Relative_Long_Velocity_37 "The relative longtitudinal speed between the target and ego vehicle. ";
CM_ SG_ 154 OBJ_Relative_Long_Velocity_V_37 "Validator for the relative longtitudinal speed.";
CM_ SG_ 154 OBJ_Relative_Long_Vel_STD_37 "STD of the relative longtitudinal speed.";
CM_ SG_ 154 OBJ_Rel_Long_Vel_STD_V_37 "Validator for the STD of the relative longtitudinal speed.";
CM_ SG_ 154 OBJ_Relative_Lat_Velocity_37 "The relative lateral speed between the target and ego vehicle. ";
CM_ SG_ 154 OBJ_Relative_Lat_Velocity_V_37 "Validator for the relative lateral speed. ";
CM_ SG_ 154 OBJ_Relative_Lat_Velocity_STD_37 "STD of the relative lateral speed. ";
CM_ SG_ 154 OBJ_Rel_Lat_Vel_STD_V_37 "Validator for the STD of the relative lateral speed. ";
CM_ SG_ 154 OBJ_Long_Distance_37 "The longitudinal distance to middle of the rear bumper (middle of the RL and RR corners) of the target.";
CM_ SG_ 154 OBJ_Long_Distance_V_37 "Validator of the longtitudinal distance field";
CM_ SG_ 154 OBJ_Long_Distance_STD_37 "STD of the  longtitudinal distance.";
CM_ SG_ 154 OBJ_Long_Distance_STD_V_37 "Validator for the STD of the  longtitudinal distance.";
CM_ SG_ 154 OBJ_Lat_Distance_37 "Lateral distance to the middle of the RL and RR corners.  ";
CM_ SG_ 154 OBJ_Lat_Distance_V_37 "Validator for the lateral distance of the object.";
CM_ SG_ 154 OBJ_Lat_Distance_STD_37 "STD of the lateral distance of the object.";
CM_ SG_ 154 OBJ_Lat_Distance_STD_V_37 "Validator for the STD of the lateral distance of the object.";
CM_ SG_ 154 OBJ_Absolute_Speed_37 "The absolute ground speed in the targets' heading direction.";
CM_ SG_ 154 OBJ_Absolute_Speed_V_37 "Validator for the absolute ground speed.";
CM_ SG_ 154 OBJ_Absolute_Speed_STD_37 "STD of the absolute ground speed.";
CM_ SG_ 154 OBJ_Absolute_Speed_STD_V_37 "Validator for the STD of the absolute ground speed.";
CM_ SG_ 154 OBJ_Heading_37 "The angle beetweenthe host longitudinal axis and target's heading (clockwise, e.g. PI/2 is a target crossing from left to right).";
CM_ SG_ 154 OBJ_Heading_V_37 "Validator for the object heading.";
CM_ SG_ 154 OBJ_Heading_STD_37 "STD of the object heading.";
CM_ SG_ 154 OBJ_Heading_STD_V_37 "Validator for the STD of the object heading.";
CM_ SG_ 154 OBJ_Angle_Rate_STD_37 "Standard deviation of the angular speed. (radians)";
CM_ SG_ 154 OBJ_Angle_Rate_STD_V_37 "Validator for the STD of the angular speed.";
CM_ SG_ 154 OBJ_Angle_Rate_37 "The momentary angular speed of the object. (radians)";
CM_ SG_ 154 OBJ_Angle_Rate_V_37 "Validator for the angular speed.";
CM_ SG_ 154 OBJ_Angle_Right_37 "The angle between the host longitudinal axis and the right side of the front / rear of the target (the visible one). The positive side is to the host's right.";
CM_ SG_ 154 OBJ_Angle_Right_V_37 "Validator for angleRight";
CM_ SG_ 154 OBJ_Angle_Right_STD_37 "Standard deviation of angleRight";
CM_ SG_ 154 OBJ_Angle_Right_STD_V_37 "Validator for the standard deviation of angleRight.";
CM_ SG_ 154 OBJ_Angle_Left_37 "The angle between the host longitudinal axis and the left side of the front / rear of the target (the visible one). The positive side is to the host's right.";
CM_ SG_ 154 OBJ_Angle_Left_V_37 "Validator for angleLeft.";
CM_ SG_ 154 OBJ_Angle_Left_STD_37 "Standard deviation of angleLeft.";
CM_ SG_ 154 OBJ_Angle_Left_STD_V_37 "Validator for the standard deviation of angleLeft.";
CM_ SG_ 154 OBJ_Angle_Side_37 "The angle between the host longitudinal axis and the far visible edge - the visible edge of the front / rear of the target that is not visible. Currently supported for vehicles only.";
CM_ SG_ 154 OBJ_Angle_Side_V_37 "Validator for angleSide.";
CM_ SG_ 154 OBJ_Angle_Side_STD_37 "Standard deviation of angleSide.";
CM_ SG_ 154 OBJ_Angle_Side_STD_V_37 "Validator for the STD of angleSide.";
CM_ SG_ 154 OBJ_Angle_Mid_V_37 "Validator for angleMid.";
CM_ SG_ 154 OBJ_Angle_Mid_37 "The angle between the host longitudinal axis and the middle of the front / rear of the target (the visible one). The positive side is to the host's right.";
CM_ SG_ 154 OBJ_Angle_Mid_STD_37 "Standard deviation of angleMid.";
CM_ SG_ 154 OBJ_Angle_Mid_STD_V_37 "Validator for the STD of angleMid.";
CM_ SG_ 154 OBJ_Angle_Bottom_V_37 "Validator for OBJAngle_Bottom. ";
CM_ SG_ 154 OBJ_Angle_Bottom_37 "The angle between the longitudinal axis and the Bottom of the front / rear of the target (the visible one). The positive side is to the host's bottom";
CM_ SG_ 154 OBJ_Angle_Bottom_STD_37 "STD for OBJAngle_Bottom. ";
CM_ SG_ 154 OBJ_Angle_Bottom_STD_V_37 "Validator for OBJAngle_Bottom_STD. ";
CM_ SG_ 154 OBJ_Visibility_Side_V_37 "Currently Supported for VD only";
CM_ SG_ 154 OBJ_Visibility_Side_37 "From what car  side is the object visible";
CM_ SG_ 154 OBJ_Is_In_Drivable_Area_37 "Indicates whether the target is in a driveable area.";
CM_ SG_ 154 OBJ_Is_In_Drivable_Area_V_37 "Validator for OBJ_Is_In_Drivable_Area.";
CM_ SG_ 154 OBJ_Is_VeryClose_V_37 "Validator for OBJ_Is_VeryClose. ";
CM_ SG_ 154 OBJ_Is_VeryClose_37 "Indicates whether the target is very close to the host such that it is hard to measure its distance. Currently relevant for peds only";
CM_ SG_ 154 OBJ_OverlapAngleEgoLaneR_37 "Lateral distance to the middle of the RL and RR corners.";
CM_ SG_ 154 OBJ_OverlapAngleEgoLaneR_V_37 "Validator for OBJ_OverlapAngleEgoLaneR";
CM_ SG_ 154 OBJ_OverlapAngleEgoLaneL_37 "Lateral distance to the middle of the RL and RR corners.  ";
CM_ SG_ 154 OBJ_OverlapAngleEgoLaneL_V_37 "Validator for OBJ_OverlapAngleEgoLaneL";
CM_ SG_ 154 OBJ_Is_EMERGENCY_VCL_37 "Is Object an Emergency Vehicle";
CM_ SG_ 154 OBJ_EMERGENCY_LIGHT_COLOR_37 "Emergency Color";
CM_ SG_ 154 OBJ_EMERGENCY_V_37 "Are OBJ_Is_EMERGENCY_VCL and OBJ_EMERGENCY_LIGHT_COLOR Valid";
CM_ SG_ 154 OBJ_Angle_Top_37 "From VD touching point on the ground till the roof of the car";
CM_ SG_ 154 OBJ_Angle_Top_V_37 "Validator for OBJ_Angle_Top ";
CM_ SG_ 154 OBJ_Angle_Top_STD_37 "STD for OBJ_Angle_Top";
CM_ SG_ 154 OBJ_Angle_Top_STD_V_37 "Validator for OBJ_Angle_Top_STD. ";
CM_ SG_ 154 OBJ_CRC_38 "Calculated over all element signals. From the signal after the CRC until the first signal in the next elements OBJ_CRC_N+1  not including";
CM_ SG_ 154 OBJ_ID_38 "The detected object ID. Range is 1-255, while 0 indicates that the field in unfilled.";
CM_ SG_ 154 OBJ_Existence_Probability_38 "The existence probability of the reported object";
CM_ SG_ 154 OBJ_Fusion_Source_38 "sources ids used for fusion";
CM_ SG_ 154 OBJ_Triggered_SDM_38 "Indicates whether the object has trigered the SDM (Safety Diagnostic Manager) alert.";
CM_ SG_ 154 OBJ_Motion_Category_38 "Relevant for VD only. Full description of values can be found at the ACC guide.";
CM_ SG_ 154 OBJ_Object_Age_38 "The number of frames in which the object was recognized.";
CM_ SG_ 154 OBJ_Measuring_Status_38 "Measurment status. Old vs New marks if this is the first frame in which the object is reported. Predicted vs Measured marks if the report is raw or has been predicted forward in time using the measured dynamics and ego motion.";
CM_ SG_ 154 OBJ_Object_Class_38 "Indicates the object type. Uncertain is outputted in case the probability that a vehicle is a truck is very similar to the probability that it is a car. ";
CM_ SG_ 154 OBJ_Class_Probability_38 "The probability of this type classification.";
CM_ SG_ 154 OBJ_Car_Probability_38 "The probability the object is a car";
CM_ SG_ 154 OBJ_Truck_Probability_38 "The probability the object is a Truck";
CM_ SG_ 154 OBJ_Bike_Probability_38 "The probability the object is a Bike";
CM_ SG_ 154 OBJ_Camera_Source_38 "The camera in which this object was detected (best choice).";
CM_ SG_ 154 OBJ_Motion_Status_38 "MOVING - the object is moving STATIONARY - the object was never seen moving STOPPED -  the object was moving and has stopped MOVING_SLOWLY - the object is moving very slowly";
CM_ SG_ 154 OBJ_Motion_Orientation_38 "The direction of the targets heading compared to the host. ";
CM_ SG_ 154 OBJ_Has_Cut_Lane_38 "Indicates whether the object cut the host's (right or left) lane. In case there are no lanes, indicates whether the objects is at most 1 meters away from the host.";
CM_ SG_ 154 OBJ_Has_Cut_Path_38 "Indicates whether the object is in the host's path.";
CM_ SG_ 154 OBJ_Brake_Light_38 "Indication for brake lights ";
CM_ SG_ 154 OBJ_Turn_Indicator_Right_38 "Indication for blinking right light.";
CM_ SG_ 154 OBJ_Turn_Indicator_Left_38 "Indication for blinking left light ";
CM_ SG_ 154 OBJ_Light_Indicator_Validity_38 "Validator for light indicators";
CM_ SG_ 154 OBJ_Right_Out_Of_Image_38 "Indicates whether the measurment are predicted out of the right side of the image bounderies.";
CM_ SG_ 154 OBJ_Left_Out_Of_Image_38 "Indicates whether if measurment are predicted out of  the left side of the image bounderies";
CM_ SG_ 154 OBJ_Right_Out_Of_Image_V_38 "validator";
CM_ SG_ 154 OBJ_Left_Out_Of_Image_V_38 "validator";
CM_ SG_ 154 OBJ_Top_Out_Of_Image_38 "Indicates whether if measurment are predicted out of  the top of the image bounderies";
CM_ SG_ 154 OBJ_Bottom_Out_Of_Image_38 "Indicates whether if measurment are predicted out of  the bottom of the image bounderies";
CM_ SG_ 154 OBJ_Top_Out_Of_Image_V_38 "validator";
CM_ SG_ 154 OBJ_Bottom_Out_Of_Image_V_38 "validator";
CM_ SG_ 154 OBJ_Lane_Assignment_38 "The object's lane relative to the host lane.";
CM_ SG_ 154 OBJ_Lane_Assignment_V_38 "Validator for lane assignment";
CM_ SG_ 154 OBJ_Age_Seconds_38 "Time in seconds in which the object was recognized. ";
CM_ SG_ 154 OBJ_Age_Seconds_V_38 "Validator for object age";
CM_ SG_ 154 OBJ_Width_38 "The width of the target vehicle in the world (not to be mistaken with the width of the visible part of the vehicle).";
CM_ SG_ 154 OBJ_Width_V_38 "Validator for object width";
CM_ SG_ 154 OBJ_Width_STD_38 "Standard deviation for object width";
CM_ SG_ 154 OBJ_Width_STD_V_38 "Validator for the standard deviation of object width";
CM_ SG_ 154 OBJ_Length_38 "The length of the vehicle in the world. For crossing bicycles it gives the viewed length of the bicycle.";
CM_ SG_ 154 OBJ_Length_V_38 "Validator for object length.";
CM_ SG_ 154 OBJ_Length_STD_38 "Standard deviation for object length.";
CM_ SG_ 154 OBJ_Length_STD_V_38 "Validator for the standard deviation of object length.";
CM_ SG_ 154 OBJ_Radar_ID_38 "Radar Object ID of the Fused Object, Only relvant when OBJ_Fusion_Source is not Camera only";
CM_ SG_ 154 OBJ_Height_38 "The height of the object in the world. ";
CM_ SG_ 154 OBJ_Height_V_38 "Validator for object height.";
CM_ SG_ 154 OBJ_Height_STD_38 "Standard deviation for object height.";
CM_ SG_ 154 OBJ_Height_STD_V_38 "Validator for the standard deviation of object height.";
CM_ SG_ 154 OBJ_Abs_Long_Velocity_38 "Absolute longitudinal velocity.";
CM_ SG_ 154 OBJ_Abs_Long_Velocity_V_38 "Validator for absolute longitudinal velocity.";
CM_ SG_ 154 OBJ_Abs_Long_Velocity_STD_38 "Standard deviation of absolute longitudinal velocity.";
CM_ SG_ 154 OBJ_Abs_Long_Vel_STD_V_38 "Validator for the standard deviation of the absolute longitudinal velocity.";
CM_ SG_ 154 OBJ_Abs_Lat_Velocity_38 "The lateral ground speed of the object.";
CM_ SG_ 154 OBJ_Abs_Lat_Velocity_V_38 "Validator for the lateral ground speed of the object.";
CM_ SG_ 154 OBJ_Abs_Lat_Velocity_STD_38 "STD of the lateral ground speed of the object.";
CM_ SG_ 154 OBJ_Abs_Lat_Vel_STD_V_38 "Validator for the STD of the lateral ground speed of the object.";
CM_ SG_ 154 OBJ_Abs_Long_Acc_38 "The longitudinal ground acceleration of the object.";
CM_ SG_ 154 OBJ_Abs_Long_Acc_V_38 "Validator for the longitudinal ground acceleration of the object.";
CM_ SG_ 154 OBJ_Abs_Long_Acc_STD_38 "STD of the longitudinal ground acceleration of the object.";
CM_ SG_ 154 OBJ_Abs_Long_Acc_STD_V_38 "Validator for the STD of the longitudinal ground acceleration of the object.";
CM_ SG_ 154 OBJ_Abs_Lat_Acc_38 "The lateral ground acceleration of the object.";
CM_ SG_ 154 OBJ_Abs_Lat_Acc_V_38 "Validator for the lateral ground acceleration of the object.";
CM_ SG_ 154 OBJ_Abs_Lat_Acc_STD_38 "STD of the lateral ground acceleration of the object.";
CM_ SG_ 154 OBJ_Abs_Lat_Acc_STD_V_38 "Validator for the STD of the lateral ground acceleration of the object.";
CM_ SG_ 154 OBJ_Abs_Acceleration_38 "The absolute ground acceleration in the target's heading direction.";
CM_ SG_ 154 OBJ_Abs_Acceleration_V_38 "Validator for the absolute ground acceleration.";
CM_ SG_ 154 OBJ_Abs_Acc_STD_38 "STD of the absolute ground acceleration.";
CM_ SG_ 154 OBJ_Abs_Acc_STD_V_38 "Validator for the STD of the absolute ground acceleration.";
CM_ SG_ 154 OBJ_Inv_TTC_38 "Inverse TTC (time to collision).";
CM_ SG_ 154 OBJ_Inv_TTC_STD_38 "STD for inverse TTC .";
CM_ SG_ 154 OBJ_Inv_TTC_STD_V_38 "Validator for the STD for inverse TTC .";
CM_ SG_ 154 OBJ_Relative_Long_Acc_38 "The relative lateral ground acceleration of the object.";
CM_ SG_ 154 OBJ_Relative_Long_Acc_V_38 "Validator for the relative lateral ground acceleration of the object.";
CM_ SG_ 154 OBJ_Relative_Long_Acc_STD_38 "STD of the relative lateral ground acceleration of the object.";
CM_ SG_ 154 OBJ_Rel_Long_Acc_STD_V_38 "Validator for the STD of the relative lateral ground acceleration.";
CM_ SG_ 154 OBJ_Relative_Long_Velocity_38 "The relative longtitudinal speed between the target and ego vehicle. ";
CM_ SG_ 154 OBJ_Relative_Long_Velocity_V_38 "Validator for the relative longtitudinal speed.";
CM_ SG_ 154 OBJ_Relative_Long_Vel_STD_38 "STD of the relative longtitudinal speed.";
CM_ SG_ 154 OBJ_Rel_Long_Vel_STD_V_38 "Validator for the STD of the relative longtitudinal speed.";
CM_ SG_ 154 OBJ_Relative_Lat_Velocity_38 "The relative lateral speed between the target and ego vehicle. ";
CM_ SG_ 154 OBJ_Relative_Lat_Velocity_V_38 "Validator for the relative lateral speed. ";
CM_ SG_ 154 OBJ_Relative_Lat_Velocity_STD_38 "STD of the relative lateral speed. ";
CM_ SG_ 154 OBJ_Rel_Lat_Vel_STD_V_38 "Validator for the STD of the relative lateral speed. ";
CM_ SG_ 154 OBJ_Long_Distance_38 "The longitudinal distance to middle of the rear bumper (middle of the RL and RR corners) of the target.";
CM_ SG_ 154 OBJ_Long_Distance_V_38 "Validator of the longtitudinal distance field";
CM_ SG_ 154 OBJ_Long_Distance_STD_38 "STD of the  longtitudinal distance.";
CM_ SG_ 154 OBJ_Long_Distance_STD_V_38 "Validator for the STD of the  longtitudinal distance.";
CM_ SG_ 154 OBJ_Lat_Distance_38 "Lateral distance to the middle of the RL and RR corners.  ";
CM_ SG_ 154 OBJ_Lat_Distance_V_38 "Validator for the lateral distance of the object.";
CM_ SG_ 154 OBJ_Lat_Distance_STD_38 "STD of the lateral distance of the object.";
CM_ SG_ 154 OBJ_Lat_Distance_STD_V_38 "Validator for the STD of the lateral distance of the object.";
CM_ SG_ 154 OBJ_Absolute_Speed_38 "The absolute ground speed in the targets' heading direction.";
CM_ SG_ 154 OBJ_Absolute_Speed_V_38 "Validator for the absolute ground speed.";
CM_ SG_ 154 OBJ_Absolute_Speed_STD_38 "STD of the absolute ground speed.";
CM_ SG_ 154 OBJ_Absolute_Speed_STD_V_38 "Validator for the STD of the absolute ground speed.";
CM_ SG_ 154 OBJ_Heading_38 "The angle beetweenthe host longitudinal axis and target's heading (clockwise, e.g. PI/2 is a target crossing from left to right).";
CM_ SG_ 154 OBJ_Heading_V_38 "Validator for the object heading.";
CM_ SG_ 154 OBJ_Heading_STD_38 "STD of the object heading.";
CM_ SG_ 154 OBJ_Heading_STD_V_38 "Validator for the STD of the object heading.";
CM_ SG_ 154 OBJ_Angle_Rate_STD_38 "Standard deviation of the angular speed. (radians)";
CM_ SG_ 154 OBJ_Angle_Rate_STD_V_38 "Validator for the STD of the angular speed.";
CM_ SG_ 154 OBJ_Angle_Rate_38 "The momentary angular speed of the object. (radians)";
CM_ SG_ 154 OBJ_Angle_Rate_V_38 "Validator for the angular speed.";
CM_ SG_ 154 OBJ_Angle_Right_38 "The angle between the host longitudinal axis and the right side of the front / rear of the target (the visible one). The positive side is to the host's right.";
CM_ SG_ 154 OBJ_Angle_Right_V_38 "Validator for angleRight";
CM_ SG_ 154 OBJ_Angle_Right_STD_38 "Standard deviation of angleRight";
CM_ SG_ 154 OBJ_Angle_Right_STD_V_38 "Validator for the standard deviation of angleRight.";
CM_ SG_ 154 OBJ_Angle_Left_38 "The angle between the host longitudinal axis and the left side of the front / rear of the target (the visible one). The positive side is to the host's right.";
CM_ SG_ 154 OBJ_Angle_Left_V_38 "Validator for angleLeft.";
CM_ SG_ 154 OBJ_Angle_Left_STD_38 "Standard deviation of angleLeft.";
CM_ SG_ 154 OBJ_Angle_Left_STD_V_38 "Validator for the standard deviation of angleLeft.";
CM_ SG_ 154 OBJ_Angle_Side_38 "The angle between the host longitudinal axis and the far visible edge - the visible edge of the front / rear of the target that is not visible. Currently supported for vehicles only.";
CM_ SG_ 154 OBJ_Angle_Side_V_38 "Validator for angleSide.";
CM_ SG_ 154 OBJ_Angle_Side_STD_38 "Standard deviation of angleSide.";
CM_ SG_ 154 OBJ_Angle_Side_STD_V_38 "Validator for the STD of angleSide.";
CM_ SG_ 154 OBJ_Angle_Mid_V_38 "Validator for angleMid.";
CM_ SG_ 154 OBJ_Angle_Mid_38 "The angle between the host longitudinal axis and the middle of the front / rear of the target (the visible one). The positive side is to the host's right.";
CM_ SG_ 154 OBJ_Angle_Mid_STD_38 "Standard deviation of angleMid.";
CM_ SG_ 154 OBJ_Angle_Mid_STD_V_38 "Validator for the STD of angleMid.";
CM_ SG_ 154 OBJ_Angle_Bottom_V_38 "Validator for OBJAngle_Bottom. ";
CM_ SG_ 154 OBJ_Angle_Bottom_38 "The angle between the longitudinal axis and the Bottom of the front / rear of the target (the visible one). The positive side is to the host's bottom";
CM_ SG_ 154 OBJ_Angle_Bottom_STD_38 "STD for OBJAngle_Bottom. ";
CM_ SG_ 154 OBJ_Angle_Bottom_STD_V_38 "Validator for OBJAngle_Bottom_STD. ";
CM_ SG_ 154 OBJ_Visibility_Side_V_38 "Currently Supported for VD only";
CM_ SG_ 154 OBJ_Visibility_Side_38 "From what car  side is the object visible";
CM_ SG_ 154 OBJ_Is_In_Drivable_Area_38 "Indicates whether the target is in a driveable area.";
CM_ SG_ 154 OBJ_Is_In_Drivable_Area_V_38 "Validator for OBJ_Is_In_Drivable_Area.";
CM_ SG_ 154 OBJ_Is_VeryClose_V_38 "Validator for OBJ_Is_VeryClose. ";
CM_ SG_ 154 OBJ_Is_VeryClose_38 "Indicates whether the target is very close to the host such that it is hard to measure its distance. Currently relevant for peds only";
CM_ SG_ 154 OBJ_OverlapAngleEgoLaneR_38 "Lateral distance to the middle of the RL and RR corners.";
CM_ SG_ 154 OBJ_OverlapAngleEgoLaneR_V_38 "Validator for OBJ_OverlapAngleEgoLaneR";
CM_ SG_ 154 OBJ_OverlapAngleEgoLaneL_38 "Lateral distance to the middle of the RL and RR corners.  ";
CM_ SG_ 154 OBJ_OverlapAngleEgoLaneL_V_38 "Validator for OBJ_OverlapAngleEgoLaneL";
CM_ SG_ 154 OBJ_Is_EMERGENCY_VCL_38 "Is Object an Emergency Vehicle";
CM_ SG_ 154 OBJ_EMERGENCY_LIGHT_COLOR_38 "Emergency Color";
CM_ SG_ 154 OBJ_EMERGENCY_V_38 "Are OBJ_Is_EMERGENCY_VCL and OBJ_EMERGENCY_LIGHT_COLOR Valid";
CM_ SG_ 154 OBJ_Angle_Top_38 "From VD touching point on the ground till the roof of the car";
CM_ SG_ 154 OBJ_Angle_Top_V_38 "Validator for OBJ_Angle_Top ";
CM_ SG_ 154 OBJ_Angle_Top_STD_38 "STD for OBJ_Angle_Top";
CM_ SG_ 154 OBJ_Angle_Top_STD_V_38 "Validator for OBJ_Angle_Top_STD. ";
CM_ SG_ 154 OBJ_CRC_39 "Calculated over all element signals. From the signal after the CRC until the first signal in the next elements OBJ_CRC_N+1  not including";
CM_ SG_ 154 OBJ_ID_39 "The detected object ID. Range is 1-255, while 0 indicates that the field in unfilled.";
CM_ SG_ 154 OBJ_Existence_Probability_39 "The existence probability of the reported object";
CM_ SG_ 154 OBJ_Fusion_Source_39 "sources ids used for fusion";
CM_ SG_ 154 OBJ_Triggered_SDM_39 "Indicates whether the object has trigered the SDM (Safety Diagnostic Manager) alert.";
CM_ SG_ 154 OBJ_Motion_Category_39 "Relevant for VD only. Full description of values can be found at the ACC guide.";
CM_ SG_ 154 OBJ_Object_Age_39 "The number of frames in which the object was recognized.";
CM_ SG_ 154 OBJ_Measuring_Status_39 "Measurment status. Old vs New marks if this is the first frame in which the object is reported. Predicted vs Measured marks if the report is raw or has been predicted forward in time using the measured dynamics and ego motion.";
CM_ SG_ 154 OBJ_Object_Class_39 "Indicates the object type. Uncertain is outputted in case the probability that a vehicle is a truck is very similar to the probability that it is a car. ";
CM_ SG_ 154 OBJ_Class_Probability_39 "The probability of this type classification.";
CM_ SG_ 154 OBJ_Car_Probability_39 "The probability the object is a car";
CM_ SG_ 154 OBJ_Truck_Probability_39 "The probability the object is a Truck";
CM_ SG_ 154 OBJ_Bike_Probability_39 "The probability the object is a Bike";
CM_ SG_ 154 OBJ_Camera_Source_39 "The camera in which this object was detected (best choice).";
CM_ SG_ 154 OBJ_Motion_Status_39 "MOVING - the object is moving STATIONARY - the object was never seen moving STOPPED -  the object was moving and has stopped MOVING_SLOWLY - the object is moving very slowly";
CM_ SG_ 154 OBJ_Motion_Orientation_39 "The direction of the targets heading compared to the host. ";
CM_ SG_ 154 OBJ_Has_Cut_Lane_39 "Indicates whether the object cut the host's (right or left) lane. In case there are no lanes, indicates whether the objects is at most 1 meters away from the host.";
CM_ SG_ 154 OBJ_Has_Cut_Path_39 "Indicates whether the object is in the host's path.";
CM_ SG_ 154 OBJ_Brake_Light_39 "Indication for brake lights ";
CM_ SG_ 154 OBJ_Turn_Indicator_Right_39 "Indication for blinking right light.";
CM_ SG_ 154 OBJ_Turn_Indicator_Left_39 "Indication for blinking left light ";
CM_ SG_ 154 OBJ_Light_Indicator_Validity_39 "Validator for light indicators";
CM_ SG_ 154 OBJ_Right_Out_Of_Image_39 "Indicates whether the measurment are predicted out of the right side of the image bounderies.";
CM_ SG_ 154 OBJ_Left_Out_Of_Image_39 "Indicates whether if measurment are predicted out of  the left side of the image bounderies";
CM_ SG_ 154 OBJ_Right_Out_Of_Image_V_39 "validator";
CM_ SG_ 154 OBJ_Left_Out_Of_Image_V_39 "validator";
CM_ SG_ 154 OBJ_Top_Out_Of_Image_39 "Indicates whether if measurment are predicted out of  the top of the image bounderies";
CM_ SG_ 154 OBJ_Bottom_Out_Of_Image_39 "Indicates whether if measurment are predicted out of  the bottom of the image bounderies";
CM_ SG_ 154 OBJ_Top_Out_Of_Image_V_39 "validator";
CM_ SG_ 154 OBJ_Bottom_Out_Of_Image_V_39 "validator";
CM_ SG_ 154 OBJ_Lane_Assignment_39 "The object's lane relative to the host lane.";
CM_ SG_ 154 OBJ_Lane_Assignment_V_39 "Validator for lane assignment";
CM_ SG_ 154 OBJ_Age_Seconds_39 "Time in seconds in which the object was recognized. ";
CM_ SG_ 154 OBJ_Age_Seconds_V_39 "Validator for object age";
CM_ SG_ 154 OBJ_Width_39 "The width of the target vehicle in the world (not to be mistaken with the width of the visible part of the vehicle).";
CM_ SG_ 154 OBJ_Width_V_39 "Validator for object width";
CM_ SG_ 154 OBJ_Width_STD_39 "Standard deviation for object width";
CM_ SG_ 154 OBJ_Width_STD_V_39 "Validator for the standard deviation of object width";
CM_ SG_ 154 OBJ_Length_39 "The length of the vehicle in the world. For crossing bicycles it gives the viewed length of the bicycle.";
CM_ SG_ 154 OBJ_Length_V_39 "Validator for object length.";
CM_ SG_ 154 OBJ_Length_STD_39 "Standard deviation for object length.";
CM_ SG_ 154 OBJ_Length_STD_V_39 "Validator for the standard deviation of object length.";
CM_ SG_ 154 OBJ_Radar_ID_39 "Radar Object ID of the Fused Object, Only relvant when OBJ_Fusion_Source is not Camera only";
CM_ SG_ 154 OBJ_Height_39 "The height of the object in the world. ";
CM_ SG_ 154 OBJ_Height_V_39 "Validator for object height.";
CM_ SG_ 154 OBJ_Height_STD_39 "Standard deviation for object height.";
CM_ SG_ 154 OBJ_Height_STD_V_39 "Validator for the standard deviation of object height.";
CM_ SG_ 154 OBJ_Abs_Long_Velocity_39 "Absolute longitudinal velocity.";
CM_ SG_ 154 OBJ_Abs_Long_Velocity_V_39 "Validator for absolute longitudinal velocity.";
CM_ SG_ 154 OBJ_Abs_Long_Velocity_STD_39 "Standard deviation of absolute longitudinal velocity.";
CM_ SG_ 154 OBJ_Abs_Long_Vel_STD_V_39 "Validator for the standard deviation of the absolute longitudinal velocity.";
CM_ SG_ 154 OBJ_Abs_Lat_Velocity_39 "The lateral ground speed of the object.";
CM_ SG_ 154 OBJ_Abs_Lat_Velocity_V_39 "Validator for the lateral ground speed of the object.";
CM_ SG_ 154 OBJ_Abs_Lat_Velocity_STD_39 "STD of the lateral ground speed of the object.";
CM_ SG_ 154 OBJ_Abs_Lat_Vel_STD_V_39 "Validator for the STD of the lateral ground speed of the object.";
CM_ SG_ 154 OBJ_Abs_Long_Acc_39 "The longitudinal ground acceleration of the object.";
CM_ SG_ 154 OBJ_Abs_Long_Acc_V_39 "Validator for the longitudinal ground acceleration of the object.";
CM_ SG_ 154 OBJ_Abs_Long_Acc_STD_39 "STD of the longitudinal ground acceleration of the object.";
CM_ SG_ 154 OBJ_Abs_Long_Acc_STD_V_39 "Validator for the STD of the longitudinal ground acceleration of the object.";
CM_ SG_ 154 OBJ_Abs_Lat_Acc_39 "The lateral ground acceleration of the object.";
CM_ SG_ 154 OBJ_Abs_Lat_Acc_V_39 "Validator for the lateral ground acceleration of the object.";
CM_ SG_ 154 OBJ_Abs_Lat_Acc_STD_39 "STD of the lateral ground acceleration of the object.";
CM_ SG_ 154 OBJ_Abs_Lat_Acc_STD_V_39 "Validator for the STD of the lateral ground acceleration of the object.";
CM_ SG_ 154 OBJ_Abs_Acceleration_39 "The absolute ground acceleration in the target's heading direction.";
CM_ SG_ 154 OBJ_Abs_Acceleration_V_39 "Validator for the absolute ground acceleration.";
CM_ SG_ 154 OBJ_Abs_Acc_STD_39 "STD of the absolute ground acceleration.";
CM_ SG_ 154 OBJ_Abs_Acc_STD_V_39 "Validator for the STD of the absolute ground acceleration.";
CM_ SG_ 154 OBJ_Inv_TTC_39 "Inverse TTC (time to collision).";
CM_ SG_ 154 OBJ_Inv_TTC_STD_39 "STD for inverse TTC .";
CM_ SG_ 154 OBJ_Inv_TTC_STD_V_39 "Validator for the STD for inverse TTC .";
CM_ SG_ 154 OBJ_Relative_Long_Acc_39 "The relative lateral ground acceleration of the object.";
CM_ SG_ 154 OBJ_Relative_Long_Acc_V_39 "Validator for the relative lateral ground acceleration of the object.";
CM_ SG_ 154 OBJ_Relative_Long_Acc_STD_39 "STD of the relative lateral ground acceleration of the object.";
CM_ SG_ 154 OBJ_Rel_Long_Acc_STD_V_39 "Validator for the STD of the relative lateral ground acceleration.";
CM_ SG_ 154 OBJ_Relative_Long_Velocity_39 "The relative longtitudinal speed between the target and ego vehicle. ";
CM_ SG_ 154 OBJ_Relative_Long_Velocity_V_39 "Validator for the relative longtitudinal speed.";
CM_ SG_ 154 OBJ_Relative_Long_Vel_STD_39 "STD of the relative longtitudinal speed.";
CM_ SG_ 154 OBJ_Rel_Long_Vel_STD_V_39 "Validator for the STD of the relative longtitudinal speed.";
CM_ SG_ 154 OBJ_Relative_Lat_Velocity_39 "The relative lateral speed between the target and ego vehicle. ";
CM_ SG_ 154 OBJ_Relative_Lat_Velocity_V_39 "Validator for the relative lateral speed. ";
CM_ SG_ 154 OBJ_Relative_Lat_Velocity_STD_39 "STD of the relative lateral speed. ";
CM_ SG_ 154 OBJ_Rel_Lat_Vel_STD_V_39 "Validator for the STD of the relative lateral speed. ";
CM_ SG_ 154 OBJ_Long_Distance_39 "The longitudinal distance to middle of the rear bumper (middle of the RL and RR corners) of the target.";
CM_ SG_ 154 OBJ_Long_Distance_V_39 "Validator of the longtitudinal distance field";
CM_ SG_ 154 OBJ_Long_Distance_STD_39 "STD of the  longtitudinal distance.";
CM_ SG_ 154 OBJ_Long_Distance_STD_V_39 "Validator for the STD of the  longtitudinal distance.";
CM_ SG_ 154 OBJ_Lat_Distance_39 "Lateral distance to the middle of the RL and RR corners.  ";
CM_ SG_ 154 OBJ_Lat_Distance_V_39 "Validator for the lateral distance of the object.";
CM_ SG_ 154 OBJ_Lat_Distance_STD_39 "STD of the lateral distance of the object.";
CM_ SG_ 154 OBJ_Lat_Distance_STD_V_39 "Validator for the STD of the lateral distance of the object.";
CM_ SG_ 154 OBJ_Absolute_Speed_39 "The absolute ground speed in the targets' heading direction.";
CM_ SG_ 154 OBJ_Absolute_Speed_V_39 "Validator for the absolute ground speed.";
CM_ SG_ 154 OBJ_Absolute_Speed_STD_39 "STD of the absolute ground speed.";
CM_ SG_ 154 OBJ_Absolute_Speed_STD_V_39 "Validator for the STD of the absolute ground speed.";
CM_ SG_ 154 OBJ_Heading_39 "The angle beetweenthe host longitudinal axis and target's heading (clockwise, e.g. PI/2 is a target crossing from left to right).";
CM_ SG_ 154 OBJ_Heading_V_39 "Validator for the object heading.";
CM_ SG_ 154 OBJ_Heading_STD_39 "STD of the object heading.";
CM_ SG_ 154 OBJ_Heading_STD_V_39 "Validator for the STD of the object heading.";
CM_ SG_ 154 OBJ_Angle_Rate_STD_39 "Standard deviation of the angular speed. (radians)";
CM_ SG_ 154 OBJ_Angle_Rate_STD_V_39 "Validator for the STD of the angular speed.";
CM_ SG_ 154 OBJ_Angle_Rate_39 "The momentary angular speed of the object. (radians)";
CM_ SG_ 154 OBJ_Angle_Rate_V_39 "Validator for the angular speed.";
CM_ SG_ 154 OBJ_Angle_Right_39 "The angle between the host longitudinal axis and the right side of the front / rear of the target (the visible one). The positive side is to the host's right.";
CM_ SG_ 154 OBJ_Angle_Right_V_39 "Validator for angleRight";
CM_ SG_ 154 OBJ_Angle_Right_STD_39 "Standard deviation of angleRight";
CM_ SG_ 154 OBJ_Angle_Right_STD_V_39 "Validator for the standard deviation of angleRight.";
CM_ SG_ 154 OBJ_Angle_Left_39 "The angle between the host longitudinal axis and the left side of the front / rear of the target (the visible one). The positive side is to the host's right.";
CM_ SG_ 154 OBJ_Angle_Left_V_39 "Validator for angleLeft.";
CM_ SG_ 154 OBJ_Angle_Left_STD_39 "Standard deviation of angleLeft.";
CM_ SG_ 154 OBJ_Angle_Left_STD_V_39 "Validator for the standard deviation of angleLeft.";
CM_ SG_ 154 OBJ_Angle_Side_39 "The angle between the host longitudinal axis and the far visible edge - the visible edge of the front / rear of the target that is not visible. Currently supported for vehicles only.";
CM_ SG_ 154 OBJ_Angle_Side_V_39 "Validator for angleSide.";
CM_ SG_ 154 OBJ_Angle_Side_STD_39 "Standard deviation of angleSide.";
CM_ SG_ 154 OBJ_Angle_Side_STD_V_39 "Validator for the STD of angleSide.";
CM_ SG_ 154 OBJ_Angle_Mid_V_39 "Validator for angleMid.";
CM_ SG_ 154 OBJ_Angle_Mid_39 "The angle between the host longitudinal axis and the middle of the front / rear of the target (the visible one). The positive side is to the host's right.";
CM_ SG_ 154 OBJ_Angle_Mid_STD_39 "Standard deviation of angleMid.";
CM_ SG_ 154 OBJ_Angle_Mid_STD_V_39 "Validator for the STD of angleMid.";
CM_ SG_ 154 OBJ_Angle_Bottom_V_39 "Validator for OBJAngle_Bottom. ";
CM_ SG_ 154 OBJ_Angle_Bottom_39 "The angle between the longitudinal axis and the Bottom of the front / rear of the target (the visible one). The positive side is to the host's bottom";
CM_ SG_ 154 OBJ_Angle_Bottom_STD_39 "STD for OBJAngle_Bottom. ";
CM_ SG_ 154 OBJ_Angle_Bottom_STD_V_39 "Validator for OBJAngle_Bottom_STD. ";
CM_ SG_ 154 OBJ_Visibility_Side_V_39 "Currently Supported for VD only";
CM_ SG_ 154 OBJ_Visibility_Side_39 "From what car  side is the object visible";
CM_ SG_ 154 OBJ_Is_In_Drivable_Area_39 "Indicates whether the target is in a driveable area.";
CM_ SG_ 154 OBJ_Is_In_Drivable_Area_V_39 "Validator for OBJ_Is_In_Drivable_Area.";
CM_ SG_ 154 OBJ_Is_VeryClose_V_39 "Validator for OBJ_Is_VeryClose. ";
CM_ SG_ 154 OBJ_Is_VeryClose_39 "Indicates whether the target is very close to the host such that it is hard to measure its distance. Currently relevant for peds only";
CM_ SG_ 154 OBJ_OverlapAngleEgoLaneR_39 "Lateral distance to the middle of the RL and RR corners.";
CM_ SG_ 154 OBJ_OverlapAngleEgoLaneR_V_39 "Validator for OBJ_OverlapAngleEgoLaneR";
CM_ SG_ 154 OBJ_OverlapAngleEgoLaneL_39 "Lateral distance to the middle of the RL and RR corners.  ";
CM_ SG_ 154 OBJ_OverlapAngleEgoLaneL_V_39 "Validator for OBJ_OverlapAngleEgoLaneL";
CM_ SG_ 154 OBJ_Is_EMERGENCY_VCL_39 "Is Object an Emergency Vehicle";
CM_ SG_ 154 OBJ_EMERGENCY_LIGHT_COLOR_39 "Emergency Color";
CM_ SG_ 154 OBJ_EMERGENCY_V_39 "Are OBJ_Is_EMERGENCY_VCL and OBJ_EMERGENCY_LIGHT_COLOR Valid";
CM_ SG_ 154 OBJ_Angle_Top_39 "From VD touching point on the ground till the roof of the car";
CM_ SG_ 154 OBJ_Angle_Top_V_39 "Validator for OBJ_Angle_Top ";
CM_ SG_ 154 OBJ_Angle_Top_STD_39 "STD for OBJ_Angle_Top";
CM_ SG_ 154 OBJ_Angle_Top_STD_V_39 "Validator for OBJ_Angle_Top_STD. ";
BA_DEF_ SG_  "GenSigStartValue" INT 0 0;
BA_DEF_DEF_  "GenSigStartValue" 0;
BA_ "GenSigStartValue" SG_ 154 OBJ_Width_35 40;
BA_ "GenSigStartValue" SG_ 154 OBJ_Length_35 24;
BA_ "GenSigStartValue" SG_ 154 OBJ_Width_36 40;
BA_ "GenSigStartValue" SG_ 154 OBJ_Length_36 24;
BA_ "GenSigStartValue" SG_ 154 OBJ_Width_37 40;
BA_ "GenSigStartValue" SG_ 154 OBJ_Length_37 24;
BA_ "GenSigStartValue" SG_ 154 OBJ_Width_38 40;
BA_ "GenSigStartValue" SG_ 154 OBJ_Length_38 24;
BA_ "GenSigStartValue" SG_ 154 OBJ_Width_39 40;
BA_ "GenSigStartValue" SG_ 154 OBJ_Length_39 24;
VAL_ 154 OBJ_Absolute_Speed_STD_V_34 1 "VALID" 0 "INVALID" ;
VAL_ 154 OBJ_Heading_V_34 1 "VALID" 0 "INVALID" ;
VAL_ 154 OBJ_Heading_STD_V_34 1 "VALID" 0 "INVALID" ;
VAL_ 154 OBJ_Angle_Rate_STD_V_34 1 "VALID" 0 "INVALID" ;
VAL_ 154 OBJ_Angle_Rate_V_34 1 "VALID" 0 "INVALID" ;
VAL_ 154 OBJ_Angle_Right_V_34 1 "VALID" 0 "INVALID" ;
VAL_ 154 OBJ_Angle_Right_STD_V_34 1 "VALID" 0 "INVALID" ;
VAL_ 154 OBJ_Angle_Left_V_34 1 "VALID" 0 "INVALID" ;
VAL_ 154 OBJ_Angle_Left_STD_V_34 1 "VALID" 0 "INVALID" ;
VAL_ 154 OBJ_Angle_Side_V_34 1 "VALID" 0 "INVALID" ;
VAL_ 154 OBJ_Angle_Side_STD_V_34 1 "VALID" 0 "INVALID" ;
VAL_ 154 OBJ_Angle_Mid_V_34 1 "VALID" 0 "INVALID" ;
VAL_ 154 OBJ_Angle_Mid_STD_V_34 1 "VALID" 0 "INVALID" ;
VAL_ 154 OBJ_Angle_Bottom_V_34 1 "VALID" 0 "INVALID" ;
VAL_ 154 OBJ_Angle_Bottom_STD_V_34 1 "VALID" 0 "INVALID" ;
VAL_ 154 OBJ_Visibility_Side_V_34 1 "VALID" 0 "INVALID" ;
VAL_ 154 OBJ_Visibility_Side_34 2 "REAR" 1 "FRONT" 0 "NOT_VISIBLE" ;
VAL_ 154 OBJ_Is_In_Drivable_Area_34 1 "TRUE" 0 "FALSE" ;
VAL_ 154 OBJ_Is_In_Drivable_Area_V_34 1 "VALID" 0 "INVALID" ;
VAL_ 154 OBJ_Is_VeryClose_V_34 1 "VALID" 0 "INVALID" ;
VAL_ 154 OBJ_Is_VeryClose_34 1 "TRUE" 0 "FALSE" ;
VAL_ 154 OBJ_OverlapAngleEgoLaneR_V_34 1 "VALID" 0 "INVALID" ;
VAL_ 154 OBJ_OverlapAngleEgoLaneL_V_34 1 "VALID" 0 "INVALID" ;
VAL_ 154 OBJ_Is_EMERGENCY_VCL_34 1 "TRUE" 0 "FALSE" ;
VAL_ 154 OBJ_EMERGENCY_LIGHT_COLOR_34 3 "(1000)ORANGE" 2 "(0100)BLUE" 1 "(0010)RED" 0 "(0001)OTHER" ;
VAL_ 154 OBJ_EMERGENCY_V_34 1 "TRUE" 0 "FALSE" ;
VAL_ 154 OBJ_Angle_Top_V_34 1 "VALID" 0 "INVALID" ;
VAL_ 154 OBJ_Angle_Top_STD_V_34 1 "VALID" 0 "INVALID" ;
VAL_ 154 OBJ_Fusion_Source_35 2 "(BIT_2)RADAR2" 1 "(BIT_1)RADAR1" 0 "(BIT_0)CAMERA" ;
VAL_ 154 OBJ_Triggered_SDM_35 2 "NOT_TRIGGERED" 1 "TRIGGERED" 0 "NOT_AVAILABLE" ;
VAL_ 154 OBJ_Motion_Category_35 13 "ONCOMING" 12 "PRECEEDING" 11 "MOVING" 10 "RTAP" 9 "LTAP" 8 "CROSSING" 7 "MOVING_OUT" 6 "MOVING_IN" 5 "CLOSE_CUT_IN" 4 "PASSING_OUT" 3 "PASSING_IN" 2 "PASSING" 1 "UNDEFINED" 0 "UNFILLED" ;
VAL_ 154 OBJ_Measuring_Status_35 2 "(BIT_2)NOT_VALID_OR_VALID" 1 "(BIT_1)PREDICTED_OR_MEASURED" 0 "(BIT_0)OLD_OR_NEW" ;
VAL_ 154 OBJ_Object_Class_35 8 "UNCERTAIN_VCL" 7 "ANIMAL" 6 "GENERAL_OBJECT" 5 "PEDESTRIAN" 4 "BICYCLE" 3 "MOTORBIKE" 2 "TRUCK" 1 "CAR" 0 "UNFILLED" ;
VAL_ 154 OBJ_Camera_Source_35 11 "PARKING_RIGHT" 10 "PARKING_LEFT" 9 "PARKING_REAR" 8 "PARKING_FRONT" 7 "FRONT_CORNER_RIGHT" 6 "FRONT_CORNER_LEFT" 5 "REAR_CORNER_RIGHT" 4 "REAR_CORNER_LEFT" 3 "REAR" 2 "FRONT_FISHEYE" 1 "FRONT_NARROW" 0 "FRONT_MAIN" ;
VAL_ 154 OBJ_Motion_Status_35 5 "MOVING_SLOWLY" 4 "STOPPED" 3 "STATIONARY" 2 "MOVING" 1 "UNKNOWN" 0 "INVALID" ;
VAL_ 154 OBJ_Motion_Orientation_35 13 "INVALID" 12 "NORTH" 11 "NORTH_WEST" 9 "WEST" 7 "SOUTH_WEST" 6 "SOUTH" 5 "SOUTH_EAST" 3 "EAST" 1 "NORTH_EAST" 0 "UNKNOWN" ;
VAL_ 154 OBJ_Has_Cut_Lane_35 1 "TRUE" 0 "FALSE" ;
VAL_ 154 OBJ_Has_Cut_Path_35 1 "TRUE" 0 "FALSE" ;
VAL_ 154 OBJ_Brake_Light_35 1 "TRUE" 0 "FALSE" ;
VAL_ 154 OBJ_Turn_Indicator_Right_35 1 "TRUE" 0 "FALSE" ;
VAL_ 154 OBJ_Turn_Indicator_Left_35 1 "TRUE" 0 "FALSE" ;
VAL_ 154 OBJ_Light_Indicator_Validity_35 1 "TRUE" 0 "FALSE" ;
VAL_ 154 OBJ_Right_Out_Of_Image_35 1 "TRUE" 0 "FALSE" ;
VAL_ 154 OBJ_Left_Out_Of_Image_35 1 "TRUE" 0 "FALSE" ;
VAL_ 154 OBJ_Right_Out_Of_Image_V_35 1 "TRUE" 0 "FALSE" ;
VAL_ 154 OBJ_Left_Out_Of_Image_V_35 1 "TRUE" 0 "FALSE" ;
VAL_ 154 OBJ_Top_Out_Of_Image_35 1 "TRUE" 0 "FALSE" ;
VAL_ 154 OBJ_Bottom_Out_Of_Image_35 1 "TRUE" 0 "FALSE" ;
VAL_ 154 OBJ_Top_Out_Of_Image_V_35 1 "VALID" 0 "INVALID" ;
VAL_ 154 OBJ_Bottom_Out_Of_Image_V_35 1 "VALID" 0 "INVALID" ;
VAL_ 154 OBJ_Lane_Assignment_35 5 "RIGHT_RIGHT" 4 "RIGHT" 3 "HOST" 2 "LEFT" 1 "LEFT_LEFT" 0 "UNKNOWN" ;
VAL_ 154 OBJ_Lane_Assignment_V_35 1 "VALID" 0 "INVALID" ;
VAL_ 154 OBJ_Age_Seconds_V_35 1 "VALID" 0 "INVALID" ;
VAL_ 154 OBJ_Width_V_35 1 "VALID" 0 "INVALID" ;
VAL_ 154 OBJ_Width_STD_V_35 1 "VALID" 0 "INVALID" ;
VAL_ 154 OBJ_Length_V_35 1 "VALID" 0 "INVALID" ;
VAL_ 154 OBJ_Length_STD_V_35 1 "VALID" 0 "INVALID" ;
VAL_ 154 OBJ_Height_V_35 1 "VALID" 0 "INVALID" ;
VAL_ 154 OBJ_Height_STD_V_35 1 "VALID" 0 "INVALID" ;
VAL_ 154 OBJ_Abs_Long_Velocity_V_35 1 "VALID" 0 "INVALID" ;
VAL_ 154 OBJ_Abs_Long_Vel_STD_V_35 1 "VALID" 0 "INVALID" ;
VAL_ 154 OBJ_Abs_Lat_Velocity_V_35 1 "VALID" 0 "INVALID" ;
VAL_ 154 OBJ_Abs_Lat_Vel_STD_V_35 1 "VALID" 0 "INVALID" ;
VAL_ 154 OBJ_Abs_Long_Acc_V_35 1 "VALID" 0 "INVALID" ;
VAL_ 154 OBJ_Abs_Long_Acc_STD_V_35 1 "VALID" 0 "INVALID" ;
VAL_ 154 OBJ_Abs_Lat_Acc_V_35 1 "VALID" 0 "INVALID" ;
VAL_ 154 OBJ_Abs_Lat_Acc_STD_V_35 1 "VALID" 0 "INVALID" ;
VAL_ 154 OBJ_Abs_Acceleration_V_35 1 "VALID" 0 "INVALID" ;
VAL_ 154 OBJ_Abs_Acc_STD_V_35 1 "VALID" 0 "INVALID" ;
VAL_ 154 OBJ_Inv_TTC_V_35 1 "VALID" 0 "INVALID" ;
VAL_ 154 OBJ_Inv_TTC_STD_V_35 1 "VALID" 0 "INVALID" ;
VAL_ 154 OBJ_Relative_Long_Acc_V_35 1 "VALID" 0 "INVALID" ;
VAL_ 154 OBJ_Rel_Long_Acc_STD_V_35 1 "VALID" 0 "INVALID" ;
VAL_ 154 OBJ_Relative_Long_Velocity_V_35 1 "VALID" 0 "INVALID" ;
VAL_ 154 OBJ_Rel_Long_Vel_STD_V_35 1 "VALID" 0 "INVALID" ;
VAL_ 154 OBJ_Relative_Lat_Velocity_V_35 1 "VALID" 0 "INVALID" ;
VAL_ 154 OBJ_Rel_Lat_Vel_STD_V_35 1 "VALID" 0 "INVALID" ;
VAL_ 154 OBJ_Long_Distance_V_35 1 "VALID" 0 "INVALID" ;
VAL_ 154 OBJ_Long_Distance_STD_V_35 1 "VALID" 0 "INVALID" ;
VAL_ 154 OBJ_Lat_Distance_V_35 1 "VALID" 0 "INVALID" ;
VAL_ 154 OBJ_Lat_Distance_STD_V_35 1 "VALID" 0 "INVALID" ;
VAL_ 154 OBJ_Absolute_Speed_V_35 1 "VALID" 0 "INVALID" ;
VAL_ 154 OBJ_Absolute_Speed_STD_V_35 1 "VALID" 0 "INVALID" ;
VAL_ 154 OBJ_Heading_V_35 1 "VALID" 0 "INVALID" ;
VAL_ 154 OBJ_Heading_STD_V_35 1 "VALID" 0 "INVALID" ;
VAL_ 154 OBJ_Angle_Rate_STD_V_35 1 "VALID" 0 "INVALID" ;
VAL_ 154 OBJ_Angle_Rate_V_35 1 "VALID" 0 "INVALID" ;
VAL_ 154 OBJ_Angle_Right_V_35 1 "VALID" 0 "INVALID" ;
VAL_ 154 OBJ_Angle_Right_STD_V_35 1 "VALID" 0 "INVALID" ;
VAL_ 154 OBJ_Angle_Left_V_35 1 "VALID" 0 "INVALID" ;
VAL_ 154 OBJ_Angle_Left_STD_V_35 1 "VALID" 0 "INVALID" ;
VAL_ 154 OBJ_Angle_Side_V_35 1 "VALID" 0 "INVALID" ;
VAL_ 154 OBJ_Angle_Side_STD_V_35 1 "VALID" 0 "INVALID" ;
VAL_ 154 OBJ_Angle_Mid_V_35 1 "VALID" 0 "INVALID" ;
VAL_ 154 OBJ_Angle_Mid_STD_V_35 1 "VALID" 0 "INVALID" ;
VAL_ 154 OBJ_Angle_Bottom_V_35 1 "VALID" 0 "INVALID" ;
VAL_ 154 OBJ_Angle_Bottom_STD_V_35 1 "VALID" 0 "INVALID" ;
VAL_ 154 OBJ_Visibility_Side_V_35 1 "VALID" 0 "INVALID" ;
VAL_ 154 OBJ_Visibility_Side_35 2 "REAR" 1 "FRONT" 0 "NOT_VISIBLE" ;
VAL_ 154 OBJ_Is_In_Drivable_Area_35 1 "TRUE" 0 "FALSE" ;
VAL_ 154 OBJ_Is_In_Drivable_Area_V_35 1 "VALID" 0 "INVALID" ;
VAL_ 154 OBJ_Is_VeryClose_V_35 1 "VALID" 0 "INVALID" ;
VAL_ 154 OBJ_Is_VeryClose_35 1 "TRUE" 0 "FALSE" ;
VAL_ 154 OBJ_OverlapAngleEgoLaneR_V_35 1 "VALID" 0 "INVALID" ;
VAL_ 154 OBJ_OverlapAngleEgoLaneL_V_35 1 "VALID" 0 "INVALID" ;
VAL_ 154 OBJ_Is_EMERGENCY_VCL_35 1 "TRUE" 0 "FALSE" ;
VAL_ 154 OBJ_EMERGENCY_LIGHT_COLOR_35 3 "(1000)ORANGE" 2 "(0100)BLUE" 1 "(0010)RED" 0 "(0001)OTHER" ;
VAL_ 154 OBJ_EMERGENCY_V_35 1 "TRUE" 0 "FALSE" ;
VAL_ 154 OBJ_Angle_Top_V_35 1 "VALID" 0 "INVALID" ;
VAL_ 154 OBJ_Angle_Top_STD_V_35 1 "VALID" 0 "INVALID" ;
VAL_ 154 OBJ_Fusion_Source_36 2 "(BIT_2)RADAR2" 1 "(BIT_1)RADAR1" 0 "(BIT_0)CAMERA" ;
VAL_ 154 OBJ_Triggered_SDM_36 2 "NOT_TRIGGERED" 1 "TRIGGERED" 0 "NOT_AVAILABLE" ;
VAL_ 154 OBJ_Motion_Category_36 13 "ONCOMING" 12 "PRECEEDING" 11 "MOVING" 10 "RTAP" 9 "LTAP" 8 "CROSSING" 7 "MOVING_OUT" 6 "MOVING_IN" 5 "CLOSE_CUT_IN" 4 "PASSING_OUT" 3 "PASSING_IN" 2 "PASSING" 1 "UNDEFINED" 0 "UNFILLED" ;
VAL_ 154 OBJ_Measuring_Status_36 2 "(BIT_2)NOT_VALID_OR_VALID" 1 "(BIT_1)PREDICTED_OR_MEASURED" 0 "(BIT_0)OLD_OR_NEW" ;
VAL_ 154 OBJ_Object_Class_36 8 "UNCERTAIN_VCL" 7 "ANIMAL" 6 "GENERAL_OBJECT" 5 "PEDESTRIAN" 4 "BICYCLE" 3 "MOTORBIKE" 2 "TRUCK" 1 "CAR" 0 "UNFILLED" ;
VAL_ 154 OBJ_Camera_Source_36 11 "PARKING_RIGHT" 10 "PARKING_LEFT" 9 "PARKING_REAR" 8 "PARKING_FRONT" 7 "FRONT_CORNER_RIGHT" 6 "FRONT_CORNER_LEFT" 5 "REAR_CORNER_RIGHT" 4 "REAR_CORNER_LEFT" 3 "REAR" 2 "FRONT_FISHEYE" 1 "FRONT_NARROW" 0 "FRONT_MAIN" ;
VAL_ 154 OBJ_Motion_Status_36 5 "MOVING_SLOWLY" 4 "STOPPED" 3 "STATIONARY" 2 "MOVING" 1 "UNKNOWN" 0 "INVALID" ;
VAL_ 154 OBJ_Motion_Orientation_36 13 "INVALID" 12 "NORTH" 11 "NORTH_WEST" 9 "WEST" 7 "SOUTH_WEST" 6 "SOUTH" 5 "SOUTH_EAST" 3 "EAST" 1 "NORTH_EAST" 0 "UNKNOWN" ;
VAL_ 154 OBJ_Has_Cut_Lane_36 1 "TRUE" 0 "FALSE" ;
VAL_ 154 OBJ_Has_Cut_Path_36 1 "TRUE" 0 "FALSE" ;
VAL_ 154 OBJ_Brake_Light_36 1 "TRUE" 0 "FALSE" ;
VAL_ 154 OBJ_Turn_Indicator_Right_36 1 "TRUE" 0 "FALSE" ;
VAL_ 154 OBJ_Turn_Indicator_Left_36 1 "TRUE" 0 "FALSE" ;
VAL_ 154 OBJ_Light_Indicator_Validity_36 1 "TRUE" 0 "FALSE" ;
VAL_ 154 OBJ_Right_Out_Of_Image_36 1 "TRUE" 0 "FALSE" ;
VAL_ 154 OBJ_Left_Out_Of_Image_36 1 "TRUE" 0 "FALSE" ;
VAL_ 154 OBJ_Right_Out_Of_Image_V_36 1 "TRUE" 0 "FALSE" ;
VAL_ 154 OBJ_Left_Out_Of_Image_V_36 1 "TRUE" 0 "FALSE" ;
VAL_ 154 OBJ_Top_Out_Of_Image_36 1 "TRUE" 0 "FALSE" ;
VAL_ 154 OBJ_Bottom_Out_Of_Image_36 1 "TRUE" 0 "FALSE" ;
VAL_ 154 OBJ_Top_Out_Of_Image_V_36 1 "VALID" 0 "INVALID" ;
VAL_ 154 OBJ_Bottom_Out_Of_Image_V_36 1 "VALID" 0 "INVALID" ;
VAL_ 154 OBJ_Lane_Assignment_36 5 "RIGHT_RIGHT" 4 "RIGHT" 3 "HOST" 2 "LEFT" 1 "LEFT_LEFT" 0 "UNKNOWN" ;
VAL_ 154 OBJ_Lane_Assignment_V_36 1 "VALID" 0 "INVALID" ;
VAL_ 154 OBJ_Age_Seconds_V_36 1 "VALID" 0 "INVALID" ;
VAL_ 154 OBJ_Width_V_36 1 "VALID" 0 "INVALID" ;
VAL_ 154 OBJ_Width_STD_V_36 1 "VALID" 0 "INVALID" ;
VAL_ 154 OBJ_Length_V_36 1 "VALID" 0 "INVALID" ;
VAL_ 154 OBJ_Length_STD_V_36 1 "VALID" 0 "INVALID" ;
VAL_ 154 OBJ_Height_V_36 1 "VALID" 0 "INVALID" ;
VAL_ 154 OBJ_Height_STD_V_36 1 "VALID" 0 "INVALID" ;
VAL_ 154 OBJ_Abs_Long_Velocity_V_36 1 "VALID" 0 "INVALID" ;
VAL_ 154 OBJ_Abs_Long_Vel_STD_V_36 1 "VALID" 0 "INVALID" ;
VAL_ 154 OBJ_Abs_Lat_Velocity_V_36 1 "VALID" 0 "INVALID" ;
VAL_ 154 OBJ_Abs_Lat_Vel_STD_V_36 1 "VALID" 0 "INVALID" ;
VAL_ 154 OBJ_Abs_Long_Acc_V_36 1 "VALID" 0 "INVALID" ;
VAL_ 154 OBJ_Abs_Long_Acc_STD_V_36 1 "VALID" 0 "INVALID" ;
VAL_ 154 OBJ_Abs_Lat_Acc_V_36 1 "VALID" 0 "INVALID" ;
VAL_ 154 OBJ_Abs_Lat_Acc_STD_V_36 1 "VALID" 0 "INVALID" ;
VAL_ 154 OBJ_Abs_Acceleration_V_36 1 "VALID" 0 "INVALID" ;
VAL_ 154 OBJ_Abs_Acc_STD_V_36 1 "VALID" 0 "INVALID" ;
VAL_ 154 OBJ_Inv_TTC_V_36 1 "VALID" 0 "INVALID" ;
VAL_ 154 OBJ_Inv_TTC_STD_V_36 1 "VALID" 0 "INVALID" ;
VAL_ 154 OBJ_Relative_Long_Acc_V_36 1 "VALID" 0 "INVALID" ;
VAL_ 154 OBJ_Rel_Long_Acc_STD_V_36 1 "VALID" 0 "INVALID" ;
VAL_ 154 OBJ_Relative_Long_Velocity_V_36 1 "VALID" 0 "INVALID" ;
VAL_ 154 OBJ_Rel_Long_Vel_STD_V_36 1 "VALID" 0 "INVALID" ;
VAL_ 154 OBJ_Relative_Lat_Velocity_V_36 1 "VALID" 0 "INVALID" ;
VAL_ 154 OBJ_Rel_Lat_Vel_STD_V_36 1 "VALID" 0 "INVALID" ;
VAL_ 154 OBJ_Long_Distance_V_36 1 "VALID" 0 "INVALID" ;
VAL_ 154 OBJ_Long_Distance_STD_V_36 1 "VALID" 0 "INVALID" ;
VAL_ 154 OBJ_Lat_Distance_V_36 1 "VALID" 0 "INVALID" ;
VAL_ 154 OBJ_Lat_Distance_STD_V_36 1 "VALID" 0 "INVALID" ;
VAL_ 154 OBJ_Absolute_Speed_V_36 1 "VALID" 0 "INVALID" ;
VAL_ 154 OBJ_Absolute_Speed_STD_V_36 1 "VALID" 0 "INVALID" ;
VAL_ 154 OBJ_Heading_V_36 1 "VALID" 0 "INVALID" ;
VAL_ 154 OBJ_Heading_STD_V_36 1 "VALID" 0 "INVALID" ;
VAL_ 154 OBJ_Angle_Rate_STD_V_36 1 "VALID" 0 "INVALID" ;
VAL_ 154 OBJ_Angle_Rate_V_36 1 "VALID" 0 "INVALID" ;
VAL_ 154 OBJ_Angle_Right_V_36 1 "VALID" 0 "INVALID" ;
VAL_ 154 OBJ_Angle_Right_STD_V_36 1 "VALID" 0 "INVALID" ;
VAL_ 154 OBJ_Angle_Left_V_36 1 "VALID" 0 "INVALID" ;
VAL_ 154 OBJ_Angle_Left_STD_V_36 1 "VALID" 0 "INVALID" ;
VAL_ 154 OBJ_Angle_Side_V_36 1 "VALID" 0 "INVALID" ;
VAL_ 154 OBJ_Angle_Side_STD_V_36 1 "VALID" 0 "INVALID" ;
VAL_ 154 OBJ_Angle_Mid_V_36 1 "VALID" 0 "INVALID" ;
VAL_ 154 OBJ_Angle_Mid_STD_V_36 1 "VALID" 0 "INVALID" ;
VAL_ 154 OBJ_Angle_Bottom_V_36 1 "VALID" 0 "INVALID" ;
VAL_ 154 OBJ_Angle_Bottom_STD_V_36 1 "VALID" 0 "INVALID" ;
VAL_ 154 OBJ_Visibility_Side_V_36 1 "VALID" 0 "INVALID" ;
VAL_ 154 OBJ_Visibility_Side_36 2 "REAR" 1 "FRONT" 0 "NOT_VISIBLE" ;
VAL_ 154 OBJ_Is_In_Drivable_Area_36 1 "TRUE" 0 "FALSE" ;
VAL_ 154 OBJ_Is_In_Drivable_Area_V_36 1 "VALID" 0 "INVALID" ;
VAL_ 154 OBJ_Is_VeryClose_V_36 1 "VALID" 0 "INVALID" ;
VAL_ 154 OBJ_Is_VeryClose_36 1 "TRUE" 0 "FALSE" ;
VAL_ 154 OBJ_OverlapAngleEgoLaneR_V_36 1 "VALID" 0 "INVALID" ;
VAL_ 154 OBJ_OverlapAngleEgoLaneL_V_36 1 "VALID" 0 "INVALID" ;
VAL_ 154 OBJ_Is_EMERGENCY_VCL_36 1 "TRUE" 0 "FALSE" ;
VAL_ 154 OBJ_EMERGENCY_LIGHT_COLOR_36 3 "(1000)ORANGE" 2 "(0100)BLUE" 1 "(0010)RED" 0 "(0001)OTHER" ;
VAL_ 154 OBJ_EMERGENCY_V_36 1 "TRUE" 0 "FALSE" ;
VAL_ 154 OBJ_Angle_Top_V_36 1 "VALID" 0 "INVALID" ;
VAL_ 154 OBJ_Angle_Top_STD_V_36 1 "VALID" 0 "INVALID" ;
VAL_ 154 OBJ_Fusion_Source_37 2 "(BIT_2)RADAR2" 1 "(BIT_1)RADAR1" 0 "(BIT_0)CAMERA" ;
VAL_ 154 OBJ_Triggered_SDM_37 2 "NOT_TRIGGERED" 1 "TRIGGERED" 0 "NOT_AVAILABLE" ;
VAL_ 154 OBJ_Motion_Category_37 13 "ONCOMING" 12 "PRECEEDING" 11 "MOVING" 10 "RTAP" 9 "LTAP" 8 "CROSSING" 7 "MOVING_OUT" 6 "MOVING_IN" 5 "CLOSE_CUT_IN" 4 "PASSING_OUT" 3 "PASSING_IN" 2 "PASSING" 1 "UNDEFINED" 0 "UNFILLED" ;
VAL_ 154 OBJ_Measuring_Status_37 2 "(BIT_2)NOT_VALID_OR_VALID" 1 "(BIT_1)PREDICTED_OR_MEASURED" 0 "(BIT_0)OLD_OR_NEW" ;
VAL_ 154 OBJ_Object_Class_37 8 "UNCERTAIN_VCL" 7 "ANIMAL" 6 "GENERAL_OBJECT" 5 "PEDESTRIAN" 4 "BICYCLE" 3 "MOTORBIKE" 2 "TRUCK" 1 "CAR" 0 "UNFILLED" ;
VAL_ 154 OBJ_Camera_Source_37 11 "PARKING_RIGHT" 10 "PARKING_LEFT" 9 "PARKING_REAR" 8 "PARKING_FRONT" 7 "FRONT_CORNER_RIGHT" 6 "FRONT_CORNER_LEFT" 5 "REAR_CORNER_RIGHT" 4 "REAR_CORNER_LEFT" 3 "REAR" 2 "FRONT_FISHEYE" 1 "FRONT_NARROW" 0 "FRONT_MAIN" ;
VAL_ 154 OBJ_Motion_Status_37 5 "MOVING_SLOWLY" 4 "STOPPED" 3 "STATIONARY" 2 "MOVING" 1 "UNKNOWN" 0 "INVALID" ;
VAL_ 154 OBJ_Motion_Orientation_37 13 "INVALID" 12 "NORTH" 11 "NORTH_WEST" 9 "WEST" 7 "SOUTH_WEST" 6 "SOUTH" 5 "SOUTH_EAST" 3 "EAST" 1 "NORTH_EAST" 0 "UNKNOWN" ;
VAL_ 154 OBJ_Has_Cut_Lane_37 1 "TRUE" 0 "FALSE" ;
VAL_ 154 OBJ_Has_Cut_Path_37 1 "TRUE" 0 "FALSE" ;
VAL_ 154 OBJ_Brake_Light_37 1 "TRUE" 0 "FALSE" ;
VAL_ 154 OBJ_Turn_Indicator_Right_37 1 "TRUE" 0 "FALSE" ;
VAL_ 154 OBJ_Turn_Indicator_Left_37 1 "TRUE" 0 "FALSE" ;
VAL_ 154 OBJ_Light_Indicator_Validity_37 1 "TRUE" 0 "FALSE" ;
VAL_ 154 OBJ_Right_Out_Of_Image_37 1 "TRUE" 0 "FALSE" ;
VAL_ 154 OBJ_Left_Out_Of_Image_37 1 "TRUE" 0 "FALSE" ;
VAL_ 154 OBJ_Right_Out_Of_Image_V_37 1 "TRUE" 0 "FALSE" ;
VAL_ 154 OBJ_Left_Out_Of_Image_V_37 1 "TRUE" 0 "FALSE" ;
VAL_ 154 OBJ_Top_Out_Of_Image_37 1 "TRUE" 0 "FALSE" ;
VAL_ 154 OBJ_Bottom_Out_Of_Image_37 1 "TRUE" 0 "FALSE" ;
VAL_ 154 OBJ_Top_Out_Of_Image_V_37 1 "VALID" 0 "INVALID" ;
VAL_ 154 OBJ_Bottom_Out_Of_Image_V_37 1 "VALID" 0 "INVALID" ;
VAL_ 154 OBJ_Lane_Assignment_37 5 "RIGHT_RIGHT" 4 "RIGHT" 3 "HOST" 2 "LEFT" 1 "LEFT_LEFT" 0 "UNKNOWN" ;
VAL_ 154 OBJ_Lane_Assignment_V_37 1 "VALID" 0 "INVALID" ;
VAL_ 154 OBJ_Age_Seconds_V_37 1 "VALID" 0 "INVALID" ;
VAL_ 154 OBJ_Width_V_37 1 "VALID" 0 "INVALID" ;
VAL_ 154 OBJ_Width_STD_V_37 1 "VALID" 0 "INVALID" ;
VAL_ 154 OBJ_Length_V_37 1 "VALID" 0 "INVALID" ;
VAL_ 154 OBJ_Length_STD_V_37 1 "VALID" 0 "INVALID" ;
VAL_ 154 OBJ_Height_V_37 1 "VALID" 0 "INVALID" ;
VAL_ 154 OBJ_Height_STD_V_37 1 "VALID" 0 "INVALID" ;
VAL_ 154 OBJ_Abs_Long_Velocity_V_37 1 "VALID" 0 "INVALID" ;
VAL_ 154 OBJ_Abs_Long_Vel_STD_V_37 1 "VALID" 0 "INVALID" ;
VAL_ 154 OBJ_Abs_Lat_Velocity_V_37 1 "VALID" 0 "INVALID" ;
VAL_ 154 OBJ_Abs_Lat_Vel_STD_V_37 1 "VALID" 0 "INVALID" ;
VAL_ 154 OBJ_Abs_Long_Acc_V_37 1 "VALID" 0 "INVALID" ;
VAL_ 154 OBJ_Abs_Long_Acc_STD_V_37 1 "VALID" 0 "INVALID" ;
VAL_ 154 OBJ_Abs_Lat_Acc_V_37 1 "VALID" 0 "INVALID" ;
VAL_ 154 OBJ_Abs_Lat_Acc_STD_V_37 1 "VALID" 0 "INVALID" ;
VAL_ 154 OBJ_Abs_Acceleration_V_37 1 "VALID" 0 "INVALID" ;
VAL_ 154 OBJ_Abs_Acc_STD_V_37 1 "VALID" 0 "INVALID" ;
VAL_ 154 OBJ_Inv_TTC_V_37 1 "VALID" 0 "INVALID" ;
VAL_ 154 OBJ_Inv_TTC_STD_V_37 1 "VALID" 0 "INVALID" ;
VAL_ 154 OBJ_Relative_Long_Acc_V_37 1 "VALID" 0 "INVALID" ;
VAL_ 154 OBJ_Rel_Long_Acc_STD_V_37 1 "VALID" 0 "INVALID" ;
VAL_ 154 OBJ_Relative_Long_Velocity_V_37 1 "VALID" 0 "INVALID" ;
VAL_ 154 OBJ_Rel_Long_Vel_STD_V_37 1 "VALID" 0 "INVALID" ;
VAL_ 154 OBJ_Relative_Lat_Velocity_V_37 1 "VALID" 0 "INVALID" ;
VAL_ 154 OBJ_Rel_Lat_Vel_STD_V_37 1 "VALID" 0 "INVALID" ;
VAL_ 154 OBJ_Long_Distance_V_37 1 "VALID" 0 "INVALID" ;
VAL_ 154 OBJ_Long_Distance_STD_V_37 1 "VALID" 0 "INVALID" ;
VAL_ 154 OBJ_Lat_Distance_V_37 1 "VALID" 0 "INVALID" ;
VAL_ 154 OBJ_Lat_Distance_STD_V_37 1 "VALID" 0 "INVALID" ;
VAL_ 154 OBJ_Absolute_Speed_V_37 1 "VALID" 0 "INVALID" ;
VAL_ 154 OBJ_Absolute_Speed_STD_V_37 1 "VALID" 0 "INVALID" ;
VAL_ 154 OBJ_Heading_V_37 1 "VALID" 0 "INVALID" ;
VAL_ 154 OBJ_Heading_STD_V_37 1 "VALID" 0 "INVALID" ;
VAL_ 154 OBJ_Angle_Rate_STD_V_37 1 "VALID" 0 "INVALID" ;
VAL_ 154 OBJ_Angle_Rate_V_37 1 "VALID" 0 "INVALID" ;
VAL_ 154 OBJ_Angle_Right_V_37 1 "VALID" 0 "INVALID" ;
VAL_ 154 OBJ_Angle_Right_STD_V_37 1 "VALID" 0 "INVALID" ;
VAL_ 154 OBJ_Angle_Left_V_37 1 "VALID" 0 "INVALID" ;
VAL_ 154 OBJ_Angle_Left_STD_V_37 1 "VALID" 0 "INVALID" ;
VAL_ 154 OBJ_Angle_Side_V_37 1 "VALID" 0 "INVALID" ;
VAL_ 154 OBJ_Angle_Side_STD_V_37 1 "VALID" 0 "INVALID" ;
VAL_ 154 OBJ_Angle_Mid_V_37 1 "VALID" 0 "INVALID" ;
VAL_ 154 OBJ_Angle_Mid_STD_V_37 1 "VALID" 0 "INVALID" ;
VAL_ 154 OBJ_Angle_Bottom_V_37 1 "VALID" 0 "INVALID" ;
VAL_ 154 OBJ_Angle_Bottom_STD_V_37 1 "VALID" 0 "INVALID" ;
VAL_ 154 OBJ_Visibility_Side_V_37 1 "VALID" 0 "INVALID" ;
VAL_ 154 OBJ_Visibility_Side_37 2 "REAR" 1 "FRONT" 0 "NOT_VISIBLE" ;
VAL_ 154 OBJ_Is_In_Drivable_Area_37 1 "TRUE" 0 "FALSE" ;
VAL_ 154 OBJ_Is_In_Drivable_Area_V_37 1 "VALID" 0 "INVALID" ;
VAL_ 154 OBJ_Is_VeryClose_V_37 1 "VALID" 0 "INVALID" ;
VAL_ 154 OBJ_Is_VeryClose_37 1 "TRUE" 0 "FALSE" ;
VAL_ 154 OBJ_OverlapAngleEgoLaneR_V_37 1 "VALID" 0 "INVALID" ;
VAL_ 154 OBJ_OverlapAngleEgoLaneL_V_37 1 "VALID" 0 "INVALID" ;
VAL_ 154 OBJ_Is_EMERGENCY_VCL_37 1 "TRUE" 0 "FALSE" ;
VAL_ 154 OBJ_EMERGENCY_LIGHT_COLOR_37 3 "(1000)ORANGE" 2 "(0100)BLUE" 1 "(0010)RED" 0 "(0001)OTHER" ;
VAL_ 154 OBJ_EMERGENCY_V_37 1 "TRUE" 0 "FALSE" ;
VAL_ 154 OBJ_Angle_Top_V_37 1 "VALID" 0 "INVALID" ;
VAL_ 154 OBJ_Angle_Top_STD_V_37 1 "VALID" 0 "INVALID" ;
VAL_ 154 OBJ_Fusion_Source_38 2 "(BIT_2)RADAR2" 1 "(BIT_1)RADAR1" 0 "(BIT_0)CAMERA" ;
VAL_ 154 OBJ_Triggered_SDM_38 2 "NOT_TRIGGERED" 1 "TRIGGERED" 0 "NOT_AVAILABLE" ;
VAL_ 154 OBJ_Motion_Category_38 13 "ONCOMING" 12 "PRECEEDING" 11 "MOVING" 10 "RTAP" 9 "LTAP" 8 "CROSSING" 7 "MOVING_OUT" 6 "MOVING_IN" 5 "CLOSE_CUT_IN" 4 "PASSING_OUT" 3 "PASSING_IN" 2 "PASSING" 1 "UNDEFINED" 0 "UNFILLED" ;
VAL_ 154 OBJ_Measuring_Status_38 2 "(BIT_2)NOT_VALID_OR_VALID" 1 "(BIT_1)PREDICTED_OR_MEASURED" 0 "(BIT_0)OLD_OR_NEW" ;
VAL_ 154 OBJ_Object_Class_38 8 "UNCERTAIN_VCL" 7 "ANIMAL" 6 "GENERAL_OBJECT" 5 "PEDESTRIAN" 4 "BICYCLE" 3 "MOTORBIKE" 2 "TRUCK" 1 "CAR" 0 "UNFILLED" ;
VAL_ 154 OBJ_Camera_Source_38 11 "PARKING_RIGHT" 10 "PARKING_LEFT" 9 "PARKING_REAR" 8 "PARKING_FRONT" 7 "FRONT_CORNER_RIGHT" 6 "FRONT_CORNER_LEFT" 5 "REAR_CORNER_RIGHT" 4 "REAR_CORNER_LEFT" 3 "REAR" 2 "FRONT_FISHEYE" 1 "FRONT_NARROW" 0 "FRONT_MAIN" ;
VAL_ 154 OBJ_Motion_Status_38 5 "MOVING_SLOWLY" 4 "STOPPED" 3 "STATIONARY" 2 "MOVING" 1 "UNKNOWN" 0 "INVALID" ;
VAL_ 154 OBJ_Motion_Orientation_38 13 "INVALID" 12 "NORTH" 11 "NORTH_WEST" 9 "WEST" 7 "SOUTH_WEST" 6 "SOUTH" 5 "SOUTH_EAST" 3 "EAST" 1 "NORTH_EAST" 0 "UNKNOWN" ;
VAL_ 154 OBJ_Has_Cut_Lane_38 1 "TRUE" 0 "FALSE" ;
VAL_ 154 OBJ_Has_Cut_Path_38 1 "TRUE" 0 "FALSE" ;
VAL_ 154 OBJ_Brake_Light_38 1 "TRUE" 0 "FALSE" ;
VAL_ 154 OBJ_Turn_Indicator_Right_38 1 "TRUE" 0 "FALSE" ;
VAL_ 154 OBJ_Turn_Indicator_Left_38 1 "TRUE" 0 "FALSE" ;
VAL_ 154 OBJ_Light_Indicator_Validity_38 1 "TRUE" 0 "FALSE" ;
VAL_ 154 OBJ_Right_Out_Of_Image_38 1 "TRUE" 0 "FALSE" ;
VAL_ 154 OBJ_Left_Out_Of_Image_38 1 "TRUE" 0 "FALSE" ;
VAL_ 154 OBJ_Right_Out_Of_Image_V_38 1 "TRUE" 0 "FALSE" ;
VAL_ 154 OBJ_Left_Out_Of_Image_V_38 1 "TRUE" 0 "FALSE" ;
VAL_ 154 OBJ_Top_Out_Of_Image_38 1 "TRUE" 0 "FALSE" ;
VAL_ 154 OBJ_Bottom_Out_Of_Image_38 1 "TRUE" 0 "FALSE" ;
VAL_ 154 OBJ_Top_Out_Of_Image_V_38 1 "VALID" 0 "INVALID" ;
VAL_ 154 OBJ_Bottom_Out_Of_Image_V_38 1 "VALID" 0 "INVALID" ;
VAL_ 154 OBJ_Lane_Assignment_38 5 "RIGHT_RIGHT" 4 "RIGHT" 3 "HOST" 2 "LEFT" 1 "LEFT_LEFT" 0 "UNKNOWN" ;
VAL_ 154 OBJ_Lane_Assignment_V_38 1 "VALID" 0 "INVALID" ;
VAL_ 154 OBJ_Age_Seconds_V_38 1 "VALID" 0 "INVALID" ;
VAL_ 154 OBJ_Width_V_38 1 "VALID" 0 "INVALID" ;
VAL_ 154 OBJ_Width_STD_V_38 1 "VALID" 0 "INVALID" ;
VAL_ 154 OBJ_Length_V_38 1 "VALID" 0 "INVALID" ;
VAL_ 154 OBJ_Length_STD_V_38 1 "VALID" 0 "INVALID" ;
VAL_ 154 OBJ_Height_V_38 1 "VALID" 0 "INVALID" ;
VAL_ 154 OBJ_Height_STD_V_38 1 "VALID" 0 "INVALID" ;
VAL_ 154 OBJ_Abs_Long_Velocity_V_38 1 "VALID" 0 "INVALID" ;
VAL_ 154 OBJ_Abs_Long_Vel_STD_V_38 1 "VALID" 0 "INVALID" ;
VAL_ 154 OBJ_Abs_Lat_Velocity_V_38 1 "VALID" 0 "INVALID" ;
VAL_ 154 OBJ_Abs_Lat_Vel_STD_V_38 1 "VALID" 0 "INVALID" ;
VAL_ 154 OBJ_Abs_Long_Acc_V_38 1 "VALID" 0 "INVALID" ;
VAL_ 154 OBJ_Abs_Long_Acc_STD_V_38 1 "VALID" 0 "INVALID" ;
VAL_ 154 OBJ_Abs_Lat_Acc_V_38 1 "VALID" 0 "INVALID" ;
VAL_ 154 OBJ_Abs_Lat_Acc_STD_V_38 1 "VALID" 0 "INVALID" ;
VAL_ 154 OBJ_Abs_Acceleration_V_38 1 "VALID" 0 "INVALID" ;
VAL_ 154 OBJ_Abs_Acc_STD_V_38 1 "VALID" 0 "INVALID" ;
VAL_ 154 OBJ_Inv_TTC_V_38 1 "VALID" 0 "INVALID" ;
VAL_ 154 OBJ_Inv_TTC_STD_V_38 1 "VALID" 0 "INVALID" ;
VAL_ 154 OBJ_Relative_Long_Acc_V_38 1 "VALID" 0 "INVALID" ;
VAL_ 154 OBJ_Rel_Long_Acc_STD_V_38 1 "VALID" 0 "INVALID" ;
VAL_ 154 OBJ_Relative_Long_Velocity_V_38 1 "VALID" 0 "INVALID" ;
VAL_ 154 OBJ_Rel_Long_Vel_STD_V_38 1 "VALID" 0 "INVALID" ;
VAL_ 154 OBJ_Relative_Lat_Velocity_V_38 1 "VALID" 0 "INVALID" ;
VAL_ 154 OBJ_Rel_Lat_Vel_STD_V_38 1 "VALID" 0 "INVALID" ;
VAL_ 154 OBJ_Long_Distance_V_38 1 "VALID" 0 "INVALID" ;
VAL_ 154 OBJ_Long_Distance_STD_V_38 1 "VALID" 0 "INVALID" ;
VAL_ 154 OBJ_Lat_Distance_V_38 1 "VALID" 0 "INVALID" ;
VAL_ 154 OBJ_Lat_Distance_STD_V_38 1 "VALID" 0 "INVALID" ;
VAL_ 154 OBJ_Absolute_Speed_V_38 1 "VALID" 0 "INVALID" ;
VAL_ 154 OBJ_Absolute_Speed_STD_V_38 1 "VALID" 0 "INVALID" ;
VAL_ 154 OBJ_Heading_V_38 1 "VALID" 0 "INVALID" ;
VAL_ 154 OBJ_Heading_STD_V_38 1 "VALID" 0 "INVALID" ;
VAL_ 154 OBJ_Angle_Rate_STD_V_38 1 "VALID" 0 "INVALID" ;
VAL_ 154 OBJ_Angle_Rate_V_38 1 "VALID" 0 "INVALID" ;
VAL_ 154 OBJ_Angle_Right_V_38 1 "VALID" 0 "INVALID" ;
VAL_ 154 OBJ_Angle_Right_STD_V_38 1 "VALID" 0 "INVALID" ;
VAL_ 154 OBJ_Angle_Left_V_38 1 "VALID" 0 "INVALID" ;
VAL_ 154 OBJ_Angle_Left_STD_V_38 1 "VALID" 0 "INVALID" ;
VAL_ 154 OBJ_Angle_Side_V_38 1 "VALID" 0 "INVALID" ;
VAL_ 154 OBJ_Angle_Side_STD_V_38 1 "VALID" 0 "INVALID" ;
VAL_ 154 OBJ_Angle_Mid_V_38 1 "VALID" 0 "INVALID" ;
VAL_ 154 OBJ_Angle_Mid_STD_V_38 1 "VALID" 0 "INVALID" ;
VAL_ 154 OBJ_Angle_Bottom_V_38 1 "VALID" 0 "INVALID" ;
VAL_ 154 OBJ_Angle_Bottom_STD_V_38 1 "VALID" 0 "INVALID" ;
VAL_ 154 OBJ_Visibility_Side_V_38 1 "VALID" 0 "INVALID" ;
VAL_ 154 OBJ_Visibility_Side_38 2 "REAR" 1 "FRONT" 0 "NOT_VISIBLE" ;
VAL_ 154 OBJ_Is_In_Drivable_Area_38 1 "TRUE" 0 "FALSE" ;
VAL_ 154 OBJ_Is_In_Drivable_Area_V_38 1 "VALID" 0 "INVALID" ;
VAL_ 154 OBJ_Is_VeryClose_V_38 1 "VALID" 0 "INVALID" ;
VAL_ 154 OBJ_Is_VeryClose_38 1 "TRUE" 0 "FALSE" ;
VAL_ 154 OBJ_OverlapAngleEgoLaneR_V_38 1 "VALID" 0 "INVALID" ;
VAL_ 154 OBJ_OverlapAngleEgoLaneL_V_38 1 "VALID" 0 "INVALID" ;
VAL_ 154 OBJ_Is_EMERGENCY_VCL_38 1 "TRUE" 0 "FALSE" ;
VAL_ 154 OBJ_EMERGENCY_LIGHT_COLOR_38 3 "(1000)ORANGE" 2 "(0100)BLUE" 1 "(0010)RED" 0 "(0001)OTHER" ;
VAL_ 154 OBJ_EMERGENCY_V_38 1 "TRUE" 0 "FALSE" ;
VAL_ 154 OBJ_Angle_Top_V_38 1 "VALID" 0 "INVALID" ;
VAL_ 154 OBJ_Angle_Top_STD_V_38 1 "VALID" 0 "INVALID" ;
VAL_ 154 OBJ_Fusion_Source_39 2 "(BIT_2)RADAR2" 1 "(BIT_1)RADAR1" 0 "(BIT_0)CAMERA" ;
VAL_ 154 OBJ_Triggered_SDM_39 2 "NOT_TRIGGERED" 1 "TRIGGERED" 0 "NOT_AVAILABLE" ;
VAL_ 154 OBJ_Motion_Category_39 13 "ONCOMING" 12 "PRECEEDING" 11 "MOVING" 10 "RTAP" 9 "LTAP" 8 "CROSSING" 7 "MOVING_OUT" 6 "MOVING_IN" 5 "CLOSE_CUT_IN" 4 "PASSING_OUT" 3 "PASSING_IN" 2 "PASSING" 1 "UNDEFINED" 0 "UNFILLED" ;
VAL_ 154 OBJ_Measuring_Status_39 2 "(BIT_2)NOT_VALID_OR_VALID" 1 "(BIT_1)PREDICTED_OR_MEASURED" 0 "(BIT_0)OLD_OR_NEW" ;
VAL_ 154 OBJ_Object_Class_39 8 "UNCERTAIN_VCL" 7 "ANIMAL" 6 "GENERAL_OBJECT" 5 "PEDESTRIAN" 4 "BICYCLE" 3 "MOTORBIKE" 2 "TRUCK" 1 "CAR" 0 "UNFILLED" ;
VAL_ 154 OBJ_Camera_Source_39 11 "PARKING_RIGHT" 10 "PARKING_LEFT" 9 "PARKING_REAR" 8 "PARKING_FRONT" 7 "FRONT_CORNER_RIGHT" 6 "FRONT_CORNER_LEFT" 5 "REAR_CORNER_RIGHT" 4 "REAR_CORNER_LEFT" 3 "REAR" 2 "FRONT_FISHEYE" 1 "FRONT_NARROW" 0 "FRONT_MAIN" ;
VAL_ 154 OBJ_Motion_Status_39 5 "MOVING_SLOWLY" 4 "STOPPED" 3 "STATIONARY" 2 "MOVING" 1 "UNKNOWN" 0 "INVALID" ;
VAL_ 154 OBJ_Motion_Orientation_39 13 "INVALID" 12 "NORTH" 11 "NORTH_WEST" 9 "WEST" 7 "SOUTH_WEST" 6 "SOUTH" 5 "SOUTH_EAST" 3 "EAST" 1 "NORTH_EAST" 0 "UNKNOWN" ;
VAL_ 154 OBJ_Has_Cut_Lane_39 1 "TRUE" 0 "FALSE" ;
VAL_ 154 OBJ_Has_Cut_Path_39 1 "TRUE" 0 "FALSE" ;
VAL_ 154 OBJ_Brake_Light_39 1 "TRUE" 0 "FALSE" ;
VAL_ 154 OBJ_Turn_Indicator_Right_39 1 "TRUE" 0 "FALSE" ;
VAL_ 154 OBJ_Turn_Indicator_Left_39 1 "TRUE" 0 "FALSE" ;
VAL_ 154 OBJ_Light_Indicator_Validity_39 1 "TRUE" 0 "FALSE" ;
VAL_ 154 OBJ_Right_Out_Of_Image_39 1 "TRUE" 0 "FALSE" ;
VAL_ 154 OBJ_Left_Out_Of_Image_39 1 "TRUE" 0 "FALSE" ;
VAL_ 154 OBJ_Right_Out_Of_Image_V_39 1 "TRUE" 0 "FALSE" ;
VAL_ 154 OBJ_Left_Out_Of_Image_V_39 1 "TRUE" 0 "FALSE" ;
VAL_ 154 OBJ_Top_Out_Of_Image_39 1 "TRUE" 0 "FALSE" ;
VAL_ 154 OBJ_Bottom_Out_Of_Image_39 1 "TRUE" 0 "FALSE" ;
VAL_ 154 OBJ_Top_Out_Of_Image_V_39 1 "VALID" 0 "INVALID" ;
VAL_ 154 OBJ_Bottom_Out_Of_Image_V_39 1 "VALID" 0 "INVALID" ;
VAL_ 154 OBJ_Lane_Assignment_39 5 "RIGHT_RIGHT" 4 "RIGHT" 3 "HOST" 2 "LEFT" 1 "LEFT_LEFT" 0 "UNKNOWN" ;
VAL_ 154 OBJ_Lane_Assignment_V_39 1 "VALID" 0 "INVALID" ;
VAL_ 154 OBJ_Age_Seconds_V_39 1 "VALID" 0 "INVALID" ;
VAL_ 154 OBJ_Width_V_39 1 "VALID" 0 "INVALID" ;
VAL_ 154 OBJ_Width_STD_V_39 1 "VALID" 0 "INVALID" ;
VAL_ 154 OBJ_Length_V_39 1 "VALID" 0 "INVALID" ;
VAL_ 154 OBJ_Length_STD_V_39 1 "VALID" 0 "INVALID" ;
VAL_ 154 OBJ_Height_V_39 1 "VALID" 0 "INVALID" ;
VAL_ 154 OBJ_Height_STD_V_39 1 "VALID" 0 "INVALID" ;
VAL_ 154 OBJ_Abs_Long_Velocity_V_39 1 "VALID" 0 "INVALID" ;
VAL_ 154 OBJ_Abs_Long_Vel_STD_V_39 1 "VALID" 0 "INVALID" ;
VAL_ 154 OBJ_Abs_Lat_Velocity_V_39 1 "VALID" 0 "INVALID" ;
VAL_ 154 OBJ_Abs_Lat_Vel_STD_V_39 1 "VALID" 0 "INVALID" ;
VAL_ 154 OBJ_Abs_Long_Acc_V_39 1 "VALID" 0 "INVALID" ;
VAL_ 154 OBJ_Abs_Long_Acc_STD_V_39 1 "VALID" 0 "INVALID" ;
VAL_ 154 OBJ_Abs_Lat_Acc_V_39 1 "VALID" 0 "INVALID" ;
VAL_ 154 OBJ_Abs_Lat_Acc_STD_V_39 1 "VALID" 0 "INVALID" ;
VAL_ 154 OBJ_Abs_Acceleration_V_39 1 "VALID" 0 "INVALID" ;
VAL_ 154 OBJ_Abs_Acc_STD_V_39 1 "VALID" 0 "INVALID" ;
VAL_ 154 OBJ_Inv_TTC_V_39 1 "VALID" 0 "INVALID" ;
VAL_ 154 OBJ_Inv_TTC_STD_V_39 1 "VALID" 0 "INVALID" ;
VAL_ 154 OBJ_Relative_Long_Acc_V_39 1 "VALID" 0 "INVALID" ;
VAL_ 154 OBJ_Rel_Long_Acc_STD_V_39 1 "VALID" 0 "INVALID" ;
VAL_ 154 OBJ_Relative_Long_Velocity_V_39 1 "VALID" 0 "INVALID" ;
VAL_ 154 OBJ_Rel_Long_Vel_STD_V_39 1 "VALID" 0 "INVALID" ;
VAL_ 154 OBJ_Relative_Lat_Velocity_V_39 1 "VALID" 0 "INVALID" ;
VAL_ 154 OBJ_Rel_Lat_Vel_STD_V_39 1 "VALID" 0 "INVALID" ;
VAL_ 154 OBJ_Long_Distance_V_39 1 "VALID" 0 "INVALID" ;
VAL_ 154 OBJ_Long_Distance_STD_V_39 1 "VALID" 0 "INVALID" ;
VAL_ 154 OBJ_Lat_Distance_V_39 1 "VALID" 0 "INVALID" ;
VAL_ 154 OBJ_Lat_Distance_STD_V_39 1 "VALID" 0 "INVALID" ;
VAL_ 154 OBJ_Absolute_Speed_V_39 1 "VALID" 0 "INVALID" ;
VAL_ 154 OBJ_Absolute_Speed_STD_V_39 1 "VALID" 0 "INVALID" ;
VAL_ 154 OBJ_Heading_V_39 1 "VALID" 0 "INVALID" ;
VAL_ 154 OBJ_Heading_STD_V_39 1 "VALID" 0 "INVALID" ;
VAL_ 154 OBJ_Angle_Rate_STD_V_39 1 "VALID" 0 "INVALID" ;
VAL_ 154 OBJ_Angle_Rate_V_39 1 "VALID" 0 "INVALID" ;
VAL_ 154 OBJ_Angle_Right_V_39 1 "VALID" 0 "INVALID" ;
VAL_ 154 OBJ_Angle_Right_STD_V_39 1 "VALID" 0 "INVALID" ;
VAL_ 154 OBJ_Angle_Left_V_39 1 "VALID" 0 "INVALID" ;
VAL_ 154 OBJ_Angle_Left_STD_V_39 1 "VALID" 0 "INVALID" ;
VAL_ 154 OBJ_Angle_Side_V_39 1 "VALID" 0 "INVALID" ;
VAL_ 154 OBJ_Angle_Side_STD_V_39 1 "VALID" 0 "INVALID" ;
VAL_ 154 OBJ_Angle_Mid_V_39 1 "VALID" 0 "INVALID" ;
VAL_ 154 OBJ_Angle_Mid_STD_V_39 1 "VALID" 0 "INVALID" ;
VAL_ 154 OBJ_Angle_Bottom_V_39 1 "VALID" 0 "INVALID" ;
VAL_ 154 OBJ_Angle_Bottom_STD_V_39 1 "VALID" 0 "INVALID" ;
VAL_ 154 OBJ_Visibility_Side_V_39 1 "VALID" 0 "INVALID" ;
VAL_ 154 OBJ_Visibility_Side_39 2 "REAR" 1 "FRONT" 0 "NOT_VISIBLE" ;
VAL_ 154 OBJ_Is_In_Drivable_Area_39 1 "TRUE" 0 "FALSE" ;
VAL_ 154 OBJ_Is_In_Drivable_Area_V_39 1 "VALID" 0 "INVALID" ;
VAL_ 154 OBJ_Is_VeryClose_V_39 1 "VALID" 0 "INVALID" ;
VAL_ 154 OBJ_Is_VeryClose_39 1 "TRUE" 0 "FALSE" ;
VAL_ 154 OBJ_OverlapAngleEgoLaneR_V_39 1 "VALID" 0 "INVALID" ;
VAL_ 154 OBJ_OverlapAngleEgoLaneL_V_39 1 "VALID" 0 "INVALID" ;
VAL_ 154 OBJ_Is_EMERGENCY_VCL_39 1 "TRUE" 0 "FALSE" ;
VAL_ 154 OBJ_EMERGENCY_LIGHT_COLOR_39 3 "(1000)ORANGE" 2 "(0100)BLUE" 1 "(0010)RED" 0 "(0001)OTHER" ;
VAL_ 154 OBJ_EMERGENCY_V_39 1 "TRUE" 0 "FALSE" ;
VAL_ 154 OBJ_Angle_Top_V_39 1 "VALID" 0 "INVALID" ;
VAL_ 154 OBJ_Angle_Top_STD_V_39 1 "VALID" 0 "INVALID" ;
