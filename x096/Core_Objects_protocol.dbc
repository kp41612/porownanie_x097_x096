VERSION "14"
// BundelVersion=v4.20.10_RC1
NS_ :

BS_:

BU_: EyeQ4 MCU

BO_ 154 Core_Objects_protocol: 4660 EyeQ4
 SG_ OBJ_Has_Cut_Lane_23 : 21639|1@1+ (1,0) [0|1] "bool" MCU
 SG_ OBJ_Has_Cut_Path_23 : 21640|1@1+ (1,0) [0|1] "bool" MCU
 SG_ OBJ_Brake_Light_23 : 21641|1@1+ (1,0) [0|1] "bool" MCU
 SG_ OBJ_Turn_Indicator_Right_23 : 21642|1@1+ (1,0) [0|1] "bool" MCU
 SG_ OBJ_Turn_Indicator_Left_23 : 21643|1@1+ (1,0) [0|1] "bool" MCU
 SG_ OBJ_Light_Indicator_Validity_23 : 21644|1@1+ (1,0) [0|1] "bool" MCU
 SG_ OBJ_Right_Out_Of_Image_23 : 21645|1@1+ (1,0) [0|1] "bool" MCU
 SG_ OBJ_Left_Out_Of_Image_23 : 21646|1@1+ (1,0) [0|1] "bool" MCU
 SG_ OBJ_Right_Out_Of_Image_V_23 : 21647|1@1+ (1,0) [0|1] "bool" MCU
 SG_ OBJ_Left_Out_Of_Image_V_23 : 21648|1@1+ (1,0) [0|1] "bool" MCU
 SG_ OBJ_Top_Out_Of_Image_23 : 21649|1@1+ (1,0) [0|1] "bool" MCU
 SG_ OBJ_Bottom_Out_Of_Image_23 : 21650|1@1+ (1,0) [0|1] "bool" MCU
 SG_ OBJ_Top_Out_Of_Image_V_23 : 21651|1@1+ (1,0) [0|1] "bool" MCU
 SG_ OBJ_Bottom_Out_Of_Image_V_23 : 21652|1@1+ (1,0) [0|1] "bool" MCU
 SG_ OBJ_Lane_Assignment_23 : 21653|3@1+ (1,0) [0|5] "ENUM" MCU
 SG_ OBJ_Lane_Assignment_V_23 : 21656|1@1+ (1,0) [0|1] "bool" MCU
 SG_ OBJ_Age_Seconds_23 : 21657|7@1+ (1,0) [0|100] "s" MCU
 SG_ OBJ_Age_Seconds_V_23 : 21664|1@1+ (1,0) [0|1] "bool" MCU
 SG_ OBJ_Width_23 : 21665|9@1+ (0.01,0) [0.4|2.95] "m" MCU
 SG_ OBJ_Width_V_23 : 21674|1@1+ (1,0) [0|1] "bool" MCU
 SG_ OBJ_Width_STD_23 : 21675|11@1+ (0.001,0) [0|2] "m" MCU
 SG_ OBJ_Width_STD_V_23 : 21686|1@1+ (1,0) [0|1] "bool" MCU
 SG_ OBJ_Length_23 : 21687|9@1+ (0.05,0) [1.2|21] "m" MCU
 SG_ OBJ_Length_V_23 : 21696|1@1+ (1,0) [0|1] "bool" MCU
 SG_ OBJ_Length_STD_23 : 21697|10@1+ (0.01,0) [0|10] "m" MCU
 SG_ OBJ_Length_STD_V_23 : 21707|1@1+ (1,0) [0|1] "bool" MCU
 SG_ OBJ_Radar_ID_23 : 21708|8@1+ (1,0) [0|255] "counter" MCU
 SG_ OBJ_Height_23 : 21716|9@1+ (0.01,0) [0|2.95] "m" MCU
 SG_ OBJ_Height_V_23 : 21725|1@1+ (1,0) [0|1] "bool" MCU
 SG_ Reserved_5_23 : 21726|2@1+ (1,0) [0|0] "NA" MCU
 SG_ OBJ_Height_STD_23 : 21728|11@1+ (0.001,0) [0|2] "m" MCU
 SG_ OBJ_Height_STD_V_23 : 21739|1@1+ (1,0) [0|1] "bool" MCU
 SG_ OBJ_Abs_Long_Velocity_23 : 21740|12@1+ (0.05,-100) [-100|100] "m_per_s" MCU
 SG_ OBJ_Abs_Long_Velocity_V_23 : 21752|1@1+ (1,0) [0|1] "bool" MCU
 SG_ Reserved_6_23 : 21753|7@1+ (1,0) [0|0] "NA" MCU
 SG_ OBJ_Abs_Long_Velocity_STD_23 : 21760|13@1+ (0.01,0) [0|65] "m_per_s" MCU
 SG_ OBJ_Abs_Long_Vel_STD_V_23 : 21773|1@1+ (1,0) [0|1] "bool" MCU
 SG_ OBJ_Abs_Lat_Velocity_23 : 21774|11@1+ (0.05,-50) [-50|50] "m_per_s" MCU
 SG_ OBJ_Abs_Lat_Velocity_V_23 : 21785|1@1+ (1,0) [0|1] "bool" MCU
 SG_ Reserved_7_23 : 21786|6@1+ (1,0) [0|0] "NA" MCU
 SG_ OBJ_Abs_Lat_Velocity_STD_23 : 21792|13@1+ (0.01,0) [0|50] "m_per_s" MCU
 SG_ OBJ_Abs_Lat_Vel_STD_V_23 : 21805|1@1+ (1,0) [0|1] "bool" MCU
 SG_ OBJ_Abs_Long_Acc_23 : 21806|9@1+ (0.05,-10) [-10|10] "m_per_s2" MCU
 SG_ OBJ_Abs_Long_Acc_V_23 : 21815|1@1+ (1,0) [0|1] "bool" MCU
 SG_ Reserved_8_23 : 21816|8@1+ (1,0) [0|0] "NA" MCU
 SG_ OBJ_Abs_Long_Acc_STD_23 : 21824|10@1+ (0.01,0) [0|7.3] "m_per_s2" MCU
 SG_ OBJ_Abs_Long_Acc_STD_V_23 : 21834|1@1+ (1,0) [0|1] "bool" MCU
 SG_ OBJ_Abs_Lat_Acc_23 : 21835|9@1+ (0.05,-10) [-10|10] "m_per_s2" MCU
 SG_ OBJ_Abs_Lat_Acc_V_23 : 21844|1@1+ (1,0) [0|1] "bool" MCU
 SG_ OBJ_Abs_Lat_Acc_STD_23 : 21845|10@1+ (0.01,0) [0|7.3] "m_per_s2" MCU
 SG_ OBJ_Abs_Lat_Acc_STD_V_23 : 21855|1@1+ (1,0) [0|1] "bool" MCU
 SG_ OBJ_Abs_Acceleration_23 : 21856|9@1+ (0.05,-12.7) [-12.7|12.7] "m_per_s2" MCU
 SG_ OBJ_Abs_Acceleration_V_23 : 21865|1@1+ (1,0) [0|1] "bool" MCU
 SG_ OBJ_Abs_Acc_STD_23 : 21866|10@1+ (0.01,0) [0|7.3] "m_per_s2" MCU
 SG_ OBJ_Abs_Acc_STD_V_23 : 21876|1@1+ (1,0) [0|1] "bool" MCU
 SG_ OBJ_Inv_TTC_23 : 21877|11@1+ (0.01,-8) [-8|8] "INV(s)" MCU
 SG_ OBJ_Inv_TTC_V_23 : 21888|1@1+ (1,0) [0|1] "bool" MCU
 SG_ OBJ_Inv_TTC_STD_23 : 21889|12@1+ (0.001,0) [0|4] "INV(s)" MCU
 SG_ OBJ_Inv_TTC_STD_V_23 : 21901|1@1+ (1,0) [0|1] "bool" MCU
 SG_ OBJ_Relative_Long_Acc_23 : 21902|10@1+ (0.05,-20) [-20|20] "m_per_s2" MCU
 SG_ OBJ_Relative_Long_Acc_V_23 : 21912|1@1+ (1,0) [0|1] "bool" MCU
 SG_ Reserved_9_23 : 21913|7@1+ (1,0) [0|0] "NA" MCU
 SG_ OBJ_Relative_Long_Acc_STD_23 : 21920|10@1+ (0.01,0) [0|7.3] "m_per_s2" MCU
 SG_ OBJ_Rel_Long_Acc_STD_V_23 : 21930|1@1+ (1,0) [0|1] "bool" MCU
 SG_ OBJ_Relative_Long_Velocity_23 : 21931|13@1+ (0.05,-120) [-120|130] "m_per_s" MCU
 SG_ OBJ_Relative_Long_Velocity_V_23 : 21944|1@1+ (1,0) [0|1] "bool" MCU
 SG_ Reserved_10_23 : 21945|7@1+ (1,0) [0|0] "NA" MCU
 SG_ OBJ_Relative_Long_Vel_STD_23 : 21952|14@1+ (0.01,0) [0|130] "m_per_s" MCU
 SG_ OBJ_Rel_Long_Vel_STD_V_23 : 21966|1@1+ (1,0) [0|1] "bool" MCU
 SG_ OBJ_Relative_Lat_Velocity_23 : 21967|11@1+ (0.05,-50) [-50|50] "m_per_s" MCU
 SG_ OBJ_Relative_Lat_Velocity_V_23 : 21978|1@1+ (1,0) [0|1] "bool" MCU
 SG_ Reserved_11_23 : 21979|5@1+ (1,0) [0|0] "NA" MCU
 SG_ OBJ_Relative_Lat_Velocity_STD_23 : 21984|13@1+ (0.01,0) [0|50] "m_per_s" MCU
 SG_ OBJ_Rel_Lat_Vel_STD_V_23 : 21997|1@1+ (1,0) [0|1] "bool" MCU
 SG_ OBJ_Long_Distance_23 : 21998|14@1+ (0.05,-200) [-200|500] "m" MCU
 SG_ OBJ_Long_Distance_V_23 : 22012|1@1+ (1,0) [0|1] "bool" MCU
 SG_ Reserved_12_23 : 22013|3@1+ (1,0) [0|0] "NA" MCU
 SG_ OBJ_Long_Distance_STD_23 : 22016|15@1+ (0.01,0) [0|250] "m" MCU
 SG_ OBJ_Long_Distance_STD_V_23 : 22031|1@1+ (1,0) [0|1] "bool" MCU
 SG_ OBJ_Lat_Distance_23 : 22032|12@1+ (0.05,-100) [-100|100] "m" MCU
 SG_ OBJ_Lat_Distance_V_23 : 22044|1@1+ (1,0) [0|1] "bool" MCU
 SG_ Reserved_13_23 : 22045|3@1+ (1,0) [0|0] "NA" MCU
 SG_ OBJ_Lat_Distance_STD_23 : 22048|14@1+ (0.01,0) [0|100] "m" MCU
 SG_ OBJ_Lat_Distance_STD_V_23 : 22062|1@1+ (1,0) [0|1] "bool" MCU
 SG_ OBJ_Absolute_Speed_23 : 22063|12@1+ (0.05,-65) [-65|65] "m_per_s" MCU
 SG_ OBJ_Absolute_Speed_V_23 : 22075|1@1+ (1,0) [0|1] "bool" MCU
 SG_ Reserved_14_23 : 22076|4@1+ (1,0) [0|0] "NA" MCU
 SG_ OBJ_Absolute_Speed_STD_23 : 22080|13@1+ (0.01,0) [0|65] "m_per_s" MCU
 SG_ OBJ_Absolute_Speed_STD_V_23 : 22093|1@1+ (1,0) [0|1] "bool" MCU
 SG_ OBJ_Heading_23 : 22094|10@1+ (0.01,-3.14) [-3.14|3.14] "rad" MCU
 SG_ OBJ_Heading_V_23 : 22104|1@1+ (1,0) [0|1] "bool" MCU
 SG_ Reserved_15_23 : 22105|7@1+ (1,0) [0|0] "NA" MCU
 SG_ OBJ_Heading_STD_23 : 22112|15@1+ (0.0001,0) [0|3.14] "rad" MCU
 SG_ OBJ_Heading_STD_V_23 : 22127|1@1+ (1,0) [0|1] "bool" MCU
 SG_ OBJ_Angle_Rate_STD_23 : 22128|15@1+ (0.0001,0) [0|2.2318] "RPS" MCU
 SG_ OBJ_Angle_Rate_STD_V_23 : 22143|1@1+ (1,0) [0|1] "bool" MCU
 SG_ OBJ_Angle_Rate_23 : 22144|12@1+ (0.002,-2.234) [-2.234|2.2318] "RPS" MCU
 SG_ OBJ_Angle_Rate_V_23 : 22156|1@1+ (1,0) [0|1] "bool" MCU
 SG_ OBJ_Angle_Right_23 : 22157|14@1+ (0.0002,-1.571) [-1.571|1.571] "rad" MCU
 SG_ OBJ_Angle_Right_V_23 : 22171|1@1+ (1,0) [0|1] "bool" MCU
 SG_ Reserved_16_23 : 22172|4@1+ (1,0) [0|0] "NA" MCU
 SG_ OBJ_Angle_Right_STD_23 : 22176|14@1+ (0.0001,0) [0|1.571] "rad" MCU
 SG_ OBJ_Angle_Right_STD_V_23 : 22190|1@1+ (1,0) [0|1] "bool" MCU
 SG_ OBJ_Angle_Left_23 : 22191|14@1+ (0.0002,-1.571) [-1.571|1.571] "rad" MCU
 SG_ OBJ_Angle_Left_V_23 : 22205|1@1+ (1,0) [0|1] "bool" MCU
 SG_ Reserved_17_23 : 22206|2@1+ (1,0) [0|0] "NA" MCU
 SG_ OBJ_Angle_Left_STD_23 : 22208|14@1+ (0.0001,0) [0|1.571] "rad" MCU
 SG_ OBJ_Angle_Left_STD_V_23 : 22222|1@1+ (1,0) [0|1] "bool" MCU
 SG_ OBJ_Angle_Side_23 : 22223|14@1+ (0.0002,-1.571) [-1.571|1.571] "rad" MCU
 SG_ OBJ_Angle_Side_V_23 : 22237|1@1+ (1,0) [0|1] "bool" MCU
 SG_ Reserved_18_23 : 22238|2@1+ (1,0) [0|0] "NA" MCU
 SG_ OBJ_Angle_Side_STD_23 : 22240|14@1+ (0.0001,0) [0|1.571] "rad" MCU
 SG_ OBJ_Angle_Side_STD_V_23 : 22254|1@1+ (1,0) [0|1] "bool" MCU
 SG_ OBJ_Angle_Mid_V_23 : 22255|1@1+ (1,0) [0|1] "bool" MCU
 SG_ OBJ_Angle_Mid_23 : 22256|14@1+ (0.0002,-1.571) [-1.571|1.571] "rad" MCU
 SG_ Reserved_19_23 : 22270|2@1+ (1,0) [0|0] "NA" MCU
 SG_ OBJ_Angle_Mid_STD_23 : 22272|14@1+ (0.0001,0) [0|1.571] "rad" MCU
 SG_ OBJ_Angle_Mid_STD_V_23 : 22286|1@1+ (1,0) [0|1] "bool" MCU
 SG_ OBJ_Angle_Bottom_V_23 : 22287|1@1+ (1,0) [0|1] "bool" MCU
 SG_ OBJ_Angle_Bottom_23 : 22288|14@1+ (0.0002,-1.571) [-1.571|1.571] "rad" MCU
 SG_ Reserved_20_23 : 22302|2@1+ (1,0) [0|0] "NA" MCU
 SG_ OBJ_Angle_Bottom_STD_23 : 22304|14@1+ (0.0001,0) [0|1.571] "rad" MCU
 SG_ OBJ_Angle_Bottom_STD_V_23 : 22318|1@1+ (1,0) [0|1] "bool" MCU
 SG_ OBJ_Visibility_Side_V_23 : 22319|1@1+ (1,0) [0|1] "bool" MCU
 SG_ OBJ_Visibility_Side_23 : 22320|2@1+ (1,0) [0|2] "ENUM" MCU
 SG_ OBJ_Is_In_Drivable_Area_23 : 22322|1@1+ (1,0) [0|1] "bool" MCU
 SG_ OBJ_Is_In_Drivable_Area_V_23 : 22323|1@1+ (1,0) [0|1] "bool" MCU
 SG_ OBJ_Is_VeryClose_V_23 : 22324|1@1+ (1,0) [0|1] "bool" MCU
 SG_ OBJ_Is_VeryClose_23 : 22325|1@1+ (1,0) [0|1] "bool" MCU
 SG_ OBJ_Buffer_C4_23 : 22326|2@1+ (1,0) [0|2] "NA" MCU
 SG_ OBJ_Buffer_C5_23 : 22328|2@1+ (1,0) [0|2] "NA" MCU
 SG_ OBJ_Buffer_C6_23 : 22330|2@1+ (1,0) [0|2] "NA" MCU
 SG_ OBJ_Buffer_C7_23 : 22332|2@1+ (1,0) [0|2] "NA" MCU
 SG_ Reserved_21_23 : 22334|2@1+ (1,0) [0|0] "NA" MCU
 SG_ OBJ_OverlapAngleEgoLaneR_23 : 22336|10@1+ (0.01,-3.14) [-3.14|3.14] "rad" MCU
 SG_ OBJ_OverlapAngleEgoLaneR_V_23 : 22346|1@1+ (1,0) [0|1] "bool" MCU
 SG_ OBJ_OverlapAngleEgoLaneL_23 : 22347|10@1+ (0.01,-3.14) [-3.14|3.14] "rad" MCU
 SG_ OBJ_OverlapAngleEgoLaneL_V_23 : 22357|1@1+ (1,0) [0|1] "bool" MCU
 SG_ OBJ_Is_EMERGENCY_VCL_23 : 22358|1@1+ (1,0) [0|1] "bool" MCU
 SG_ OBJ_EMERGENCY_LIGHT_COLOR_23 : 22359|4@1+ (1,0) [0|15] "BITWIZE" MCU
 SG_ OBJ_EMERGENCY_V_23 : 22363|1@1+ (1,0) [0|1] "bool" MCU
 SG_ Reserved_22_23 : 22364|4@1+ (1,0) [0|0] "NA" MCU
 SG_ OBJ_Angle_Top_23 : 22368|14@1+ (0.0002,0) [0|3.1415] "rad" MCU
 SG_ OBJ_Angle_Top_V_23 : 22382|1@1+ (1,0) [0|1] "bool" MCU
 SG_ OBJ_Angle_Top_STD_23 : 22383|15@1+ (0.0001,0) [0|3.1415] "rad" MCU
 SG_ OBJ_Angle_Top_STD_V_23 : 22398|1@1+ (1,0) [0|1] "bool" MCU
 SG_ OBJ_Buffer_C14_23 : 22399|1@1+ (1,0) [0|1] "NA" MCU
 SG_ OBJ_Buffer_C15_23 : 22400|1@1+ (1,0) [0|1] "NA" MCU
 SG_ OBJ_Buffer_C18_23 : 22401|2@1+ (1,0) [0|2] "NA" MCU
 SG_ OBJ_Buffer_C19_23 : 22403|1@1+ (1,0) [0|1] "NA" MCU
 SG_ Reserved_23_23 : 22404|28@1+ (1,0) [0|0] "NA" MCU
 SG_ OBJ_CRC_24 : 22432|32@1+ (1,0) [0|4294967295] "NA" MCU
 SG_ OBJ_ID_24 : 22464|8@1+ (1,0) [0|255] "counter" MCU
 SG_ OBJ_Existence_Probability_24 : 22472|8@1+ (0.01,0) [0|1] "NA" MCU
 SG_ OBJ_Fusion_Source_24 : 22480|16@1+ (1,0) [0|65535] "BITWIZE" MCU
 SG_ OBJ_Triggered_SDM_24 : 22496|2@1+ (1,0) [0|2] "ENUM" MCU
 SG_ OBJ_Motion_Category_24 : 22498|4@1+ (1,0) [0|13] "ENUM" MCU
 SG_ OBJ_Buffer_C0_24 : 22502|7@1+ (0.01,0) [0|1] "NA" MCU
 SG_ OBJ_Object_Age_24 : 22509|11@1+ (1,0) [0|2047] "frames" MCU
 SG_ OBJ_Measuring_Status_24 : 22520|3@1+ (1,0) [0|7] "BITWIZE" MCU
 SG_ OBJ_Object_Class_24 : 22523|4@1+ (1,0) [0|8] "ENUM" MCU
 SG_ Reserved_4_24 : 22527|1@1+ (1,0) [0|0] "NA" MCU
 SG_ OBJ_Class_Probability_24 : 22528|7@1+ (0.01,0) [0|1] "NA" MCU
 SG_ OBJ_Car_Probability_24 : 22535|7@1+ (0.01,0) [0|1] "NA" MCU
 SG_ OBJ_Truck_Probability_24 : 22542|7@1+ (0.01,0) [0|1] "NA" MCU
 SG_ OBJ_Bike_Probability_24 : 22549|7@1+ (0.01,0) [0|1] "NA" MCU
 SG_ OBJ_Camera_Source_24 : 22556|4@1+ (1,0) [0|15] "ENUM" MCU
 SG_ OBJ_Motion_Status_24 : 22560|3@1+ (1,0) [0|5] "ENUM" MCU
 SG_ OBJ_Motion_Orientation_24 : 22563|4@1+ (1,0) [0|13] "ENUM" MCU
 SG_ OBJ_Has_Cut_Lane_24 : 22567|1@1+ (1,0) [0|1] "bool" MCU
 SG_ OBJ_Has_Cut_Path_24 : 22568|1@1+ (1,0) [0|1] "bool" MCU
 SG_ OBJ_Brake_Light_24 : 22569|1@1+ (1,0) [0|1] "bool" MCU
 SG_ OBJ_Turn_Indicator_Right_24 : 22570|1@1+ (1,0) [0|1] "bool" MCU
 SG_ OBJ_Turn_Indicator_Left_24 : 22571|1@1+ (1,0) [0|1] "bool" MCU
 SG_ OBJ_Light_Indicator_Validity_24 : 22572|1@1+ (1,0) [0|1] "bool" MCU
 SG_ OBJ_Right_Out_Of_Image_24 : 22573|1@1+ (1,0) [0|1] "bool" MCU
 SG_ OBJ_Left_Out_Of_Image_24 : 22574|1@1+ (1,0) [0|1] "bool" MCU
 SG_ OBJ_Right_Out_Of_Image_V_24 : 22575|1@1+ (1,0) [0|1] "bool" MCU
 SG_ OBJ_Left_Out_Of_Image_V_24 : 22576|1@1+ (1,0) [0|1] "bool" MCU
 SG_ OBJ_Top_Out_Of_Image_24 : 22577|1@1+ (1,0) [0|1] "bool" MCU
 SG_ OBJ_Bottom_Out_Of_Image_24 : 22578|1@1+ (1,0) [0|1] "bool" MCU
 SG_ OBJ_Top_Out_Of_Image_V_24 : 22579|1@1+ (1,0) [0|1] "bool" MCU
 SG_ OBJ_Bottom_Out_Of_Image_V_24 : 22580|1@1+ (1,0) [0|1] "bool" MCU
 SG_ OBJ_Lane_Assignment_24 : 22581|3@1+ (1,0) [0|5] "ENUM" MCU
 SG_ OBJ_Lane_Assignment_V_24 : 22584|1@1+ (1,0) [0|1] "bool" MCU
 SG_ OBJ_Age_Seconds_24 : 22585|7@1+ (1,0) [0|100] "s" MCU
 SG_ OBJ_Age_Seconds_V_24 : 22592|1@1+ (1,0) [0|1] "bool" MCU
 SG_ OBJ_Width_24 : 22593|9@1+ (0.01,0) [0.4|2.95] "m" MCU
 SG_ OBJ_Width_V_24 : 22602|1@1+ (1,0) [0|1] "bool" MCU
 SG_ OBJ_Width_STD_24 : 22603|11@1+ (0.001,0) [0|2] "m" MCU
 SG_ OBJ_Width_STD_V_24 : 22614|1@1+ (1,0) [0|1] "bool" MCU
 SG_ OBJ_Length_24 : 22615|9@1+ (0.05,0) [1.2|21] "m" MCU
 SG_ OBJ_Length_V_24 : 22624|1@1+ (1,0) [0|1] "bool" MCU
 SG_ OBJ_Length_STD_24 : 22625|10@1+ (0.01,0) [0|10] "m" MCU
 SG_ OBJ_Length_STD_V_24 : 22635|1@1+ (1,0) [0|1] "bool" MCU
 SG_ OBJ_Radar_ID_24 : 22636|8@1+ (1,0) [0|255] "counter" MCU
 SG_ OBJ_Height_24 : 22644|9@1+ (0.01,0) [0|2.95] "m" MCU
 SG_ OBJ_Height_V_24 : 22653|1@1+ (1,0) [0|1] "bool" MCU
 SG_ Reserved_5_24 : 22654|2@1+ (1,0) [0|0] "NA" MCU
 SG_ OBJ_Height_STD_24 : 22656|11@1+ (0.001,0) [0|2] "m" MCU
 SG_ OBJ_Height_STD_V_24 : 22667|1@1+ (1,0) [0|1] "bool" MCU
 SG_ OBJ_Abs_Long_Velocity_24 : 22668|12@1+ (0.05,-100) [-100|100] "m_per_s" MCU
 SG_ OBJ_Abs_Long_Velocity_V_24 : 22680|1@1+ (1,0) [0|1] "bool" MCU
 SG_ Reserved_6_24 : 22681|7@1+ (1,0) [0|0] "NA" MCU
 SG_ OBJ_Abs_Long_Velocity_STD_24 : 22688|13@1+ (0.01,0) [0|65] "m_per_s" MCU
 SG_ OBJ_Abs_Long_Vel_STD_V_24 : 22701|1@1+ (1,0) [0|1] "bool" MCU
 SG_ OBJ_Abs_Lat_Velocity_24 : 22702|11@1+ (0.05,-50) [-50|50] "m_per_s" MCU
 SG_ OBJ_Abs_Lat_Velocity_V_24 : 22713|1@1+ (1,0) [0|1] "bool" MCU
 SG_ Reserved_7_24 : 22714|6@1+ (1,0) [0|0] "NA" MCU
 SG_ OBJ_Abs_Lat_Velocity_STD_24 : 22720|13@1+ (0.01,0) [0|50] "m_per_s" MCU
 SG_ OBJ_Abs_Lat_Vel_STD_V_24 : 22733|1@1+ (1,0) [0|1] "bool" MCU
 SG_ OBJ_Abs_Long_Acc_24 : 22734|9@1+ (0.05,-10) [-10|10] "m_per_s2" MCU
 SG_ OBJ_Abs_Long_Acc_V_24 : 22743|1@1+ (1,0) [0|1] "bool" MCU
 SG_ Reserved_8_24 : 22744|8@1+ (1,0) [0|0] "NA" MCU
 SG_ OBJ_Abs_Long_Acc_STD_24 : 22752|10@1+ (0.01,0) [0|7.3] "m_per_s2" MCU
 SG_ OBJ_Abs_Long_Acc_STD_V_24 : 22762|1@1+ (1,0) [0|1] "bool" MCU
 SG_ OBJ_Abs_Lat_Acc_24 : 22763|9@1+ (0.05,-10) [-10|10] "m_per_s2" MCU
 SG_ OBJ_Abs_Lat_Acc_V_24 : 22772|1@1+ (1,0) [0|1] "bool" MCU
 SG_ OBJ_Abs_Lat_Acc_STD_24 : 22773|10@1+ (0.01,0) [0|7.3] "m_per_s2" MCU
 SG_ OBJ_Abs_Lat_Acc_STD_V_24 : 22783|1@1+ (1,0) [0|1] "bool" MCU
 SG_ OBJ_Abs_Acceleration_24 : 22784|9@1+ (0.05,-12.7) [-12.7|12.7] "m_per_s2" MCU
 SG_ OBJ_Abs_Acceleration_V_24 : 22793|1@1+ (1,0) [0|1] "bool" MCU
 SG_ OBJ_Abs_Acc_STD_24 : 22794|10@1+ (0.01,0) [0|7.3] "m_per_s2" MCU
 SG_ OBJ_Abs_Acc_STD_V_24 : 22804|1@1+ (1,0) [0|1] "bool" MCU
 SG_ OBJ_Inv_TTC_24 : 22805|11@1+ (0.01,-8) [-8|8] "INV(s)" MCU
 SG_ OBJ_Inv_TTC_V_24 : 22816|1@1+ (1,0) [0|1] "bool" MCU
 SG_ OBJ_Inv_TTC_STD_24 : 22817|12@1+ (0.001,0) [0|4] "INV(s)" MCU
 SG_ OBJ_Inv_TTC_STD_V_24 : 22829|1@1+ (1,0) [0|1] "bool" MCU
 SG_ OBJ_Relative_Long_Acc_24 : 22830|10@1+ (0.05,-20) [-20|20] "m_per_s2" MCU
 SG_ OBJ_Relative_Long_Acc_V_24 : 22840|1@1+ (1,0) [0|1] "bool" MCU
 SG_ Reserved_9_24 : 22841|7@1+ (1,0) [0|0] "NA" MCU
 SG_ OBJ_Relative_Long_Acc_STD_24 : 22848|10@1+ (0.01,0) [0|7.3] "m_per_s2" MCU
 SG_ OBJ_Rel_Long_Acc_STD_V_24 : 22858|1@1+ (1,0) [0|1] "bool" MCU
 SG_ OBJ_Relative_Long_Velocity_24 : 22859|13@1+ (0.05,-120) [-120|130] "m_per_s" MCU
 SG_ OBJ_Relative_Long_Velocity_V_24 : 22872|1@1+ (1,0) [0|1] "bool" MCU
 SG_ Reserved_10_24 : 22873|7@1+ (1,0) [0|0] "NA" MCU
 SG_ OBJ_Relative_Long_Vel_STD_24 : 22880|14@1+ (0.01,0) [0|130] "m_per_s" MCU
 SG_ OBJ_Rel_Long_Vel_STD_V_24 : 22894|1@1+ (1,0) [0|1] "bool" MCU
 SG_ OBJ_Relative_Lat_Velocity_24 : 22895|11@1+ (0.05,-50) [-50|50] "m_per_s" MCU
 SG_ OBJ_Relative_Lat_Velocity_V_24 : 22906|1@1+ (1,0) [0|1] "bool" MCU
 SG_ Reserved_11_24 : 22907|5@1+ (1,0) [0|0] "NA" MCU
 SG_ OBJ_Relative_Lat_Velocity_STD_24 : 22912|13@1+ (0.01,0) [0|50] "m_per_s" MCU
 SG_ OBJ_Rel_Lat_Vel_STD_V_24 : 22925|1@1+ (1,0) [0|1] "bool" MCU
 SG_ OBJ_Long_Distance_24 : 22926|14@1+ (0.05,-200) [-200|500] "m" MCU
 SG_ OBJ_Long_Distance_V_24 : 22940|1@1+ (1,0) [0|1] "bool" MCU
 SG_ Reserved_12_24 : 22941|3@1+ (1,0) [0|0] "NA" MCU
 SG_ OBJ_Long_Distance_STD_24 : 22944|15@1+ (0.01,0) [0|250] "m" MCU
 SG_ OBJ_Long_Distance_STD_V_24 : 22959|1@1+ (1,0) [0|1] "bool" MCU
 SG_ OBJ_Lat_Distance_24 : 22960|12@1+ (0.05,-100) [-100|100] "m" MCU
 SG_ OBJ_Lat_Distance_V_24 : 22972|1@1+ (1,0) [0|1] "bool" MCU
 SG_ Reserved_13_24 : 22973|3@1+ (1,0) [0|0] "NA" MCU
 SG_ OBJ_Lat_Distance_STD_24 : 22976|14@1+ (0.01,0) [0|100] "m" MCU
 SG_ OBJ_Lat_Distance_STD_V_24 : 22990|1@1+ (1,0) [0|1] "bool" MCU
 SG_ OBJ_Absolute_Speed_24 : 22991|12@1+ (0.05,-65) [-65|65] "m_per_s" MCU
 SG_ OBJ_Absolute_Speed_V_24 : 23003|1@1+ (1,0) [0|1] "bool" MCU
 SG_ Reserved_14_24 : 23004|4@1+ (1,0) [0|0] "NA" MCU
 SG_ OBJ_Absolute_Speed_STD_24 : 23008|13@1+ (0.01,0) [0|65] "m_per_s" MCU
 SG_ OBJ_Absolute_Speed_STD_V_24 : 23021|1@1+ (1,0) [0|1] "bool" MCU
 SG_ OBJ_Heading_24 : 23022|10@1+ (0.01,-3.14) [-3.14|3.14] "rad" MCU
 SG_ OBJ_Heading_V_24 : 23032|1@1+ (1,0) [0|1] "bool" MCU
 SG_ Reserved_15_24 : 23033|7@1+ (1,0) [0|0] "NA" MCU
 SG_ OBJ_Heading_STD_24 : 23040|15@1+ (0.0001,0) [0|3.14] "rad" MCU
 SG_ OBJ_Heading_STD_V_24 : 23055|1@1+ (1,0) [0|1] "bool" MCU
 SG_ OBJ_Angle_Rate_STD_24 : 23056|15@1+ (0.0001,0) [0|2.2318] "RPS" MCU
 SG_ OBJ_Angle_Rate_STD_V_24 : 23071|1@1+ (1,0) [0|1] "bool" MCU
 SG_ OBJ_Angle_Rate_24 : 23072|12@1+ (0.002,-2.234) [-2.234|2.2318] "RPS" MCU
 SG_ OBJ_Angle_Rate_V_24 : 23084|1@1+ (1,0) [0|1] "bool" MCU
 SG_ OBJ_Angle_Right_24 : 23085|14@1+ (0.0002,-1.571) [-1.571|1.571] "rad" MCU
 SG_ OBJ_Angle_Right_V_24 : 23099|1@1+ (1,0) [0|1] "bool" MCU
 SG_ Reserved_16_24 : 23100|4@1+ (1,0) [0|0] "NA" MCU
 SG_ OBJ_Angle_Right_STD_24 : 23104|14@1+ (0.0001,0) [0|1.571] "rad" MCU
 SG_ OBJ_Angle_Right_STD_V_24 : 23118|1@1+ (1,0) [0|1] "bool" MCU
 SG_ OBJ_Angle_Left_24 : 23119|14@1+ (0.0002,-1.571) [-1.571|1.571] "rad" MCU
 SG_ OBJ_Angle_Left_V_24 : 23133|1@1+ (1,0) [0|1] "bool" MCU
 SG_ Reserved_17_24 : 23134|2@1+ (1,0) [0|0] "NA" MCU
 SG_ OBJ_Angle_Left_STD_24 : 23136|14@1+ (0.0001,0) [0|1.571] "rad" MCU
 SG_ OBJ_Angle_Left_STD_V_24 : 23150|1@1+ (1,0) [0|1] "bool" MCU
 SG_ OBJ_Angle_Side_24 : 23151|14@1+ (0.0002,-1.571) [-1.571|1.571] "rad" MCU
 SG_ OBJ_Angle_Side_V_24 : 23165|1@1+ (1,0) [0|1] "bool" MCU
 SG_ Reserved_18_24 : 23166|2@1+ (1,0) [0|0] "NA" MCU
 SG_ OBJ_Angle_Side_STD_24 : 23168|14@1+ (0.0001,0) [0|1.571] "rad" MCU
 SG_ OBJ_Angle_Side_STD_V_24 : 23182|1@1+ (1,0) [0|1] "bool" MCU
 SG_ OBJ_Angle_Mid_V_24 : 23183|1@1+ (1,0) [0|1] "bool" MCU
 SG_ OBJ_Angle_Mid_24 : 23184|14@1+ (0.0002,-1.571) [-1.571|1.571] "rad" MCU
 SG_ Reserved_19_24 : 23198|2@1+ (1,0) [0|0] "NA" MCU
 SG_ OBJ_Angle_Mid_STD_24 : 23200|14@1+ (0.0001,0) [0|1.571] "rad" MCU
 SG_ OBJ_Angle_Mid_STD_V_24 : 23214|1@1+ (1,0) [0|1] "bool" MCU
 SG_ OBJ_Angle_Bottom_V_24 : 23215|1@1+ (1,0) [0|1] "bool" MCU
 SG_ OBJ_Angle_Bottom_24 : 23216|14@1+ (0.0002,-1.571) [-1.571|1.571] "rad" MCU
 SG_ Reserved_20_24 : 23230|2@1+ (1,0) [0|0] "NA" MCU
 SG_ OBJ_Angle_Bottom_STD_24 : 23232|14@1+ (0.0001,0) [0|1.571] "rad" MCU
 SG_ OBJ_Angle_Bottom_STD_V_24 : 23246|1@1+ (1,0) [0|1] "bool" MCU
 SG_ OBJ_Visibility_Side_V_24 : 23247|1@1+ (1,0) [0|1] "bool" MCU
 SG_ OBJ_Visibility_Side_24 : 23248|2@1+ (1,0) [0|2] "ENUM" MCU
 SG_ OBJ_Is_In_Drivable_Area_24 : 23250|1@1+ (1,0) [0|1] "bool" MCU
 SG_ OBJ_Is_In_Drivable_Area_V_24 : 23251|1@1+ (1,0) [0|1] "bool" MCU
 SG_ OBJ_Is_VeryClose_V_24 : 23252|1@1+ (1,0) [0|1] "bool" MCU
 SG_ OBJ_Is_VeryClose_24 : 23253|1@1+ (1,0) [0|1] "bool" MCU
 SG_ OBJ_Buffer_C4_24 : 23254|2@1+ (1,0) [0|2] "NA" MCU
 SG_ OBJ_Buffer_C5_24 : 23256|2@1+ (1,0) [0|2] "NA" MCU
 SG_ OBJ_Buffer_C6_24 : 23258|2@1+ (1,0) [0|2] "NA" MCU
 SG_ OBJ_Buffer_C7_24 : 23260|2@1+ (1,0) [0|2] "NA" MCU
 SG_ Reserved_21_24 : 23262|2@1+ (1,0) [0|0] "NA" MCU
 SG_ OBJ_OverlapAngleEgoLaneR_24 : 23264|10@1+ (0.01,-3.14) [-3.14|3.14] "rad" MCU
 SG_ OBJ_OverlapAngleEgoLaneR_V_24 : 23274|1@1+ (1,0) [0|1] "bool" MCU
 SG_ OBJ_OverlapAngleEgoLaneL_24 : 23275|10@1+ (0.01,-3.14) [-3.14|3.14] "rad" MCU
 SG_ OBJ_OverlapAngleEgoLaneL_V_24 : 23285|1@1+ (1,0) [0|1] "bool" MCU
 SG_ OBJ_Is_EMERGENCY_VCL_24 : 23286|1@1+ (1,0) [0|1] "bool" MCU
 SG_ OBJ_EMERGENCY_LIGHT_COLOR_24 : 23287|4@1+ (1,0) [0|15] "BITWIZE" MCU
 SG_ OBJ_EMERGENCY_V_24 : 23291|1@1+ (1,0) [0|1] "bool" MCU
 SG_ Reserved_22_24 : 23292|4@1+ (1,0) [0|0] "NA" MCU
 SG_ OBJ_Angle_Top_24 : 23296|14@1+ (0.0002,0) [0|3.1415] "rad" MCU
 SG_ OBJ_Angle_Top_V_24 : 23310|1@1+ (1,0) [0|1] "bool" MCU
 SG_ OBJ_Angle_Top_STD_24 : 23311|15@1+ (0.0001,0) [0|3.1415] "rad" MCU
 SG_ OBJ_Angle_Top_STD_V_24 : 23326|1@1+ (1,0) [0|1] "bool" MCU
 SG_ OBJ_Buffer_C14_24 : 23327|1@1+ (1,0) [0|1] "NA" MCU
 SG_ OBJ_Buffer_C15_24 : 23328|1@1+ (1,0) [0|1] "NA" MCU
 SG_ OBJ_Buffer_C18_24 : 23329|2@1+ (1,0) [0|2] "NA" MCU
 SG_ OBJ_Buffer_C19_24 : 23331|1@1+ (1,0) [0|1] "NA" MCU
 SG_ Reserved_23_24 : 23332|28@1+ (1,0) [0|0] "NA" MCU
 SG_ OBJ_CRC_25 : 23360|32@1+ (1,0) [0|4294967295] "NA" MCU
 SG_ OBJ_ID_25 : 23392|8@1+ (1,0) [0|255] "counter" MCU
 SG_ OBJ_Existence_Probability_25 : 23400|8@1+ (0.01,0) [0|1] "NA" MCU
 SG_ OBJ_Fusion_Source_25 : 23408|16@1+ (1,0) [0|65535] "BITWIZE" MCU
 SG_ OBJ_Triggered_SDM_25 : 23424|2@1+ (1,0) [0|2] "ENUM" MCU
 SG_ OBJ_Motion_Category_25 : 23426|4@1+ (1,0) [0|13] "ENUM" MCU
 SG_ OBJ_Buffer_C0_25 : 23430|7@1+ (0.01,0) [0|1] "NA" MCU
 SG_ OBJ_Object_Age_25 : 23437|11@1+ (1,0) [0|2047] "frames" MCU
 SG_ OBJ_Measuring_Status_25 : 23448|3@1+ (1,0) [0|7] "BITWIZE" MCU
 SG_ OBJ_Object_Class_25 : 23451|4@1+ (1,0) [0|8] "ENUM" MCU
 SG_ Reserved_4_25 : 23455|1@1+ (1,0) [0|0] "NA" MCU
 SG_ OBJ_Class_Probability_25 : 23456|7@1+ (0.01,0) [0|1] "NA" MCU
 SG_ OBJ_Car_Probability_25 : 23463|7@1+ (0.01,0) [0|1] "NA" MCU
 SG_ OBJ_Truck_Probability_25 : 23470|7@1+ (0.01,0) [0|1] "NA" MCU
 SG_ OBJ_Bike_Probability_25 : 23477|7@1+ (0.01,0) [0|1] "NA" MCU
 SG_ OBJ_Camera_Source_25 : 23484|4@1+ (1,0) [0|15] "ENUM" MCU
 SG_ OBJ_Motion_Status_25 : 23488|3@1+ (1,0) [0|5] "ENUM" MCU
 SG_ OBJ_Motion_Orientation_25 : 23491|4@1+ (1,0) [0|13] "ENUM" MCU
 SG_ OBJ_Has_Cut_Lane_25 : 23495|1@1+ (1,0) [0|1] "bool" MCU
 SG_ OBJ_Has_Cut_Path_25 : 23496|1@1+ (1,0) [0|1] "bool" MCU
 SG_ OBJ_Brake_Light_25 : 23497|1@1+ (1,0) [0|1] "bool" MCU
 SG_ OBJ_Turn_Indicator_Right_25 : 23498|1@1+ (1,0) [0|1] "bool" MCU
 SG_ OBJ_Turn_Indicator_Left_25 : 23499|1@1+ (1,0) [0|1] "bool" MCU
 SG_ OBJ_Light_Indicator_Validity_25 : 23500|1@1+ (1,0) [0|1] "bool" MCU
 SG_ OBJ_Right_Out_Of_Image_25 : 23501|1@1+ (1,0) [0|1] "bool" MCU
 SG_ OBJ_Left_Out_Of_Image_25 : 23502|1@1+ (1,0) [0|1] "bool" MCU
 SG_ OBJ_Right_Out_Of_Image_V_25 : 23503|1@1+ (1,0) [0|1] "bool" MCU
 SG_ OBJ_Left_Out_Of_Image_V_25 : 23504|1@1+ (1,0) [0|1] "bool" MCU
 SG_ OBJ_Top_Out_Of_Image_25 : 23505|1@1+ (1,0) [0|1] "bool" MCU
 SG_ OBJ_Bottom_Out_Of_Image_25 : 23506|1@1+ (1,0) [0|1] "bool" MCU
 SG_ OBJ_Top_Out_Of_Image_V_25 : 23507|1@1+ (1,0) [0|1] "bool" MCU
 SG_ OBJ_Bottom_Out_Of_Image_V_25 : 23508|1@1+ (1,0) [0|1] "bool" MCU
 SG_ OBJ_Lane_Assignment_25 : 23509|3@1+ (1,0) [0|5] "ENUM" MCU
 SG_ OBJ_Lane_Assignment_V_25 : 23512|1@1+ (1,0) [0|1] "bool" MCU
 SG_ OBJ_Age_Seconds_25 : 23513|7@1+ (1,0) [0|100] "s" MCU
 SG_ OBJ_Age_Seconds_V_25 : 23520|1@1+ (1,0) [0|1] "bool" MCU
 SG_ OBJ_Width_25 : 23521|9@1+ (0.01,0) [0.4|2.95] "m" MCU
 SG_ OBJ_Width_V_25 : 23530|1@1+ (1,0) [0|1] "bool" MCU
 SG_ OBJ_Width_STD_25 : 23531|11@1+ (0.001,0) [0|2] "m" MCU
 SG_ OBJ_Width_STD_V_25 : 23542|1@1+ (1,0) [0|1] "bool" MCU
 SG_ OBJ_Length_25 : 23543|9@1+ (0.05,0) [1.2|21] "m" MCU
 SG_ OBJ_Length_V_25 : 23552|1@1+ (1,0) [0|1] "bool" MCU
 SG_ OBJ_Length_STD_25 : 23553|10@1+ (0.01,0) [0|10] "m" MCU
 SG_ OBJ_Length_STD_V_25 : 23563|1@1+ (1,0) [0|1] "bool" MCU
 SG_ OBJ_Radar_ID_25 : 23564|8@1+ (1,0) [0|255] "counter" MCU
 SG_ OBJ_Height_25 : 23572|9@1+ (0.01,0) [0|2.95] "m" MCU
 SG_ OBJ_Height_V_25 : 23581|1@1+ (1,0) [0|1] "bool" MCU
 SG_ Reserved_5_25 : 23582|2@1+ (1,0) [0|0] "NA" MCU
 SG_ OBJ_Height_STD_25 : 23584|11@1+ (0.001,0) [0|2] "m" MCU
 SG_ OBJ_Height_STD_V_25 : 23595|1@1+ (1,0) [0|1] "bool" MCU
 SG_ OBJ_Abs_Long_Velocity_25 : 23596|12@1+ (0.05,-100) [-100|100] "m_per_s" MCU
 SG_ OBJ_Abs_Long_Velocity_V_25 : 23608|1@1+ (1,0) [0|1] "bool" MCU
 SG_ Reserved_6_25 : 23609|7@1+ (1,0) [0|0] "NA" MCU
 SG_ OBJ_Abs_Long_Velocity_STD_25 : 23616|13@1+ (0.01,0) [0|65] "m_per_s" MCU
 SG_ OBJ_Abs_Long_Vel_STD_V_25 : 23629|1@1+ (1,0) [0|1] "bool" MCU
 SG_ OBJ_Abs_Lat_Velocity_25 : 23630|11@1+ (0.05,-50) [-50|50] "m_per_s" MCU
 SG_ OBJ_Abs_Lat_Velocity_V_25 : 23641|1@1+ (1,0) [0|1] "bool" MCU
 SG_ Reserved_7_25 : 23642|6@1+ (1,0) [0|0] "NA" MCU
 SG_ OBJ_Abs_Lat_Velocity_STD_25 : 23648|13@1+ (0.01,0) [0|50] "m_per_s" MCU
 SG_ OBJ_Abs_Lat_Vel_STD_V_25 : 23661|1@1+ (1,0) [0|1] "bool" MCU
 SG_ OBJ_Abs_Long_Acc_25 : 23662|9@1+ (0.05,-10) [-10|10] "m_per_s2" MCU
 SG_ OBJ_Abs_Long_Acc_V_25 : 23671|1@1+ (1,0) [0|1] "bool" MCU
 SG_ Reserved_8_25 : 23672|8@1+ (1,0) [0|0] "NA" MCU
 SG_ OBJ_Abs_Long_Acc_STD_25 : 23680|10@1+ (0.01,0) [0|7.3] "m_per_s2" MCU
 SG_ OBJ_Abs_Long_Acc_STD_V_25 : 23690|1@1+ (1,0) [0|1] "bool" MCU
 SG_ OBJ_Abs_Lat_Acc_25 : 23691|9@1+ (0.05,-10) [-10|10] "m_per_s2" MCU
 SG_ OBJ_Abs_Lat_Acc_V_25 : 23700|1@1+ (1,0) [0|1] "bool" MCU
 SG_ OBJ_Abs_Lat_Acc_STD_25 : 23701|10@1+ (0.01,0) [0|7.3] "m_per_s2" MCU
 SG_ OBJ_Abs_Lat_Acc_STD_V_25 : 23711|1@1+ (1,0) [0|1] "bool" MCU
 SG_ OBJ_Abs_Acceleration_25 : 23712|9@1+ (0.05,-12.7) [-12.7|12.7] "m_per_s2" MCU
 SG_ OBJ_Abs_Acceleration_V_25 : 23721|1@1+ (1,0) [0|1] "bool" MCU
 SG_ OBJ_Abs_Acc_STD_25 : 23722|10@1+ (0.01,0) [0|7.3] "m_per_s2" MCU
 SG_ OBJ_Abs_Acc_STD_V_25 : 23732|1@1+ (1,0) [0|1] "bool" MCU
 SG_ OBJ_Inv_TTC_25 : 23733|11@1+ (0.01,-8) [-8|8] "INV(s)" MCU
 SG_ OBJ_Inv_TTC_V_25 : 23744|1@1+ (1,0) [0|1] "bool" MCU
 SG_ OBJ_Inv_TTC_STD_25 : 23745|12@1+ (0.001,0) [0|4] "INV(s)" MCU
 SG_ OBJ_Inv_TTC_STD_V_25 : 23757|1@1+ (1,0) [0|1] "bool" MCU
 SG_ OBJ_Relative_Long_Acc_25 : 23758|10@1+ (0.05,-20) [-20|20] "m_per_s2" MCU
 SG_ OBJ_Relative_Long_Acc_V_25 : 23768|1@1+ (1,0) [0|1] "bool" MCU
 SG_ Reserved_9_25 : 23769|7@1+ (1,0) [0|0] "NA" MCU
 SG_ OBJ_Relative_Long_Acc_STD_25 : 23776|10@1+ (0.01,0) [0|7.3] "m_per_s2" MCU
 SG_ OBJ_Rel_Long_Acc_STD_V_25 : 23786|1@1+ (1,0) [0|1] "bool" MCU
 SG_ OBJ_Relative_Long_Velocity_25 : 23787|13@1+ (0.05,-120) [-120|130] "m_per_s" MCU
 SG_ OBJ_Relative_Long_Velocity_V_25 : 23800|1@1+ (1,0) [0|1] "bool" MCU
 SG_ Reserved_10_25 : 23801|7@1+ (1,0) [0|0] "NA" MCU
 SG_ OBJ_Relative_Long_Vel_STD_25 : 23808|14@1+ (0.01,0) [0|130] "m_per_s" MCU
 SG_ OBJ_Rel_Long_Vel_STD_V_25 : 23822|1@1+ (1,0) [0|1] "bool" MCU
 SG_ OBJ_Relative_Lat_Velocity_25 : 23823|11@1+ (0.05,-50) [-50|50] "m_per_s" MCU
 SG_ OBJ_Relative_Lat_Velocity_V_25 : 23834|1@1+ (1,0) [0|1] "bool" MCU
 SG_ Reserved_11_25 : 23835|5@1+ (1,0) [0|0] "NA" MCU
 SG_ OBJ_Relative_Lat_Velocity_STD_25 : 23840|13@1+ (0.01,0) [0|50] "m_per_s" MCU
 SG_ OBJ_Rel_Lat_Vel_STD_V_25 : 23853|1@1+ (1,0) [0|1] "bool" MCU
 SG_ OBJ_Long_Distance_25 : 23854|14@1+ (0.05,-200) [-200|500] "m" MCU
 SG_ OBJ_Long_Distance_V_25 : 23868|1@1+ (1,0) [0|1] "bool" MCU
 SG_ Reserved_12_25 : 23869|3@1+ (1,0) [0|0] "NA" MCU
 SG_ OBJ_Long_Distance_STD_25 : 23872|15@1+ (0.01,0) [0|250] "m" MCU
 SG_ OBJ_Long_Distance_STD_V_25 : 23887|1@1+ (1,0) [0|1] "bool" MCU
 SG_ OBJ_Lat_Distance_25 : 23888|12@1+ (0.05,-100) [-100|100] "m" MCU
 SG_ OBJ_Lat_Distance_V_25 : 23900|1@1+ (1,0) [0|1] "bool" MCU
 SG_ Reserved_13_25 : 23901|3@1+ (1,0) [0|0] "NA" MCU
 SG_ OBJ_Lat_Distance_STD_25 : 23904|14@1+ (0.01,0) [0|100] "m" MCU
 SG_ OBJ_Lat_Distance_STD_V_25 : 23918|1@1+ (1,0) [0|1] "bool" MCU
 SG_ OBJ_Absolute_Speed_25 : 23919|12@1+ (0.05,-65) [-65|65] "m_per_s" MCU
 SG_ OBJ_Absolute_Speed_V_25 : 23931|1@1+ (1,0) [0|1] "bool" MCU
 SG_ Reserved_14_25 : 23932|4@1+ (1,0) [0|0] "NA" MCU
 SG_ OBJ_Absolute_Speed_STD_25 : 23936|13@1+ (0.01,0) [0|65] "m_per_s" MCU
 SG_ OBJ_Absolute_Speed_STD_V_25 : 23949|1@1+ (1,0) [0|1] "bool" MCU
 SG_ OBJ_Heading_25 : 23950|10@1+ (0.01,-3.14) [-3.14|3.14] "rad" MCU
 SG_ OBJ_Heading_V_25 : 23960|1@1+ (1,0) [0|1] "bool" MCU
 SG_ Reserved_15_25 : 23961|7@1+ (1,0) [0|0] "NA" MCU
 SG_ OBJ_Heading_STD_25 : 23968|15@1+ (0.0001,0) [0|3.14] "rad" MCU
 SG_ OBJ_Heading_STD_V_25 : 23983|1@1+ (1,0) [0|1] "bool" MCU
 SG_ OBJ_Angle_Rate_STD_25 : 23984|15@1+ (0.0001,0) [0|2.2318] "RPS" MCU
 SG_ OBJ_Angle_Rate_STD_V_25 : 23999|1@1+ (1,0) [0|1] "bool" MCU
 SG_ OBJ_Angle_Rate_25 : 24000|12@1+ (0.002,-2.234) [-2.234|2.2318] "RPS" MCU
 SG_ OBJ_Angle_Rate_V_25 : 24012|1@1+ (1,0) [0|1] "bool" MCU
 SG_ OBJ_Angle_Right_25 : 24013|14@1+ (0.0002,-1.571) [-1.571|1.571] "rad" MCU
 SG_ OBJ_Angle_Right_V_25 : 24027|1@1+ (1,0) [0|1] "bool" MCU
 SG_ Reserved_16_25 : 24028|4@1+ (1,0) [0|0] "NA" MCU
 SG_ OBJ_Angle_Right_STD_25 : 24032|14@1+ (0.0001,0) [0|1.571] "rad" MCU
 SG_ OBJ_Angle_Right_STD_V_25 : 24046|1@1+ (1,0) [0|1] "bool" MCU
 SG_ OBJ_Angle_Left_25 : 24047|14@1+ (0.0002,-1.571) [-1.571|1.571] "rad" MCU
 SG_ OBJ_Angle_Left_V_25 : 24061|1@1+ (1,0) [0|1] "bool" MCU
 SG_ Reserved_17_25 : 24062|2@1+ (1,0) [0|0] "NA" MCU
 SG_ OBJ_Angle_Left_STD_25 : 24064|14@1+ (0.0001,0) [0|1.571] "rad" MCU
 SG_ OBJ_Angle_Left_STD_V_25 : 24078|1@1+ (1,0) [0|1] "bool" MCU
 SG_ OBJ_Angle_Side_25 : 24079|14@1+ (0.0002,-1.571) [-1.571|1.571] "rad" MCU
 SG_ OBJ_Angle_Side_V_25 : 24093|1@1+ (1,0) [0|1] "bool" MCU
 SG_ Reserved_18_25 : 24094|2@1+ (1,0) [0|0] "NA" MCU
 SG_ OBJ_Angle_Side_STD_25 : 24096|14@1+ (0.0001,0) [0|1.571] "rad" MCU
 SG_ OBJ_Angle_Side_STD_V_25 : 24110|1@1+ (1,0) [0|1] "bool" MCU
 SG_ OBJ_Angle_Mid_V_25 : 24111|1@1+ (1,0) [0|1] "bool" MCU
 SG_ OBJ_Angle_Mid_25 : 24112|14@1+ (0.0002,-1.571) [-1.571|1.571] "rad" MCU
 SG_ Reserved_19_25 : 24126|2@1+ (1,0) [0|0] "NA" MCU
 SG_ OBJ_Angle_Mid_STD_25 : 24128|14@1+ (0.0001,0) [0|1.571] "rad" MCU
 SG_ OBJ_Angle_Mid_STD_V_25 : 24142|1@1+ (1,0) [0|1] "bool" MCU
 SG_ OBJ_Angle_Bottom_V_25 : 24143|1@1+ (1,0) [0|1] "bool" MCU
 SG_ OBJ_Angle_Bottom_25 : 24144|14@1+ (0.0002,-1.571) [-1.571|1.571] "rad" MCU
 SG_ Reserved_20_25 : 24158|2@1+ (1,0) [0|0] "NA" MCU
 SG_ OBJ_Angle_Bottom_STD_25 : 24160|14@1+ (0.0001,0) [0|1.571] "rad" MCU
 SG_ OBJ_Angle_Bottom_STD_V_25 : 24174|1@1+ (1,0) [0|1] "bool" MCU
 SG_ OBJ_Visibility_Side_V_25 : 24175|1@1+ (1,0) [0|1] "bool" MCU
 SG_ OBJ_Visibility_Side_25 : 24176|2@1+ (1,0) [0|2] "ENUM" MCU
 SG_ OBJ_Is_In_Drivable_Area_25 : 24178|1@1+ (1,0) [0|1] "bool" MCU
 SG_ OBJ_Is_In_Drivable_Area_V_25 : 24179|1@1+ (1,0) [0|1] "bool" MCU
 SG_ OBJ_Is_VeryClose_V_25 : 24180|1@1+ (1,0) [0|1] "bool" MCU
 SG_ OBJ_Is_VeryClose_25 : 24181|1@1+ (1,0) [0|1] "bool" MCU
 SG_ OBJ_Buffer_C4_25 : 24182|2@1+ (1,0) [0|2] "NA" MCU
 SG_ OBJ_Buffer_C5_25 : 24184|2@1+ (1,0) [0|2] "NA" MCU
 SG_ OBJ_Buffer_C6_25 : 24186|2@1+ (1,0) [0|2] "NA" MCU
 SG_ OBJ_Buffer_C7_25 : 24188|2@1+ (1,0) [0|2] "NA" MCU
 SG_ Reserved_21_25 : 24190|2@1+ (1,0) [0|0] "NA" MCU
 SG_ OBJ_OverlapAngleEgoLaneR_25 : 24192|10@1+ (0.01,-3.14) [-3.14|3.14] "rad" MCU
 SG_ OBJ_OverlapAngleEgoLaneR_V_25 : 24202|1@1+ (1,0) [0|1] "bool" MCU
 SG_ OBJ_OverlapAngleEgoLaneL_25 : 24203|10@1+ (0.01,-3.14) [-3.14|3.14] "rad" MCU
 SG_ OBJ_OverlapAngleEgoLaneL_V_25 : 24213|1@1+ (1,0) [0|1] "bool" MCU
 SG_ OBJ_Is_EMERGENCY_VCL_25 : 24214|1@1+ (1,0) [0|1] "bool" MCU
 SG_ OBJ_EMERGENCY_LIGHT_COLOR_25 : 24215|4@1+ (1,0) [0|15] "BITWIZE" MCU
 SG_ OBJ_EMERGENCY_V_25 : 24219|1@1+ (1,0) [0|1] "bool" MCU
 SG_ Reserved_22_25 : 24220|4@1+ (1,0) [0|0] "NA" MCU
 SG_ OBJ_Angle_Top_25 : 24224|14@1+ (0.0002,0) [0|3.1415] "rad" MCU
 SG_ OBJ_Angle_Top_V_25 : 24238|1@1+ (1,0) [0|1] "bool" MCU
 SG_ OBJ_Angle_Top_STD_25 : 24239|15@1+ (0.0001,0) [0|3.1415] "rad" MCU
 SG_ OBJ_Angle_Top_STD_V_25 : 24254|1@1+ (1,0) [0|1] "bool" MCU
 SG_ OBJ_Buffer_C14_25 : 24255|1@1+ (1,0) [0|1] "NA" MCU
 SG_ OBJ_Buffer_C15_25 : 24256|1@1+ (1,0) [0|1] "NA" MCU
 SG_ OBJ_Buffer_C18_25 : 24257|2@1+ (1,0) [0|2] "NA" MCU
 SG_ OBJ_Buffer_C19_25 : 24259|1@1+ (1,0) [0|1] "NA" MCU
 SG_ Reserved_23_25 : 24260|28@1+ (1,0) [0|0] "NA" MCU
 SG_ OBJ_CRC_26 : 24288|32@1+ (1,0) [0|4294967295] "NA" MCU
 SG_ OBJ_ID_26 : 24320|8@1+ (1,0) [0|255] "counter" MCU
 SG_ OBJ_Existence_Probability_26 : 24328|8@1+ (0.01,0) [0|1] "NA" MCU
 SG_ OBJ_Fusion_Source_26 : 24336|16@1+ (1,0) [0|65535] "BITWIZE" MCU
 SG_ OBJ_Triggered_SDM_26 : 24352|2@1+ (1,0) [0|2] "ENUM" MCU
 SG_ OBJ_Motion_Category_26 : 24354|4@1+ (1,0) [0|13] "ENUM" MCU
 SG_ OBJ_Buffer_C0_26 : 24358|7@1+ (0.01,0) [0|1] "NA" MCU
 SG_ OBJ_Object_Age_26 : 24365|11@1+ (1,0) [0|2047] "frames" MCU
 SG_ OBJ_Measuring_Status_26 : 24376|3@1+ (1,0) [0|7] "BITWIZE" MCU
 SG_ OBJ_Object_Class_26 : 24379|4@1+ (1,0) [0|8] "ENUM" MCU
 SG_ Reserved_4_26 : 24383|1@1+ (1,0) [0|0] "NA" MCU
 SG_ OBJ_Class_Probability_26 : 24384|7@1+ (0.01,0) [0|1] "NA" MCU
 SG_ OBJ_Car_Probability_26 : 24391|7@1+ (0.01,0) [0|1] "NA" MCU
 SG_ OBJ_Truck_Probability_26 : 24398|7@1+ (0.01,0) [0|1] "NA" MCU
 SG_ OBJ_Bike_Probability_26 : 24405|7@1+ (0.01,0) [0|1] "NA" MCU
 SG_ OBJ_Camera_Source_26 : 24412|4@1+ (1,0) [0|15] "ENUM" MCU
 SG_ OBJ_Motion_Status_26 : 24416|3@1+ (1,0) [0|5] "ENUM" MCU
 SG_ OBJ_Motion_Orientation_26 : 24419|4@1+ (1,0) [0|13] "ENUM" MCU
 SG_ OBJ_Has_Cut_Lane_26 : 24423|1@1+ (1,0) [0|1] "bool" MCU
 SG_ OBJ_Has_Cut_Path_26 : 24424|1@1+ (1,0) [0|1] "bool" MCU
 SG_ OBJ_Brake_Light_26 : 24425|1@1+ (1,0) [0|1] "bool" MCU
 SG_ OBJ_Turn_Indicator_Right_26 : 24426|1@1+ (1,0) [0|1] "bool" MCU
 SG_ OBJ_Turn_Indicator_Left_26 : 24427|1@1+ (1,0) [0|1] "bool" MCU
 SG_ OBJ_Light_Indicator_Validity_26 : 24428|1@1+ (1,0) [0|1] "bool" MCU
 SG_ OBJ_Right_Out_Of_Image_26 : 24429|1@1+ (1,0) [0|1] "bool" MCU
 SG_ OBJ_Left_Out_Of_Image_26 : 24430|1@1+ (1,0) [0|1] "bool" MCU
 SG_ OBJ_Right_Out_Of_Image_V_26 : 24431|1@1+ (1,0) [0|1] "bool" MCU
 SG_ OBJ_Left_Out_Of_Image_V_26 : 24432|1@1+ (1,0) [0|1] "bool" MCU
 SG_ OBJ_Top_Out_Of_Image_26 : 24433|1@1+ (1,0) [0|1] "bool" MCU
 SG_ OBJ_Bottom_Out_Of_Image_26 : 24434|1@1+ (1,0) [0|1] "bool" MCU
 SG_ OBJ_Top_Out_Of_Image_V_26 : 24435|1@1+ (1,0) [0|1] "bool" MCU
 SG_ OBJ_Bottom_Out_Of_Image_V_26 : 24436|1@1+ (1,0) [0|1] "bool" MCU
 SG_ OBJ_Lane_Assignment_26 : 24437|3@1+ (1,0) [0|5] "ENUM" MCU
 SG_ OBJ_Lane_Assignment_V_26 : 24440|1@1+ (1,0) [0|1] "bool" MCU
 SG_ OBJ_Age_Seconds_26 : 24441|7@1+ (1,0) [0|100] "s" MCU
 SG_ OBJ_Age_Seconds_V_26 : 24448|1@1+ (1,0) [0|1] "bool" MCU
 SG_ OBJ_Width_26 : 24449|9@1+ (0.01,0) [0.4|2.95] "m" MCU
 SG_ OBJ_Width_V_26 : 24458|1@1+ (1,0) [0|1] "bool" MCU
 SG_ OBJ_Width_STD_26 : 24459|11@1+ (0.001,0) [0|2] "m" MCU
 SG_ OBJ_Width_STD_V_26 : 24470|1@1+ (1,0) [0|1] "bool" MCU
 SG_ OBJ_Length_26 : 24471|9@1+ (0.05,0) [1.2|21] "m" MCU
 SG_ OBJ_Length_V_26 : 24480|1@1+ (1,0) [0|1] "bool" MCU
 SG_ OBJ_Length_STD_26 : 24481|10@1+ (0.01,0) [0|10] "m" MCU
 SG_ OBJ_Length_STD_V_26 : 24491|1@1+ (1,0) [0|1] "bool" MCU
 SG_ OBJ_Radar_ID_26 : 24492|8@1+ (1,0) [0|255] "counter" MCU
 SG_ OBJ_Height_26 : 24500|9@1+ (0.01,0) [0|2.95] "m" MCU
 SG_ OBJ_Height_V_26 : 24509|1@1+ (1,0) [0|1] "bool" MCU
 SG_ Reserved_5_26 : 24510|2@1+ (1,0) [0|0] "NA" MCU
 SG_ OBJ_Height_STD_26 : 24512|11@1+ (0.001,0) [0|2] "m" MCU
 SG_ OBJ_Height_STD_V_26 : 24523|1@1+ (1,0) [0|1] "bool" MCU
 SG_ OBJ_Abs_Long_Velocity_26 : 24524|12@1+ (0.05,-100) [-100|100] "m_per_s" MCU
 SG_ OBJ_Abs_Long_Velocity_V_26 : 24536|1@1+ (1,0) [0|1] "bool" MCU
 SG_ Reserved_6_26 : 24537|7@1+ (1,0) [0|0] "NA" MCU
 SG_ OBJ_Abs_Long_Velocity_STD_26 : 24544|13@1+ (0.01,0) [0|65] "m_per_s" MCU
 SG_ OBJ_Abs_Long_Vel_STD_V_26 : 24557|1@1+ (1,0) [0|1] "bool" MCU
 SG_ OBJ_Abs_Lat_Velocity_26 : 24558|11@1+ (0.05,-50) [-50|50] "m_per_s" MCU
 SG_ OBJ_Abs_Lat_Velocity_V_26 : 24569|1@1+ (1,0) [0|1] "bool" MCU
 SG_ Reserved_7_26 : 24570|6@1+ (1,0) [0|0] "NA" MCU
 SG_ OBJ_Abs_Lat_Velocity_STD_26 : 24576|13@1+ (0.01,0) [0|50] "m_per_s" MCU
 SG_ OBJ_Abs_Lat_Vel_STD_V_26 : 24589|1@1+ (1,0) [0|1] "bool" MCU
 SG_ OBJ_Abs_Long_Acc_26 : 24590|9@1+ (0.05,-10) [-10|10] "m_per_s2" MCU
 SG_ OBJ_Abs_Long_Acc_V_26 : 24599|1@1+ (1,0) [0|1] "bool" MCU
 SG_ Reserved_8_26 : 24600|8@1+ (1,0) [0|0] "NA" MCU
 SG_ OBJ_Abs_Long_Acc_STD_26 : 24608|10@1+ (0.01,0) [0|7.3] "m_per_s2" MCU
 SG_ OBJ_Abs_Long_Acc_STD_V_26 : 24618|1@1+ (1,0) [0|1] "bool" MCU
 SG_ OBJ_Abs_Lat_Acc_26 : 24619|9@1+ (0.05,-10) [-10|10] "m_per_s2" MCU
 SG_ OBJ_Abs_Lat_Acc_V_26 : 24628|1@1+ (1,0) [0|1] "bool" MCU
 SG_ OBJ_Abs_Lat_Acc_STD_26 : 24629|10@1+ (0.01,0) [0|7.3] "m_per_s2" MCU
 SG_ OBJ_Abs_Lat_Acc_STD_V_26 : 24639|1@1+ (1,0) [0|1] "bool" MCU
 SG_ OBJ_Abs_Acceleration_26 : 24640|9@1+ (0.05,-12.7) [-12.7|12.7] "m_per_s2" MCU
 SG_ OBJ_Abs_Acceleration_V_26 : 24649|1@1+ (1,0) [0|1] "bool" MCU
 SG_ OBJ_Abs_Acc_STD_26 : 24650|10@1+ (0.01,0) [0|7.3] "m_per_s2" MCU
 SG_ OBJ_Abs_Acc_STD_V_26 : 24660|1@1+ (1,0) [0|1] "bool" MCU
 SG_ OBJ_Inv_TTC_26 : 24661|11@1+ (0.01,-8) [-8|8] "INV(s)" MCU
 SG_ OBJ_Inv_TTC_V_26 : 24672|1@1+ (1,0) [0|1] "bool" MCU
 SG_ OBJ_Inv_TTC_STD_26 : 24673|12@1+ (0.001,0) [0|4] "INV(s)" MCU
 SG_ OBJ_Inv_TTC_STD_V_26 : 24685|1@1+ (1,0) [0|1] "bool" MCU
 SG_ OBJ_Relative_Long_Acc_26 : 24686|10@1+ (0.05,-20) [-20|20] "m_per_s2" MCU
 SG_ OBJ_Relative_Long_Acc_V_26 : 24696|1@1+ (1,0) [0|1] "bool" MCU
 SG_ Reserved_9_26 : 24697|7@1+ (1,0) [0|0] "NA" MCU
 SG_ OBJ_Relative_Long_Acc_STD_26 : 24704|10@1+ (0.01,0) [0|7.3] "m_per_s2" MCU
 SG_ OBJ_Rel_Long_Acc_STD_V_26 : 24714|1@1+ (1,0) [0|1] "bool" MCU
 SG_ OBJ_Relative_Long_Velocity_26 : 24715|13@1+ (0.05,-120) [-120|130] "m_per_s" MCU
 SG_ OBJ_Relative_Long_Velocity_V_26 : 24728|1@1+ (1,0) [0|1] "bool" MCU
 SG_ Reserved_10_26 : 24729|7@1+ (1,0) [0|0] "NA" MCU
 SG_ OBJ_Relative_Long_Vel_STD_26 : 24736|14@1+ (0.01,0) [0|130] "m_per_s" MCU
 SG_ OBJ_Rel_Long_Vel_STD_V_26 : 24750|1@1+ (1,0) [0|1] "bool" MCU
 SG_ OBJ_Relative_Lat_Velocity_26 : 24751|11@1+ (0.05,-50) [-50|50] "m_per_s" MCU
 SG_ OBJ_Relative_Lat_Velocity_V_26 : 24762|1@1+ (1,0) [0|1] "bool" MCU
 SG_ Reserved_11_26 : 24763|5@1+ (1,0) [0|0] "NA" MCU
 SG_ OBJ_Relative_Lat_Velocity_STD_26 : 24768|13@1+ (0.01,0) [0|50] "m_per_s" MCU
 SG_ OBJ_Rel_Lat_Vel_STD_V_26 : 24781|1@1+ (1,0) [0|1] "bool" MCU
 SG_ OBJ_Long_Distance_26 : 24782|14@1+ (0.05,-200) [-200|500] "m" MCU
 SG_ OBJ_Long_Distance_V_26 : 24796|1@1+ (1,0) [0|1] "bool" MCU
 SG_ Reserved_12_26 : 24797|3@1+ (1,0) [0|0] "NA" MCU
 SG_ OBJ_Long_Distance_STD_26 : 24800|15@1+ (0.01,0) [0|250] "m" MCU
 SG_ OBJ_Long_Distance_STD_V_26 : 24815|1@1+ (1,0) [0|1] "bool" MCU
 SG_ OBJ_Lat_Distance_26 : 24816|12@1+ (0.05,-100) [-100|100] "m" MCU
 SG_ OBJ_Lat_Distance_V_26 : 24828|1@1+ (1,0) [0|1] "bool" MCU
 SG_ Reserved_13_26 : 24829|3@1+ (1,0) [0|0] "NA" MCU
 SG_ OBJ_Lat_Distance_STD_26 : 24832|14@1+ (0.01,0) [0|100] "m" MCU
 SG_ OBJ_Lat_Distance_STD_V_26 : 24846|1@1+ (1,0) [0|1] "bool" MCU
 SG_ OBJ_Absolute_Speed_26 : 24847|12@1+ (0.05,-65) [-65|65] "m_per_s" MCU
 SG_ OBJ_Absolute_Speed_V_26 : 24859|1@1+ (1,0) [0|1] "bool" MCU
 SG_ Reserved_14_26 : 24860|4@1+ (1,0) [0|0] "NA" MCU
 SG_ OBJ_Absolute_Speed_STD_26 : 24864|13@1+ (0.01,0) [0|65] "m_per_s" MCU
 SG_ OBJ_Absolute_Speed_STD_V_26 : 24877|1@1+ (1,0) [0|1] "bool" MCU
 SG_ OBJ_Heading_26 : 24878|10@1+ (0.01,-3.14) [-3.14|3.14] "rad" MCU
 SG_ OBJ_Heading_V_26 : 24888|1@1+ (1,0) [0|1] "bool" MCU
 SG_ Reserved_15_26 : 24889|7@1+ (1,0) [0|0] "NA" MCU
 SG_ OBJ_Heading_STD_26 : 24896|15@1+ (0.0001,0) [0|3.14] "rad" MCU
 SG_ OBJ_Heading_STD_V_26 : 24911|1@1+ (1,0) [0|1] "bool" MCU
 SG_ OBJ_Angle_Rate_STD_26 : 24912|15@1+ (0.0001,0) [0|2.2318] "RPS" MCU
 SG_ OBJ_Angle_Rate_STD_V_26 : 24927|1@1+ (1,0) [0|1] "bool" MCU
 SG_ OBJ_Angle_Rate_26 : 24928|12@1+ (0.002,-2.234) [-2.234|2.2318] "RPS" MCU
 SG_ OBJ_Angle_Rate_V_26 : 24940|1@1+ (1,0) [0|1] "bool" MCU
 SG_ OBJ_Angle_Right_26 : 24941|14@1+ (0.0002,-1.571) [-1.571|1.571] "rad" MCU
 SG_ OBJ_Angle_Right_V_26 : 24955|1@1+ (1,0) [0|1] "bool" MCU
 SG_ Reserved_16_26 : 24956|4@1+ (1,0) [0|0] "NA" MCU
 SG_ OBJ_Angle_Right_STD_26 : 24960|14@1+ (0.0001,0) [0|1.571] "rad" MCU
 SG_ OBJ_Angle_Right_STD_V_26 : 24974|1@1+ (1,0) [0|1] "bool" MCU
 SG_ OBJ_Angle_Left_26 : 24975|14@1+ (0.0002,-1.571) [-1.571|1.571] "rad" MCU
 SG_ OBJ_Angle_Left_V_26 : 24989|1@1+ (1,0) [0|1] "bool" MCU
 SG_ Reserved_17_26 : 24990|2@1+ (1,0) [0|0] "NA" MCU
 SG_ OBJ_Angle_Left_STD_26 : 24992|14@1+ (0.0001,0) [0|1.571] "rad" MCU
 SG_ OBJ_Angle_Left_STD_V_26 : 25006|1@1+ (1,0) [0|1] "bool" MCU
 SG_ OBJ_Angle_Side_26 : 25007|14@1+ (0.0002,-1.571) [-1.571|1.571] "rad" MCU
 SG_ OBJ_Angle_Side_V_26 : 25021|1@1+ (1,0) [0|1] "bool" MCU
 SG_ Reserved_18_26 : 25022|2@1+ (1,0) [0|0] "NA" MCU
 SG_ OBJ_Angle_Side_STD_26 : 25024|14@1+ (0.0001,0) [0|1.571] "rad" MCU
 SG_ OBJ_Angle_Side_STD_V_26 : 25038|1@1+ (1,0) [0|1] "bool" MCU
 SG_ OBJ_Angle_Mid_V_26 : 25039|1@1+ (1,0) [0|1] "bool" MCU
 SG_ OBJ_Angle_Mid_26 : 25040|14@1+ (0.0002,-1.571) [-1.571|1.571] "rad" MCU
 SG_ Reserved_19_26 : 25054|2@1+ (1,0) [0|0] "NA" MCU
 SG_ OBJ_Angle_Mid_STD_26 : 25056|14@1+ (0.0001,0) [0|1.571] "rad" MCU
 SG_ OBJ_Angle_Mid_STD_V_26 : 25070|1@1+ (1,0) [0|1] "bool" MCU
 SG_ OBJ_Angle_Bottom_V_26 : 25071|1@1+ (1,0) [0|1] "bool" MCU
 SG_ OBJ_Angle_Bottom_26 : 25072|14@1+ (0.0002,-1.571) [-1.571|1.571] "rad" MCU
 SG_ Reserved_20_26 : 25086|2@1+ (1,0) [0|0] "NA" MCU
 SG_ OBJ_Angle_Bottom_STD_26 : 25088|14@1+ (0.0001,0) [0|1.571] "rad" MCU
 SG_ OBJ_Angle_Bottom_STD_V_26 : 25102|1@1+ (1,0) [0|1] "bool" MCU
 SG_ OBJ_Visibility_Side_V_26 : 25103|1@1+ (1,0) [0|1] "bool" MCU
 SG_ OBJ_Visibility_Side_26 : 25104|2@1+ (1,0) [0|2] "ENUM" MCU
 SG_ OBJ_Is_In_Drivable_Area_26 : 25106|1@1+ (1,0) [0|1] "bool" MCU
 SG_ OBJ_Is_In_Drivable_Area_V_26 : 25107|1@1+ (1,0) [0|1] "bool" MCU
 SG_ OBJ_Is_VeryClose_V_26 : 25108|1@1+ (1,0) [0|1] "bool" MCU
 SG_ OBJ_Is_VeryClose_26 : 25109|1@1+ (1,0) [0|1] "bool" MCU
 SG_ OBJ_Buffer_C4_26 : 25110|2@1+ (1,0) [0|2] "NA" MCU
 SG_ OBJ_Buffer_C5_26 : 25112|2@1+ (1,0) [0|2] "NA" MCU
 SG_ OBJ_Buffer_C6_26 : 25114|2@1+ (1,0) [0|2] "NA" MCU
 SG_ OBJ_Buffer_C7_26 : 25116|2@1+ (1,0) [0|2] "NA" MCU
 SG_ Reserved_21_26 : 25118|2@1+ (1,0) [0|0] "NA" MCU
 SG_ OBJ_OverlapAngleEgoLaneR_26 : 25120|10@1+ (0.01,-3.14) [-3.14|3.14] "rad" MCU
 SG_ OBJ_OverlapAngleEgoLaneR_V_26 : 25130|1@1+ (1,0) [0|1] "bool" MCU
 SG_ OBJ_OverlapAngleEgoLaneL_26 : 25131|10@1+ (0.01,-3.14) [-3.14|3.14] "rad" MCU
 SG_ OBJ_OverlapAngleEgoLaneL_V_26 : 25141|1@1+ (1,0) [0|1] "bool" MCU
 SG_ OBJ_Is_EMERGENCY_VCL_26 : 25142|1@1+ (1,0) [0|1] "bool" MCU
 SG_ OBJ_EMERGENCY_LIGHT_COLOR_26 : 25143|4@1+ (1,0) [0|15] "BITWIZE" MCU
 SG_ OBJ_EMERGENCY_V_26 : 25147|1@1+ (1,0) [0|1] "bool" MCU
 SG_ Reserved_22_26 : 25148|4@1+ (1,0) [0|0] "NA" MCU
 SG_ OBJ_Angle_Top_26 : 25152|14@1+ (0.0002,0) [0|3.1415] "rad" MCU
 SG_ OBJ_Angle_Top_V_26 : 25166|1@1+ (1,0) [0|1] "bool" MCU
 SG_ OBJ_Angle_Top_STD_26 : 25167|15@1+ (0.0001,0) [0|3.1415] "rad" MCU
 SG_ OBJ_Angle_Top_STD_V_26 : 25182|1@1+ (1,0) [0|1] "bool" MCU
 SG_ OBJ_Buffer_C14_26 : 25183|1@1+ (1,0) [0|1] "NA" MCU
 SG_ OBJ_Buffer_C15_26 : 25184|1@1+ (1,0) [0|1] "NA" MCU
 SG_ OBJ_Buffer_C18_26 : 25185|2@1+ (1,0) [0|2] "NA" MCU
 SG_ OBJ_Buffer_C19_26 : 25187|1@1+ (1,0) [0|1] "NA" MCU
 SG_ Reserved_23_26 : 25188|28@1+ (1,0) [0|0] "NA" MCU
 SG_ OBJ_CRC_27 : 25216|32@1+ (1,0) [0|4294967295] "NA" MCU
 SG_ OBJ_ID_27 : 25248|8@1+ (1,0) [0|255] "counter" MCU
 SG_ OBJ_Existence_Probability_27 : 25256|8@1+ (0.01,0) [0|1] "NA" MCU
 SG_ OBJ_Fusion_Source_27 : 25264|16@1+ (1,0) [0|65535] "BITWIZE" MCU
 SG_ OBJ_Triggered_SDM_27 : 25280|2@1+ (1,0) [0|2] "ENUM" MCU
 SG_ OBJ_Motion_Category_27 : 25282|4@1+ (1,0) [0|13] "ENUM" MCU
 SG_ OBJ_Buffer_C0_27 : 25286|7@1+ (0.01,0) [0|1] "NA" MCU
 SG_ OBJ_Object_Age_27 : 25293|11@1+ (1,0) [0|2047] "frames" MCU
 SG_ OBJ_Measuring_Status_27 : 25304|3@1+ (1,0) [0|7] "BITWIZE" MCU
 SG_ OBJ_Object_Class_27 : 25307|4@1+ (1,0) [0|8] "ENUM" MCU
 SG_ Reserved_4_27 : 25311|1@1+ (1,0) [0|0] "NA" MCU
 SG_ OBJ_Class_Probability_27 : 25312|7@1+ (0.01,0) [0|1] "NA" MCU
 SG_ OBJ_Car_Probability_27 : 25319|7@1+ (0.01,0) [0|1] "NA" MCU
 SG_ OBJ_Truck_Probability_27 : 25326|7@1+ (0.01,0) [0|1] "NA" MCU
 SG_ OBJ_Bike_Probability_27 : 25333|7@1+ (0.01,0) [0|1] "NA" MCU
 SG_ OBJ_Camera_Source_27 : 25340|4@1+ (1,0) [0|15] "ENUM" MCU
 SG_ OBJ_Motion_Status_27 : 25344|3@1+ (1,0) [0|5] "ENUM" MCU
 SG_ OBJ_Motion_Orientation_27 : 25347|4@1+ (1,0) [0|13] "ENUM" MCU
 SG_ OBJ_Has_Cut_Lane_27 : 25351|1@1+ (1,0) [0|1] "bool" MCU
 SG_ OBJ_Has_Cut_Path_27 : 25352|1@1+ (1,0) [0|1] "bool" MCU
 SG_ OBJ_Brake_Light_27 : 25353|1@1+ (1,0) [0|1] "bool" MCU
 SG_ OBJ_Turn_Indicator_Right_27 : 25354|1@1+ (1,0) [0|1] "bool" MCU
 SG_ OBJ_Turn_Indicator_Left_27 : 25355|1@1+ (1,0) [0|1] "bool" MCU
 SG_ OBJ_Light_Indicator_Validity_27 : 25356|1@1+ (1,0) [0|1] "bool" MCU
 SG_ OBJ_Right_Out_Of_Image_27 : 25357|1@1+ (1,0) [0|1] "bool" MCU
 SG_ OBJ_Left_Out_Of_Image_27 : 25358|1@1+ (1,0) [0|1] "bool" MCU
 SG_ OBJ_Right_Out_Of_Image_V_27 : 25359|1@1+ (1,0) [0|1] "bool" MCU
 SG_ OBJ_Left_Out_Of_Image_V_27 : 25360|1@1+ (1,0) [0|1] "bool" MCU
 SG_ OBJ_Top_Out_Of_Image_27 : 25361|1@1+ (1,0) [0|1] "bool" MCU
 SG_ OBJ_Bottom_Out_Of_Image_27 : 25362|1@1+ (1,0) [0|1] "bool" MCU
 SG_ OBJ_Top_Out_Of_Image_V_27 : 25363|1@1+ (1,0) [0|1] "bool" MCU
 SG_ OBJ_Bottom_Out_Of_Image_V_27 : 25364|1@1+ (1,0) [0|1] "bool" MCU
 SG_ OBJ_Lane_Assignment_27 : 25365|3@1+ (1,0) [0|5] "ENUM" MCU
 SG_ OBJ_Lane_Assignment_V_27 : 25368|1@1+ (1,0) [0|1] "bool" MCU
 SG_ OBJ_Age_Seconds_27 : 25369|7@1+ (1,0) [0|100] "s" MCU
 SG_ OBJ_Age_Seconds_V_27 : 25376|1@1+ (1,0) [0|1] "bool" MCU
 SG_ OBJ_Width_27 : 25377|9@1+ (0.01,0) [0.4|2.95] "m" MCU
 SG_ OBJ_Width_V_27 : 25386|1@1+ (1,0) [0|1] "bool" MCU
 SG_ OBJ_Width_STD_27 : 25387|11@1+ (0.001,0) [0|2] "m" MCU
 SG_ OBJ_Width_STD_V_27 : 25398|1@1+ (1,0) [0|1] "bool" MCU
 SG_ OBJ_Length_27 : 25399|9@1+ (0.05,0) [1.2|21] "m" MCU
 SG_ OBJ_Length_V_27 : 25408|1@1+ (1,0) [0|1] "bool" MCU
 SG_ OBJ_Length_STD_27 : 25409|10@1+ (0.01,0) [0|10] "m" MCU
 SG_ OBJ_Length_STD_V_27 : 25419|1@1+ (1,0) [0|1] "bool" MCU
 SG_ OBJ_Radar_ID_27 : 25420|8@1+ (1,0) [0|255] "counter" MCU
 SG_ OBJ_Height_27 : 25428|9@1+ (0.01,0) [0|2.95] "m" MCU
 SG_ OBJ_Height_V_27 : 25437|1@1+ (1,0) [0|1] "bool" MCU
 SG_ Reserved_5_27 : 25438|2@1+ (1,0) [0|0] "NA" MCU
 SG_ OBJ_Height_STD_27 : 25440|11@1+ (0.001,0) [0|2] "m" MCU
 SG_ OBJ_Height_STD_V_27 : 25451|1@1+ (1,0) [0|1] "bool" MCU
 SG_ OBJ_Abs_Long_Velocity_27 : 25452|12@1+ (0.05,-100) [-100|100] "m_per_s" MCU
 SG_ OBJ_Abs_Long_Velocity_V_27 : 25464|1@1+ (1,0) [0|1] "bool" MCU
 SG_ Reserved_6_27 : 25465|7@1+ (1,0) [0|0] "NA" MCU
 SG_ OBJ_Abs_Long_Velocity_STD_27 : 25472|13@1+ (0.01,0) [0|65] "m_per_s" MCU
 SG_ OBJ_Abs_Long_Vel_STD_V_27 : 25485|1@1+ (1,0) [0|1] "bool" MCU
 SG_ OBJ_Abs_Lat_Velocity_27 : 25486|11@1+ (0.05,-50) [-50|50] "m_per_s" MCU
 SG_ OBJ_Abs_Lat_Velocity_V_27 : 25497|1@1+ (1,0) [0|1] "bool" MCU
 SG_ Reserved_7_27 : 25498|6@1+ (1,0) [0|0] "NA" MCU
 SG_ OBJ_Abs_Lat_Velocity_STD_27 : 25504|13@1+ (0.01,0) [0|50] "m_per_s" MCU
 SG_ OBJ_Abs_Lat_Vel_STD_V_27 : 25517|1@1+ (1,0) [0|1] "bool" MCU
 SG_ OBJ_Abs_Long_Acc_27 : 25518|9@1+ (0.05,-10) [-10|10] "m_per_s2" MCU
 SG_ OBJ_Abs_Long_Acc_V_27 : 25527|1@1+ (1,0) [0|1] "bool" MCU
 SG_ Reserved_8_27 : 25528|8@1+ (1,0) [0|0] "NA" MCU
 SG_ OBJ_Abs_Long_Acc_STD_27 : 25536|10@1+ (0.01,0) [0|7.3] "m_per_s2" MCU
 SG_ OBJ_Abs_Long_Acc_STD_V_27 : 25546|1@1+ (1,0) [0|1] "bool" MCU
 SG_ OBJ_Abs_Lat_Acc_27 : 25547|9@1+ (0.05,-10) [-10|10] "m_per_s2" MCU
 SG_ OBJ_Abs_Lat_Acc_V_27 : 25556|1@1+ (1,0) [0|1] "bool" MCU
 SG_ OBJ_Abs_Lat_Acc_STD_27 : 25557|10@1+ (0.01,0) [0|7.3] "m_per_s2" MCU
 SG_ OBJ_Abs_Lat_Acc_STD_V_27 : 25567|1@1+ (1,0) [0|1] "bool" MCU
 SG_ OBJ_Abs_Acceleration_27 : 25568|9@1+ (0.05,-12.7) [-12.7|12.7] "m_per_s2" MCU
 SG_ OBJ_Abs_Acceleration_V_27 : 25577|1@1+ (1,0) [0|1] "bool" MCU
 SG_ OBJ_Abs_Acc_STD_27 : 25578|10@1+ (0.01,0) [0|7.3] "m_per_s2" MCU
 SG_ OBJ_Abs_Acc_STD_V_27 : 25588|1@1+ (1,0) [0|1] "bool" MCU
 SG_ OBJ_Inv_TTC_27 : 25589|11@1+ (0.01,-8) [-8|8] "INV(s)" MCU
 SG_ OBJ_Inv_TTC_V_27 : 25600|1@1+ (1,0) [0|1] "bool" MCU
 SG_ OBJ_Inv_TTC_STD_27 : 25601|12@1+ (0.001,0) [0|4] "INV(s)" MCU
 SG_ OBJ_Inv_TTC_STD_V_27 : 25613|1@1+ (1,0) [0|1] "bool" MCU
 SG_ OBJ_Relative_Long_Acc_27 : 25614|10@1+ (0.05,-20) [-20|20] "m_per_s2" MCU
 SG_ OBJ_Relative_Long_Acc_V_27 : 25624|1@1+ (1,0) [0|1] "bool" MCU
 SG_ Reserved_9_27 : 25625|7@1+ (1,0) [0|0] "NA" MCU
 SG_ OBJ_Relative_Long_Acc_STD_27 : 25632|10@1+ (0.01,0) [0|7.3] "m_per_s2" MCU
 SG_ OBJ_Rel_Long_Acc_STD_V_27 : 25642|1@1+ (1,0) [0|1] "bool" MCU
 SG_ OBJ_Relative_Long_Velocity_27 : 25643|13@1+ (0.05,-120) [-120|130] "m_per_s" MCU
 SG_ OBJ_Relative_Long_Velocity_V_27 : 25656|1@1+ (1,0) [0|1] "bool" MCU
 SG_ Reserved_10_27 : 25657|7@1+ (1,0) [0|0] "NA" MCU
 SG_ OBJ_Relative_Long_Vel_STD_27 : 25664|14@1+ (0.01,0) [0|130] "m_per_s" MCU
 SG_ OBJ_Rel_Long_Vel_STD_V_27 : 25678|1@1+ (1,0) [0|1] "bool" MCU
 SG_ OBJ_Relative_Lat_Velocity_27 : 25679|11@1+ (0.05,-50) [-50|50] "m_per_s" MCU
 SG_ OBJ_Relative_Lat_Velocity_V_27 : 25690|1@1+ (1,0) [0|1] "bool" MCU
 SG_ Reserved_11_27 : 25691|5@1+ (1,0) [0|0] "NA" MCU
 SG_ OBJ_Relative_Lat_Velocity_STD_27 : 25696|13@1+ (0.01,0) [0|50] "m_per_s" MCU
 SG_ OBJ_Rel_Lat_Vel_STD_V_27 : 25709|1@1+ (1,0) [0|1] "bool" MCU
 SG_ OBJ_Long_Distance_27 : 25710|14@1+ (0.05,-200) [-200|500] "m" MCU
 SG_ OBJ_Long_Distance_V_27 : 25724|1@1+ (1,0) [0|1] "bool" MCU
 SG_ Reserved_12_27 : 25725|3@1+ (1,0) [0|0] "NA" MCU
 SG_ OBJ_Long_Distance_STD_27 : 25728|15@1+ (0.01,0) [0|250] "m" MCU
 SG_ OBJ_Long_Distance_STD_V_27 : 25743|1@1+ (1,0) [0|1] "bool" MCU
 SG_ OBJ_Lat_Distance_27 : 25744|12@1+ (0.05,-100) [-100|100] "m" MCU
 SG_ OBJ_Lat_Distance_V_27 : 25756|1@1+ (1,0) [0|1] "bool" MCU
 SG_ Reserved_13_27 : 25757|3@1+ (1,0) [0|0] "NA" MCU
 SG_ OBJ_Lat_Distance_STD_27 : 25760|14@1+ (0.01,0) [0|100] "m" MCU
 SG_ OBJ_Lat_Distance_STD_V_27 : 25774|1@1+ (1,0) [0|1] "bool" MCU
 SG_ OBJ_Absolute_Speed_27 : 25775|12@1+ (0.05,-65) [-65|65] "m_per_s" MCU
 SG_ OBJ_Absolute_Speed_V_27 : 25787|1@1+ (1,0) [0|1] "bool" MCU
 SG_ Reserved_14_27 : 25788|4@1+ (1,0) [0|0] "NA" MCU
 SG_ OBJ_Absolute_Speed_STD_27 : 25792|13@1+ (0.01,0) [0|65] "m_per_s" MCU
 SG_ OBJ_Absolute_Speed_STD_V_27 : 25805|1@1+ (1,0) [0|1] "bool" MCU
 SG_ OBJ_Heading_27 : 25806|10@1+ (0.01,-3.14) [-3.14|3.14] "rad" MCU
 SG_ OBJ_Heading_V_27 : 25816|1@1+ (1,0) [0|1] "bool" MCU
 SG_ Reserved_15_27 : 25817|7@1+ (1,0) [0|0] "NA" MCU
 SG_ OBJ_Heading_STD_27 : 25824|15@1+ (0.0001,0) [0|3.14] "rad" MCU
 SG_ OBJ_Heading_STD_V_27 : 25839|1@1+ (1,0) [0|1] "bool" MCU
 SG_ OBJ_Angle_Rate_STD_27 : 25840|15@1+ (0.0001,0) [0|2.2318] "RPS" MCU
 SG_ OBJ_Angle_Rate_STD_V_27 : 25855|1@1+ (1,0) [0|1] "bool" MCU
 SG_ OBJ_Angle_Rate_27 : 25856|12@1+ (0.002,-2.234) [-2.234|2.2318] "RPS" MCU
 SG_ OBJ_Angle_Rate_V_27 : 25868|1@1+ (1,0) [0|1] "bool" MCU
 SG_ OBJ_Angle_Right_27 : 25869|14@1+ (0.0002,-1.571) [-1.571|1.571] "rad" MCU
 SG_ OBJ_Angle_Right_V_27 : 25883|1@1+ (1,0) [0|1] "bool" MCU
 SG_ Reserved_16_27 : 25884|4@1+ (1,0) [0|0] "NA" MCU
 SG_ OBJ_Angle_Right_STD_27 : 25888|14@1+ (0.0001,0) [0|1.571] "rad" MCU
 SG_ OBJ_Angle_Right_STD_V_27 : 25902|1@1+ (1,0) [0|1] "bool" MCU
 SG_ OBJ_Angle_Left_27 : 25903|14@1+ (0.0002,-1.571) [-1.571|1.571] "rad" MCU
 SG_ OBJ_Angle_Left_V_27 : 25917|1@1+ (1,0) [0|1] "bool" MCU
 SG_ Reserved_17_27 : 25918|2@1+ (1,0) [0|0] "NA" MCU
 SG_ OBJ_Angle_Left_STD_27 : 25920|14@1+ (0.0001,0) [0|1.571] "rad" MCU
 SG_ OBJ_Angle_Left_STD_V_27 : 25934|1@1+ (1,0) [0|1] "bool" MCU
 SG_ OBJ_Angle_Side_27 : 25935|14@1+ (0.0002,-1.571) [-1.571|1.571] "rad" MCU
 SG_ OBJ_Angle_Side_V_27 : 25949|1@1+ (1,0) [0|1] "bool" MCU
 SG_ Reserved_18_27 : 25950|2@1+ (1,0) [0|0] "NA" MCU
 SG_ OBJ_Angle_Side_STD_27 : 25952|14@1+ (0.0001,0) [0|1.571] "rad" MCU
 SG_ OBJ_Angle_Side_STD_V_27 : 25966|1@1+ (1,0) [0|1] "bool" MCU
 SG_ OBJ_Angle_Mid_V_27 : 25967|1@1+ (1,0) [0|1] "bool" MCU
 SG_ OBJ_Angle_Mid_27 : 25968|14@1+ (0.0002,-1.571) [-1.571|1.571] "rad" MCU
 SG_ Reserved_19_27 : 25982|2@1+ (1,0) [0|0] "NA" MCU
 SG_ OBJ_Angle_Mid_STD_27 : 25984|14@1+ (0.0001,0) [0|1.571] "rad" MCU
 SG_ OBJ_Angle_Mid_STD_V_27 : 25998|1@1+ (1,0) [0|1] "bool" MCU
 SG_ OBJ_Angle_Bottom_V_27 : 25999|1@1+ (1,0) [0|1] "bool" MCU
 SG_ OBJ_Angle_Bottom_27 : 26000|14@1+ (0.0002,-1.571) [-1.571|1.571] "rad" MCU
 SG_ Reserved_20_27 : 26014|2@1+ (1,0) [0|0] "NA" MCU
 SG_ OBJ_Angle_Bottom_STD_27 : 26016|14@1+ (0.0001,0) [0|1.571] "rad" MCU
 SG_ OBJ_Angle_Bottom_STD_V_27 : 26030|1@1+ (1,0) [0|1] "bool" MCU
 SG_ OBJ_Visibility_Side_V_27 : 26031|1@1+ (1,0) [0|1] "bool" MCU
 SG_ OBJ_Visibility_Side_27 : 26032|2@1+ (1,0) [0|2] "ENUM" MCU
 SG_ OBJ_Is_In_Drivable_Area_27 : 26034|1@1+ (1,0) [0|1] "bool" MCU
 SG_ OBJ_Is_In_Drivable_Area_V_27 : 26035|1@1+ (1,0) [0|1] "bool" MCU
 SG_ OBJ_Is_VeryClose_V_27 : 26036|1@1+ (1,0) [0|1] "bool" MCU
 SG_ OBJ_Is_VeryClose_27 : 26037|1@1+ (1,0) [0|1] "bool" MCU
 SG_ OBJ_Buffer_C4_27 : 26038|2@1+ (1,0) [0|2] "NA" MCU
 SG_ OBJ_Buffer_C5_27 : 26040|2@1+ (1,0) [0|2] "NA" MCU
 SG_ OBJ_Buffer_C6_27 : 26042|2@1+ (1,0) [0|2] "NA" MCU
 SG_ OBJ_Buffer_C7_27 : 26044|2@1+ (1,0) [0|2] "NA" MCU
 SG_ Reserved_21_27 : 26046|2@1+ (1,0) [0|0] "NA" MCU
 SG_ OBJ_OverlapAngleEgoLaneR_27 : 26048|10@1+ (0.01,-3.14) [-3.14|3.14] "rad" MCU
 SG_ OBJ_OverlapAngleEgoLaneR_V_27 : 26058|1@1+ (1,0) [0|1] "bool" MCU
 SG_ OBJ_OverlapAngleEgoLaneL_27 : 26059|10@1+ (0.01,-3.14) [-3.14|3.14] "rad" MCU
 SG_ OBJ_OverlapAngleEgoLaneL_V_27 : 26069|1@1+ (1,0) [0|1] "bool" MCU
 SG_ OBJ_Is_EMERGENCY_VCL_27 : 26070|1@1+ (1,0) [0|1] "bool" MCU
 SG_ OBJ_EMERGENCY_LIGHT_COLOR_27 : 26071|4@1+ (1,0) [0|15] "BITWIZE" MCU
 SG_ OBJ_EMERGENCY_V_27 : 26075|1@1+ (1,0) [0|1] "bool" MCU
 SG_ Reserved_22_27 : 26076|4@1+ (1,0) [0|0] "NA" MCU
 SG_ OBJ_Angle_Top_27 : 26080|14@1+ (0.0002,0) [0|3.1415] "rad" MCU
 SG_ OBJ_Angle_Top_V_27 : 26094|1@1+ (1,0) [0|1] "bool" MCU
 SG_ OBJ_Angle_Top_STD_27 : 26095|15@1+ (0.0001,0) [0|3.1415] "rad" MCU
 SG_ OBJ_Angle_Top_STD_V_27 : 26110|1@1+ (1,0) [0|1] "bool" MCU
 SG_ OBJ_Buffer_C14_27 : 26111|1@1+ (1,0) [0|1] "NA" MCU
 SG_ OBJ_Buffer_C15_27 : 26112|1@1+ (1,0) [0|1] "NA" MCU
 SG_ OBJ_Buffer_C18_27 : 26113|2@1+ (1,0) [0|2] "NA" MCU
 SG_ OBJ_Buffer_C19_27 : 26115|1@1+ (1,0) [0|1] "NA" MCU
 SG_ Reserved_23_27 : 26116|28@1+ (1,0) [0|0] "NA" MCU
 SG_ OBJ_CRC_28 : 26144|32@1+ (1,0) [0|4294967295] "NA" MCU
 SG_ OBJ_ID_28 : 26176|8@1+ (1,0) [0|255] "counter" MCU
 SG_ OBJ_Existence_Probability_28 : 26184|8@1+ (0.01,0) [0|1] "NA" MCU
 SG_ OBJ_Fusion_Source_28 : 26192|16@1+ (1,0) [0|65535] "BITWIZE" MCU
 SG_ OBJ_Triggered_SDM_28 : 26208|2@1+ (1,0) [0|2] "ENUM" MCU
 SG_ OBJ_Motion_Category_28 : 26210|4@1+ (1,0) [0|13] "ENUM" MCU
 SG_ OBJ_Buffer_C0_28 : 26214|7@1+ (0.01,0) [0|1] "NA" MCU
 SG_ OBJ_Object_Age_28 : 26221|11@1+ (1,0) [0|2047] "frames" MCU
 SG_ OBJ_Measuring_Status_28 : 26232|3@1+ (1,0) [0|7] "BITWIZE" MCU
 SG_ OBJ_Object_Class_28 : 26235|4@1+ (1,0) [0|8] "ENUM" MCU
 SG_ Reserved_4_28 : 26239|1@1+ (1,0) [0|0] "NA" MCU
 SG_ OBJ_Class_Probability_28 : 26240|7@1+ (0.01,0) [0|1] "NA" MCU
 SG_ OBJ_Car_Probability_28 : 26247|7@1+ (0.01,0) [0|1] "NA" MCU
 SG_ OBJ_Truck_Probability_28 : 26254|7@1+ (0.01,0) [0|1] "NA" MCU
 SG_ OBJ_Bike_Probability_28 : 26261|7@1+ (0.01,0) [0|1] "NA" MCU
 SG_ OBJ_Camera_Source_28 : 26268|4@1+ (1,0) [0|15] "ENUM" MCU
 SG_ OBJ_Motion_Status_28 : 26272|3@1+ (1,0) [0|5] "ENUM" MCU
 SG_ OBJ_Motion_Orientation_28 : 26275|4@1+ (1,0) [0|13] "ENUM" MCU
 SG_ OBJ_Has_Cut_Lane_28 : 26279|1@1+ (1,0) [0|1] "bool" MCU
 SG_ OBJ_Has_Cut_Path_28 : 26280|1@1+ (1,0) [0|1] "bool" MCU
 SG_ OBJ_Brake_Light_28 : 26281|1@1+ (1,0) [0|1] "bool" MCU
 SG_ OBJ_Turn_Indicator_Right_28 : 26282|1@1+ (1,0) [0|1] "bool" MCU
 SG_ OBJ_Turn_Indicator_Left_28 : 26283|1@1+ (1,0) [0|1] "bool" MCU
 SG_ OBJ_Light_Indicator_Validity_28 : 26284|1@1+ (1,0) [0|1] "bool" MCU
 SG_ OBJ_Right_Out_Of_Image_28 : 26285|1@1+ (1,0) [0|1] "bool" MCU
 SG_ OBJ_Left_Out_Of_Image_28 : 26286|1@1+ (1,0) [0|1] "bool" MCU
 SG_ OBJ_Right_Out_Of_Image_V_28 : 26287|1@1+ (1,0) [0|1] "bool" MCU
 SG_ OBJ_Left_Out_Of_Image_V_28 : 26288|1@1+ (1,0) [0|1] "bool" MCU
 SG_ OBJ_Top_Out_Of_Image_28 : 26289|1@1+ (1,0) [0|1] "bool" MCU
 SG_ OBJ_Bottom_Out_Of_Image_28 : 26290|1@1+ (1,0) [0|1] "bool" MCU
 SG_ OBJ_Top_Out_Of_Image_V_28 : 26291|1@1+ (1,0) [0|1] "bool" MCU
 SG_ OBJ_Bottom_Out_Of_Image_V_28 : 26292|1@1+ (1,0) [0|1] "bool" MCU
 SG_ OBJ_Lane_Assignment_28 : 26293|3@1+ (1,0) [0|5] "ENUM" MCU
 SG_ OBJ_Lane_Assignment_V_28 : 26296|1@1+ (1,0) [0|1] "bool" MCU
 SG_ OBJ_Age_Seconds_28 : 26297|7@1+ (1,0) [0|100] "s" MCU
 SG_ OBJ_Age_Seconds_V_28 : 26304|1@1+ (1,0) [0|1] "bool" MCU
 SG_ OBJ_Width_28 : 26305|9@1+ (0.01,0) [0.4|2.95] "m" MCU
 SG_ OBJ_Width_V_28 : 26314|1@1+ (1,0) [0|1] "bool" MCU
 SG_ OBJ_Width_STD_28 : 26315|11@1+ (0.001,0) [0|2] "m" MCU
 SG_ OBJ_Width_STD_V_28 : 26326|1@1+ (1,0) [0|1] "bool" MCU
 SG_ OBJ_Length_28 : 26327|9@1+ (0.05,0) [1.2|21] "m" MCU
 SG_ OBJ_Length_V_28 : 26336|1@1+ (1,0) [0|1] "bool" MCU
 SG_ OBJ_Length_STD_28 : 26337|10@1+ (0.01,0) [0|10] "m" MCU
 SG_ OBJ_Length_STD_V_28 : 26347|1@1+ (1,0) [0|1] "bool" MCU
 SG_ OBJ_Radar_ID_28 : 26348|8@1+ (1,0) [0|255] "counter" MCU
 SG_ OBJ_Height_28 : 26356|9@1+ (0.01,0) [0|2.95] "m" MCU
 SG_ OBJ_Height_V_28 : 26365|1@1+ (1,0) [0|1] "bool" MCU
 SG_ Reserved_5_28 : 26366|2@1+ (1,0) [0|0] "NA" MCU
 SG_ OBJ_Height_STD_28 : 26368|11@1+ (0.001,0) [0|2] "m" MCU
 SG_ OBJ_Height_STD_V_28 : 26379|1@1+ (1,0) [0|1] "bool" MCU
 SG_ OBJ_Abs_Long_Velocity_28 : 26380|12@1+ (0.05,-100) [-100|100] "m_per_s" MCU
 SG_ OBJ_Abs_Long_Velocity_V_28 : 26392|1@1+ (1,0) [0|1] "bool" MCU
 SG_ Reserved_6_28 : 26393|7@1+ (1,0) [0|0] "NA" MCU
 SG_ OBJ_Abs_Long_Velocity_STD_28 : 26400|13@1+ (0.01,0) [0|65] "m_per_s" MCU
 SG_ OBJ_Abs_Long_Vel_STD_V_28 : 26413|1@1+ (1,0) [0|1] "bool" MCU
 SG_ OBJ_Abs_Lat_Velocity_28 : 26414|11@1+ (0.05,-50) [-50|50] "m_per_s" MCU
 SG_ OBJ_Abs_Lat_Velocity_V_28 : 26425|1@1+ (1,0) [0|1] "bool" MCU
 SG_ Reserved_7_28 : 26426|6@1+ (1,0) [0|0] "NA" MCU
 SG_ OBJ_Abs_Lat_Velocity_STD_28 : 26432|13@1+ (0.01,0) [0|50] "m_per_s" MCU
 SG_ OBJ_Abs_Lat_Vel_STD_V_28 : 26445|1@1+ (1,0) [0|1] "bool" MCU
 SG_ OBJ_Abs_Long_Acc_28 : 26446|9@1+ (0.05,-10) [-10|10] "m_per_s2" MCU
 SG_ OBJ_Abs_Long_Acc_V_28 : 26455|1@1+ (1,0) [0|1] "bool" MCU
 SG_ Reserved_8_28 : 26456|8@1+ (1,0) [0|0] "NA" MCU
 SG_ OBJ_Abs_Long_Acc_STD_28 : 26464|10@1+ (0.01,0) [0|7.3] "m_per_s2" MCU
 SG_ OBJ_Abs_Long_Acc_STD_V_28 : 26474|1@1+ (1,0) [0|1] "bool" MCU
 SG_ OBJ_Abs_Lat_Acc_28 : 26475|9@1+ (0.05,-10) [-10|10] "m_per_s2" MCU
 SG_ OBJ_Abs_Lat_Acc_V_28 : 26484|1@1+ (1,0) [0|1] "bool" MCU
 SG_ OBJ_Abs_Lat_Acc_STD_28 : 26485|10@1+ (0.01,0) [0|7.3] "m_per_s2" MCU
 SG_ OBJ_Abs_Lat_Acc_STD_V_28 : 26495|1@1+ (1,0) [0|1] "bool" MCU
 SG_ OBJ_Abs_Acceleration_28 : 26496|9@1+ (0.05,-12.7) [-12.7|12.7] "m_per_s2" MCU
 SG_ OBJ_Abs_Acceleration_V_28 : 26505|1@1+ (1,0) [0|1] "bool" MCU
 SG_ OBJ_Abs_Acc_STD_28 : 26506|10@1+ (0.01,0) [0|7.3] "m_per_s2" MCU
 SG_ OBJ_Abs_Acc_STD_V_28 : 26516|1@1+ (1,0) [0|1] "bool" MCU
 SG_ OBJ_Inv_TTC_28 : 26517|11@1+ (0.01,-8) [-8|8] "INV(s)" MCU
 SG_ OBJ_Inv_TTC_V_28 : 26528|1@1+ (1,0) [0|1] "bool" MCU
 SG_ OBJ_Inv_TTC_STD_28 : 26529|12@1+ (0.001,0) [0|4] "INV(s)" MCU
 SG_ OBJ_Inv_TTC_STD_V_28 : 26541|1@1+ (1,0) [0|1] "bool" MCU
 SG_ OBJ_Relative_Long_Acc_28 : 26542|10@1+ (0.05,-20) [-20|20] "m_per_s2" MCU
 SG_ OBJ_Relative_Long_Acc_V_28 : 26552|1@1+ (1,0) [0|1] "bool" MCU
 SG_ Reserved_9_28 : 26553|7@1+ (1,0) [0|0] "NA" MCU
 SG_ OBJ_Relative_Long_Acc_STD_28 : 26560|10@1+ (0.01,0) [0|7.3] "m_per_s2" MCU
 SG_ OBJ_Rel_Long_Acc_STD_V_28 : 26570|1@1+ (1,0) [0|1] "bool" MCU
 SG_ OBJ_Relative_Long_Velocity_28 : 26571|13@1+ (0.05,-120) [-120|130] "m_per_s" MCU
 SG_ OBJ_Relative_Long_Velocity_V_28 : 26584|1@1+ (1,0) [0|1] "bool" MCU
 SG_ Reserved_10_28 : 26585|7@1+ (1,0) [0|0] "NA" MCU
 SG_ OBJ_Relative_Long_Vel_STD_28 : 26592|14@1+ (0.01,0) [0|130] "m_per_s" MCU
 SG_ OBJ_Rel_Long_Vel_STD_V_28 : 26606|1@1+ (1,0) [0|1] "bool" MCU
 SG_ OBJ_Relative_Lat_Velocity_28 : 26607|11@1+ (0.05,-50) [-50|50] "m_per_s" MCU
 SG_ OBJ_Relative_Lat_Velocity_V_28 : 26618|1@1+ (1,0) [0|1] "bool" MCU
 SG_ Reserved_11_28 : 26619|5@1+ (1,0) [0|0] "NA" MCU
 SG_ OBJ_Relative_Lat_Velocity_STD_28 : 26624|13@1+ (0.01,0) [0|50] "m_per_s" MCU
 SG_ OBJ_Rel_Lat_Vel_STD_V_28 : 26637|1@1+ (1,0) [0|1] "bool" MCU
 SG_ OBJ_Long_Distance_28 : 26638|14@1+ (0.05,-200) [-200|500] "m" MCU
 SG_ OBJ_Long_Distance_V_28 : 26652|1@1+ (1,0) [0|1] "bool" MCU
 SG_ Reserved_12_28 : 26653|3@1+ (1,0) [0|0] "NA" MCU
 SG_ OBJ_Long_Distance_STD_28 : 26656|15@1+ (0.01,0) [0|250] "m" MCU
 SG_ OBJ_Long_Distance_STD_V_28 : 26671|1@1+ (1,0) [0|1] "bool" MCU
 SG_ OBJ_Lat_Distance_28 : 26672|12@1+ (0.05,-100) [-100|100] "m" MCU
 SG_ OBJ_Lat_Distance_V_28 : 26684|1@1+ (1,0) [0|1] "bool" MCU
 SG_ Reserved_13_28 : 26685|3@1+ (1,0) [0|0] "NA" MCU
 SG_ OBJ_Lat_Distance_STD_28 : 26688|14@1+ (0.01,0) [0|100] "m" MCU
 SG_ OBJ_Lat_Distance_STD_V_28 : 26702|1@1+ (1,0) [0|1] "bool" MCU
 SG_ OBJ_Absolute_Speed_28 : 26703|12@1+ (0.05,-65) [-65|65] "m_per_s" MCU
 SG_ OBJ_Absolute_Speed_V_28 : 26715|1@1+ (1,0) [0|1] "bool" MCU
 SG_ Reserved_14_28 : 26716|4@1+ (1,0) [0|0] "NA" MCU
 SG_ OBJ_Absolute_Speed_STD_28 : 26720|13@1+ (0.01,0) [0|65] "m_per_s" MCU
 SG_ OBJ_Absolute_Speed_STD_V_28 : 26733|1@1+ (1,0) [0|1] "bool" MCU
 SG_ OBJ_Heading_28 : 26734|10@1+ (0.01,-3.14) [-3.14|3.14] "rad" MCU
 SG_ OBJ_Heading_V_28 : 26744|1@1+ (1,0) [0|1] "bool" MCU
 SG_ Reserved_15_28 : 26745|7@1+ (1,0) [0|0] "NA" MCU
 SG_ OBJ_Heading_STD_28 : 26752|15@1+ (0.0001,0) [0|3.14] "rad" MCU
 SG_ OBJ_Heading_STD_V_28 : 26767|1@1+ (1,0) [0|1] "bool" MCU
 SG_ OBJ_Angle_Rate_STD_28 : 26768|15@1+ (0.0001,0) [0|2.2318] "RPS" MCU
 SG_ OBJ_Angle_Rate_STD_V_28 : 26783|1@1+ (1,0) [0|1] "bool" MCU
 SG_ OBJ_Angle_Rate_28 : 26784|12@1+ (0.002,-2.234) [-2.234|2.2318] "RPS" MCU
 SG_ OBJ_Angle_Rate_V_28 : 26796|1@1+ (1,0) [0|1] "bool" MCU
 SG_ OBJ_Angle_Right_28 : 26797|14@1+ (0.0002,-1.571) [-1.571|1.571] "rad" MCU
 SG_ OBJ_Angle_Right_V_28 : 26811|1@1+ (1,0) [0|1] "bool" MCU
 SG_ Reserved_16_28 : 26812|4@1+ (1,0) [0|0] "NA" MCU
 SG_ OBJ_Angle_Right_STD_28 : 26816|14@1+ (0.0001,0) [0|1.571] "rad" MCU
 SG_ OBJ_Angle_Right_STD_V_28 : 26830|1@1+ (1,0) [0|1] "bool" MCU
 SG_ OBJ_Angle_Left_28 : 26831|14@1+ (0.0002,-1.571) [-1.571|1.571] "rad" MCU
 SG_ OBJ_Angle_Left_V_28 : 26845|1@1+ (1,0) [0|1] "bool" MCU
 SG_ Reserved_17_28 : 26846|2@1+ (1,0) [0|0] "NA" MCU
 SG_ OBJ_Angle_Left_STD_28 : 26848|14@1+ (0.0001,0) [0|1.571] "rad" MCU
 SG_ OBJ_Angle_Left_STD_V_28 : 26862|1@1+ (1,0) [0|1] "bool" MCU
 SG_ OBJ_Angle_Side_28 : 26863|14@1+ (0.0002,-1.571) [-1.571|1.571] "rad" MCU
 SG_ OBJ_Angle_Side_V_28 : 26877|1@1+ (1,0) [0|1] "bool" MCU
 SG_ Reserved_18_28 : 26878|2@1+ (1,0) [0|0] "NA" MCU
 SG_ OBJ_Angle_Side_STD_28 : 26880|14@1+ (0.0001,0) [0|1.571] "rad" MCU
 SG_ OBJ_Angle_Side_STD_V_28 : 26894|1@1+ (1,0) [0|1] "bool" MCU
 SG_ OBJ_Angle_Mid_V_28 : 26895|1@1+ (1,0) [0|1] "bool" MCU
 SG_ OBJ_Angle_Mid_28 : 26896|14@1+ (0.0002,-1.571) [-1.571|1.571] "rad" MCU
 SG_ Reserved_19_28 : 26910|2@1+ (1,0) [0|0] "NA" MCU
 SG_ OBJ_Angle_Mid_STD_28 : 26912|14@1+ (0.0001,0) [0|1.571] "rad" MCU
 SG_ OBJ_Angle_Mid_STD_V_28 : 26926|1@1+ (1,0) [0|1] "bool" MCU
 SG_ OBJ_Angle_Bottom_V_28 : 26927|1@1+ (1,0) [0|1] "bool" MCU
 SG_ OBJ_Angle_Bottom_28 : 26928|14@1+ (0.0002,-1.571) [-1.571|1.571] "rad" MCU
 SG_ Reserved_20_28 : 26942|2@1+ (1,0) [0|0] "NA" MCU
 SG_ OBJ_Angle_Bottom_STD_28 : 26944|14@1+ (0.0001,0) [0|1.571] "rad" MCU
 SG_ OBJ_Angle_Bottom_STD_V_28 : 26958|1@1+ (1,0) [0|1] "bool" MCU
 SG_ OBJ_Visibility_Side_V_28 : 26959|1@1+ (1,0) [0|1] "bool" MCU
 SG_ OBJ_Visibility_Side_28 : 26960|2@1+ (1,0) [0|2] "ENUM" MCU
 SG_ OBJ_Is_In_Drivable_Area_28 : 26962|1@1+ (1,0) [0|1] "bool" MCU
 SG_ OBJ_Is_In_Drivable_Area_V_28 : 26963|1@1+ (1,0) [0|1] "bool" MCU
 SG_ OBJ_Is_VeryClose_V_28 : 26964|1@1+ (1,0) [0|1] "bool" MCU

CM_ SG_ 154 OBJ_Has_Cut_Lane_23 "Indicates whether the object cut the host's (right or left) lane. In case there are no lanes, indicates whether the objects is at most 1 meters away from the host.";
CM_ SG_ 154 OBJ_Has_Cut_Path_23 "Indicates whether the object is in the host's path.";
CM_ SG_ 154 OBJ_Brake_Light_23 "Indication for brake lights ";
CM_ SG_ 154 OBJ_Turn_Indicator_Right_23 "Indication for blinking right light.";
CM_ SG_ 154 OBJ_Turn_Indicator_Left_23 "Indication for blinking left light ";
CM_ SG_ 154 OBJ_Light_Indicator_Validity_23 "Validator for light indicators";
CM_ SG_ 154 OBJ_Right_Out_Of_Image_23 "Indicates whether the measurment are predicted out of the right side of the image bounderies.";
CM_ SG_ 154 OBJ_Left_Out_Of_Image_23 "Indicates whether if measurment are predicted out of  the left side of the image bounderies";
CM_ SG_ 154 OBJ_Right_Out_Of_Image_V_23 "validator";
CM_ SG_ 154 OBJ_Left_Out_Of_Image_V_23 "validator";
CM_ SG_ 154 OBJ_Top_Out_Of_Image_23 "Indicates whether if measurment are predicted out of  the top of the image bounderies";
CM_ SG_ 154 OBJ_Bottom_Out_Of_Image_23 "Indicates whether if measurment are predicted out of  the bottom of the image bounderies";
CM_ SG_ 154 OBJ_Top_Out_Of_Image_V_23 "validator";
CM_ SG_ 154 OBJ_Bottom_Out_Of_Image_V_23 "validator";
CM_ SG_ 154 OBJ_Lane_Assignment_23 "The object's lane relative to the host lane.";
CM_ SG_ 154 OBJ_Lane_Assignment_V_23 "Validator for lane assignment";
CM_ SG_ 154 OBJ_Age_Seconds_23 "Time in seconds in which the object was recognized. ";
CM_ SG_ 154 OBJ_Age_Seconds_V_23 "Validator for object age";
CM_ SG_ 154 OBJ_Width_23 "The width of the target vehicle in the world (not to be mistaken with the width of the visible part of the vehicle).";
CM_ SG_ 154 OBJ_Width_V_23 "Validator for object width";
CM_ SG_ 154 OBJ_Width_STD_23 "Standard deviation for object width";
CM_ SG_ 154 OBJ_Width_STD_V_23 "Validator for the standard deviation of object width";
CM_ SG_ 154 OBJ_Length_23 "The length of the vehicle in the world. For crossing bicycles it gives the viewed length of the bicycle.";
CM_ SG_ 154 OBJ_Length_V_23 "Validator for object length.";
CM_ SG_ 154 OBJ_Length_STD_23 "Standard deviation for object length.";
CM_ SG_ 154 OBJ_Length_STD_V_23 "Validator for the standard deviation of object length.";
CM_ SG_ 154 OBJ_Radar_ID_23 "Radar Object ID of the Fused Object, Only relvant when OBJ_Fusion_Source is not Camera only";
CM_ SG_ 154 OBJ_Height_23 "The height of the object in the world. ";
CM_ SG_ 154 OBJ_Height_V_23 "Validator for object height.";
CM_ SG_ 154 OBJ_Height_STD_23 "Standard deviation for object height.";
CM_ SG_ 154 OBJ_Height_STD_V_23 "Validator for the standard deviation of object height.";
CM_ SG_ 154 OBJ_Abs_Long_Velocity_23 "Absolute longitudinal velocity.";
CM_ SG_ 154 OBJ_Abs_Long_Velocity_V_23 "Validator for absolute longitudinal velocity.";
CM_ SG_ 154 OBJ_Abs_Long_Velocity_STD_23 "Standard deviation of absolute longitudinal velocity.";
CM_ SG_ 154 OBJ_Abs_Long_Vel_STD_V_23 "Validator for the standard deviation of the absolute longitudinal velocity.";
CM_ SG_ 154 OBJ_Abs_Lat_Velocity_23 "The lateral ground speed of the object.";
CM_ SG_ 154 OBJ_Abs_Lat_Velocity_V_23 "Validator for the lateral ground speed of the object.";
CM_ SG_ 154 OBJ_Abs_Lat_Velocity_STD_23 "STD of the lateral ground speed of the object.";
CM_ SG_ 154 OBJ_Abs_Lat_Vel_STD_V_23 "Validator for the STD of the lateral ground speed of the object.";
CM_ SG_ 154 OBJ_Abs_Long_Acc_23 "The longitudinal ground acceleration of the object.";
CM_ SG_ 154 OBJ_Abs_Long_Acc_V_23 "Validator for the longitudinal ground acceleration of the object.";
CM_ SG_ 154 OBJ_Abs_Long_Acc_STD_23 "STD of the longitudinal ground acceleration of the object.";
CM_ SG_ 154 OBJ_Abs_Long_Acc_STD_V_23 "Validator for the STD of the longitudinal ground acceleration of the object.";
CM_ SG_ 154 OBJ_Abs_Lat_Acc_23 "The lateral ground acceleration of the object.";
CM_ SG_ 154 OBJ_Abs_Lat_Acc_V_23 "Validator for the lateral ground acceleration of the object.";
CM_ SG_ 154 OBJ_Abs_Lat_Acc_STD_23 "STD of the lateral ground acceleration of the object.";
CM_ SG_ 154 OBJ_Abs_Lat_Acc_STD_V_23 "Validator for the STD of the lateral ground acceleration of the object.";
CM_ SG_ 154 OBJ_Abs_Acceleration_23 "The absolute ground acceleration in the target's heading direction.";
CM_ SG_ 154 OBJ_Abs_Acceleration_V_23 "Validator for the absolute ground acceleration.";
CM_ SG_ 154 OBJ_Abs_Acc_STD_23 "STD of the absolute ground acceleration.";
CM_ SG_ 154 OBJ_Abs_Acc_STD_V_23 "Validator for the STD of the absolute ground acceleration.";
CM_ SG_ 154 OBJ_Inv_TTC_23 "Inverse TTC (time to collision).";
CM_ SG_ 154 OBJ_Inv_TTC_STD_23 "STD for inverse TTC .";
CM_ SG_ 154 OBJ_Inv_TTC_STD_V_23 "Validator for the STD for inverse TTC .";
CM_ SG_ 154 OBJ_Relative_Long_Acc_23 "The relative lateral ground acceleration of the object.";
CM_ SG_ 154 OBJ_Relative_Long_Acc_V_23 "Validator for the relative lateral ground acceleration of the object.";
CM_ SG_ 154 OBJ_Relative_Long_Acc_STD_23 "STD of the relative lateral ground acceleration of the object.";
CM_ SG_ 154 OBJ_Rel_Long_Acc_STD_V_23 "Validator for the STD of the relative lateral ground acceleration.";
CM_ SG_ 154 OBJ_Relative_Long_Velocity_23 "The relative longtitudinal speed between the target and ego vehicle. ";
CM_ SG_ 154 OBJ_Relative_Long_Velocity_V_23 "Validator for the relative longtitudinal speed.";
CM_ SG_ 154 OBJ_Relative_Long_Vel_STD_23 "STD of the relative longtitudinal speed.";
CM_ SG_ 154 OBJ_Rel_Long_Vel_STD_V_23 "Validator for the STD of the relative longtitudinal speed.";
CM_ SG_ 154 OBJ_Relative_Lat_Velocity_23 "The relative lateral speed between the target and ego vehicle. ";
CM_ SG_ 154 OBJ_Relative_Lat_Velocity_V_23 "Validator for the relative lateral speed. ";
CM_ SG_ 154 OBJ_Relative_Lat_Velocity_STD_23 "STD of the relative lateral speed. ";
CM_ SG_ 154 OBJ_Rel_Lat_Vel_STD_V_23 "Validator for the STD of the relative lateral speed. ";
CM_ SG_ 154 OBJ_Long_Distance_23 "The longitudinal distance to middle of the rear bumper (middle of the RL and RR corners) of the target.";
CM_ SG_ 154 OBJ_Long_Distance_V_23 "Validator of the longtitudinal distance field";
CM_ SG_ 154 OBJ_Long_Distance_STD_23 "STD of the  longtitudinal distance.";
CM_ SG_ 154 OBJ_Long_Distance_STD_V_23 "Validator for the STD of the  longtitudinal distance.";
CM_ SG_ 154 OBJ_Lat_Distance_23 "Lateral distance to the middle of the RL and RR corners.  ";
CM_ SG_ 154 OBJ_Lat_Distance_V_23 "Validator for the lateral distance of the object.";
CM_ SG_ 154 OBJ_Lat_Distance_STD_23 "STD of the lateral distance of the object.";
CM_ SG_ 154 OBJ_Lat_Distance_STD_V_23 "Validator for the STD of the lateral distance of the object.";
CM_ SG_ 154 OBJ_Absolute_Speed_23 "The absolute ground speed in the targets' heading direction.";
CM_ SG_ 154 OBJ_Absolute_Speed_V_23 "Validator for the absolute ground speed.";
CM_ SG_ 154 OBJ_Absolute_Speed_STD_23 "STD of the absolute ground speed.";
CM_ SG_ 154 OBJ_Absolute_Speed_STD_V_23 "Validator for the STD of the absolute ground speed.";
CM_ SG_ 154 OBJ_Heading_23 "The angle beetweenthe host longitudinal axis and target's heading (clockwise, e.g. PI/2 is a target crossing from left to right).";
CM_ SG_ 154 OBJ_Heading_V_23 "Validator for the object heading.";
CM_ SG_ 154 OBJ_Heading_STD_23 "STD of the object heading.";
CM_ SG_ 154 OBJ_Heading_STD_V_23 "Validator for the STD of the object heading.";
CM_ SG_ 154 OBJ_Angle_Rate_STD_23 "Standard deviation of the angular speed. (radians)";
CM_ SG_ 154 OBJ_Angle_Rate_STD_V_23 "Validator for the STD of the angular speed.";
CM_ SG_ 154 OBJ_Angle_Rate_23 "The momentary angular speed of the object. (radians)";
CM_ SG_ 154 OBJ_Angle_Rate_V_23 "Validator for the angular speed.";
CM_ SG_ 154 OBJ_Angle_Right_23 "The angle between the host longitudinal axis and the right side of the front / rear of the target (the visible one). The positive side is to the host's right.";
CM_ SG_ 154 OBJ_Angle_Right_V_23 "Validator for angleRight";
CM_ SG_ 154 OBJ_Angle_Right_STD_23 "Standard deviation of angleRight";
CM_ SG_ 154 OBJ_Angle_Right_STD_V_23 "Validator for the standard deviation of angleRight.";
CM_ SG_ 154 OBJ_Angle_Left_23 "The angle between the host longitudinal axis and the left side of the front / rear of the target (the visible one). The positive side is to the host's right.";
CM_ SG_ 154 OBJ_Angle_Left_V_23 "Validator for angleLeft.";
CM_ SG_ 154 OBJ_Angle_Left_STD_23 "Standard deviation of angleLeft.";
CM_ SG_ 154 OBJ_Angle_Left_STD_V_23 "Validator for the standard deviation of angleLeft.";
CM_ SG_ 154 OBJ_Angle_Side_23 "The angle between the host longitudinal axis and the far visible edge - the visible edge of the front / rear of the target that is not visible. Currently supported for vehicles only.";
CM_ SG_ 154 OBJ_Angle_Side_V_23 "Validator for angleSide.";
CM_ SG_ 154 OBJ_Angle_Side_STD_23 "Standard deviation of angleSide.";
CM_ SG_ 154 OBJ_Angle_Side_STD_V_23 "Validator for the STD of angleSide.";
CM_ SG_ 154 OBJ_Angle_Mid_V_23 "Validator for angleMid.";
CM_ SG_ 154 OBJ_Angle_Mid_23 "The angle between the host longitudinal axis and the middle of the front / rear of the target (the visible one). The positive side is to the host's right.";
CM_ SG_ 154 OBJ_Angle_Mid_STD_23 "Standard deviation of angleMid.";
CM_ SG_ 154 OBJ_Angle_Mid_STD_V_23 "Validator for the STD of angleMid.";
CM_ SG_ 154 OBJ_Angle_Bottom_V_23 "Validator for OBJAngle_Bottom. ";
CM_ SG_ 154 OBJ_Angle_Bottom_23 "The angle between the longitudinal axis and the Bottom of the front / rear of the target (the visible one). The positive side is to the host's bottom";
CM_ SG_ 154 OBJ_Angle_Bottom_STD_23 "STD for OBJAngle_Bottom. ";
CM_ SG_ 154 OBJ_Angle_Bottom_STD_V_23 "Validator for OBJAngle_Bottom_STD. ";
CM_ SG_ 154 OBJ_Visibility_Side_V_23 "Currently Supported for VD only";
CM_ SG_ 154 OBJ_Visibility_Side_23 "From what car  side is the object visible";
CM_ SG_ 154 OBJ_Is_In_Drivable_Area_23 "Indicates whether the target is in a driveable area.";
CM_ SG_ 154 OBJ_Is_In_Drivable_Area_V_23 "Validator for OBJ_Is_In_Drivable_Area.";
CM_ SG_ 154 OBJ_Is_VeryClose_V_23 "Validator for OBJ_Is_VeryClose. ";
CM_ SG_ 154 OBJ_Is_VeryClose_23 "Indicates whether the target is very close to the host such that it is hard to measure its distance. Currently relevant for peds only";
CM_ SG_ 154 OBJ_OverlapAngleEgoLaneR_23 "Lateral distance to the middle of the RL and RR corners.";
CM_ SG_ 154 OBJ_OverlapAngleEgoLaneR_V_23 "Validator for OBJ_OverlapAngleEgoLaneR";
CM_ SG_ 154 OBJ_OverlapAngleEgoLaneL_23 "Lateral distance to the middle of the RL and RR corners.  ";
CM_ SG_ 154 OBJ_OverlapAngleEgoLaneL_V_23 "Validator for OBJ_OverlapAngleEgoLaneL";
CM_ SG_ 154 OBJ_Is_EMERGENCY_VCL_23 "Is Object an Emergency Vehicle";
CM_ SG_ 154 OBJ_EMERGENCY_LIGHT_COLOR_23 "Emergency Color";
CM_ SG_ 154 OBJ_EMERGENCY_V_23 "Are OBJ_Is_EMERGENCY_VCL and OBJ_EMERGENCY_LIGHT_COLOR Valid";
CM_ SG_ 154 OBJ_Angle_Top_23 "From VD touching point on the ground till the roof of the car";
CM_ SG_ 154 OBJ_Angle_Top_V_23 "Validator for OBJ_Angle_Top ";
CM_ SG_ 154 OBJ_Angle_Top_STD_23 "STD for OBJ_Angle_Top";
CM_ SG_ 154 OBJ_Angle_Top_STD_V_23 "Validator for OBJ_Angle_Top_STD. ";
CM_ SG_ 154 OBJ_CRC_24 "Calculated over all element signals. From the signal after the CRC until the first signal in the next elements OBJ_CRC_N+1  not including";
CM_ SG_ 154 OBJ_ID_24 "The detected object ID. Range is 1-255, while 0 indicates that the field in unfilled.";
CM_ SG_ 154 OBJ_Existence_Probability_24 "The existence probability of the reported object";
CM_ SG_ 154 OBJ_Fusion_Source_24 "sources ids used for fusion";
CM_ SG_ 154 OBJ_Triggered_SDM_24 "Indicates whether the object has trigered the SDM (Safety Diagnostic Manager) alert.";
CM_ SG_ 154 OBJ_Motion_Category_24 "Relevant for VD only. Full description of values can be found at the ACC guide.";
CM_ SG_ 154 OBJ_Object_Age_24 "The number of frames in which the object was recognized.";
CM_ SG_ 154 OBJ_Measuring_Status_24 "Measurment status. Old vs New marks if this is the first frame in which the object is reported. Predicted vs Measured marks if the report is raw or has been predicted forward in time using the measured dynamics and ego motion.";
CM_ SG_ 154 OBJ_Object_Class_24 "Indicates the object type. Uncertain is outputted in case the probability that a vehicle is a truck is very similar to the probability that it is a car. ";
CM_ SG_ 154 OBJ_Class_Probability_24 "The probability of this type classification.";
CM_ SG_ 154 OBJ_Car_Probability_24 "The probability the object is a car";
CM_ SG_ 154 OBJ_Truck_Probability_24 "The probability the object is a Truck";
CM_ SG_ 154 OBJ_Bike_Probability_24 "The probability the object is a Bike";
CM_ SG_ 154 OBJ_Camera_Source_24 "The camera in which this object was detected (best choice).";
CM_ SG_ 154 OBJ_Motion_Status_24 "MOVING - the object is moving STATIONARY - the object was never seen moving STOPPED -  the object was moving and has stopped MOVING_SLOWLY - the object is moving very slowly";
CM_ SG_ 154 OBJ_Motion_Orientation_24 "The direction of the targets heading compared to the host. ";
CM_ SG_ 154 OBJ_Has_Cut_Lane_24 "Indicates whether the object cut the host's (right or left) lane. In case there are no lanes, indicates whether the objects is at most 1 meters away from the host.";
CM_ SG_ 154 OBJ_Has_Cut_Path_24 "Indicates whether the object is in the host's path.";
CM_ SG_ 154 OBJ_Brake_Light_24 "Indication for brake lights ";
CM_ SG_ 154 OBJ_Turn_Indicator_Right_24 "Indication for blinking right light.";
CM_ SG_ 154 OBJ_Turn_Indicator_Left_24 "Indication for blinking left light ";
CM_ SG_ 154 OBJ_Light_Indicator_Validity_24 "Validator for light indicators";
CM_ SG_ 154 OBJ_Right_Out_Of_Image_24 "Indicates whether the measurment are predicted out of the right side of the image bounderies.";
CM_ SG_ 154 OBJ_Left_Out_Of_Image_24 "Indicates whether if measurment are predicted out of  the left side of the image bounderies";
CM_ SG_ 154 OBJ_Right_Out_Of_Image_V_24 "validator";
CM_ SG_ 154 OBJ_Left_Out_Of_Image_V_24 "validator";
CM_ SG_ 154 OBJ_Top_Out_Of_Image_24 "Indicates whether if measurment are predicted out of  the top of the image bounderies";
CM_ SG_ 154 OBJ_Bottom_Out_Of_Image_24 "Indicates whether if measurment are predicted out of  the bottom of the image bounderies";
CM_ SG_ 154 OBJ_Top_Out_Of_Image_V_24 "validator";
CM_ SG_ 154 OBJ_Bottom_Out_Of_Image_V_24 "validator";
CM_ SG_ 154 OBJ_Lane_Assignment_24 "The object's lane relative to the host lane.";
CM_ SG_ 154 OBJ_Lane_Assignment_V_24 "Validator for lane assignment";
CM_ SG_ 154 OBJ_Age_Seconds_24 "Time in seconds in which the object was recognized. ";
CM_ SG_ 154 OBJ_Age_Seconds_V_24 "Validator for object age";
CM_ SG_ 154 OBJ_Width_24 "The width of the target vehicle in the world (not to be mistaken with the width of the visible part of the vehicle).";
CM_ SG_ 154 OBJ_Width_V_24 "Validator for object width";
CM_ SG_ 154 OBJ_Width_STD_24 "Standard deviation for object width";
CM_ SG_ 154 OBJ_Width_STD_V_24 "Validator for the standard deviation of object width";
CM_ SG_ 154 OBJ_Length_24 "The length of the vehicle in the world. For crossing bicycles it gives the viewed length of the bicycle.";
CM_ SG_ 154 OBJ_Length_V_24 "Validator for object length.";
CM_ SG_ 154 OBJ_Length_STD_24 "Standard deviation for object length.";
CM_ SG_ 154 OBJ_Length_STD_V_24 "Validator for the standard deviation of object length.";
CM_ SG_ 154 OBJ_Radar_ID_24 "Radar Object ID of the Fused Object, Only relvant when OBJ_Fusion_Source is not Camera only";
CM_ SG_ 154 OBJ_Height_24 "The height of the object in the world. ";
CM_ SG_ 154 OBJ_Height_V_24 "Validator for object height.";
CM_ SG_ 154 OBJ_Height_STD_24 "Standard deviation for object height.";
CM_ SG_ 154 OBJ_Height_STD_V_24 "Validator for the standard deviation of object height.";
CM_ SG_ 154 OBJ_Abs_Long_Velocity_24 "Absolute longitudinal velocity.";
CM_ SG_ 154 OBJ_Abs_Long_Velocity_V_24 "Validator for absolute longitudinal velocity.";
CM_ SG_ 154 OBJ_Abs_Long_Velocity_STD_24 "Standard deviation of absolute longitudinal velocity.";
CM_ SG_ 154 OBJ_Abs_Long_Vel_STD_V_24 "Validator for the standard deviation of the absolute longitudinal velocity.";
CM_ SG_ 154 OBJ_Abs_Lat_Velocity_24 "The lateral ground speed of the object.";
CM_ SG_ 154 OBJ_Abs_Lat_Velocity_V_24 "Validator for the lateral ground speed of the object.";
CM_ SG_ 154 OBJ_Abs_Lat_Velocity_STD_24 "STD of the lateral ground speed of the object.";
CM_ SG_ 154 OBJ_Abs_Lat_Vel_STD_V_24 "Validator for the STD of the lateral ground speed of the object.";
CM_ SG_ 154 OBJ_Abs_Long_Acc_24 "The longitudinal ground acceleration of the object.";
CM_ SG_ 154 OBJ_Abs_Long_Acc_V_24 "Validator for the longitudinal ground acceleration of the object.";
CM_ SG_ 154 OBJ_Abs_Long_Acc_STD_24 "STD of the longitudinal ground acceleration of the object.";
CM_ SG_ 154 OBJ_Abs_Long_Acc_STD_V_24 "Validator for the STD of the longitudinal ground acceleration of the object.";
CM_ SG_ 154 OBJ_Abs_Lat_Acc_24 "The lateral ground acceleration of the object.";
CM_ SG_ 154 OBJ_Abs_Lat_Acc_V_24 "Validator for the lateral ground acceleration of the object.";
CM_ SG_ 154 OBJ_Abs_Lat_Acc_STD_24 "STD of the lateral ground acceleration of the object.";
CM_ SG_ 154 OBJ_Abs_Lat_Acc_STD_V_24 "Validator for the STD of the lateral ground acceleration of the object.";
CM_ SG_ 154 OBJ_Abs_Acceleration_24 "The absolute ground acceleration in the target's heading direction.";
CM_ SG_ 154 OBJ_Abs_Acceleration_V_24 "Validator for the absolute ground acceleration.";
CM_ SG_ 154 OBJ_Abs_Acc_STD_24 "STD of the absolute ground acceleration.";
CM_ SG_ 154 OBJ_Abs_Acc_STD_V_24 "Validator for the STD of the absolute ground acceleration.";
CM_ SG_ 154 OBJ_Inv_TTC_24 "Inverse TTC (time to collision).";
CM_ SG_ 154 OBJ_Inv_TTC_STD_24 "STD for inverse TTC .";
CM_ SG_ 154 OBJ_Inv_TTC_STD_V_24 "Validator for the STD for inverse TTC .";
CM_ SG_ 154 OBJ_Relative_Long_Acc_24 "The relative lateral ground acceleration of the object.";
CM_ SG_ 154 OBJ_Relative_Long_Acc_V_24 "Validator for the relative lateral ground acceleration of the object.";
CM_ SG_ 154 OBJ_Relative_Long_Acc_STD_24 "STD of the relative lateral ground acceleration of the object.";
CM_ SG_ 154 OBJ_Rel_Long_Acc_STD_V_24 "Validator for the STD of the relative lateral ground acceleration.";
CM_ SG_ 154 OBJ_Relative_Long_Velocity_24 "The relative longtitudinal speed between the target and ego vehicle. ";
CM_ SG_ 154 OBJ_Relative_Long_Velocity_V_24 "Validator for the relative longtitudinal speed.";
CM_ SG_ 154 OBJ_Relative_Long_Vel_STD_24 "STD of the relative longtitudinal speed.";
CM_ SG_ 154 OBJ_Rel_Long_Vel_STD_V_24 "Validator for the STD of the relative longtitudinal speed.";
CM_ SG_ 154 OBJ_Relative_Lat_Velocity_24 "The relative lateral speed between the target and ego vehicle. ";
CM_ SG_ 154 OBJ_Relative_Lat_Velocity_V_24 "Validator for the relative lateral speed. ";
CM_ SG_ 154 OBJ_Relative_Lat_Velocity_STD_24 "STD of the relative lateral speed. ";
CM_ SG_ 154 OBJ_Rel_Lat_Vel_STD_V_24 "Validator for the STD of the relative lateral speed. ";
CM_ SG_ 154 OBJ_Long_Distance_24 "The longitudinal distance to middle of the rear bumper (middle of the RL and RR corners) of the target.";
CM_ SG_ 154 OBJ_Long_Distance_V_24 "Validator of the longtitudinal distance field";
CM_ SG_ 154 OBJ_Long_Distance_STD_24 "STD of the  longtitudinal distance.";
CM_ SG_ 154 OBJ_Long_Distance_STD_V_24 "Validator for the STD of the  longtitudinal distance.";
CM_ SG_ 154 OBJ_Lat_Distance_24 "Lateral distance to the middle of the RL and RR corners.  ";
CM_ SG_ 154 OBJ_Lat_Distance_V_24 "Validator for the lateral distance of the object.";
CM_ SG_ 154 OBJ_Lat_Distance_STD_24 "STD of the lateral distance of the object.";
CM_ SG_ 154 OBJ_Lat_Distance_STD_V_24 "Validator for the STD of the lateral distance of the object.";
CM_ SG_ 154 OBJ_Absolute_Speed_24 "The absolute ground speed in the targets' heading direction.";
CM_ SG_ 154 OBJ_Absolute_Speed_V_24 "Validator for the absolute ground speed.";
CM_ SG_ 154 OBJ_Absolute_Speed_STD_24 "STD of the absolute ground speed.";
CM_ SG_ 154 OBJ_Absolute_Speed_STD_V_24 "Validator for the STD of the absolute ground speed.";
CM_ SG_ 154 OBJ_Heading_24 "The angle beetweenthe host longitudinal axis and target's heading (clockwise, e.g. PI/2 is a target crossing from left to right).";
CM_ SG_ 154 OBJ_Heading_V_24 "Validator for the object heading.";
CM_ SG_ 154 OBJ_Heading_STD_24 "STD of the object heading.";
CM_ SG_ 154 OBJ_Heading_STD_V_24 "Validator for the STD of the object heading.";
CM_ SG_ 154 OBJ_Angle_Rate_STD_24 "Standard deviation of the angular speed. (radians)";
CM_ SG_ 154 OBJ_Angle_Rate_STD_V_24 "Validator for the STD of the angular speed.";
CM_ SG_ 154 OBJ_Angle_Rate_24 "The momentary angular speed of the object. (radians)";
CM_ SG_ 154 OBJ_Angle_Rate_V_24 "Validator for the angular speed.";
CM_ SG_ 154 OBJ_Angle_Right_24 "The angle between the host longitudinal axis and the right side of the front / rear of the target (the visible one). The positive side is to the host's right.";
CM_ SG_ 154 OBJ_Angle_Right_V_24 "Validator for angleRight";
CM_ SG_ 154 OBJ_Angle_Right_STD_24 "Standard deviation of angleRight";
CM_ SG_ 154 OBJ_Angle_Right_STD_V_24 "Validator for the standard deviation of angleRight.";
CM_ SG_ 154 OBJ_Angle_Left_24 "The angle between the host longitudinal axis and the left side of the front / rear of the target (the visible one). The positive side is to the host's right.";
CM_ SG_ 154 OBJ_Angle_Left_V_24 "Validator for angleLeft.";
CM_ SG_ 154 OBJ_Angle_Left_STD_24 "Standard deviation of angleLeft.";
CM_ SG_ 154 OBJ_Angle_Left_STD_V_24 "Validator for the standard deviation of angleLeft.";
CM_ SG_ 154 OBJ_Angle_Side_24 "The angle between the host longitudinal axis and the far visible edge - the visible edge of the front / rear of the target that is not visible. Currently supported for vehicles only.";
CM_ SG_ 154 OBJ_Angle_Side_V_24 "Validator for angleSide.";
CM_ SG_ 154 OBJ_Angle_Side_STD_24 "Standard deviation of angleSide.";
CM_ SG_ 154 OBJ_Angle_Side_STD_V_24 "Validator for the STD of angleSide.";
CM_ SG_ 154 OBJ_Angle_Mid_V_24 "Validator for angleMid.";
CM_ SG_ 154 OBJ_Angle_Mid_24 "The angle between the host longitudinal axis and the middle of the front / rear of the target (the visible one). The positive side is to the host's right.";
CM_ SG_ 154 OBJ_Angle_Mid_STD_24 "Standard deviation of angleMid.";
CM_ SG_ 154 OBJ_Angle_Mid_STD_V_24 "Validator for the STD of angleMid.";
CM_ SG_ 154 OBJ_Angle_Bottom_V_24 "Validator for OBJAngle_Bottom. ";
CM_ SG_ 154 OBJ_Angle_Bottom_24 "The angle between the longitudinal axis and the Bottom of the front / rear of the target (the visible one). The positive side is to the host's bottom";
CM_ SG_ 154 OBJ_Angle_Bottom_STD_24 "STD for OBJAngle_Bottom. ";
CM_ SG_ 154 OBJ_Angle_Bottom_STD_V_24 "Validator for OBJAngle_Bottom_STD. ";
CM_ SG_ 154 OBJ_Visibility_Side_V_24 "Currently Supported for VD only";
CM_ SG_ 154 OBJ_Visibility_Side_24 "From what car  side is the object visible";
CM_ SG_ 154 OBJ_Is_In_Drivable_Area_24 "Indicates whether the target is in a driveable area.";
CM_ SG_ 154 OBJ_Is_In_Drivable_Area_V_24 "Validator for OBJ_Is_In_Drivable_Area.";
CM_ SG_ 154 OBJ_Is_VeryClose_V_24 "Validator for OBJ_Is_VeryClose. ";
CM_ SG_ 154 OBJ_Is_VeryClose_24 "Indicates whether the target is very close to the host such that it is hard to measure its distance. Currently relevant for peds only";
CM_ SG_ 154 OBJ_OverlapAngleEgoLaneR_24 "Lateral distance to the middle of the RL and RR corners.";
CM_ SG_ 154 OBJ_OverlapAngleEgoLaneR_V_24 "Validator for OBJ_OverlapAngleEgoLaneR";
CM_ SG_ 154 OBJ_OverlapAngleEgoLaneL_24 "Lateral distance to the middle of the RL and RR corners.  ";
CM_ SG_ 154 OBJ_OverlapAngleEgoLaneL_V_24 "Validator for OBJ_OverlapAngleEgoLaneL";
CM_ SG_ 154 OBJ_Is_EMERGENCY_VCL_24 "Is Object an Emergency Vehicle";
CM_ SG_ 154 OBJ_EMERGENCY_LIGHT_COLOR_24 "Emergency Color";
CM_ SG_ 154 OBJ_EMERGENCY_V_24 "Are OBJ_Is_EMERGENCY_VCL and OBJ_EMERGENCY_LIGHT_COLOR Valid";
CM_ SG_ 154 OBJ_Angle_Top_24 "From VD touching point on the ground till the roof of the car";
CM_ SG_ 154 OBJ_Angle_Top_V_24 "Validator for OBJ_Angle_Top ";
CM_ SG_ 154 OBJ_Angle_Top_STD_24 "STD for OBJ_Angle_Top";
CM_ SG_ 154 OBJ_Angle_Top_STD_V_24 "Validator for OBJ_Angle_Top_STD. ";
CM_ SG_ 154 OBJ_CRC_25 "Calculated over all element signals. From the signal after the CRC until the first signal in the next elements OBJ_CRC_N+1  not including";
CM_ SG_ 154 OBJ_ID_25 "The detected object ID. Range is 1-255, while 0 indicates that the field in unfilled.";
CM_ SG_ 154 OBJ_Existence_Probability_25 "The existence probability of the reported object";
CM_ SG_ 154 OBJ_Fusion_Source_25 "sources ids used for fusion";
CM_ SG_ 154 OBJ_Triggered_SDM_25 "Indicates whether the object has trigered the SDM (Safety Diagnostic Manager) alert.";
CM_ SG_ 154 OBJ_Motion_Category_25 "Relevant for VD only. Full description of values can be found at the ACC guide.";
CM_ SG_ 154 OBJ_Object_Age_25 "The number of frames in which the object was recognized.";
CM_ SG_ 154 OBJ_Measuring_Status_25 "Measurment status. Old vs New marks if this is the first frame in which the object is reported. Predicted vs Measured marks if the report is raw or has been predicted forward in time using the measured dynamics and ego motion.";
CM_ SG_ 154 OBJ_Object_Class_25 "Indicates the object type. Uncertain is outputted in case the probability that a vehicle is a truck is very similar to the probability that it is a car. ";
CM_ SG_ 154 OBJ_Class_Probability_25 "The probability of this type classification.";
CM_ SG_ 154 OBJ_Car_Probability_25 "The probability the object is a car";
CM_ SG_ 154 OBJ_Truck_Probability_25 "The probability the object is a Truck";
CM_ SG_ 154 OBJ_Bike_Probability_25 "The probability the object is a Bike";
CM_ SG_ 154 OBJ_Camera_Source_25 "The camera in which this object was detected (best choice).";
CM_ SG_ 154 OBJ_Motion_Status_25 "MOVING - the object is moving STATIONARY - the object was never seen moving STOPPED -  the object was moving and has stopped MOVING_SLOWLY - the object is moving very slowly";
CM_ SG_ 154 OBJ_Motion_Orientation_25 "The direction of the targets heading compared to the host. ";
CM_ SG_ 154 OBJ_Has_Cut_Lane_25 "Indicates whether the object cut the host's (right or left) lane. In case there are no lanes, indicates whether the objects is at most 1 meters away from the host.";
CM_ SG_ 154 OBJ_Has_Cut_Path_25 "Indicates whether the object is in the host's path.";
CM_ SG_ 154 OBJ_Brake_Light_25 "Indication for brake lights ";
CM_ SG_ 154 OBJ_Turn_Indicator_Right_25 "Indication for blinking right light.";
CM_ SG_ 154 OBJ_Turn_Indicator_Left_25 "Indication for blinking left light ";
CM_ SG_ 154 OBJ_Light_Indicator_Validity_25 "Validator for light indicators";
CM_ SG_ 154 OBJ_Right_Out_Of_Image_25 "Indicates whether the measurment are predicted out of the right side of the image bounderies.";
CM_ SG_ 154 OBJ_Left_Out_Of_Image_25 "Indicates whether if measurment are predicted out of  the left side of the image bounderies";
CM_ SG_ 154 OBJ_Right_Out_Of_Image_V_25 "validator";
CM_ SG_ 154 OBJ_Left_Out_Of_Image_V_25 "validator";
CM_ SG_ 154 OBJ_Top_Out_Of_Image_25 "Indicates whether if measurment are predicted out of  the top of the image bounderies";
CM_ SG_ 154 OBJ_Bottom_Out_Of_Image_25 "Indicates whether if measurment are predicted out of  the bottom of the image bounderies";
CM_ SG_ 154 OBJ_Top_Out_Of_Image_V_25 "validator";
CM_ SG_ 154 OBJ_Bottom_Out_Of_Image_V_25 "validator";
CM_ SG_ 154 OBJ_Lane_Assignment_25 "The object's lane relative to the host lane.";
CM_ SG_ 154 OBJ_Lane_Assignment_V_25 "Validator for lane assignment";
CM_ SG_ 154 OBJ_Age_Seconds_25 "Time in seconds in which the object was recognized. ";
CM_ SG_ 154 OBJ_Age_Seconds_V_25 "Validator for object age";
CM_ SG_ 154 OBJ_Width_25 "The width of the target vehicle in the world (not to be mistaken with the width of the visible part of the vehicle).";
CM_ SG_ 154 OBJ_Width_V_25 "Validator for object width";
CM_ SG_ 154 OBJ_Width_STD_25 "Standard deviation for object width";
CM_ SG_ 154 OBJ_Width_STD_V_25 "Validator for the standard deviation of object width";
CM_ SG_ 154 OBJ_Length_25 "The length of the vehicle in the world. For crossing bicycles it gives the viewed length of the bicycle.";
CM_ SG_ 154 OBJ_Length_V_25 "Validator for object length.";
CM_ SG_ 154 OBJ_Length_STD_25 "Standard deviation for object length.";
CM_ SG_ 154 OBJ_Length_STD_V_25 "Validator for the standard deviation of object length.";
CM_ SG_ 154 OBJ_Radar_ID_25 "Radar Object ID of the Fused Object, Only relvant when OBJ_Fusion_Source is not Camera only";
CM_ SG_ 154 OBJ_Height_25 "The height of the object in the world. ";
CM_ SG_ 154 OBJ_Height_V_25 "Validator for object height.";
CM_ SG_ 154 OBJ_Height_STD_25 "Standard deviation for object height.";
CM_ SG_ 154 OBJ_Height_STD_V_25 "Validator for the standard deviation of object height.";
CM_ SG_ 154 OBJ_Abs_Long_Velocity_25 "Absolute longitudinal velocity.";
CM_ SG_ 154 OBJ_Abs_Long_Velocity_V_25 "Validator for absolute longitudinal velocity.";
CM_ SG_ 154 OBJ_Abs_Long_Velocity_STD_25 "Standard deviation of absolute longitudinal velocity.";
CM_ SG_ 154 OBJ_Abs_Long_Vel_STD_V_25 "Validator for the standard deviation of the absolute longitudinal velocity.";
CM_ SG_ 154 OBJ_Abs_Lat_Velocity_25 "The lateral ground speed of the object.";
CM_ SG_ 154 OBJ_Abs_Lat_Velocity_V_25 "Validator for the lateral ground speed of the object.";
CM_ SG_ 154 OBJ_Abs_Lat_Velocity_STD_25 "STD of the lateral ground speed of the object.";
CM_ SG_ 154 OBJ_Abs_Lat_Vel_STD_V_25 "Validator for the STD of the lateral ground speed of the object.";
CM_ SG_ 154 OBJ_Abs_Long_Acc_25 "The longitudinal ground acceleration of the object.";
CM_ SG_ 154 OBJ_Abs_Long_Acc_V_25 "Validator for the longitudinal ground acceleration of the object.";
CM_ SG_ 154 OBJ_Abs_Long_Acc_STD_25 "STD of the longitudinal ground acceleration of the object.";
CM_ SG_ 154 OBJ_Abs_Long_Acc_STD_V_25 "Validator for the STD of the longitudinal ground acceleration of the object.";
CM_ SG_ 154 OBJ_Abs_Lat_Acc_25 "The lateral ground acceleration of the object.";
CM_ SG_ 154 OBJ_Abs_Lat_Acc_V_25 "Validator for the lateral ground acceleration of the object.";
CM_ SG_ 154 OBJ_Abs_Lat_Acc_STD_25 "STD of the lateral ground acceleration of the object.";
CM_ SG_ 154 OBJ_Abs_Lat_Acc_STD_V_25 "Validator for the STD of the lateral ground acceleration of the object.";
CM_ SG_ 154 OBJ_Abs_Acceleration_25 "The absolute ground acceleration in the target's heading direction.";
CM_ SG_ 154 OBJ_Abs_Acceleration_V_25 "Validator for the absolute ground acceleration.";
CM_ SG_ 154 OBJ_Abs_Acc_STD_25 "STD of the absolute ground acceleration.";
CM_ SG_ 154 OBJ_Abs_Acc_STD_V_25 "Validator for the STD of the absolute ground acceleration.";
CM_ SG_ 154 OBJ_Inv_TTC_25 "Inverse TTC (time to collision).";
CM_ SG_ 154 OBJ_Inv_TTC_STD_25 "STD for inverse TTC .";
CM_ SG_ 154 OBJ_Inv_TTC_STD_V_25 "Validator for the STD for inverse TTC .";
CM_ SG_ 154 OBJ_Relative_Long_Acc_25 "The relative lateral ground acceleration of the object.";
CM_ SG_ 154 OBJ_Relative_Long_Acc_V_25 "Validator for the relative lateral ground acceleration of the object.";
CM_ SG_ 154 OBJ_Relative_Long_Acc_STD_25 "STD of the relative lateral ground acceleration of the object.";
CM_ SG_ 154 OBJ_Rel_Long_Acc_STD_V_25 "Validator for the STD of the relative lateral ground acceleration.";
CM_ SG_ 154 OBJ_Relative_Long_Velocity_25 "The relative longtitudinal speed between the target and ego vehicle. ";
CM_ SG_ 154 OBJ_Relative_Long_Velocity_V_25 "Validator for the relative longtitudinal speed.";
CM_ SG_ 154 OBJ_Relative_Long_Vel_STD_25 "STD of the relative longtitudinal speed.";
CM_ SG_ 154 OBJ_Rel_Long_Vel_STD_V_25 "Validator for the STD of the relative longtitudinal speed.";
CM_ SG_ 154 OBJ_Relative_Lat_Velocity_25 "The relative lateral speed between the target and ego vehicle. ";
CM_ SG_ 154 OBJ_Relative_Lat_Velocity_V_25 "Validator for the relative lateral speed. ";
CM_ SG_ 154 OBJ_Relative_Lat_Velocity_STD_25 "STD of the relative lateral speed. ";
CM_ SG_ 154 OBJ_Rel_Lat_Vel_STD_V_25 "Validator for the STD of the relative lateral speed. ";
CM_ SG_ 154 OBJ_Long_Distance_25 "The longitudinal distance to middle of the rear bumper (middle of the RL and RR corners) of the target.";
CM_ SG_ 154 OBJ_Long_Distance_V_25 "Validator of the longtitudinal distance field";
CM_ SG_ 154 OBJ_Long_Distance_STD_25 "STD of the  longtitudinal distance.";
CM_ SG_ 154 OBJ_Long_Distance_STD_V_25 "Validator for the STD of the  longtitudinal distance.";
CM_ SG_ 154 OBJ_Lat_Distance_25 "Lateral distance to the middle of the RL and RR corners.  ";
CM_ SG_ 154 OBJ_Lat_Distance_V_25 "Validator for the lateral distance of the object.";
CM_ SG_ 154 OBJ_Lat_Distance_STD_25 "STD of the lateral distance of the object.";
CM_ SG_ 154 OBJ_Lat_Distance_STD_V_25 "Validator for the STD of the lateral distance of the object.";
CM_ SG_ 154 OBJ_Absolute_Speed_25 "The absolute ground speed in the targets' heading direction.";
CM_ SG_ 154 OBJ_Absolute_Speed_V_25 "Validator for the absolute ground speed.";
CM_ SG_ 154 OBJ_Absolute_Speed_STD_25 "STD of the absolute ground speed.";
CM_ SG_ 154 OBJ_Absolute_Speed_STD_V_25 "Validator for the STD of the absolute ground speed.";
CM_ SG_ 154 OBJ_Heading_25 "The angle beetweenthe host longitudinal axis and target's heading (clockwise, e.g. PI/2 is a target crossing from left to right).";
CM_ SG_ 154 OBJ_Heading_V_25 "Validator for the object heading.";
CM_ SG_ 154 OBJ_Heading_STD_25 "STD of the object heading.";
CM_ SG_ 154 OBJ_Heading_STD_V_25 "Validator for the STD of the object heading.";
CM_ SG_ 154 OBJ_Angle_Rate_STD_25 "Standard deviation of the angular speed. (radians)";
CM_ SG_ 154 OBJ_Angle_Rate_STD_V_25 "Validator for the STD of the angular speed.";
CM_ SG_ 154 OBJ_Angle_Rate_25 "The momentary angular speed of the object. (radians)";
CM_ SG_ 154 OBJ_Angle_Rate_V_25 "Validator for the angular speed.";
CM_ SG_ 154 OBJ_Angle_Right_25 "The angle between the host longitudinal axis and the right side of the front / rear of the target (the visible one). The positive side is to the host's right.";
CM_ SG_ 154 OBJ_Angle_Right_V_25 "Validator for angleRight";
CM_ SG_ 154 OBJ_Angle_Right_STD_25 "Standard deviation of angleRight";
CM_ SG_ 154 OBJ_Angle_Right_STD_V_25 "Validator for the standard deviation of angleRight.";
CM_ SG_ 154 OBJ_Angle_Left_25 "The angle between the host longitudinal axis and the left side of the front / rear of the target (the visible one). The positive side is to the host's right.";
CM_ SG_ 154 OBJ_Angle_Left_V_25 "Validator for angleLeft.";
CM_ SG_ 154 OBJ_Angle_Left_STD_25 "Standard deviation of angleLeft.";
CM_ SG_ 154 OBJ_Angle_Left_STD_V_25 "Validator for the standard deviation of angleLeft.";
CM_ SG_ 154 OBJ_Angle_Side_25 "The angle between the host longitudinal axis and the far visible edge - the visible edge of the front / rear of the target that is not visible. Currently supported for vehicles only.";
CM_ SG_ 154 OBJ_Angle_Side_V_25 "Validator for angleSide.";
CM_ SG_ 154 OBJ_Angle_Side_STD_25 "Standard deviation of angleSide.";
CM_ SG_ 154 OBJ_Angle_Side_STD_V_25 "Validator for the STD of angleSide.";
CM_ SG_ 154 OBJ_Angle_Mid_V_25 "Validator for angleMid.";
CM_ SG_ 154 OBJ_Angle_Mid_25 "The angle between the host longitudinal axis and the middle of the front / rear of the target (the visible one). The positive side is to the host's right.";
CM_ SG_ 154 OBJ_Angle_Mid_STD_25 "Standard deviation of angleMid.";
CM_ SG_ 154 OBJ_Angle_Mid_STD_V_25 "Validator for the STD of angleMid.";
CM_ SG_ 154 OBJ_Angle_Bottom_V_25 "Validator for OBJAngle_Bottom. ";
CM_ SG_ 154 OBJ_Angle_Bottom_25 "The angle between the longitudinal axis and the Bottom of the front / rear of the target (the visible one). The positive side is to the host's bottom";
CM_ SG_ 154 OBJ_Angle_Bottom_STD_25 "STD for OBJAngle_Bottom. ";
CM_ SG_ 154 OBJ_Angle_Bottom_STD_V_25 "Validator for OBJAngle_Bottom_STD. ";
CM_ SG_ 154 OBJ_Visibility_Side_V_25 "Currently Supported for VD only";
CM_ SG_ 154 OBJ_Visibility_Side_25 "From what car  side is the object visible";
CM_ SG_ 154 OBJ_Is_In_Drivable_Area_25 "Indicates whether the target is in a driveable area.";
CM_ SG_ 154 OBJ_Is_In_Drivable_Area_V_25 "Validator for OBJ_Is_In_Drivable_Area.";
CM_ SG_ 154 OBJ_Is_VeryClose_V_25 "Validator for OBJ_Is_VeryClose. ";
CM_ SG_ 154 OBJ_Is_VeryClose_25 "Indicates whether the target is very close to the host such that it is hard to measure its distance. Currently relevant for peds only";
CM_ SG_ 154 OBJ_OverlapAngleEgoLaneR_25 "Lateral distance to the middle of the RL and RR corners.";
CM_ SG_ 154 OBJ_OverlapAngleEgoLaneR_V_25 "Validator for OBJ_OverlapAngleEgoLaneR";
CM_ SG_ 154 OBJ_OverlapAngleEgoLaneL_25 "Lateral distance to the middle of the RL and RR corners.  ";
CM_ SG_ 154 OBJ_OverlapAngleEgoLaneL_V_25 "Validator for OBJ_OverlapAngleEgoLaneL";
CM_ SG_ 154 OBJ_Is_EMERGENCY_VCL_25 "Is Object an Emergency Vehicle";
CM_ SG_ 154 OBJ_EMERGENCY_LIGHT_COLOR_25 "Emergency Color";
CM_ SG_ 154 OBJ_EMERGENCY_V_25 "Are OBJ_Is_EMERGENCY_VCL and OBJ_EMERGENCY_LIGHT_COLOR Valid";
CM_ SG_ 154 OBJ_Angle_Top_25 "From VD touching point on the ground till the roof of the car";
CM_ SG_ 154 OBJ_Angle_Top_V_25 "Validator for OBJ_Angle_Top ";
CM_ SG_ 154 OBJ_Angle_Top_STD_25 "STD for OBJ_Angle_Top";
CM_ SG_ 154 OBJ_Angle_Top_STD_V_25 "Validator for OBJ_Angle_Top_STD. ";
CM_ SG_ 154 OBJ_CRC_26 "Calculated over all element signals. From the signal after the CRC until the first signal in the next elements OBJ_CRC_N+1  not including";
CM_ SG_ 154 OBJ_ID_26 "The detected object ID. Range is 1-255, while 0 indicates that the field in unfilled.";
CM_ SG_ 154 OBJ_Existence_Probability_26 "The existence probability of the reported object";
CM_ SG_ 154 OBJ_Fusion_Source_26 "sources ids used for fusion";
CM_ SG_ 154 OBJ_Triggered_SDM_26 "Indicates whether the object has trigered the SDM (Safety Diagnostic Manager) alert.";
CM_ SG_ 154 OBJ_Motion_Category_26 "Relevant for VD only. Full description of values can be found at the ACC guide.";
CM_ SG_ 154 OBJ_Object_Age_26 "The number of frames in which the object was recognized.";
CM_ SG_ 154 OBJ_Measuring_Status_26 "Measurment status. Old vs New marks if this is the first frame in which the object is reported. Predicted vs Measured marks if the report is raw or has been predicted forward in time using the measured dynamics and ego motion.";
CM_ SG_ 154 OBJ_Object_Class_26 "Indicates the object type. Uncertain is outputted in case the probability that a vehicle is a truck is very similar to the probability that it is a car. ";
CM_ SG_ 154 OBJ_Class_Probability_26 "The probability of this type classification.";
CM_ SG_ 154 OBJ_Car_Probability_26 "The probability the object is a car";
CM_ SG_ 154 OBJ_Truck_Probability_26 "The probability the object is a Truck";
CM_ SG_ 154 OBJ_Bike_Probability_26 "The probability the object is a Bike";
CM_ SG_ 154 OBJ_Camera_Source_26 "The camera in which this object was detected (best choice).";
CM_ SG_ 154 OBJ_Motion_Status_26 "MOVING - the object is moving STATIONARY - the object was never seen moving STOPPED -  the object was moving and has stopped MOVING_SLOWLY - the object is moving very slowly";
CM_ SG_ 154 OBJ_Motion_Orientation_26 "The direction of the targets heading compared to the host. ";
CM_ SG_ 154 OBJ_Has_Cut_Lane_26 "Indicates whether the object cut the host's (right or left) lane. In case there are no lanes, indicates whether the objects is at most 1 meters away from the host.";
CM_ SG_ 154 OBJ_Has_Cut_Path_26 "Indicates whether the object is in the host's path.";
CM_ SG_ 154 OBJ_Brake_Light_26 "Indication for brake lights ";
CM_ SG_ 154 OBJ_Turn_Indicator_Right_26 "Indication for blinking right light.";
CM_ SG_ 154 OBJ_Turn_Indicator_Left_26 "Indication for blinking left light ";
CM_ SG_ 154 OBJ_Light_Indicator_Validity_26 "Validator for light indicators";
CM_ SG_ 154 OBJ_Right_Out_Of_Image_26 "Indicates whether the measurment are predicted out of the right side of the image bounderies.";
CM_ SG_ 154 OBJ_Left_Out_Of_Image_26 "Indicates whether if measurment are predicted out of  the left side of the image bounderies";
CM_ SG_ 154 OBJ_Right_Out_Of_Image_V_26 "validator";
CM_ SG_ 154 OBJ_Left_Out_Of_Image_V_26 "validator";
CM_ SG_ 154 OBJ_Top_Out_Of_Image_26 "Indicates whether if measurment are predicted out of  the top of the image bounderies";
CM_ SG_ 154 OBJ_Bottom_Out_Of_Image_26 "Indicates whether if measurment are predicted out of  the bottom of the image bounderies";
CM_ SG_ 154 OBJ_Top_Out_Of_Image_V_26 "validator";
CM_ SG_ 154 OBJ_Bottom_Out_Of_Image_V_26 "validator";
CM_ SG_ 154 OBJ_Lane_Assignment_26 "The object's lane relative to the host lane.";
CM_ SG_ 154 OBJ_Lane_Assignment_V_26 "Validator for lane assignment";
CM_ SG_ 154 OBJ_Age_Seconds_26 "Time in seconds in which the object was recognized. ";
CM_ SG_ 154 OBJ_Age_Seconds_V_26 "Validator for object age";
CM_ SG_ 154 OBJ_Width_26 "The width of the target vehicle in the world (not to be mistaken with the width of the visible part of the vehicle).";
CM_ SG_ 154 OBJ_Width_V_26 "Validator for object width";
CM_ SG_ 154 OBJ_Width_STD_26 "Standard deviation for object width";
CM_ SG_ 154 OBJ_Width_STD_V_26 "Validator for the standard deviation of object width";
CM_ SG_ 154 OBJ_Length_26 "The length of the vehicle in the world. For crossing bicycles it gives the viewed length of the bicycle.";
CM_ SG_ 154 OBJ_Length_V_26 "Validator for object length.";
CM_ SG_ 154 OBJ_Length_STD_26 "Standard deviation for object length.";
CM_ SG_ 154 OBJ_Length_STD_V_26 "Validator for the standard deviation of object length.";
CM_ SG_ 154 OBJ_Radar_ID_26 "Radar Object ID of the Fused Object, Only relvant when OBJ_Fusion_Source is not Camera only";
CM_ SG_ 154 OBJ_Height_26 "The height of the object in the world. ";
CM_ SG_ 154 OBJ_Height_V_26 "Validator for object height.";
CM_ SG_ 154 OBJ_Height_STD_26 "Standard deviation for object height.";
CM_ SG_ 154 OBJ_Height_STD_V_26 "Validator for the standard deviation of object height.";
CM_ SG_ 154 OBJ_Abs_Long_Velocity_26 "Absolute longitudinal velocity.";
CM_ SG_ 154 OBJ_Abs_Long_Velocity_V_26 "Validator for absolute longitudinal velocity.";
CM_ SG_ 154 OBJ_Abs_Long_Velocity_STD_26 "Standard deviation of absolute longitudinal velocity.";
CM_ SG_ 154 OBJ_Abs_Long_Vel_STD_V_26 "Validator for the standard deviation of the absolute longitudinal velocity.";
CM_ SG_ 154 OBJ_Abs_Lat_Velocity_26 "The lateral ground speed of the object.";
CM_ SG_ 154 OBJ_Abs_Lat_Velocity_V_26 "Validator for the lateral ground speed of the object.";
CM_ SG_ 154 OBJ_Abs_Lat_Velocity_STD_26 "STD of the lateral ground speed of the object.";
CM_ SG_ 154 OBJ_Abs_Lat_Vel_STD_V_26 "Validator for the STD of the lateral ground speed of the object.";
CM_ SG_ 154 OBJ_Abs_Long_Acc_26 "The longitudinal ground acceleration of the object.";
CM_ SG_ 154 OBJ_Abs_Long_Acc_V_26 "Validator for the longitudinal ground acceleration of the object.";
CM_ SG_ 154 OBJ_Abs_Long_Acc_STD_26 "STD of the longitudinal ground acceleration of the object.";
CM_ SG_ 154 OBJ_Abs_Long_Acc_STD_V_26 "Validator for the STD of the longitudinal ground acceleration of the object.";
CM_ SG_ 154 OBJ_Abs_Lat_Acc_26 "The lateral ground acceleration of the object.";
CM_ SG_ 154 OBJ_Abs_Lat_Acc_V_26 "Validator for the lateral ground acceleration of the object.";
CM_ SG_ 154 OBJ_Abs_Lat_Acc_STD_26 "STD of the lateral ground acceleration of the object.";
CM_ SG_ 154 OBJ_Abs_Lat_Acc_STD_V_26 "Validator for the STD of the lateral ground acceleration of the object.";
CM_ SG_ 154 OBJ_Abs_Acceleration_26 "The absolute ground acceleration in the target's heading direction.";
CM_ SG_ 154 OBJ_Abs_Acceleration_V_26 "Validator for the absolute ground acceleration.";
CM_ SG_ 154 OBJ_Abs_Acc_STD_26 "STD of the absolute ground acceleration.";
CM_ SG_ 154 OBJ_Abs_Acc_STD_V_26 "Validator for the STD of the absolute ground acceleration.";
CM_ SG_ 154 OBJ_Inv_TTC_26 "Inverse TTC (time to collision).";
CM_ SG_ 154 OBJ_Inv_TTC_STD_26 "STD for inverse TTC .";
CM_ SG_ 154 OBJ_Inv_TTC_STD_V_26 "Validator for the STD for inverse TTC .";
CM_ SG_ 154 OBJ_Relative_Long_Acc_26 "The relative lateral ground acceleration of the object.";
CM_ SG_ 154 OBJ_Relative_Long_Acc_V_26 "Validator for the relative lateral ground acceleration of the object.";
CM_ SG_ 154 OBJ_Relative_Long_Acc_STD_26 "STD of the relative lateral ground acceleration of the object.";
CM_ SG_ 154 OBJ_Rel_Long_Acc_STD_V_26 "Validator for the STD of the relative lateral ground acceleration.";
CM_ SG_ 154 OBJ_Relative_Long_Velocity_26 "The relative longtitudinal speed between the target and ego vehicle. ";
CM_ SG_ 154 OBJ_Relative_Long_Velocity_V_26 "Validator for the relative longtitudinal speed.";
CM_ SG_ 154 OBJ_Relative_Long_Vel_STD_26 "STD of the relative longtitudinal speed.";
CM_ SG_ 154 OBJ_Rel_Long_Vel_STD_V_26 "Validator for the STD of the relative longtitudinal speed.";
CM_ SG_ 154 OBJ_Relative_Lat_Velocity_26 "The relative lateral speed between the target and ego vehicle. ";
CM_ SG_ 154 OBJ_Relative_Lat_Velocity_V_26 "Validator for the relative lateral speed. ";
CM_ SG_ 154 OBJ_Relative_Lat_Velocity_STD_26 "STD of the relative lateral speed. ";
CM_ SG_ 154 OBJ_Rel_Lat_Vel_STD_V_26 "Validator for the STD of the relative lateral speed. ";
CM_ SG_ 154 OBJ_Long_Distance_26 "The longitudinal distance to middle of the rear bumper (middle of the RL and RR corners) of the target.";
CM_ SG_ 154 OBJ_Long_Distance_V_26 "Validator of the longtitudinal distance field";
CM_ SG_ 154 OBJ_Long_Distance_STD_26 "STD of the  longtitudinal distance.";
CM_ SG_ 154 OBJ_Long_Distance_STD_V_26 "Validator for the STD of the  longtitudinal distance.";
CM_ SG_ 154 OBJ_Lat_Distance_26 "Lateral distance to the middle of the RL and RR corners.  ";
CM_ SG_ 154 OBJ_Lat_Distance_V_26 "Validator for the lateral distance of the object.";
CM_ SG_ 154 OBJ_Lat_Distance_STD_26 "STD of the lateral distance of the object.";
CM_ SG_ 154 OBJ_Lat_Distance_STD_V_26 "Validator for the STD of the lateral distance of the object.";
CM_ SG_ 154 OBJ_Absolute_Speed_26 "The absolute ground speed in the targets' heading direction.";
CM_ SG_ 154 OBJ_Absolute_Speed_V_26 "Validator for the absolute ground speed.";
CM_ SG_ 154 OBJ_Absolute_Speed_STD_26 "STD of the absolute ground speed.";
CM_ SG_ 154 OBJ_Absolute_Speed_STD_V_26 "Validator for the STD of the absolute ground speed.";
CM_ SG_ 154 OBJ_Heading_26 "The angle beetweenthe host longitudinal axis and target's heading (clockwise, e.g. PI/2 is a target crossing from left to right).";
CM_ SG_ 154 OBJ_Heading_V_26 "Validator for the object heading.";
CM_ SG_ 154 OBJ_Heading_STD_26 "STD of the object heading.";
CM_ SG_ 154 OBJ_Heading_STD_V_26 "Validator for the STD of the object heading.";
CM_ SG_ 154 OBJ_Angle_Rate_STD_26 "Standard deviation of the angular speed. (radians)";
CM_ SG_ 154 OBJ_Angle_Rate_STD_V_26 "Validator for the STD of the angular speed.";
CM_ SG_ 154 OBJ_Angle_Rate_26 "The momentary angular speed of the object. (radians)";
CM_ SG_ 154 OBJ_Angle_Rate_V_26 "Validator for the angular speed.";
CM_ SG_ 154 OBJ_Angle_Right_26 "The angle between the host longitudinal axis and the right side of the front / rear of the target (the visible one). The positive side is to the host's right.";
CM_ SG_ 154 OBJ_Angle_Right_V_26 "Validator for angleRight";
CM_ SG_ 154 OBJ_Angle_Right_STD_26 "Standard deviation of angleRight";
CM_ SG_ 154 OBJ_Angle_Right_STD_V_26 "Validator for the standard deviation of angleRight.";
CM_ SG_ 154 OBJ_Angle_Left_26 "The angle between the host longitudinal axis and the left side of the front / rear of the target (the visible one). The positive side is to the host's right.";
CM_ SG_ 154 OBJ_Angle_Left_V_26 "Validator for angleLeft.";
CM_ SG_ 154 OBJ_Angle_Left_STD_26 "Standard deviation of angleLeft.";
CM_ SG_ 154 OBJ_Angle_Left_STD_V_26 "Validator for the standard deviation of angleLeft.";
CM_ SG_ 154 OBJ_Angle_Side_26 "The angle between the host longitudinal axis and the far visible edge - the visible edge of the front / rear of the target that is not visible. Currently supported for vehicles only.";
CM_ SG_ 154 OBJ_Angle_Side_V_26 "Validator for angleSide.";
CM_ SG_ 154 OBJ_Angle_Side_STD_26 "Standard deviation of angleSide.";
CM_ SG_ 154 OBJ_Angle_Side_STD_V_26 "Validator for the STD of angleSide.";
CM_ SG_ 154 OBJ_Angle_Mid_V_26 "Validator for angleMid.";
CM_ SG_ 154 OBJ_Angle_Mid_26 "The angle between the host longitudinal axis and the middle of the front / rear of the target (the visible one). The positive side is to the host's right.";
CM_ SG_ 154 OBJ_Angle_Mid_STD_26 "Standard deviation of angleMid.";
CM_ SG_ 154 OBJ_Angle_Mid_STD_V_26 "Validator for the STD of angleMid.";
CM_ SG_ 154 OBJ_Angle_Bottom_V_26 "Validator for OBJAngle_Bottom. ";
CM_ SG_ 154 OBJ_Angle_Bottom_26 "The angle between the longitudinal axis and the Bottom of the front / rear of the target (the visible one). The positive side is to the host's bottom";
CM_ SG_ 154 OBJ_Angle_Bottom_STD_26 "STD for OBJAngle_Bottom. ";
CM_ SG_ 154 OBJ_Angle_Bottom_STD_V_26 "Validator for OBJAngle_Bottom_STD. ";
CM_ SG_ 154 OBJ_Visibility_Side_V_26 "Currently Supported for VD only";
CM_ SG_ 154 OBJ_Visibility_Side_26 "From what car  side is the object visible";
CM_ SG_ 154 OBJ_Is_In_Drivable_Area_26 "Indicates whether the target is in a driveable area.";
CM_ SG_ 154 OBJ_Is_In_Drivable_Area_V_26 "Validator for OBJ_Is_In_Drivable_Area.";
CM_ SG_ 154 OBJ_Is_VeryClose_V_26 "Validator for OBJ_Is_VeryClose. ";
CM_ SG_ 154 OBJ_Is_VeryClose_26 "Indicates whether the target is very close to the host such that it is hard to measure its distance. Currently relevant for peds only";
CM_ SG_ 154 OBJ_OverlapAngleEgoLaneR_26 "Lateral distance to the middle of the RL and RR corners.";
CM_ SG_ 154 OBJ_OverlapAngleEgoLaneR_V_26 "Validator for OBJ_OverlapAngleEgoLaneR";
CM_ SG_ 154 OBJ_OverlapAngleEgoLaneL_26 "Lateral distance to the middle of the RL and RR corners.  ";
CM_ SG_ 154 OBJ_OverlapAngleEgoLaneL_V_26 "Validator for OBJ_OverlapAngleEgoLaneL";
CM_ SG_ 154 OBJ_Is_EMERGENCY_VCL_26 "Is Object an Emergency Vehicle";
CM_ SG_ 154 OBJ_EMERGENCY_LIGHT_COLOR_26 "Emergency Color";
CM_ SG_ 154 OBJ_EMERGENCY_V_26 "Are OBJ_Is_EMERGENCY_VCL and OBJ_EMERGENCY_LIGHT_COLOR Valid";
CM_ SG_ 154 OBJ_Angle_Top_26 "From VD touching point on the ground till the roof of the car";
CM_ SG_ 154 OBJ_Angle_Top_V_26 "Validator for OBJ_Angle_Top ";
CM_ SG_ 154 OBJ_Angle_Top_STD_26 "STD for OBJ_Angle_Top";
CM_ SG_ 154 OBJ_Angle_Top_STD_V_26 "Validator for OBJ_Angle_Top_STD. ";
CM_ SG_ 154 OBJ_CRC_27 "Calculated over all element signals. From the signal after the CRC until the first signal in the next elements OBJ_CRC_N+1  not including";
CM_ SG_ 154 OBJ_ID_27 "The detected object ID. Range is 1-255, while 0 indicates that the field in unfilled.";
CM_ SG_ 154 OBJ_Existence_Probability_27 "The existence probability of the reported object";
CM_ SG_ 154 OBJ_Fusion_Source_27 "sources ids used for fusion";
CM_ SG_ 154 OBJ_Triggered_SDM_27 "Indicates whether the object has trigered the SDM (Safety Diagnostic Manager) alert.";
CM_ SG_ 154 OBJ_Motion_Category_27 "Relevant for VD only. Full description of values can be found at the ACC guide.";
CM_ SG_ 154 OBJ_Object_Age_27 "The number of frames in which the object was recognized.";
CM_ SG_ 154 OBJ_Measuring_Status_27 "Measurment status. Old vs New marks if this is the first frame in which the object is reported. Predicted vs Measured marks if the report is raw or has been predicted forward in time using the measured dynamics and ego motion.";
CM_ SG_ 154 OBJ_Object_Class_27 "Indicates the object type. Uncertain is outputted in case the probability that a vehicle is a truck is very similar to the probability that it is a car. ";
CM_ SG_ 154 OBJ_Class_Probability_27 "The probability of this type classification.";
CM_ SG_ 154 OBJ_Car_Probability_27 "The probability the object is a car";
CM_ SG_ 154 OBJ_Truck_Probability_27 "The probability the object is a Truck";
CM_ SG_ 154 OBJ_Bike_Probability_27 "The probability the object is a Bike";
CM_ SG_ 154 OBJ_Camera_Source_27 "The camera in which this object was detected (best choice).";
CM_ SG_ 154 OBJ_Motion_Status_27 "MOVING - the object is moving STATIONARY - the object was never seen moving STOPPED -  the object was moving and has stopped MOVING_SLOWLY - the object is moving very slowly";
CM_ SG_ 154 OBJ_Motion_Orientation_27 "The direction of the targets heading compared to the host. ";
CM_ SG_ 154 OBJ_Has_Cut_Lane_27 "Indicates whether the object cut the host's (right or left) lane. In case there are no lanes, indicates whether the objects is at most 1 meters away from the host.";
CM_ SG_ 154 OBJ_Has_Cut_Path_27 "Indicates whether the object is in the host's path.";
CM_ SG_ 154 OBJ_Brake_Light_27 "Indication for brake lights ";
CM_ SG_ 154 OBJ_Turn_Indicator_Right_27 "Indication for blinking right light.";
CM_ SG_ 154 OBJ_Turn_Indicator_Left_27 "Indication for blinking left light ";
CM_ SG_ 154 OBJ_Light_Indicator_Validity_27 "Validator for light indicators";
CM_ SG_ 154 OBJ_Right_Out_Of_Image_27 "Indicates whether the measurment are predicted out of the right side of the image bounderies.";
CM_ SG_ 154 OBJ_Left_Out_Of_Image_27 "Indicates whether if measurment are predicted out of  the left side of the image bounderies";
CM_ SG_ 154 OBJ_Right_Out_Of_Image_V_27 "validator";
CM_ SG_ 154 OBJ_Left_Out_Of_Image_V_27 "validator";
CM_ SG_ 154 OBJ_Top_Out_Of_Image_27 "Indicates whether if measurment are predicted out of  the top of the image bounderies";
CM_ SG_ 154 OBJ_Bottom_Out_Of_Image_27 "Indicates whether if measurment are predicted out of  the bottom of the image bounderies";
CM_ SG_ 154 OBJ_Top_Out_Of_Image_V_27 "validator";
CM_ SG_ 154 OBJ_Bottom_Out_Of_Image_V_27 "validator";
CM_ SG_ 154 OBJ_Lane_Assignment_27 "The object's lane relative to the host lane.";
CM_ SG_ 154 OBJ_Lane_Assignment_V_27 "Validator for lane assignment";
CM_ SG_ 154 OBJ_Age_Seconds_27 "Time in seconds in which the object was recognized. ";
CM_ SG_ 154 OBJ_Age_Seconds_V_27 "Validator for object age";
CM_ SG_ 154 OBJ_Width_27 "The width of the target vehicle in the world (not to be mistaken with the width of the visible part of the vehicle).";
CM_ SG_ 154 OBJ_Width_V_27 "Validator for object width";
CM_ SG_ 154 OBJ_Width_STD_27 "Standard deviation for object width";
CM_ SG_ 154 OBJ_Width_STD_V_27 "Validator for the standard deviation of object width";
CM_ SG_ 154 OBJ_Length_27 "The length of the vehicle in the world. For crossing bicycles it gives the viewed length of the bicycle.";
CM_ SG_ 154 OBJ_Length_V_27 "Validator for object length.";
CM_ SG_ 154 OBJ_Length_STD_27 "Standard deviation for object length.";
CM_ SG_ 154 OBJ_Length_STD_V_27 "Validator for the standard deviation of object length.";
CM_ SG_ 154 OBJ_Radar_ID_27 "Radar Object ID of the Fused Object, Only relvant when OBJ_Fusion_Source is not Camera only";
CM_ SG_ 154 OBJ_Height_27 "The height of the object in the world. ";
CM_ SG_ 154 OBJ_Height_V_27 "Validator for object height.";
CM_ SG_ 154 OBJ_Height_STD_27 "Standard deviation for object height.";
CM_ SG_ 154 OBJ_Height_STD_V_27 "Validator for the standard deviation of object height.";
CM_ SG_ 154 OBJ_Abs_Long_Velocity_27 "Absolute longitudinal velocity.";
CM_ SG_ 154 OBJ_Abs_Long_Velocity_V_27 "Validator for absolute longitudinal velocity.";
CM_ SG_ 154 OBJ_Abs_Long_Velocity_STD_27 "Standard deviation of absolute longitudinal velocity.";
CM_ SG_ 154 OBJ_Abs_Long_Vel_STD_V_27 "Validator for the standard deviation of the absolute longitudinal velocity.";
CM_ SG_ 154 OBJ_Abs_Lat_Velocity_27 "The lateral ground speed of the object.";
CM_ SG_ 154 OBJ_Abs_Lat_Velocity_V_27 "Validator for the lateral ground speed of the object.";
CM_ SG_ 154 OBJ_Abs_Lat_Velocity_STD_27 "STD of the lateral ground speed of the object.";
CM_ SG_ 154 OBJ_Abs_Lat_Vel_STD_V_27 "Validator for the STD of the lateral ground speed of the object.";
CM_ SG_ 154 OBJ_Abs_Long_Acc_27 "The longitudinal ground acceleration of the object.";
CM_ SG_ 154 OBJ_Abs_Long_Acc_V_27 "Validator for the longitudinal ground acceleration of the object.";
CM_ SG_ 154 OBJ_Abs_Long_Acc_STD_27 "STD of the longitudinal ground acceleration of the object.";
CM_ SG_ 154 OBJ_Abs_Long_Acc_STD_V_27 "Validator for the STD of the longitudinal ground acceleration of the object.";
CM_ SG_ 154 OBJ_Abs_Lat_Acc_27 "The lateral ground acceleration of the object.";
CM_ SG_ 154 OBJ_Abs_Lat_Acc_V_27 "Validator for the lateral ground acceleration of the object.";
CM_ SG_ 154 OBJ_Abs_Lat_Acc_STD_27 "STD of the lateral ground acceleration of the object.";
CM_ SG_ 154 OBJ_Abs_Lat_Acc_STD_V_27 "Validator for the STD of the lateral ground acceleration of the object.";
CM_ SG_ 154 OBJ_Abs_Acceleration_27 "The absolute ground acceleration in the target's heading direction.";
CM_ SG_ 154 OBJ_Abs_Acceleration_V_27 "Validator for the absolute ground acceleration.";
CM_ SG_ 154 OBJ_Abs_Acc_STD_27 "STD of the absolute ground acceleration.";
CM_ SG_ 154 OBJ_Abs_Acc_STD_V_27 "Validator for the STD of the absolute ground acceleration.";
CM_ SG_ 154 OBJ_Inv_TTC_27 "Inverse TTC (time to collision).";
CM_ SG_ 154 OBJ_Inv_TTC_STD_27 "STD for inverse TTC .";
CM_ SG_ 154 OBJ_Inv_TTC_STD_V_27 "Validator for the STD for inverse TTC .";
CM_ SG_ 154 OBJ_Relative_Long_Acc_27 "The relative lateral ground acceleration of the object.";
CM_ SG_ 154 OBJ_Relative_Long_Acc_V_27 "Validator for the relative lateral ground acceleration of the object.";
CM_ SG_ 154 OBJ_Relative_Long_Acc_STD_27 "STD of the relative lateral ground acceleration of the object.";
CM_ SG_ 154 OBJ_Rel_Long_Acc_STD_V_27 "Validator for the STD of the relative lateral ground acceleration.";
CM_ SG_ 154 OBJ_Relative_Long_Velocity_27 "The relative longtitudinal speed between the target and ego vehicle. ";
CM_ SG_ 154 OBJ_Relative_Long_Velocity_V_27 "Validator for the relative longtitudinal speed.";
CM_ SG_ 154 OBJ_Relative_Long_Vel_STD_27 "STD of the relative longtitudinal speed.";
CM_ SG_ 154 OBJ_Rel_Long_Vel_STD_V_27 "Validator for the STD of the relative longtitudinal speed.";
CM_ SG_ 154 OBJ_Relative_Lat_Velocity_27 "The relative lateral speed between the target and ego vehicle. ";
CM_ SG_ 154 OBJ_Relative_Lat_Velocity_V_27 "Validator for the relative lateral speed. ";
CM_ SG_ 154 OBJ_Relative_Lat_Velocity_STD_27 "STD of the relative lateral speed. ";
CM_ SG_ 154 OBJ_Rel_Lat_Vel_STD_V_27 "Validator for the STD of the relative lateral speed. ";
CM_ SG_ 154 OBJ_Long_Distance_27 "The longitudinal distance to middle of the rear bumper (middle of the RL and RR corners) of the target.";
CM_ SG_ 154 OBJ_Long_Distance_V_27 "Validator of the longtitudinal distance field";
CM_ SG_ 154 OBJ_Long_Distance_STD_27 "STD of the  longtitudinal distance.";
CM_ SG_ 154 OBJ_Long_Distance_STD_V_27 "Validator for the STD of the  longtitudinal distance.";
CM_ SG_ 154 OBJ_Lat_Distance_27 "Lateral distance to the middle of the RL and RR corners.  ";
CM_ SG_ 154 OBJ_Lat_Distance_V_27 "Validator for the lateral distance of the object.";
CM_ SG_ 154 OBJ_Lat_Distance_STD_27 "STD of the lateral distance of the object.";
CM_ SG_ 154 OBJ_Lat_Distance_STD_V_27 "Validator for the STD of the lateral distance of the object.";
CM_ SG_ 154 OBJ_Absolute_Speed_27 "The absolute ground speed in the targets' heading direction.";
CM_ SG_ 154 OBJ_Absolute_Speed_V_27 "Validator for the absolute ground speed.";
CM_ SG_ 154 OBJ_Absolute_Speed_STD_27 "STD of the absolute ground speed.";
CM_ SG_ 154 OBJ_Absolute_Speed_STD_V_27 "Validator for the STD of the absolute ground speed.";
CM_ SG_ 154 OBJ_Heading_27 "The angle beetweenthe host longitudinal axis and target's heading (clockwise, e.g. PI/2 is a target crossing from left to right).";
CM_ SG_ 154 OBJ_Heading_V_27 "Validator for the object heading.";
CM_ SG_ 154 OBJ_Heading_STD_27 "STD of the object heading.";
CM_ SG_ 154 OBJ_Heading_STD_V_27 "Validator for the STD of the object heading.";
CM_ SG_ 154 OBJ_Angle_Rate_STD_27 "Standard deviation of the angular speed. (radians)";
CM_ SG_ 154 OBJ_Angle_Rate_STD_V_27 "Validator for the STD of the angular speed.";
CM_ SG_ 154 OBJ_Angle_Rate_27 "The momentary angular speed of the object. (radians)";
CM_ SG_ 154 OBJ_Angle_Rate_V_27 "Validator for the angular speed.";
CM_ SG_ 154 OBJ_Angle_Right_27 "The angle between the host longitudinal axis and the right side of the front / rear of the target (the visible one). The positive side is to the host's right.";
CM_ SG_ 154 OBJ_Angle_Right_V_27 "Validator for angleRight";
CM_ SG_ 154 OBJ_Angle_Right_STD_27 "Standard deviation of angleRight";
CM_ SG_ 154 OBJ_Angle_Right_STD_V_27 "Validator for the standard deviation of angleRight.";
CM_ SG_ 154 OBJ_Angle_Left_27 "The angle between the host longitudinal axis and the left side of the front / rear of the target (the visible one). The positive side is to the host's right.";
CM_ SG_ 154 OBJ_Angle_Left_V_27 "Validator for angleLeft.";
CM_ SG_ 154 OBJ_Angle_Left_STD_27 "Standard deviation of angleLeft.";
CM_ SG_ 154 OBJ_Angle_Left_STD_V_27 "Validator for the standard deviation of angleLeft.";
CM_ SG_ 154 OBJ_Angle_Side_27 "The angle between the host longitudinal axis and the far visible edge - the visible edge of the front / rear of the target that is not visible. Currently supported for vehicles only.";
CM_ SG_ 154 OBJ_Angle_Side_V_27 "Validator for angleSide.";
CM_ SG_ 154 OBJ_Angle_Side_STD_27 "Standard deviation of angleSide.";
CM_ SG_ 154 OBJ_Angle_Side_STD_V_27 "Validator for the STD of angleSide.";
CM_ SG_ 154 OBJ_Angle_Mid_V_27 "Validator for angleMid.";
CM_ SG_ 154 OBJ_Angle_Mid_27 "The angle between the host longitudinal axis and the middle of the front / rear of the target (the visible one). The positive side is to the host's right.";
CM_ SG_ 154 OBJ_Angle_Mid_STD_27 "Standard deviation of angleMid.";
CM_ SG_ 154 OBJ_Angle_Mid_STD_V_27 "Validator for the STD of angleMid.";
CM_ SG_ 154 OBJ_Angle_Bottom_V_27 "Validator for OBJAngle_Bottom. ";
CM_ SG_ 154 OBJ_Angle_Bottom_27 "The angle between the longitudinal axis and the Bottom of the front / rear of the target (the visible one). The positive side is to the host's bottom";
CM_ SG_ 154 OBJ_Angle_Bottom_STD_27 "STD for OBJAngle_Bottom. ";
CM_ SG_ 154 OBJ_Angle_Bottom_STD_V_27 "Validator for OBJAngle_Bottom_STD. ";
CM_ SG_ 154 OBJ_Visibility_Side_V_27 "Currently Supported for VD only";
CM_ SG_ 154 OBJ_Visibility_Side_27 "From what car  side is the object visible";
CM_ SG_ 154 OBJ_Is_In_Drivable_Area_27 "Indicates whether the target is in a driveable area.";
CM_ SG_ 154 OBJ_Is_In_Drivable_Area_V_27 "Validator for OBJ_Is_In_Drivable_Area.";
CM_ SG_ 154 OBJ_Is_VeryClose_V_27 "Validator for OBJ_Is_VeryClose. ";
CM_ SG_ 154 OBJ_Is_VeryClose_27 "Indicates whether the target is very close to the host such that it is hard to measure its distance. Currently relevant for peds only";
CM_ SG_ 154 OBJ_OverlapAngleEgoLaneR_27 "Lateral distance to the middle of the RL and RR corners.";
CM_ SG_ 154 OBJ_OverlapAngleEgoLaneR_V_27 "Validator for OBJ_OverlapAngleEgoLaneR";
CM_ SG_ 154 OBJ_OverlapAngleEgoLaneL_27 "Lateral distance to the middle of the RL and RR corners.  ";
CM_ SG_ 154 OBJ_OverlapAngleEgoLaneL_V_27 "Validator for OBJ_OverlapAngleEgoLaneL";
CM_ SG_ 154 OBJ_Is_EMERGENCY_VCL_27 "Is Object an Emergency Vehicle";
CM_ SG_ 154 OBJ_EMERGENCY_LIGHT_COLOR_27 "Emergency Color";
CM_ SG_ 154 OBJ_EMERGENCY_V_27 "Are OBJ_Is_EMERGENCY_VCL and OBJ_EMERGENCY_LIGHT_COLOR Valid";
CM_ SG_ 154 OBJ_Angle_Top_27 "From VD touching point on the ground till the roof of the car";
CM_ SG_ 154 OBJ_Angle_Top_V_27 "Validator for OBJ_Angle_Top ";
CM_ SG_ 154 OBJ_Angle_Top_STD_27 "STD for OBJ_Angle_Top";
CM_ SG_ 154 OBJ_Angle_Top_STD_V_27 "Validator for OBJ_Angle_Top_STD. ";
CM_ SG_ 154 OBJ_CRC_28 "Calculated over all element signals. From the signal after the CRC until the first signal in the next elements OBJ_CRC_N+1  not including";
CM_ SG_ 154 OBJ_ID_28 "The detected object ID. Range is 1-255, while 0 indicates that the field in unfilled.";
CM_ SG_ 154 OBJ_Existence_Probability_28 "The existence probability of the reported object";
CM_ SG_ 154 OBJ_Fusion_Source_28 "sources ids used for fusion";
CM_ SG_ 154 OBJ_Triggered_SDM_28 "Indicates whether the object has trigered the SDM (Safety Diagnostic Manager) alert.";
CM_ SG_ 154 OBJ_Motion_Category_28 "Relevant for VD only. Full description of values can be found at the ACC guide.";
CM_ SG_ 154 OBJ_Object_Age_28 "The number of frames in which the object was recognized.";
CM_ SG_ 154 OBJ_Measuring_Status_28 "Measurment status. Old vs New marks if this is the first frame in which the object is reported. Predicted vs Measured marks if the report is raw or has been predicted forward in time using the measured dynamics and ego motion.";
CM_ SG_ 154 OBJ_Object_Class_28 "Indicates the object type. Uncertain is outputted in case the probability that a vehicle is a truck is very similar to the probability that it is a car. ";
CM_ SG_ 154 OBJ_Class_Probability_28 "The probability of this type classification.";
CM_ SG_ 154 OBJ_Car_Probability_28 "The probability the object is a car";
CM_ SG_ 154 OBJ_Truck_Probability_28 "The probability the object is a Truck";
CM_ SG_ 154 OBJ_Bike_Probability_28 "The probability the object is a Bike";
CM_ SG_ 154 OBJ_Camera_Source_28 "The camera in which this object was detected (best choice).";
CM_ SG_ 154 OBJ_Motion_Status_28 "MOVING - the object is moving STATIONARY - the object was never seen moving STOPPED -  the object was moving and has stopped MOVING_SLOWLY - the object is moving very slowly";
CM_ SG_ 154 OBJ_Motion_Orientation_28 "The direction of the targets heading compared to the host. ";
CM_ SG_ 154 OBJ_Has_Cut_Lane_28 "Indicates whether the object cut the host's (right or left) lane. In case there are no lanes, indicates whether the objects is at most 1 meters away from the host.";
CM_ SG_ 154 OBJ_Has_Cut_Path_28 "Indicates whether the object is in the host's path.";
CM_ SG_ 154 OBJ_Brake_Light_28 "Indication for brake lights ";
CM_ SG_ 154 OBJ_Turn_Indicator_Right_28 "Indication for blinking right light.";
CM_ SG_ 154 OBJ_Turn_Indicator_Left_28 "Indication for blinking left light ";
CM_ SG_ 154 OBJ_Light_Indicator_Validity_28 "Validator for light indicators";
CM_ SG_ 154 OBJ_Right_Out_Of_Image_28 "Indicates whether the measurment are predicted out of the right side of the image bounderies.";
CM_ SG_ 154 OBJ_Left_Out_Of_Image_28 "Indicates whether if measurment are predicted out of  the left side of the image bounderies";
CM_ SG_ 154 OBJ_Right_Out_Of_Image_V_28 "validator";
CM_ SG_ 154 OBJ_Left_Out_Of_Image_V_28 "validator";
CM_ SG_ 154 OBJ_Top_Out_Of_Image_28 "Indicates whether if measurment are predicted out of  the top of the image bounderies";
CM_ SG_ 154 OBJ_Bottom_Out_Of_Image_28 "Indicates whether if measurment are predicted out of  the bottom of the image bounderies";
CM_ SG_ 154 OBJ_Top_Out_Of_Image_V_28 "validator";
CM_ SG_ 154 OBJ_Bottom_Out_Of_Image_V_28 "validator";
CM_ SG_ 154 OBJ_Lane_Assignment_28 "The object's lane relative to the host lane.";
CM_ SG_ 154 OBJ_Lane_Assignment_V_28 "Validator for lane assignment";
CM_ SG_ 154 OBJ_Age_Seconds_28 "Time in seconds in which the object was recognized. ";
CM_ SG_ 154 OBJ_Age_Seconds_V_28 "Validator for object age";
CM_ SG_ 154 OBJ_Width_28 "The width of the target vehicle in the world (not to be mistaken with the width of the visible part of the vehicle).";
CM_ SG_ 154 OBJ_Width_V_28 "Validator for object width";
CM_ SG_ 154 OBJ_Width_STD_28 "Standard deviation for object width";
CM_ SG_ 154 OBJ_Width_STD_V_28 "Validator for the standard deviation of object width";
CM_ SG_ 154 OBJ_Length_28 "The length of the vehicle in the world. For crossing bicycles it gives the viewed length of the bicycle.";
CM_ SG_ 154 OBJ_Length_V_28 "Validator for object length.";
CM_ SG_ 154 OBJ_Length_STD_28 "Standard deviation for object length.";
CM_ SG_ 154 OBJ_Length_STD_V_28 "Validator for the standard deviation of object length.";
CM_ SG_ 154 OBJ_Radar_ID_28 "Radar Object ID of the Fused Object, Only relvant when OBJ_Fusion_Source is not Camera only";
CM_ SG_ 154 OBJ_Height_28 "The height of the object in the world. ";
CM_ SG_ 154 OBJ_Height_V_28 "Validator for object height.";
CM_ SG_ 154 OBJ_Height_STD_28 "Standard deviation for object height.";
CM_ SG_ 154 OBJ_Height_STD_V_28 "Validator for the standard deviation of object height.";
CM_ SG_ 154 OBJ_Abs_Long_Velocity_28 "Absolute longitudinal velocity.";
CM_ SG_ 154 OBJ_Abs_Long_Velocity_V_28 "Validator for absolute longitudinal velocity.";
CM_ SG_ 154 OBJ_Abs_Long_Velocity_STD_28 "Standard deviation of absolute longitudinal velocity.";
CM_ SG_ 154 OBJ_Abs_Long_Vel_STD_V_28 "Validator for the standard deviation of the absolute longitudinal velocity.";
CM_ SG_ 154 OBJ_Abs_Lat_Velocity_28 "The lateral ground speed of the object.";
CM_ SG_ 154 OBJ_Abs_Lat_Velocity_V_28 "Validator for the lateral ground speed of the object.";
CM_ SG_ 154 OBJ_Abs_Lat_Velocity_STD_28 "STD of the lateral ground speed of the object.";
CM_ SG_ 154 OBJ_Abs_Lat_Vel_STD_V_28 "Validator for the STD of the lateral ground speed of the object.";
CM_ SG_ 154 OBJ_Abs_Long_Acc_28 "The longitudinal ground acceleration of the object.";
CM_ SG_ 154 OBJ_Abs_Long_Acc_V_28 "Validator for the longitudinal ground acceleration of the object.";
CM_ SG_ 154 OBJ_Abs_Long_Acc_STD_28 "STD of the longitudinal ground acceleration of the object.";
CM_ SG_ 154 OBJ_Abs_Long_Acc_STD_V_28 "Validator for the STD of the longitudinal ground acceleration of the object.";
CM_ SG_ 154 OBJ_Abs_Lat_Acc_28 "The lateral ground acceleration of the object.";
CM_ SG_ 154 OBJ_Abs_Lat_Acc_V_28 "Validator for the lateral ground acceleration of the object.";
CM_ SG_ 154 OBJ_Abs_Lat_Acc_STD_28 "STD of the lateral ground acceleration of the object.";
CM_ SG_ 154 OBJ_Abs_Lat_Acc_STD_V_28 "Validator for the STD of the lateral ground acceleration of the object.";
CM_ SG_ 154 OBJ_Abs_Acceleration_28 "The absolute ground acceleration in the target's heading direction.";
CM_ SG_ 154 OBJ_Abs_Acceleration_V_28 "Validator for the absolute ground acceleration.";
CM_ SG_ 154 OBJ_Abs_Acc_STD_28 "STD of the absolute ground acceleration.";
CM_ SG_ 154 OBJ_Abs_Acc_STD_V_28 "Validator for the STD of the absolute ground acceleration.";
CM_ SG_ 154 OBJ_Inv_TTC_28 "Inverse TTC (time to collision).";
CM_ SG_ 154 OBJ_Inv_TTC_STD_28 "STD for inverse TTC .";
CM_ SG_ 154 OBJ_Inv_TTC_STD_V_28 "Validator for the STD for inverse TTC .";
CM_ SG_ 154 OBJ_Relative_Long_Acc_28 "The relative lateral ground acceleration of the object.";
CM_ SG_ 154 OBJ_Relative_Long_Acc_V_28 "Validator for the relative lateral ground acceleration of the object.";
CM_ SG_ 154 OBJ_Relative_Long_Acc_STD_28 "STD of the relative lateral ground acceleration of the object.";
CM_ SG_ 154 OBJ_Rel_Long_Acc_STD_V_28 "Validator for the STD of the relative lateral ground acceleration.";
CM_ SG_ 154 OBJ_Relative_Long_Velocity_28 "The relative longtitudinal speed between the target and ego vehicle. ";
CM_ SG_ 154 OBJ_Relative_Long_Velocity_V_28 "Validator for the relative longtitudinal speed.";
CM_ SG_ 154 OBJ_Relative_Long_Vel_STD_28 "STD of the relative longtitudinal speed.";
CM_ SG_ 154 OBJ_Rel_Long_Vel_STD_V_28 "Validator for the STD of the relative longtitudinal speed.";
CM_ SG_ 154 OBJ_Relative_Lat_Velocity_28 "The relative lateral speed between the target and ego vehicle. ";
CM_ SG_ 154 OBJ_Relative_Lat_Velocity_V_28 "Validator for the relative lateral speed. ";
CM_ SG_ 154 OBJ_Relative_Lat_Velocity_STD_28 "STD of the relative lateral speed. ";
CM_ SG_ 154 OBJ_Rel_Lat_Vel_STD_V_28 "Validator for the STD of the relative lateral speed. ";
CM_ SG_ 154 OBJ_Long_Distance_28 "The longitudinal distance to middle of the rear bumper (middle of the RL and RR corners) of the target.";
CM_ SG_ 154 OBJ_Long_Distance_V_28 "Validator of the longtitudinal distance field";
CM_ SG_ 154 OBJ_Long_Distance_STD_28 "STD of the  longtitudinal distance.";
CM_ SG_ 154 OBJ_Long_Distance_STD_V_28 "Validator for the STD of the  longtitudinal distance.";
CM_ SG_ 154 OBJ_Lat_Distance_28 "Lateral distance to the middle of the RL and RR corners.  ";
CM_ SG_ 154 OBJ_Lat_Distance_V_28 "Validator for the lateral distance of the object.";
CM_ SG_ 154 OBJ_Lat_Distance_STD_28 "STD of the lateral distance of the object.";
CM_ SG_ 154 OBJ_Lat_Distance_STD_V_28 "Validator for the STD of the lateral distance of the object.";
CM_ SG_ 154 OBJ_Absolute_Speed_28 "The absolute ground speed in the targets' heading direction.";
CM_ SG_ 154 OBJ_Absolute_Speed_V_28 "Validator for the absolute ground speed.";
CM_ SG_ 154 OBJ_Absolute_Speed_STD_28 "STD of the absolute ground speed.";
CM_ SG_ 154 OBJ_Absolute_Speed_STD_V_28 "Validator for the STD of the absolute ground speed.";
CM_ SG_ 154 OBJ_Heading_28 "The angle beetweenthe host longitudinal axis and target's heading (clockwise, e.g. PI/2 is a target crossing from left to right).";
CM_ SG_ 154 OBJ_Heading_V_28 "Validator for the object heading.";
CM_ SG_ 154 OBJ_Heading_STD_28 "STD of the object heading.";
CM_ SG_ 154 OBJ_Heading_STD_V_28 "Validator for the STD of the object heading.";
CM_ SG_ 154 OBJ_Angle_Rate_STD_28 "Standard deviation of the angular speed. (radians)";
CM_ SG_ 154 OBJ_Angle_Rate_STD_V_28 "Validator for the STD of the angular speed.";
CM_ SG_ 154 OBJ_Angle_Rate_28 "The momentary angular speed of the object. (radians)";
CM_ SG_ 154 OBJ_Angle_Rate_V_28 "Validator for the angular speed.";
CM_ SG_ 154 OBJ_Angle_Right_28 "The angle between the host longitudinal axis and the right side of the front / rear of the target (the visible one). The positive side is to the host's right.";
CM_ SG_ 154 OBJ_Angle_Right_V_28 "Validator for angleRight";
CM_ SG_ 154 OBJ_Angle_Right_STD_28 "Standard deviation of angleRight";
CM_ SG_ 154 OBJ_Angle_Right_STD_V_28 "Validator for the standard deviation of angleRight.";
CM_ SG_ 154 OBJ_Angle_Left_28 "The angle between the host longitudinal axis and the left side of the front / rear of the target (the visible one). The positive side is to the host's right.";
CM_ SG_ 154 OBJ_Angle_Left_V_28 "Validator for angleLeft.";
CM_ SG_ 154 OBJ_Angle_Left_STD_28 "Standard deviation of angleLeft.";
CM_ SG_ 154 OBJ_Angle_Left_STD_V_28 "Validator for the standard deviation of angleLeft.";
CM_ SG_ 154 OBJ_Angle_Side_28 "The angle between the host longitudinal axis and the far visible edge - the visible edge of the front / rear of the target that is not visible. Currently supported for vehicles only.";
CM_ SG_ 154 OBJ_Angle_Side_V_28 "Validator for angleSide.";
CM_ SG_ 154 OBJ_Angle_Side_STD_28 "Standard deviation of angleSide.";
CM_ SG_ 154 OBJ_Angle_Side_STD_V_28 "Validator for the STD of angleSide.";
CM_ SG_ 154 OBJ_Angle_Mid_V_28 "Validator for angleMid.";
CM_ SG_ 154 OBJ_Angle_Mid_28 "The angle between the host longitudinal axis and the middle of the front / rear of the target (the visible one). The positive side is to the host's right.";
CM_ SG_ 154 OBJ_Angle_Mid_STD_28 "Standard deviation of angleMid.";
CM_ SG_ 154 OBJ_Angle_Mid_STD_V_28 "Validator for the STD of angleMid.";
CM_ SG_ 154 OBJ_Angle_Bottom_V_28 "Validator for OBJAngle_Bottom. ";
CM_ SG_ 154 OBJ_Angle_Bottom_28 "The angle between the longitudinal axis and the Bottom of the front / rear of the target (the visible one). The positive side is to the host's bottom";
CM_ SG_ 154 OBJ_Angle_Bottom_STD_28 "STD for OBJAngle_Bottom. ";
CM_ SG_ 154 OBJ_Angle_Bottom_STD_V_28 "Validator for OBJAngle_Bottom_STD. ";
CM_ SG_ 154 OBJ_Visibility_Side_V_28 "Currently Supported for VD only";
CM_ SG_ 154 OBJ_Visibility_Side_28 "From what car  side is the object visible";
CM_ SG_ 154 OBJ_Is_In_Drivable_Area_28 "Indicates whether the target is in a driveable area.";
CM_ SG_ 154 OBJ_Is_In_Drivable_Area_V_28 "Validator for OBJ_Is_In_Drivable_Area.";
CM_ SG_ 154 OBJ_Is_VeryClose_V_28 "Validator for OBJ_Is_VeryClose. ";
BA_DEF_ SG_  "GenSigStartValue" INT 0 0;
BA_DEF_DEF_  "GenSigStartValue" 0;
BA_ "GenSigStartValue" SG_ 154 OBJ_Width_23 40;
BA_ "GenSigStartValue" SG_ 154 OBJ_Length_23 24;
BA_ "GenSigStartValue" SG_ 154 OBJ_Width_24 40;
BA_ "GenSigStartValue" SG_ 154 OBJ_Length_24 24;
BA_ "GenSigStartValue" SG_ 154 OBJ_Width_25 40;
BA_ "GenSigStartValue" SG_ 154 OBJ_Length_25 24;
BA_ "GenSigStartValue" SG_ 154 OBJ_Width_26 40;
BA_ "GenSigStartValue" SG_ 154 OBJ_Length_26 24;
BA_ "GenSigStartValue" SG_ 154 OBJ_Width_27 40;
BA_ "GenSigStartValue" SG_ 154 OBJ_Length_27 24;
BA_ "GenSigStartValue" SG_ 154 OBJ_Width_28 40;
BA_ "GenSigStartValue" SG_ 154 OBJ_Length_28 24;
VAL_ 154 OBJ_Has_Cut_Lane_23 1 "TRUE" 0 "FALSE" ;
VAL_ 154 OBJ_Has_Cut_Path_23 1 "TRUE" 0 "FALSE" ;
VAL_ 154 OBJ_Brake_Light_23 1 "TRUE" 0 "FALSE" ;
VAL_ 154 OBJ_Turn_Indicator_Right_23 1 "TRUE" 0 "FALSE" ;
VAL_ 154 OBJ_Turn_Indicator_Left_23 1 "TRUE" 0 "FALSE" ;
VAL_ 154 OBJ_Light_Indicator_Validity_23 1 "TRUE" 0 "FALSE" ;
VAL_ 154 OBJ_Right_Out_Of_Image_23 1 "TRUE" 0 "FALSE" ;
VAL_ 154 OBJ_Left_Out_Of_Image_23 1 "TRUE" 0 "FALSE" ;
VAL_ 154 OBJ_Right_Out_Of_Image_V_23 1 "TRUE" 0 "FALSE" ;
VAL_ 154 OBJ_Left_Out_Of_Image_V_23 1 "TRUE" 0 "FALSE" ;
VAL_ 154 OBJ_Top_Out_Of_Image_23 1 "TRUE" 0 "FALSE" ;
VAL_ 154 OBJ_Bottom_Out_Of_Image_23 1 "TRUE" 0 "FALSE" ;
VAL_ 154 OBJ_Top_Out_Of_Image_V_23 1 "VALID" 0 "INVALID" ;
VAL_ 154 OBJ_Bottom_Out_Of_Image_V_23 1 "VALID" 0 "INVALID" ;
VAL_ 154 OBJ_Lane_Assignment_23 5 "RIGHT_RIGHT" 4 "RIGHT" 3 "HOST" 2 "LEFT" 1 "LEFT_LEFT" 0 "UNKNOWN" ;
VAL_ 154 OBJ_Lane_Assignment_V_23 1 "VALID" 0 "INVALID" ;
VAL_ 154 OBJ_Age_Seconds_V_23 1 "VALID" 0 "INVALID" ;
VAL_ 154 OBJ_Width_V_23 1 "VALID" 0 "INVALID" ;
VAL_ 154 OBJ_Width_STD_V_23 1 "VALID" 0 "INVALID" ;
VAL_ 154 OBJ_Length_V_23 1 "VALID" 0 "INVALID" ;
VAL_ 154 OBJ_Length_STD_V_23 1 "VALID" 0 "INVALID" ;
VAL_ 154 OBJ_Height_V_23 1 "VALID" 0 "INVALID" ;
VAL_ 154 OBJ_Height_STD_V_23 1 "VALID" 0 "INVALID" ;
VAL_ 154 OBJ_Abs_Long_Velocity_V_23 1 "VALID" 0 "INVALID" ;
VAL_ 154 OBJ_Abs_Long_Vel_STD_V_23 1 "VALID" 0 "INVALID" ;
VAL_ 154 OBJ_Abs_Lat_Velocity_V_23 1 "VALID" 0 "INVALID" ;
VAL_ 154 OBJ_Abs_Lat_Vel_STD_V_23 1 "VALID" 0 "INVALID" ;
VAL_ 154 OBJ_Abs_Long_Acc_V_23 1 "VALID" 0 "INVALID" ;
VAL_ 154 OBJ_Abs_Long_Acc_STD_V_23 1 "VALID" 0 "INVALID" ;
VAL_ 154 OBJ_Abs_Lat_Acc_V_23 1 "VALID" 0 "INVALID" ;
VAL_ 154 OBJ_Abs_Lat_Acc_STD_V_23 1 "VALID" 0 "INVALID" ;
VAL_ 154 OBJ_Abs_Acceleration_V_23 1 "VALID" 0 "INVALID" ;
VAL_ 154 OBJ_Abs_Acc_STD_V_23 1 "VALID" 0 "INVALID" ;
VAL_ 154 OBJ_Inv_TTC_V_23 1 "VALID" 0 "INVALID" ;
VAL_ 154 OBJ_Inv_TTC_STD_V_23 1 "VALID" 0 "INVALID" ;
VAL_ 154 OBJ_Relative_Long_Acc_V_23 1 "VALID" 0 "INVALID" ;
VAL_ 154 OBJ_Rel_Long_Acc_STD_V_23 1 "VALID" 0 "INVALID" ;
VAL_ 154 OBJ_Relative_Long_Velocity_V_23 1 "VALID" 0 "INVALID" ;
VAL_ 154 OBJ_Rel_Long_Vel_STD_V_23 1 "VALID" 0 "INVALID" ;
VAL_ 154 OBJ_Relative_Lat_Velocity_V_23 1 "VALID" 0 "INVALID" ;
VAL_ 154 OBJ_Rel_Lat_Vel_STD_V_23 1 "VALID" 0 "INVALID" ;
VAL_ 154 OBJ_Long_Distance_V_23 1 "VALID" 0 "INVALID" ;
VAL_ 154 OBJ_Long_Distance_STD_V_23 1 "VALID" 0 "INVALID" ;
VAL_ 154 OBJ_Lat_Distance_V_23 1 "VALID" 0 "INVALID" ;
VAL_ 154 OBJ_Lat_Distance_STD_V_23 1 "VALID" 0 "INVALID" ;
VAL_ 154 OBJ_Absolute_Speed_V_23 1 "VALID" 0 "INVALID" ;
VAL_ 154 OBJ_Absolute_Speed_STD_V_23 1 "VALID" 0 "INVALID" ;
VAL_ 154 OBJ_Heading_V_23 1 "VALID" 0 "INVALID" ;
VAL_ 154 OBJ_Heading_STD_V_23 1 "VALID" 0 "INVALID" ;
VAL_ 154 OBJ_Angle_Rate_STD_V_23 1 "VALID" 0 "INVALID" ;
VAL_ 154 OBJ_Angle_Rate_V_23 1 "VALID" 0 "INVALID" ;
VAL_ 154 OBJ_Angle_Right_V_23 1 "VALID" 0 "INVALID" ;
VAL_ 154 OBJ_Angle_Right_STD_V_23 1 "VALID" 0 "INVALID" ;
VAL_ 154 OBJ_Angle_Left_V_23 1 "VALID" 0 "INVALID" ;
VAL_ 154 OBJ_Angle_Left_STD_V_23 1 "VALID" 0 "INVALID" ;
VAL_ 154 OBJ_Angle_Side_V_23 1 "VALID" 0 "INVALID" ;
VAL_ 154 OBJ_Angle_Side_STD_V_23 1 "VALID" 0 "INVALID" ;
VAL_ 154 OBJ_Angle_Mid_V_23 1 "VALID" 0 "INVALID" ;
VAL_ 154 OBJ_Angle_Mid_STD_V_23 1 "VALID" 0 "INVALID" ;
VAL_ 154 OBJ_Angle_Bottom_V_23 1 "VALID" 0 "INVALID" ;
VAL_ 154 OBJ_Angle_Bottom_STD_V_23 1 "VALID" 0 "INVALID" ;
VAL_ 154 OBJ_Visibility_Side_V_23 1 "VALID" 0 "INVALID" ;
VAL_ 154 OBJ_Visibility_Side_23 2 "REAR" 1 "FRONT" 0 "NOT_VISIBLE" ;
VAL_ 154 OBJ_Is_In_Drivable_Area_23 1 "TRUE" 0 "FALSE" ;
VAL_ 154 OBJ_Is_In_Drivable_Area_V_23 1 "VALID" 0 "INVALID" ;
VAL_ 154 OBJ_Is_VeryClose_V_23 1 "VALID" 0 "INVALID" ;
VAL_ 154 OBJ_Is_VeryClose_23 1 "TRUE" 0 "FALSE" ;
VAL_ 154 OBJ_OverlapAngleEgoLaneR_V_23 1 "VALID" 0 "INVALID" ;
VAL_ 154 OBJ_OverlapAngleEgoLaneL_V_23 1 "VALID" 0 "INVALID" ;
VAL_ 154 OBJ_Is_EMERGENCY_VCL_23 1 "TRUE" 0 "FALSE" ;
VAL_ 154 OBJ_EMERGENCY_LIGHT_COLOR_23 3 "(1000)ORANGE" 2 "(0100)BLUE" 1 "(0010)RED" 0 "(0001)OTHER" ;
VAL_ 154 OBJ_EMERGENCY_V_23 1 "TRUE" 0 "FALSE" ;
VAL_ 154 OBJ_Angle_Top_V_23 1 "VALID" 0 "INVALID" ;
VAL_ 154 OBJ_Angle_Top_STD_V_23 1 "VALID" 0 "INVALID" ;
VAL_ 154 OBJ_Fusion_Source_24 2 "(BIT_2)RADAR2" 1 "(BIT_1)RADAR1" 0 "(BIT_0)CAMERA" ;
VAL_ 154 OBJ_Triggered_SDM_24 2 "NOT_TRIGGERED" 1 "TRIGGERED" 0 "NOT_AVAILABLE" ;
VAL_ 154 OBJ_Motion_Category_24 13 "ONCOMING" 12 "PRECEEDING" 11 "MOVING" 10 "RTAP" 9 "LTAP" 8 "CROSSING" 7 "MOVING_OUT" 6 "MOVING_IN" 5 "CLOSE_CUT_IN" 4 "PASSING_OUT" 3 "PASSING_IN" 2 "PASSING" 1 "UNDEFINED" 0 "UNFILLED" ;
VAL_ 154 OBJ_Measuring_Status_24 2 "(BIT_2)NOT_VALID_OR_VALID" 1 "(BIT_1)PREDICTED_OR_MEASURED" 0 "(BIT_0)OLD_OR_NEW" ;
VAL_ 154 OBJ_Object_Class_24 8 "UNCERTAIN_VCL" 7 "ANIMAL" 6 "GENERAL_OBJECT" 5 "PEDESTRIAN" 4 "BICYCLE" 3 "MOTORBIKE" 2 "TRUCK" 1 "CAR" 0 "UNFILLED" ;
VAL_ 154 OBJ_Camera_Source_24 11 "PARKING_RIGHT" 10 "PARKING_LEFT" 9 "PARKING_REAR" 8 "PARKING_FRONT" 7 "FRONT_CORNER_RIGHT" 6 "FRONT_CORNER_LEFT" 5 "REAR_CORNER_RIGHT" 4 "REAR_CORNER_LEFT" 3 "REAR" 2 "FRONT_FISHEYE" 1 "FRONT_NARROW" 0 "FRONT_MAIN" ;
VAL_ 154 OBJ_Motion_Status_24 5 "MOVING_SLOWLY" 4 "STOPPED" 3 "STATIONARY" 2 "MOVING" 1 "UNKNOWN" 0 "INVALID" ;
VAL_ 154 OBJ_Motion_Orientation_24 13 "INVALID" 12 "NORTH" 11 "NORTH_WEST" 9 "WEST" 7 "SOUTH_WEST" 6 "SOUTH" 5 "SOUTH_EAST" 3 "EAST" 1 "NORTH_EAST" 0 "UNKNOWN" ;
VAL_ 154 OBJ_Has_Cut_Lane_24 1 "TRUE" 0 "FALSE" ;
VAL_ 154 OBJ_Has_Cut_Path_24 1 "TRUE" 0 "FALSE" ;
VAL_ 154 OBJ_Brake_Light_24 1 "TRUE" 0 "FALSE" ;
VAL_ 154 OBJ_Turn_Indicator_Right_24 1 "TRUE" 0 "FALSE" ;
VAL_ 154 OBJ_Turn_Indicator_Left_24 1 "TRUE" 0 "FALSE" ;
VAL_ 154 OBJ_Light_Indicator_Validity_24 1 "TRUE" 0 "FALSE" ;
VAL_ 154 OBJ_Right_Out_Of_Image_24 1 "TRUE" 0 "FALSE" ;
VAL_ 154 OBJ_Left_Out_Of_Image_24 1 "TRUE" 0 "FALSE" ;
VAL_ 154 OBJ_Right_Out_Of_Image_V_24 1 "TRUE" 0 "FALSE" ;
VAL_ 154 OBJ_Left_Out_Of_Image_V_24 1 "TRUE" 0 "FALSE" ;
VAL_ 154 OBJ_Top_Out_Of_Image_24 1 "TRUE" 0 "FALSE" ;
VAL_ 154 OBJ_Bottom_Out_Of_Image_24 1 "TRUE" 0 "FALSE" ;
VAL_ 154 OBJ_Top_Out_Of_Image_V_24 1 "VALID" 0 "INVALID" ;
VAL_ 154 OBJ_Bottom_Out_Of_Image_V_24 1 "VALID" 0 "INVALID" ;
VAL_ 154 OBJ_Lane_Assignment_24 5 "RIGHT_RIGHT" 4 "RIGHT" 3 "HOST" 2 "LEFT" 1 "LEFT_LEFT" 0 "UNKNOWN" ;
VAL_ 154 OBJ_Lane_Assignment_V_24 1 "VALID" 0 "INVALID" ;
VAL_ 154 OBJ_Age_Seconds_V_24 1 "VALID" 0 "INVALID" ;
VAL_ 154 OBJ_Width_V_24 1 "VALID" 0 "INVALID" ;
VAL_ 154 OBJ_Width_STD_V_24 1 "VALID" 0 "INVALID" ;
VAL_ 154 OBJ_Length_V_24 1 "VALID" 0 "INVALID" ;
VAL_ 154 OBJ_Length_STD_V_24 1 "VALID" 0 "INVALID" ;
VAL_ 154 OBJ_Height_V_24 1 "VALID" 0 "INVALID" ;
VAL_ 154 OBJ_Height_STD_V_24 1 "VALID" 0 "INVALID" ;
VAL_ 154 OBJ_Abs_Long_Velocity_V_24 1 "VALID" 0 "INVALID" ;
VAL_ 154 OBJ_Abs_Long_Vel_STD_V_24 1 "VALID" 0 "INVALID" ;
VAL_ 154 OBJ_Abs_Lat_Velocity_V_24 1 "VALID" 0 "INVALID" ;
VAL_ 154 OBJ_Abs_Lat_Vel_STD_V_24 1 "VALID" 0 "INVALID" ;
VAL_ 154 OBJ_Abs_Long_Acc_V_24 1 "VALID" 0 "INVALID" ;
VAL_ 154 OBJ_Abs_Long_Acc_STD_V_24 1 "VALID" 0 "INVALID" ;
VAL_ 154 OBJ_Abs_Lat_Acc_V_24 1 "VALID" 0 "INVALID" ;
VAL_ 154 OBJ_Abs_Lat_Acc_STD_V_24 1 "VALID" 0 "INVALID" ;
VAL_ 154 OBJ_Abs_Acceleration_V_24 1 "VALID" 0 "INVALID" ;
VAL_ 154 OBJ_Abs_Acc_STD_V_24 1 "VALID" 0 "INVALID" ;
VAL_ 154 OBJ_Inv_TTC_V_24 1 "VALID" 0 "INVALID" ;
VAL_ 154 OBJ_Inv_TTC_STD_V_24 1 "VALID" 0 "INVALID" ;
VAL_ 154 OBJ_Relative_Long_Acc_V_24 1 "VALID" 0 "INVALID" ;
VAL_ 154 OBJ_Rel_Long_Acc_STD_V_24 1 "VALID" 0 "INVALID" ;
VAL_ 154 OBJ_Relative_Long_Velocity_V_24 1 "VALID" 0 "INVALID" ;
VAL_ 154 OBJ_Rel_Long_Vel_STD_V_24 1 "VALID" 0 "INVALID" ;
VAL_ 154 OBJ_Relative_Lat_Velocity_V_24 1 "VALID" 0 "INVALID" ;
VAL_ 154 OBJ_Rel_Lat_Vel_STD_V_24 1 "VALID" 0 "INVALID" ;
VAL_ 154 OBJ_Long_Distance_V_24 1 "VALID" 0 "INVALID" ;
VAL_ 154 OBJ_Long_Distance_STD_V_24 1 "VALID" 0 "INVALID" ;
VAL_ 154 OBJ_Lat_Distance_V_24 1 "VALID" 0 "INVALID" ;
VAL_ 154 OBJ_Lat_Distance_STD_V_24 1 "VALID" 0 "INVALID" ;
VAL_ 154 OBJ_Absolute_Speed_V_24 1 "VALID" 0 "INVALID" ;
VAL_ 154 OBJ_Absolute_Speed_STD_V_24 1 "VALID" 0 "INVALID" ;
VAL_ 154 OBJ_Heading_V_24 1 "VALID" 0 "INVALID" ;
VAL_ 154 OBJ_Heading_STD_V_24 1 "VALID" 0 "INVALID" ;
VAL_ 154 OBJ_Angle_Rate_STD_V_24 1 "VALID" 0 "INVALID" ;
VAL_ 154 OBJ_Angle_Rate_V_24 1 "VALID" 0 "INVALID" ;
VAL_ 154 OBJ_Angle_Right_V_24 1 "VALID" 0 "INVALID" ;
VAL_ 154 OBJ_Angle_Right_STD_V_24 1 "VALID" 0 "INVALID" ;
VAL_ 154 OBJ_Angle_Left_V_24 1 "VALID" 0 "INVALID" ;
VAL_ 154 OBJ_Angle_Left_STD_V_24 1 "VALID" 0 "INVALID" ;
VAL_ 154 OBJ_Angle_Side_V_24 1 "VALID" 0 "INVALID" ;
VAL_ 154 OBJ_Angle_Side_STD_V_24 1 "VALID" 0 "INVALID" ;
VAL_ 154 OBJ_Angle_Mid_V_24 1 "VALID" 0 "INVALID" ;
VAL_ 154 OBJ_Angle_Mid_STD_V_24 1 "VALID" 0 "INVALID" ;
VAL_ 154 OBJ_Angle_Bottom_V_24 1 "VALID" 0 "INVALID" ;
VAL_ 154 OBJ_Angle_Bottom_STD_V_24 1 "VALID" 0 "INVALID" ;
VAL_ 154 OBJ_Visibility_Side_V_24 1 "VALID" 0 "INVALID" ;
VAL_ 154 OBJ_Visibility_Side_24 2 "REAR" 1 "FRONT" 0 "NOT_VISIBLE" ;
VAL_ 154 OBJ_Is_In_Drivable_Area_24 1 "TRUE" 0 "FALSE" ;
VAL_ 154 OBJ_Is_In_Drivable_Area_V_24 1 "VALID" 0 "INVALID" ;
VAL_ 154 OBJ_Is_VeryClose_V_24 1 "VALID" 0 "INVALID" ;
VAL_ 154 OBJ_Is_VeryClose_24 1 "TRUE" 0 "FALSE" ;
VAL_ 154 OBJ_OverlapAngleEgoLaneR_V_24 1 "VALID" 0 "INVALID" ;
VAL_ 154 OBJ_OverlapAngleEgoLaneL_V_24 1 "VALID" 0 "INVALID" ;
VAL_ 154 OBJ_Is_EMERGENCY_VCL_24 1 "TRUE" 0 "FALSE" ;
VAL_ 154 OBJ_EMERGENCY_LIGHT_COLOR_24 3 "(1000)ORANGE" 2 "(0100)BLUE" 1 "(0010)RED" 0 "(0001)OTHER" ;
VAL_ 154 OBJ_EMERGENCY_V_24 1 "TRUE" 0 "FALSE" ;
VAL_ 154 OBJ_Angle_Top_V_24 1 "VALID" 0 "INVALID" ;
VAL_ 154 OBJ_Angle_Top_STD_V_24 1 "VALID" 0 "INVALID" ;
VAL_ 154 OBJ_Fusion_Source_25 2 "(BIT_2)RADAR2" 1 "(BIT_1)RADAR1" 0 "(BIT_0)CAMERA" ;
VAL_ 154 OBJ_Triggered_SDM_25 2 "NOT_TRIGGERED" 1 "TRIGGERED" 0 "NOT_AVAILABLE" ;
VAL_ 154 OBJ_Motion_Category_25 13 "ONCOMING" 12 "PRECEEDING" 11 "MOVING" 10 "RTAP" 9 "LTAP" 8 "CROSSING" 7 "MOVING_OUT" 6 "MOVING_IN" 5 "CLOSE_CUT_IN" 4 "PASSING_OUT" 3 "PASSING_IN" 2 "PASSING" 1 "UNDEFINED" 0 "UNFILLED" ;
VAL_ 154 OBJ_Measuring_Status_25 2 "(BIT_2)NOT_VALID_OR_VALID" 1 "(BIT_1)PREDICTED_OR_MEASURED" 0 "(BIT_0)OLD_OR_NEW" ;
VAL_ 154 OBJ_Object_Class_25 8 "UNCERTAIN_VCL" 7 "ANIMAL" 6 "GENERAL_OBJECT" 5 "PEDESTRIAN" 4 "BICYCLE" 3 "MOTORBIKE" 2 "TRUCK" 1 "CAR" 0 "UNFILLED" ;
VAL_ 154 OBJ_Camera_Source_25 11 "PARKING_RIGHT" 10 "PARKING_LEFT" 9 "PARKING_REAR" 8 "PARKING_FRONT" 7 "FRONT_CORNER_RIGHT" 6 "FRONT_CORNER_LEFT" 5 "REAR_CORNER_RIGHT" 4 "REAR_CORNER_LEFT" 3 "REAR" 2 "FRONT_FISHEYE" 1 "FRONT_NARROW" 0 "FRONT_MAIN" ;
VAL_ 154 OBJ_Motion_Status_25 5 "MOVING_SLOWLY" 4 "STOPPED" 3 "STATIONARY" 2 "MOVING" 1 "UNKNOWN" 0 "INVALID" ;
VAL_ 154 OBJ_Motion_Orientation_25 13 "INVALID" 12 "NORTH" 11 "NORTH_WEST" 9 "WEST" 7 "SOUTH_WEST" 6 "SOUTH" 5 "SOUTH_EAST" 3 "EAST" 1 "NORTH_EAST" 0 "UNKNOWN" ;
VAL_ 154 OBJ_Has_Cut_Lane_25 1 "TRUE" 0 "FALSE" ;
VAL_ 154 OBJ_Has_Cut_Path_25 1 "TRUE" 0 "FALSE" ;
VAL_ 154 OBJ_Brake_Light_25 1 "TRUE" 0 "FALSE" ;
VAL_ 154 OBJ_Turn_Indicator_Right_25 1 "TRUE" 0 "FALSE" ;
VAL_ 154 OBJ_Turn_Indicator_Left_25 1 "TRUE" 0 "FALSE" ;
VAL_ 154 OBJ_Light_Indicator_Validity_25 1 "TRUE" 0 "FALSE" ;
VAL_ 154 OBJ_Right_Out_Of_Image_25 1 "TRUE" 0 "FALSE" ;
VAL_ 154 OBJ_Left_Out_Of_Image_25 1 "TRUE" 0 "FALSE" ;
VAL_ 154 OBJ_Right_Out_Of_Image_V_25 1 "TRUE" 0 "FALSE" ;
VAL_ 154 OBJ_Left_Out_Of_Image_V_25 1 "TRUE" 0 "FALSE" ;
VAL_ 154 OBJ_Top_Out_Of_Image_25 1 "TRUE" 0 "FALSE" ;
VAL_ 154 OBJ_Bottom_Out_Of_Image_25 1 "TRUE" 0 "FALSE" ;
VAL_ 154 OBJ_Top_Out_Of_Image_V_25 1 "VALID" 0 "INVALID" ;
VAL_ 154 OBJ_Bottom_Out_Of_Image_V_25 1 "VALID" 0 "INVALID" ;
VAL_ 154 OBJ_Lane_Assignment_25 5 "RIGHT_RIGHT" 4 "RIGHT" 3 "HOST" 2 "LEFT" 1 "LEFT_LEFT" 0 "UNKNOWN" ;
VAL_ 154 OBJ_Lane_Assignment_V_25 1 "VALID" 0 "INVALID" ;
VAL_ 154 OBJ_Age_Seconds_V_25 1 "VALID" 0 "INVALID" ;
VAL_ 154 OBJ_Width_V_25 1 "VALID" 0 "INVALID" ;
VAL_ 154 OBJ_Width_STD_V_25 1 "VALID" 0 "INVALID" ;
VAL_ 154 OBJ_Length_V_25 1 "VALID" 0 "INVALID" ;
VAL_ 154 OBJ_Length_STD_V_25 1 "VALID" 0 "INVALID" ;
VAL_ 154 OBJ_Height_V_25 1 "VALID" 0 "INVALID" ;
VAL_ 154 OBJ_Height_STD_V_25 1 "VALID" 0 "INVALID" ;
VAL_ 154 OBJ_Abs_Long_Velocity_V_25 1 "VALID" 0 "INVALID" ;
VAL_ 154 OBJ_Abs_Long_Vel_STD_V_25 1 "VALID" 0 "INVALID" ;
VAL_ 154 OBJ_Abs_Lat_Velocity_V_25 1 "VALID" 0 "INVALID" ;
VAL_ 154 OBJ_Abs_Lat_Vel_STD_V_25 1 "VALID" 0 "INVALID" ;
VAL_ 154 OBJ_Abs_Long_Acc_V_25 1 "VALID" 0 "INVALID" ;
VAL_ 154 OBJ_Abs_Long_Acc_STD_V_25 1 "VALID" 0 "INVALID" ;
VAL_ 154 OBJ_Abs_Lat_Acc_V_25 1 "VALID" 0 "INVALID" ;
VAL_ 154 OBJ_Abs_Lat_Acc_STD_V_25 1 "VALID" 0 "INVALID" ;
VAL_ 154 OBJ_Abs_Acceleration_V_25 1 "VALID" 0 "INVALID" ;
VAL_ 154 OBJ_Abs_Acc_STD_V_25 1 "VALID" 0 "INVALID" ;
VAL_ 154 OBJ_Inv_TTC_V_25 1 "VALID" 0 "INVALID" ;
VAL_ 154 OBJ_Inv_TTC_STD_V_25 1 "VALID" 0 "INVALID" ;
VAL_ 154 OBJ_Relative_Long_Acc_V_25 1 "VALID" 0 "INVALID" ;
VAL_ 154 OBJ_Rel_Long_Acc_STD_V_25 1 "VALID" 0 "INVALID" ;
VAL_ 154 OBJ_Relative_Long_Velocity_V_25 1 "VALID" 0 "INVALID" ;
VAL_ 154 OBJ_Rel_Long_Vel_STD_V_25 1 "VALID" 0 "INVALID" ;
VAL_ 154 OBJ_Relative_Lat_Velocity_V_25 1 "VALID" 0 "INVALID" ;
VAL_ 154 OBJ_Rel_Lat_Vel_STD_V_25 1 "VALID" 0 "INVALID" ;
VAL_ 154 OBJ_Long_Distance_V_25 1 "VALID" 0 "INVALID" ;
VAL_ 154 OBJ_Long_Distance_STD_V_25 1 "VALID" 0 "INVALID" ;
VAL_ 154 OBJ_Lat_Distance_V_25 1 "VALID" 0 "INVALID" ;
VAL_ 154 OBJ_Lat_Distance_STD_V_25 1 "VALID" 0 "INVALID" ;
VAL_ 154 OBJ_Absolute_Speed_V_25 1 "VALID" 0 "INVALID" ;
VAL_ 154 OBJ_Absolute_Speed_STD_V_25 1 "VALID" 0 "INVALID" ;
VAL_ 154 OBJ_Heading_V_25 1 "VALID" 0 "INVALID" ;
VAL_ 154 OBJ_Heading_STD_V_25 1 "VALID" 0 "INVALID" ;
VAL_ 154 OBJ_Angle_Rate_STD_V_25 1 "VALID" 0 "INVALID" ;
VAL_ 154 OBJ_Angle_Rate_V_25 1 "VALID" 0 "INVALID" ;
VAL_ 154 OBJ_Angle_Right_V_25 1 "VALID" 0 "INVALID" ;
VAL_ 154 OBJ_Angle_Right_STD_V_25 1 "VALID" 0 "INVALID" ;
VAL_ 154 OBJ_Angle_Left_V_25 1 "VALID" 0 "INVALID" ;
VAL_ 154 OBJ_Angle_Left_STD_V_25 1 "VALID" 0 "INVALID" ;
VAL_ 154 OBJ_Angle_Side_V_25 1 "VALID" 0 "INVALID" ;
VAL_ 154 OBJ_Angle_Side_STD_V_25 1 "VALID" 0 "INVALID" ;
VAL_ 154 OBJ_Angle_Mid_V_25 1 "VALID" 0 "INVALID" ;
VAL_ 154 OBJ_Angle_Mid_STD_V_25 1 "VALID" 0 "INVALID" ;
VAL_ 154 OBJ_Angle_Bottom_V_25 1 "VALID" 0 "INVALID" ;
VAL_ 154 OBJ_Angle_Bottom_STD_V_25 1 "VALID" 0 "INVALID" ;
VAL_ 154 OBJ_Visibility_Side_V_25 1 "VALID" 0 "INVALID" ;
VAL_ 154 OBJ_Visibility_Side_25 2 "REAR" 1 "FRONT" 0 "NOT_VISIBLE" ;
VAL_ 154 OBJ_Is_In_Drivable_Area_25 1 "TRUE" 0 "FALSE" ;
VAL_ 154 OBJ_Is_In_Drivable_Area_V_25 1 "VALID" 0 "INVALID" ;
VAL_ 154 OBJ_Is_VeryClose_V_25 1 "VALID" 0 "INVALID" ;
VAL_ 154 OBJ_Is_VeryClose_25 1 "TRUE" 0 "FALSE" ;
VAL_ 154 OBJ_OverlapAngleEgoLaneR_V_25 1 "VALID" 0 "INVALID" ;
VAL_ 154 OBJ_OverlapAngleEgoLaneL_V_25 1 "VALID" 0 "INVALID" ;
VAL_ 154 OBJ_Is_EMERGENCY_VCL_25 1 "TRUE" 0 "FALSE" ;
VAL_ 154 OBJ_EMERGENCY_LIGHT_COLOR_25 3 "(1000)ORANGE" 2 "(0100)BLUE" 1 "(0010)RED" 0 "(0001)OTHER" ;
VAL_ 154 OBJ_EMERGENCY_V_25 1 "TRUE" 0 "FALSE" ;
VAL_ 154 OBJ_Angle_Top_V_25 1 "VALID" 0 "INVALID" ;
VAL_ 154 OBJ_Angle_Top_STD_V_25 1 "VALID" 0 "INVALID" ;
VAL_ 154 OBJ_Fusion_Source_26 2 "(BIT_2)RADAR2" 1 "(BIT_1)RADAR1" 0 "(BIT_0)CAMERA" ;
VAL_ 154 OBJ_Triggered_SDM_26 2 "NOT_TRIGGERED" 1 "TRIGGERED" 0 "NOT_AVAILABLE" ;
VAL_ 154 OBJ_Motion_Category_26 13 "ONCOMING" 12 "PRECEEDING" 11 "MOVING" 10 "RTAP" 9 "LTAP" 8 "CROSSING" 7 "MOVING_OUT" 6 "MOVING_IN" 5 "CLOSE_CUT_IN" 4 "PASSING_OUT" 3 "PASSING_IN" 2 "PASSING" 1 "UNDEFINED" 0 "UNFILLED" ;
VAL_ 154 OBJ_Measuring_Status_26 2 "(BIT_2)NOT_VALID_OR_VALID" 1 "(BIT_1)PREDICTED_OR_MEASURED" 0 "(BIT_0)OLD_OR_NEW" ;
VAL_ 154 OBJ_Object_Class_26 8 "UNCERTAIN_VCL" 7 "ANIMAL" 6 "GENERAL_OBJECT" 5 "PEDESTRIAN" 4 "BICYCLE" 3 "MOTORBIKE" 2 "TRUCK" 1 "CAR" 0 "UNFILLED" ;
VAL_ 154 OBJ_Camera_Source_26 11 "PARKING_RIGHT" 10 "PARKING_LEFT" 9 "PARKING_REAR" 8 "PARKING_FRONT" 7 "FRONT_CORNER_RIGHT" 6 "FRONT_CORNER_LEFT" 5 "REAR_CORNER_RIGHT" 4 "REAR_CORNER_LEFT" 3 "REAR" 2 "FRONT_FISHEYE" 1 "FRONT_NARROW" 0 "FRONT_MAIN" ;
VAL_ 154 OBJ_Motion_Status_26 5 "MOVING_SLOWLY" 4 "STOPPED" 3 "STATIONARY" 2 "MOVING" 1 "UNKNOWN" 0 "INVALID" ;
VAL_ 154 OBJ_Motion_Orientation_26 13 "INVALID" 12 "NORTH" 11 "NORTH_WEST" 9 "WEST" 7 "SOUTH_WEST" 6 "SOUTH" 5 "SOUTH_EAST" 3 "EAST" 1 "NORTH_EAST" 0 "UNKNOWN" ;
VAL_ 154 OBJ_Has_Cut_Lane_26 1 "TRUE" 0 "FALSE" ;
VAL_ 154 OBJ_Has_Cut_Path_26 1 "TRUE" 0 "FALSE" ;
VAL_ 154 OBJ_Brake_Light_26 1 "TRUE" 0 "FALSE" ;
VAL_ 154 OBJ_Turn_Indicator_Right_26 1 "TRUE" 0 "FALSE" ;
VAL_ 154 OBJ_Turn_Indicator_Left_26 1 "TRUE" 0 "FALSE" ;
VAL_ 154 OBJ_Light_Indicator_Validity_26 1 "TRUE" 0 "FALSE" ;
VAL_ 154 OBJ_Right_Out_Of_Image_26 1 "TRUE" 0 "FALSE" ;
VAL_ 154 OBJ_Left_Out_Of_Image_26 1 "TRUE" 0 "FALSE" ;
VAL_ 154 OBJ_Right_Out_Of_Image_V_26 1 "TRUE" 0 "FALSE" ;
VAL_ 154 OBJ_Left_Out_Of_Image_V_26 1 "TRUE" 0 "FALSE" ;
VAL_ 154 OBJ_Top_Out_Of_Image_26 1 "TRUE" 0 "FALSE" ;
VAL_ 154 OBJ_Bottom_Out_Of_Image_26 1 "TRUE" 0 "FALSE" ;
VAL_ 154 OBJ_Top_Out_Of_Image_V_26 1 "VALID" 0 "INVALID" ;
VAL_ 154 OBJ_Bottom_Out_Of_Image_V_26 1 "VALID" 0 "INVALID" ;
VAL_ 154 OBJ_Lane_Assignment_26 5 "RIGHT_RIGHT" 4 "RIGHT" 3 "HOST" 2 "LEFT" 1 "LEFT_LEFT" 0 "UNKNOWN" ;
VAL_ 154 OBJ_Lane_Assignment_V_26 1 "VALID" 0 "INVALID" ;
VAL_ 154 OBJ_Age_Seconds_V_26 1 "VALID" 0 "INVALID" ;
VAL_ 154 OBJ_Width_V_26 1 "VALID" 0 "INVALID" ;
VAL_ 154 OBJ_Width_STD_V_26 1 "VALID" 0 "INVALID" ;
VAL_ 154 OBJ_Length_V_26 1 "VALID" 0 "INVALID" ;
VAL_ 154 OBJ_Length_STD_V_26 1 "VALID" 0 "INVALID" ;
VAL_ 154 OBJ_Height_V_26 1 "VALID" 0 "INVALID" ;
VAL_ 154 OBJ_Height_STD_V_26 1 "VALID" 0 "INVALID" ;
VAL_ 154 OBJ_Abs_Long_Velocity_V_26 1 "VALID" 0 "INVALID" ;
VAL_ 154 OBJ_Abs_Long_Vel_STD_V_26 1 "VALID" 0 "INVALID" ;
VAL_ 154 OBJ_Abs_Lat_Velocity_V_26 1 "VALID" 0 "INVALID" ;
VAL_ 154 OBJ_Abs_Lat_Vel_STD_V_26 1 "VALID" 0 "INVALID" ;
VAL_ 154 OBJ_Abs_Long_Acc_V_26 1 "VALID" 0 "INVALID" ;
VAL_ 154 OBJ_Abs_Long_Acc_STD_V_26 1 "VALID" 0 "INVALID" ;
VAL_ 154 OBJ_Abs_Lat_Acc_V_26 1 "VALID" 0 "INVALID" ;
VAL_ 154 OBJ_Abs_Lat_Acc_STD_V_26 1 "VALID" 0 "INVALID" ;
VAL_ 154 OBJ_Abs_Acceleration_V_26 1 "VALID" 0 "INVALID" ;
VAL_ 154 OBJ_Abs_Acc_STD_V_26 1 "VALID" 0 "INVALID" ;
VAL_ 154 OBJ_Inv_TTC_V_26 1 "VALID" 0 "INVALID" ;
VAL_ 154 OBJ_Inv_TTC_STD_V_26 1 "VALID" 0 "INVALID" ;
VAL_ 154 OBJ_Relative_Long_Acc_V_26 1 "VALID" 0 "INVALID" ;
VAL_ 154 OBJ_Rel_Long_Acc_STD_V_26 1 "VALID" 0 "INVALID" ;
VAL_ 154 OBJ_Relative_Long_Velocity_V_26 1 "VALID" 0 "INVALID" ;
VAL_ 154 OBJ_Rel_Long_Vel_STD_V_26 1 "VALID" 0 "INVALID" ;
VAL_ 154 OBJ_Relative_Lat_Velocity_V_26 1 "VALID" 0 "INVALID" ;
VAL_ 154 OBJ_Rel_Lat_Vel_STD_V_26 1 "VALID" 0 "INVALID" ;
VAL_ 154 OBJ_Long_Distance_V_26 1 "VALID" 0 "INVALID" ;
VAL_ 154 OBJ_Long_Distance_STD_V_26 1 "VALID" 0 "INVALID" ;
VAL_ 154 OBJ_Lat_Distance_V_26 1 "VALID" 0 "INVALID" ;
VAL_ 154 OBJ_Lat_Distance_STD_V_26 1 "VALID" 0 "INVALID" ;
VAL_ 154 OBJ_Absolute_Speed_V_26 1 "VALID" 0 "INVALID" ;
VAL_ 154 OBJ_Absolute_Speed_STD_V_26 1 "VALID" 0 "INVALID" ;
VAL_ 154 OBJ_Heading_V_26 1 "VALID" 0 "INVALID" ;
VAL_ 154 OBJ_Heading_STD_V_26 1 "VALID" 0 "INVALID" ;
VAL_ 154 OBJ_Angle_Rate_STD_V_26 1 "VALID" 0 "INVALID" ;
VAL_ 154 OBJ_Angle_Rate_V_26 1 "VALID" 0 "INVALID" ;
VAL_ 154 OBJ_Angle_Right_V_26 1 "VALID" 0 "INVALID" ;
VAL_ 154 OBJ_Angle_Right_STD_V_26 1 "VALID" 0 "INVALID" ;
VAL_ 154 OBJ_Angle_Left_V_26 1 "VALID" 0 "INVALID" ;
VAL_ 154 OBJ_Angle_Left_STD_V_26 1 "VALID" 0 "INVALID" ;
VAL_ 154 OBJ_Angle_Side_V_26 1 "VALID" 0 "INVALID" ;
VAL_ 154 OBJ_Angle_Side_STD_V_26 1 "VALID" 0 "INVALID" ;
VAL_ 154 OBJ_Angle_Mid_V_26 1 "VALID" 0 "INVALID" ;
VAL_ 154 OBJ_Angle_Mid_STD_V_26 1 "VALID" 0 "INVALID" ;
VAL_ 154 OBJ_Angle_Bottom_V_26 1 "VALID" 0 "INVALID" ;
VAL_ 154 OBJ_Angle_Bottom_STD_V_26 1 "VALID" 0 "INVALID" ;
VAL_ 154 OBJ_Visibility_Side_V_26 1 "VALID" 0 "INVALID" ;
VAL_ 154 OBJ_Visibility_Side_26 2 "REAR" 1 "FRONT" 0 "NOT_VISIBLE" ;
VAL_ 154 OBJ_Is_In_Drivable_Area_26 1 "TRUE" 0 "FALSE" ;
VAL_ 154 OBJ_Is_In_Drivable_Area_V_26 1 "VALID" 0 "INVALID" ;
VAL_ 154 OBJ_Is_VeryClose_V_26 1 "VALID" 0 "INVALID" ;
VAL_ 154 OBJ_Is_VeryClose_26 1 "TRUE" 0 "FALSE" ;
VAL_ 154 OBJ_OverlapAngleEgoLaneR_V_26 1 "VALID" 0 "INVALID" ;
VAL_ 154 OBJ_OverlapAngleEgoLaneL_V_26 1 "VALID" 0 "INVALID" ;
VAL_ 154 OBJ_Is_EMERGENCY_VCL_26 1 "TRUE" 0 "FALSE" ;
VAL_ 154 OBJ_EMERGENCY_LIGHT_COLOR_26 3 "(1000)ORANGE" 2 "(0100)BLUE" 1 "(0010)RED" 0 "(0001)OTHER" ;
VAL_ 154 OBJ_EMERGENCY_V_26 1 "TRUE" 0 "FALSE" ;
VAL_ 154 OBJ_Angle_Top_V_26 1 "VALID" 0 "INVALID" ;
VAL_ 154 OBJ_Angle_Top_STD_V_26 1 "VALID" 0 "INVALID" ;
VAL_ 154 OBJ_Fusion_Source_27 2 "(BIT_2)RADAR2" 1 "(BIT_1)RADAR1" 0 "(BIT_0)CAMERA" ;
VAL_ 154 OBJ_Triggered_SDM_27 2 "NOT_TRIGGERED" 1 "TRIGGERED" 0 "NOT_AVAILABLE" ;
VAL_ 154 OBJ_Motion_Category_27 13 "ONCOMING" 12 "PRECEEDING" 11 "MOVING" 10 "RTAP" 9 "LTAP" 8 "CROSSING" 7 "MOVING_OUT" 6 "MOVING_IN" 5 "CLOSE_CUT_IN" 4 "PASSING_OUT" 3 "PASSING_IN" 2 "PASSING" 1 "UNDEFINED" 0 "UNFILLED" ;
VAL_ 154 OBJ_Measuring_Status_27 2 "(BIT_2)NOT_VALID_OR_VALID" 1 "(BIT_1)PREDICTED_OR_MEASURED" 0 "(BIT_0)OLD_OR_NEW" ;
VAL_ 154 OBJ_Object_Class_27 8 "UNCERTAIN_VCL" 7 "ANIMAL" 6 "GENERAL_OBJECT" 5 "PEDESTRIAN" 4 "BICYCLE" 3 "MOTORBIKE" 2 "TRUCK" 1 "CAR" 0 "UNFILLED" ;
VAL_ 154 OBJ_Camera_Source_27 11 "PARKING_RIGHT" 10 "PARKING_LEFT" 9 "PARKING_REAR" 8 "PARKING_FRONT" 7 "FRONT_CORNER_RIGHT" 6 "FRONT_CORNER_LEFT" 5 "REAR_CORNER_RIGHT" 4 "REAR_CORNER_LEFT" 3 "REAR" 2 "FRONT_FISHEYE" 1 "FRONT_NARROW" 0 "FRONT_MAIN" ;
VAL_ 154 OBJ_Motion_Status_27 5 "MOVING_SLOWLY" 4 "STOPPED" 3 "STATIONARY" 2 "MOVING" 1 "UNKNOWN" 0 "INVALID" ;
VAL_ 154 OBJ_Motion_Orientation_27 13 "INVALID" 12 "NORTH" 11 "NORTH_WEST" 9 "WEST" 7 "SOUTH_WEST" 6 "SOUTH" 5 "SOUTH_EAST" 3 "EAST" 1 "NORTH_EAST" 0 "UNKNOWN" ;
VAL_ 154 OBJ_Has_Cut_Lane_27 1 "TRUE" 0 "FALSE" ;
VAL_ 154 OBJ_Has_Cut_Path_27 1 "TRUE" 0 "FALSE" ;
VAL_ 154 OBJ_Brake_Light_27 1 "TRUE" 0 "FALSE" ;
VAL_ 154 OBJ_Turn_Indicator_Right_27 1 "TRUE" 0 "FALSE" ;
VAL_ 154 OBJ_Turn_Indicator_Left_27 1 "TRUE" 0 "FALSE" ;
VAL_ 154 OBJ_Light_Indicator_Validity_27 1 "TRUE" 0 "FALSE" ;
VAL_ 154 OBJ_Right_Out_Of_Image_27 1 "TRUE" 0 "FALSE" ;
VAL_ 154 OBJ_Left_Out_Of_Image_27 1 "TRUE" 0 "FALSE" ;
VAL_ 154 OBJ_Right_Out_Of_Image_V_27 1 "TRUE" 0 "FALSE" ;
VAL_ 154 OBJ_Left_Out_Of_Image_V_27 1 "TRUE" 0 "FALSE" ;
VAL_ 154 OBJ_Top_Out_Of_Image_27 1 "TRUE" 0 "FALSE" ;
VAL_ 154 OBJ_Bottom_Out_Of_Image_27 1 "TRUE" 0 "FALSE" ;
VAL_ 154 OBJ_Top_Out_Of_Image_V_27 1 "VALID" 0 "INVALID" ;
VAL_ 154 OBJ_Bottom_Out_Of_Image_V_27 1 "VALID" 0 "INVALID" ;
VAL_ 154 OBJ_Lane_Assignment_27 5 "RIGHT_RIGHT" 4 "RIGHT" 3 "HOST" 2 "LEFT" 1 "LEFT_LEFT" 0 "UNKNOWN" ;
VAL_ 154 OBJ_Lane_Assignment_V_27 1 "VALID" 0 "INVALID" ;
VAL_ 154 OBJ_Age_Seconds_V_27 1 "VALID" 0 "INVALID" ;
VAL_ 154 OBJ_Width_V_27 1 "VALID" 0 "INVALID" ;
VAL_ 154 OBJ_Width_STD_V_27 1 "VALID" 0 "INVALID" ;
VAL_ 154 OBJ_Length_V_27 1 "VALID" 0 "INVALID" ;
VAL_ 154 OBJ_Length_STD_V_27 1 "VALID" 0 "INVALID" ;
VAL_ 154 OBJ_Height_V_27 1 "VALID" 0 "INVALID" ;
VAL_ 154 OBJ_Height_STD_V_27 1 "VALID" 0 "INVALID" ;
VAL_ 154 OBJ_Abs_Long_Velocity_V_27 1 "VALID" 0 "INVALID" ;
VAL_ 154 OBJ_Abs_Long_Vel_STD_V_27 1 "VALID" 0 "INVALID" ;
VAL_ 154 OBJ_Abs_Lat_Velocity_V_27 1 "VALID" 0 "INVALID" ;
VAL_ 154 OBJ_Abs_Lat_Vel_STD_V_27 1 "VALID" 0 "INVALID" ;
VAL_ 154 OBJ_Abs_Long_Acc_V_27 1 "VALID" 0 "INVALID" ;
VAL_ 154 OBJ_Abs_Long_Acc_STD_V_27 1 "VALID" 0 "INVALID" ;
VAL_ 154 OBJ_Abs_Lat_Acc_V_27 1 "VALID" 0 "INVALID" ;
VAL_ 154 OBJ_Abs_Lat_Acc_STD_V_27 1 "VALID" 0 "INVALID" ;
VAL_ 154 OBJ_Abs_Acceleration_V_27 1 "VALID" 0 "INVALID" ;
VAL_ 154 OBJ_Abs_Acc_STD_V_27 1 "VALID" 0 "INVALID" ;
VAL_ 154 OBJ_Inv_TTC_V_27 1 "VALID" 0 "INVALID" ;
VAL_ 154 OBJ_Inv_TTC_STD_V_27 1 "VALID" 0 "INVALID" ;
VAL_ 154 OBJ_Relative_Long_Acc_V_27 1 "VALID" 0 "INVALID" ;
VAL_ 154 OBJ_Rel_Long_Acc_STD_V_27 1 "VALID" 0 "INVALID" ;
VAL_ 154 OBJ_Relative_Long_Velocity_V_27 1 "VALID" 0 "INVALID" ;
VAL_ 154 OBJ_Rel_Long_Vel_STD_V_27 1 "VALID" 0 "INVALID" ;
VAL_ 154 OBJ_Relative_Lat_Velocity_V_27 1 "VALID" 0 "INVALID" ;
VAL_ 154 OBJ_Rel_Lat_Vel_STD_V_27 1 "VALID" 0 "INVALID" ;
VAL_ 154 OBJ_Long_Distance_V_27 1 "VALID" 0 "INVALID" ;
VAL_ 154 OBJ_Long_Distance_STD_V_27 1 "VALID" 0 "INVALID" ;
VAL_ 154 OBJ_Lat_Distance_V_27 1 "VALID" 0 "INVALID" ;
VAL_ 154 OBJ_Lat_Distance_STD_V_27 1 "VALID" 0 "INVALID" ;
VAL_ 154 OBJ_Absolute_Speed_V_27 1 "VALID" 0 "INVALID" ;
VAL_ 154 OBJ_Absolute_Speed_STD_V_27 1 "VALID" 0 "INVALID" ;
VAL_ 154 OBJ_Heading_V_27 1 "VALID" 0 "INVALID" ;
VAL_ 154 OBJ_Heading_STD_V_27 1 "VALID" 0 "INVALID" ;
VAL_ 154 OBJ_Angle_Rate_STD_V_27 1 "VALID" 0 "INVALID" ;
VAL_ 154 OBJ_Angle_Rate_V_27 1 "VALID" 0 "INVALID" ;
VAL_ 154 OBJ_Angle_Right_V_27 1 "VALID" 0 "INVALID" ;
VAL_ 154 OBJ_Angle_Right_STD_V_27 1 "VALID" 0 "INVALID" ;
VAL_ 154 OBJ_Angle_Left_V_27 1 "VALID" 0 "INVALID" ;
VAL_ 154 OBJ_Angle_Left_STD_V_27 1 "VALID" 0 "INVALID" ;
VAL_ 154 OBJ_Angle_Side_V_27 1 "VALID" 0 "INVALID" ;
VAL_ 154 OBJ_Angle_Side_STD_V_27 1 "VALID" 0 "INVALID" ;
VAL_ 154 OBJ_Angle_Mid_V_27 1 "VALID" 0 "INVALID" ;
VAL_ 154 OBJ_Angle_Mid_STD_V_27 1 "VALID" 0 "INVALID" ;
VAL_ 154 OBJ_Angle_Bottom_V_27 1 "VALID" 0 "INVALID" ;
VAL_ 154 OBJ_Angle_Bottom_STD_V_27 1 "VALID" 0 "INVALID" ;
VAL_ 154 OBJ_Visibility_Side_V_27 1 "VALID" 0 "INVALID" ;
VAL_ 154 OBJ_Visibility_Side_27 2 "REAR" 1 "FRONT" 0 "NOT_VISIBLE" ;
VAL_ 154 OBJ_Is_In_Drivable_Area_27 1 "TRUE" 0 "FALSE" ;
VAL_ 154 OBJ_Is_In_Drivable_Area_V_27 1 "VALID" 0 "INVALID" ;
VAL_ 154 OBJ_Is_VeryClose_V_27 1 "VALID" 0 "INVALID" ;
VAL_ 154 OBJ_Is_VeryClose_27 1 "TRUE" 0 "FALSE" ;
VAL_ 154 OBJ_OverlapAngleEgoLaneR_V_27 1 "VALID" 0 "INVALID" ;
VAL_ 154 OBJ_OverlapAngleEgoLaneL_V_27 1 "VALID" 0 "INVALID" ;
VAL_ 154 OBJ_Is_EMERGENCY_VCL_27 1 "TRUE" 0 "FALSE" ;
VAL_ 154 OBJ_EMERGENCY_LIGHT_COLOR_27 3 "(1000)ORANGE" 2 "(0100)BLUE" 1 "(0010)RED" 0 "(0001)OTHER" ;
VAL_ 154 OBJ_EMERGENCY_V_27 1 "TRUE" 0 "FALSE" ;
VAL_ 154 OBJ_Angle_Top_V_27 1 "VALID" 0 "INVALID" ;
VAL_ 154 OBJ_Angle_Top_STD_V_27 1 "VALID" 0 "INVALID" ;
VAL_ 154 OBJ_Fusion_Source_28 2 "(BIT_2)RADAR2" 1 "(BIT_1)RADAR1" 0 "(BIT_0)CAMERA" ;
VAL_ 154 OBJ_Triggered_SDM_28 2 "NOT_TRIGGERED" 1 "TRIGGERED" 0 "NOT_AVAILABLE" ;
VAL_ 154 OBJ_Motion_Category_28 13 "ONCOMING" 12 "PRECEEDING" 11 "MOVING" 10 "RTAP" 9 "LTAP" 8 "CROSSING" 7 "MOVING_OUT" 6 "MOVING_IN" 5 "CLOSE_CUT_IN" 4 "PASSING_OUT" 3 "PASSING_IN" 2 "PASSING" 1 "UNDEFINED" 0 "UNFILLED" ;
VAL_ 154 OBJ_Measuring_Status_28 2 "(BIT_2)NOT_VALID_OR_VALID" 1 "(BIT_1)PREDICTED_OR_MEASURED" 0 "(BIT_0)OLD_OR_NEW" ;
VAL_ 154 OBJ_Object_Class_28 8 "UNCERTAIN_VCL" 7 "ANIMAL" 6 "GENERAL_OBJECT" 5 "PEDESTRIAN" 4 "BICYCLE" 3 "MOTORBIKE" 2 "TRUCK" 1 "CAR" 0 "UNFILLED" ;
VAL_ 154 OBJ_Camera_Source_28 11 "PARKING_RIGHT" 10 "PARKING_LEFT" 9 "PARKING_REAR" 8 "PARKING_FRONT" 7 "FRONT_CORNER_RIGHT" 6 "FRONT_CORNER_LEFT" 5 "REAR_CORNER_RIGHT" 4 "REAR_CORNER_LEFT" 3 "REAR" 2 "FRONT_FISHEYE" 1 "FRONT_NARROW" 0 "FRONT_MAIN" ;
VAL_ 154 OBJ_Motion_Status_28 5 "MOVING_SLOWLY" 4 "STOPPED" 3 "STATIONARY" 2 "MOVING" 1 "UNKNOWN" 0 "INVALID" ;
VAL_ 154 OBJ_Motion_Orientation_28 13 "INVALID" 12 "NORTH" 11 "NORTH_WEST" 9 "WEST" 7 "SOUTH_WEST" 6 "SOUTH" 5 "SOUTH_EAST" 3 "EAST" 1 "NORTH_EAST" 0 "UNKNOWN" ;
VAL_ 154 OBJ_Has_Cut_Lane_28 1 "TRUE" 0 "FALSE" ;
VAL_ 154 OBJ_Has_Cut_Path_28 1 "TRUE" 0 "FALSE" ;
VAL_ 154 OBJ_Brake_Light_28 1 "TRUE" 0 "FALSE" ;
VAL_ 154 OBJ_Turn_Indicator_Right_28 1 "TRUE" 0 "FALSE" ;
VAL_ 154 OBJ_Turn_Indicator_Left_28 1 "TRUE" 0 "FALSE" ;
VAL_ 154 OBJ_Light_Indicator_Validity_28 1 "TRUE" 0 "FALSE" ;
VAL_ 154 OBJ_Right_Out_Of_Image_28 1 "TRUE" 0 "FALSE" ;
VAL_ 154 OBJ_Left_Out_Of_Image_28 1 "TRUE" 0 "FALSE" ;
VAL_ 154 OBJ_Right_Out_Of_Image_V_28 1 "TRUE" 0 "FALSE" ;
VAL_ 154 OBJ_Left_Out_Of_Image_V_28 1 "TRUE" 0 "FALSE" ;
VAL_ 154 OBJ_Top_Out_Of_Image_28 1 "TRUE" 0 "FALSE" ;
VAL_ 154 OBJ_Bottom_Out_Of_Image_28 1 "TRUE" 0 "FALSE" ;
VAL_ 154 OBJ_Top_Out_Of_Image_V_28 1 "VALID" 0 "INVALID" ;
VAL_ 154 OBJ_Bottom_Out_Of_Image_V_28 1 "VALID" 0 "INVALID" ;
VAL_ 154 OBJ_Lane_Assignment_28 5 "RIGHT_RIGHT" 4 "RIGHT" 3 "HOST" 2 "LEFT" 1 "LEFT_LEFT" 0 "UNKNOWN" ;
VAL_ 154 OBJ_Lane_Assignment_V_28 1 "VALID" 0 "INVALID" ;
VAL_ 154 OBJ_Age_Seconds_V_28 1 "VALID" 0 "INVALID" ;
VAL_ 154 OBJ_Width_V_28 1 "VALID" 0 "INVALID" ;
VAL_ 154 OBJ_Width_STD_V_28 1 "VALID" 0 "INVALID" ;
VAL_ 154 OBJ_Length_V_28 1 "VALID" 0 "INVALID" ;
VAL_ 154 OBJ_Length_STD_V_28 1 "VALID" 0 "INVALID" ;
VAL_ 154 OBJ_Height_V_28 1 "VALID" 0 "INVALID" ;
VAL_ 154 OBJ_Height_STD_V_28 1 "VALID" 0 "INVALID" ;
VAL_ 154 OBJ_Abs_Long_Velocity_V_28 1 "VALID" 0 "INVALID" ;
VAL_ 154 OBJ_Abs_Long_Vel_STD_V_28 1 "VALID" 0 "INVALID" ;
VAL_ 154 OBJ_Abs_Lat_Velocity_V_28 1 "VALID" 0 "INVALID" ;
VAL_ 154 OBJ_Abs_Lat_Vel_STD_V_28 1 "VALID" 0 "INVALID" ;
VAL_ 154 OBJ_Abs_Long_Acc_V_28 1 "VALID" 0 "INVALID" ;
VAL_ 154 OBJ_Abs_Long_Acc_STD_V_28 1 "VALID" 0 "INVALID" ;
VAL_ 154 OBJ_Abs_Lat_Acc_V_28 1 "VALID" 0 "INVALID" ;
VAL_ 154 OBJ_Abs_Lat_Acc_STD_V_28 1 "VALID" 0 "INVALID" ;
VAL_ 154 OBJ_Abs_Acceleration_V_28 1 "VALID" 0 "INVALID" ;
VAL_ 154 OBJ_Abs_Acc_STD_V_28 1 "VALID" 0 "INVALID" ;
VAL_ 154 OBJ_Inv_TTC_V_28 1 "VALID" 0 "INVALID" ;
VAL_ 154 OBJ_Inv_TTC_STD_V_28 1 "VALID" 0 "INVALID" ;
VAL_ 154 OBJ_Relative_Long_Acc_V_28 1 "VALID" 0 "INVALID" ;
VAL_ 154 OBJ_Rel_Long_Acc_STD_V_28 1 "VALID" 0 "INVALID" ;
VAL_ 154 OBJ_Relative_Long_Velocity_V_28 1 "VALID" 0 "INVALID" ;
VAL_ 154 OBJ_Rel_Long_Vel_STD_V_28 1 "VALID" 0 "INVALID" ;
VAL_ 154 OBJ_Relative_Lat_Velocity_V_28 1 "VALID" 0 "INVALID" ;
VAL_ 154 OBJ_Rel_Lat_Vel_STD_V_28 1 "VALID" 0 "INVALID" ;
VAL_ 154 OBJ_Long_Distance_V_28 1 "VALID" 0 "INVALID" ;
VAL_ 154 OBJ_Long_Distance_STD_V_28 1 "VALID" 0 "INVALID" ;
VAL_ 154 OBJ_Lat_Distance_V_28 1 "VALID" 0 "INVALID" ;
VAL_ 154 OBJ_Lat_Distance_STD_V_28 1 "VALID" 0 "INVALID" ;
VAL_ 154 OBJ_Absolute_Speed_V_28 1 "VALID" 0 "INVALID" ;
VAL_ 154 OBJ_Absolute_Speed_STD_V_28 1 "VALID" 0 "INVALID" ;
VAL_ 154 OBJ_Heading_V_28 1 "VALID" 0 "INVALID" ;
VAL_ 154 OBJ_Heading_STD_V_28 1 "VALID" 0 "INVALID" ;
VAL_ 154 OBJ_Angle_Rate_STD_V_28 1 "VALID" 0 "INVALID" ;
VAL_ 154 OBJ_Angle_Rate_V_28 1 "VALID" 0 "INVALID" ;
VAL_ 154 OBJ_Angle_Right_V_28 1 "VALID" 0 "INVALID" ;
VAL_ 154 OBJ_Angle_Right_STD_V_28 1 "VALID" 0 "INVALID" ;
VAL_ 154 OBJ_Angle_Left_V_28 1 "VALID" 0 "INVALID" ;
VAL_ 154 OBJ_Angle_Left_STD_V_28 1 "VALID" 0 "INVALID" ;
VAL_ 154 OBJ_Angle_Side_V_28 1 "VALID" 0 "INVALID" ;
VAL_ 154 OBJ_Angle_Side_STD_V_28 1 "VALID" 0 "INVALID" ;
VAL_ 154 OBJ_Angle_Mid_V_28 1 "VALID" 0 "INVALID" ;
VAL_ 154 OBJ_Angle_Mid_STD_V_28 1 "VALID" 0 "INVALID" ;
VAL_ 154 OBJ_Angle_Bottom_V_28 1 "VALID" 0 "INVALID" ;
VAL_ 154 OBJ_Angle_Bottom_STD_V_28 1 "VALID" 0 "INVALID" ;
VAL_ 154 OBJ_Visibility_Side_V_28 1 "VALID" 0 "INVALID" ;
VAL_ 154 OBJ_Visibility_Side_28 2 "REAR" 1 "FRONT" 0 "NOT_VISIBLE" ;
VAL_ 154 OBJ_Is_In_Drivable_Area_28 1 "TRUE" 0 "FALSE" ;
VAL_ 154 OBJ_Is_In_Drivable_Area_V_28 1 "VALID" 0 "INVALID" ;
VAL_ 154 OBJ_Is_VeryClose_V_28 1 "VALID" 0 "INVALID" ;
