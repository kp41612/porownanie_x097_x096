VERSION "14"
// BundelVersion=v4.20.10_RC1
NS_ :

BS_:

BU_: EyeQ4 MCU

BO_ 154 Core_Objects_protocol: 4660 EyeQ4
 SG_ OBJ_Lat_Distance_11 : 10896|12@1+ (0.05,-100) [-100|100] "m" MCU
 SG_ OBJ_Lat_Distance_V_11 : 10908|1@1+ (1,0) [0|1] "bool" MCU
 SG_ Reserved_13_11 : 10909|3@1+ (1,0) [0|0] "NA" MCU
 SG_ OBJ_Lat_Distance_STD_11 : 10912|14@1+ (0.01,0) [0|100] "m" MCU
 SG_ OBJ_Lat_Distance_STD_V_11 : 10926|1@1+ (1,0) [0|1] "bool" MCU
 SG_ OBJ_Absolute_Speed_11 : 10927|12@1+ (0.05,-65) [-65|65] "m_per_s" MCU
 SG_ OBJ_Absolute_Speed_V_11 : 10939|1@1+ (1,0) [0|1] "bool" MCU
 SG_ Reserved_14_11 : 10940|4@1+ (1,0) [0|0] "NA" MCU
 SG_ OBJ_Absolute_Speed_STD_11 : 10944|13@1+ (0.01,0) [0|65] "m_per_s" MCU
 SG_ OBJ_Absolute_Speed_STD_V_11 : 10957|1@1+ (1,0) [0|1] "bool" MCU
 SG_ OBJ_Heading_11 : 10958|10@1+ (0.01,-3.14) [-3.14|3.14] "rad" MCU
 SG_ OBJ_Heading_V_11 : 10968|1@1+ (1,0) [0|1] "bool" MCU
 SG_ Reserved_15_11 : 10969|7@1+ (1,0) [0|0] "NA" MCU
 SG_ OBJ_Heading_STD_11 : 10976|15@1+ (0.0001,0) [0|3.14] "rad" MCU
 SG_ OBJ_Heading_STD_V_11 : 10991|1@1+ (1,0) [0|1] "bool" MCU
 SG_ OBJ_Angle_Rate_STD_11 : 10992|15@1+ (0.0001,0) [0|2.2318] "RPS" MCU
 SG_ OBJ_Angle_Rate_STD_V_11 : 11007|1@1+ (1,0) [0|1] "bool" MCU
 SG_ OBJ_Angle_Rate_11 : 11008|12@1+ (0.002,-2.234) [-2.234|2.2318] "RPS" MCU
 SG_ OBJ_Angle_Rate_V_11 : 11020|1@1+ (1,0) [0|1] "bool" MCU
 SG_ OBJ_Angle_Right_11 : 11021|14@1+ (0.0002,-1.571) [-1.571|1.571] "rad" MCU
 SG_ OBJ_Angle_Right_V_11 : 11035|1@1+ (1,0) [0|1] "bool" MCU
 SG_ Reserved_16_11 : 11036|4@1+ (1,0) [0|0] "NA" MCU
 SG_ OBJ_Angle_Right_STD_11 : 11040|14@1+ (0.0001,0) [0|1.571] "rad" MCU
 SG_ OBJ_Angle_Right_STD_V_11 : 11054|1@1+ (1,0) [0|1] "bool" MCU
 SG_ OBJ_Angle_Left_11 : 11055|14@1+ (0.0002,-1.571) [-1.571|1.571] "rad" MCU
 SG_ OBJ_Angle_Left_V_11 : 11069|1@1+ (1,0) [0|1] "bool" MCU
 SG_ Reserved_17_11 : 11070|2@1+ (1,0) [0|0] "NA" MCU
 SG_ OBJ_Angle_Left_STD_11 : 11072|14@1+ (0.0001,0) [0|1.571] "rad" MCU
 SG_ OBJ_Angle_Left_STD_V_11 : 11086|1@1+ (1,0) [0|1] "bool" MCU
 SG_ OBJ_Angle_Side_11 : 11087|14@1+ (0.0002,-1.571) [-1.571|1.571] "rad" MCU
 SG_ OBJ_Angle_Side_V_11 : 11101|1@1+ (1,0) [0|1] "bool" MCU
 SG_ Reserved_18_11 : 11102|2@1+ (1,0) [0|0] "NA" MCU
 SG_ OBJ_Angle_Side_STD_11 : 11104|14@1+ (0.0001,0) [0|1.571] "rad" MCU
 SG_ OBJ_Angle_Side_STD_V_11 : 11118|1@1+ (1,0) [0|1] "bool" MCU
 SG_ OBJ_Angle_Mid_V_11 : 11119|1@1+ (1,0) [0|1] "bool" MCU
 SG_ OBJ_Angle_Mid_11 : 11120|14@1+ (0.0002,-1.571) [-1.571|1.571] "rad" MCU
 SG_ Reserved_19_11 : 11134|2@1+ (1,0) [0|0] "NA" MCU
 SG_ OBJ_Angle_Mid_STD_11 : 11136|14@1+ (0.0001,0) [0|1.571] "rad" MCU
 SG_ OBJ_Angle_Mid_STD_V_11 : 11150|1@1+ (1,0) [0|1] "bool" MCU
 SG_ OBJ_Angle_Bottom_V_11 : 11151|1@1+ (1,0) [0|1] "bool" MCU
 SG_ OBJ_Angle_Bottom_11 : 11152|14@1+ (0.0002,-1.571) [-1.571|1.571] "rad" MCU
 SG_ Reserved_20_11 : 11166|2@1+ (1,0) [0|0] "NA" MCU
 SG_ OBJ_Angle_Bottom_STD_11 : 11168|14@1+ (0.0001,0) [0|1.571] "rad" MCU
 SG_ OBJ_Angle_Bottom_STD_V_11 : 11182|1@1+ (1,0) [0|1] "bool" MCU
 SG_ OBJ_Visibility_Side_V_11 : 11183|1@1+ (1,0) [0|1] "bool" MCU
 SG_ OBJ_Visibility_Side_11 : 11184|2@1+ (1,0) [0|2] "ENUM" MCU
 SG_ OBJ_Is_In_Drivable_Area_11 : 11186|1@1+ (1,0) [0|1] "bool" MCU
 SG_ OBJ_Is_In_Drivable_Area_V_11 : 11187|1@1+ (1,0) [0|1] "bool" MCU
 SG_ OBJ_Is_VeryClose_V_11 : 11188|1@1+ (1,0) [0|1] "bool" MCU
 SG_ OBJ_Is_VeryClose_11 : 11189|1@1+ (1,0) [0|1] "bool" MCU
 SG_ OBJ_Buffer_C4_11 : 11190|2@1+ (1,0) [0|2] "NA" MCU
 SG_ OBJ_Buffer_C5_11 : 11192|2@1+ (1,0) [0|2] "NA" MCU
 SG_ OBJ_Buffer_C6_11 : 11194|2@1+ (1,0) [0|2] "NA" MCU
 SG_ OBJ_Buffer_C7_11 : 11196|2@1+ (1,0) [0|2] "NA" MCU
 SG_ Reserved_21_11 : 11198|2@1+ (1,0) [0|0] "NA" MCU
 SG_ OBJ_OverlapAngleEgoLaneR_11 : 11200|10@1+ (0.01,-3.14) [-3.14|3.14] "rad" MCU
 SG_ OBJ_OverlapAngleEgoLaneR_V_11 : 11210|1@1+ (1,0) [0|1] "bool" MCU
 SG_ OBJ_OverlapAngleEgoLaneL_11 : 11211|10@1+ (0.01,-3.14) [-3.14|3.14] "rad" MCU
 SG_ OBJ_OverlapAngleEgoLaneL_V_11 : 11221|1@1+ (1,0) [0|1] "bool" MCU
 SG_ OBJ_Is_EMERGENCY_VCL_11 : 11222|1@1+ (1,0) [0|1] "bool" MCU
 SG_ OBJ_EMERGENCY_LIGHT_COLOR_11 : 11223|4@1+ (1,0) [0|15] "BITWIZE" MCU
 SG_ OBJ_EMERGENCY_V_11 : 11227|1@1+ (1,0) [0|1] "bool" MCU
 SG_ Reserved_22_11 : 11228|4@1+ (1,0) [0|0] "NA" MCU
 SG_ OBJ_Angle_Top_11 : 11232|14@1+ (0.0002,0) [0|3.1415] "rad" MCU
 SG_ OBJ_Angle_Top_V_11 : 11246|1@1+ (1,0) [0|1] "bool" MCU
 SG_ OBJ_Angle_Top_STD_11 : 11247|15@1+ (0.0001,0) [0|3.1415] "rad" MCU
 SG_ OBJ_Angle_Top_STD_V_11 : 11262|1@1+ (1,0) [0|1] "bool" MCU
 SG_ OBJ_Buffer_C14_11 : 11263|1@1+ (1,0) [0|1] "NA" MCU
 SG_ OBJ_Buffer_C15_11 : 11264|1@1+ (1,0) [0|1] "NA" MCU
 SG_ OBJ_Buffer_C18_11 : 11265|2@1+ (1,0) [0|2] "NA" MCU
 SG_ OBJ_Buffer_C19_11 : 11267|1@1+ (1,0) [0|1] "NA" MCU
 SG_ Reserved_23_11 : 11268|28@1+ (1,0) [0|0] "NA" MCU
 SG_ OBJ_CRC_12 : 11296|32@1+ (1,0) [0|4294967295] "NA" MCU
 SG_ OBJ_ID_12 : 11328|8@1+ (1,0) [0|255] "counter" MCU
 SG_ OBJ_Existence_Probability_12 : 11336|8@1+ (0.01,0) [0|1] "NA" MCU
 SG_ OBJ_Fusion_Source_12 : 11344|16@1+ (1,0) [0|65535] "BITWIZE" MCU
 SG_ OBJ_Triggered_SDM_12 : 11360|2@1+ (1,0) [0|2] "ENUM" MCU
 SG_ OBJ_Motion_Category_12 : 11362|4@1+ (1,0) [0|13] "ENUM" MCU
 SG_ OBJ_Buffer_C0_12 : 11366|7@1+ (0.01,0) [0|1] "NA" MCU
 SG_ OBJ_Object_Age_12 : 11373|11@1+ (1,0) [0|2047] "frames" MCU
 SG_ OBJ_Measuring_Status_12 : 11384|3@1+ (1,0) [0|7] "BITWIZE" MCU
 SG_ OBJ_Object_Class_12 : 11387|4@1+ (1,0) [0|8] "ENUM" MCU
 SG_ Reserved_4_12 : 11391|1@1+ (1,0) [0|0] "NA" MCU
 SG_ OBJ_Class_Probability_12 : 11392|7@1+ (0.01,0) [0|1] "NA" MCU
 SG_ OBJ_Car_Probability_12 : 11399|7@1+ (0.01,0) [0|1] "NA" MCU
 SG_ OBJ_Truck_Probability_12 : 11406|7@1+ (0.01,0) [0|1] "NA" MCU
 SG_ OBJ_Bike_Probability_12 : 11413|7@1+ (0.01,0) [0|1] "NA" MCU
 SG_ OBJ_Camera_Source_12 : 11420|4@1+ (1,0) [0|15] "ENUM" MCU
 SG_ OBJ_Motion_Status_12 : 11424|3@1+ (1,0) [0|5] "ENUM" MCU
 SG_ OBJ_Motion_Orientation_12 : 11427|4@1+ (1,0) [0|13] "ENUM" MCU
 SG_ OBJ_Has_Cut_Lane_12 : 11431|1@1+ (1,0) [0|1] "bool" MCU
 SG_ OBJ_Has_Cut_Path_12 : 11432|1@1+ (1,0) [0|1] "bool" MCU
 SG_ OBJ_Brake_Light_12 : 11433|1@1+ (1,0) [0|1] "bool" MCU
 SG_ OBJ_Turn_Indicator_Right_12 : 11434|1@1+ (1,0) [0|1] "bool" MCU
 SG_ OBJ_Turn_Indicator_Left_12 : 11435|1@1+ (1,0) [0|1] "bool" MCU
 SG_ OBJ_Light_Indicator_Validity_12 : 11436|1@1+ (1,0) [0|1] "bool" MCU
 SG_ OBJ_Right_Out_Of_Image_12 : 11437|1@1+ (1,0) [0|1] "bool" MCU
 SG_ OBJ_Left_Out_Of_Image_12 : 11438|1@1+ (1,0) [0|1] "bool" MCU
 SG_ OBJ_Right_Out_Of_Image_V_12 : 11439|1@1+ (1,0) [0|1] "bool" MCU
 SG_ OBJ_Left_Out_Of_Image_V_12 : 11440|1@1+ (1,0) [0|1] "bool" MCU
 SG_ OBJ_Top_Out_Of_Image_12 : 11441|1@1+ (1,0) [0|1] "bool" MCU
 SG_ OBJ_Bottom_Out_Of_Image_12 : 11442|1@1+ (1,0) [0|1] "bool" MCU
 SG_ OBJ_Top_Out_Of_Image_V_12 : 11443|1@1+ (1,0) [0|1] "bool" MCU
 SG_ OBJ_Bottom_Out_Of_Image_V_12 : 11444|1@1+ (1,0) [0|1] "bool" MCU
 SG_ OBJ_Lane_Assignment_12 : 11445|3@1+ (1,0) [0|5] "ENUM" MCU
 SG_ OBJ_Lane_Assignment_V_12 : 11448|1@1+ (1,0) [0|1] "bool" MCU
 SG_ OBJ_Age_Seconds_12 : 11449|7@1+ (1,0) [0|100] "s" MCU
 SG_ OBJ_Age_Seconds_V_12 : 11456|1@1+ (1,0) [0|1] "bool" MCU
 SG_ OBJ_Width_12 : 11457|9@1+ (0.01,0) [0.4|2.95] "m" MCU
 SG_ OBJ_Width_V_12 : 11466|1@1+ (1,0) [0|1] "bool" MCU
 SG_ OBJ_Width_STD_12 : 11467|11@1+ (0.001,0) [0|2] "m" MCU
 SG_ OBJ_Width_STD_V_12 : 11478|1@1+ (1,0) [0|1] "bool" MCU
 SG_ OBJ_Length_12 : 11479|9@1+ (0.05,0) [1.2|21] "m" MCU
 SG_ OBJ_Length_V_12 : 11488|1@1+ (1,0) [0|1] "bool" MCU
 SG_ OBJ_Length_STD_12 : 11489|10@1+ (0.01,0) [0|10] "m" MCU
 SG_ OBJ_Length_STD_V_12 : 11499|1@1+ (1,0) [0|1] "bool" MCU
 SG_ OBJ_Radar_ID_12 : 11500|8@1+ (1,0) [0|255] "counter" MCU
 SG_ OBJ_Height_12 : 11508|9@1+ (0.01,0) [0|2.95] "m" MCU
 SG_ OBJ_Height_V_12 : 11517|1@1+ (1,0) [0|1] "bool" MCU
 SG_ Reserved_5_12 : 11518|2@1+ (1,0) [0|0] "NA" MCU
 SG_ OBJ_Height_STD_12 : 11520|11@1+ (0.001,0) [0|2] "m" MCU
 SG_ OBJ_Height_STD_V_12 : 11531|1@1+ (1,0) [0|1] "bool" MCU
 SG_ OBJ_Abs_Long_Velocity_12 : 11532|12@1+ (0.05,-100) [-100|100] "m_per_s" MCU
 SG_ OBJ_Abs_Long_Velocity_V_12 : 11544|1@1+ (1,0) [0|1] "bool" MCU
 SG_ Reserved_6_12 : 11545|7@1+ (1,0) [0|0] "NA" MCU
 SG_ OBJ_Abs_Long_Velocity_STD_12 : 11552|13@1+ (0.01,0) [0|65] "m_per_s" MCU
 SG_ OBJ_Abs_Long_Vel_STD_V_12 : 11565|1@1+ (1,0) [0|1] "bool" MCU
 SG_ OBJ_Abs_Lat_Velocity_12 : 11566|11@1+ (0.05,-50) [-50|50] "m_per_s" MCU
 SG_ OBJ_Abs_Lat_Velocity_V_12 : 11577|1@1+ (1,0) [0|1] "bool" MCU
 SG_ Reserved_7_12 : 11578|6@1+ (1,0) [0|0] "NA" MCU
 SG_ OBJ_Abs_Lat_Velocity_STD_12 : 11584|13@1+ (0.01,0) [0|50] "m_per_s" MCU
 SG_ OBJ_Abs_Lat_Vel_STD_V_12 : 11597|1@1+ (1,0) [0|1] "bool" MCU
 SG_ OBJ_Abs_Long_Acc_12 : 11598|9@1+ (0.05,-10) [-10|10] "m_per_s2" MCU
 SG_ OBJ_Abs_Long_Acc_V_12 : 11607|1@1+ (1,0) [0|1] "bool" MCU
 SG_ Reserved_8_12 : 11608|8@1+ (1,0) [0|0] "NA" MCU
 SG_ OBJ_Abs_Long_Acc_STD_12 : 11616|10@1+ (0.01,0) [0|7.3] "m_per_s2" MCU
 SG_ OBJ_Abs_Long_Acc_STD_V_12 : 11626|1@1+ (1,0) [0|1] "bool" MCU
 SG_ OBJ_Abs_Lat_Acc_12 : 11627|9@1+ (0.05,-10) [-10|10] "m_per_s2" MCU
 SG_ OBJ_Abs_Lat_Acc_V_12 : 11636|1@1+ (1,0) [0|1] "bool" MCU
 SG_ OBJ_Abs_Lat_Acc_STD_12 : 11637|10@1+ (0.01,0) [0|7.3] "m_per_s2" MCU
 SG_ OBJ_Abs_Lat_Acc_STD_V_12 : 11647|1@1+ (1,0) [0|1] "bool" MCU
 SG_ OBJ_Abs_Acceleration_12 : 11648|9@1+ (0.05,-12.7) [-12.7|12.7] "m_per_s2" MCU
 SG_ OBJ_Abs_Acceleration_V_12 : 11657|1@1+ (1,0) [0|1] "bool" MCU
 SG_ OBJ_Abs_Acc_STD_12 : 11658|10@1+ (0.01,0) [0|7.3] "m_per_s2" MCU
 SG_ OBJ_Abs_Acc_STD_V_12 : 11668|1@1+ (1,0) [0|1] "bool" MCU
 SG_ OBJ_Inv_TTC_12 : 11669|11@1+ (0.01,-8) [-8|8] "INV(s)" MCU
 SG_ OBJ_Inv_TTC_V_12 : 11680|1@1+ (1,0) [0|1] "bool" MCU
 SG_ OBJ_Inv_TTC_STD_12 : 11681|12@1+ (0.001,0) [0|4] "INV(s)" MCU
 SG_ OBJ_Inv_TTC_STD_V_12 : 11693|1@1+ (1,0) [0|1] "bool" MCU
 SG_ OBJ_Relative_Long_Acc_12 : 11694|10@1+ (0.05,-20) [-20|20] "m_per_s2" MCU
 SG_ OBJ_Relative_Long_Acc_V_12 : 11704|1@1+ (1,0) [0|1] "bool" MCU
 SG_ Reserved_9_12 : 11705|7@1+ (1,0) [0|0] "NA" MCU
 SG_ OBJ_Relative_Long_Acc_STD_12 : 11712|10@1+ (0.01,0) [0|7.3] "m_per_s2" MCU
 SG_ OBJ_Rel_Long_Acc_STD_V_12 : 11722|1@1+ (1,0) [0|1] "bool" MCU
 SG_ OBJ_Relative_Long_Velocity_12 : 11723|13@1+ (0.05,-120) [-120|130] "m_per_s" MCU
 SG_ OBJ_Relative_Long_Velocity_V_12 : 11736|1@1+ (1,0) [0|1] "bool" MCU
 SG_ Reserved_10_12 : 11737|7@1+ (1,0) [0|0] "NA" MCU
 SG_ OBJ_Relative_Long_Vel_STD_12 : 11744|14@1+ (0.01,0) [0|130] "m_per_s" MCU
 SG_ OBJ_Rel_Long_Vel_STD_V_12 : 11758|1@1+ (1,0) [0|1] "bool" MCU
 SG_ OBJ_Relative_Lat_Velocity_12 : 11759|11@1+ (0.05,-50) [-50|50] "m_per_s" MCU
 SG_ OBJ_Relative_Lat_Velocity_V_12 : 11770|1@1+ (1,0) [0|1] "bool" MCU
 SG_ Reserved_11_12 : 11771|5@1+ (1,0) [0|0] "NA" MCU
 SG_ OBJ_Relative_Lat_Velocity_STD_12 : 11776|13@1+ (0.01,0) [0|50] "m_per_s" MCU
 SG_ OBJ_Rel_Lat_Vel_STD_V_12 : 11789|1@1+ (1,0) [0|1] "bool" MCU
 SG_ OBJ_Long_Distance_12 : 11790|14@1+ (0.05,-200) [-200|500] "m" MCU
 SG_ OBJ_Long_Distance_V_12 : 11804|1@1+ (1,0) [0|1] "bool" MCU
 SG_ Reserved_12_12 : 11805|3@1+ (1,0) [0|0] "NA" MCU
 SG_ OBJ_Long_Distance_STD_12 : 11808|15@1+ (0.01,0) [0|250] "m" MCU
 SG_ OBJ_Long_Distance_STD_V_12 : 11823|1@1+ (1,0) [0|1] "bool" MCU
 SG_ OBJ_Lat_Distance_12 : 11824|12@1+ (0.05,-100) [-100|100] "m" MCU
 SG_ OBJ_Lat_Distance_V_12 : 11836|1@1+ (1,0) [0|1] "bool" MCU
 SG_ Reserved_13_12 : 11837|3@1+ (1,0) [0|0] "NA" MCU
 SG_ OBJ_Lat_Distance_STD_12 : 11840|14@1+ (0.01,0) [0|100] "m" MCU
 SG_ OBJ_Lat_Distance_STD_V_12 : 11854|1@1+ (1,0) [0|1] "bool" MCU
 SG_ OBJ_Absolute_Speed_12 : 11855|12@1+ (0.05,-65) [-65|65] "m_per_s" MCU
 SG_ OBJ_Absolute_Speed_V_12 : 11867|1@1+ (1,0) [0|1] "bool" MCU
 SG_ Reserved_14_12 : 11868|4@1+ (1,0) [0|0] "NA" MCU
 SG_ OBJ_Absolute_Speed_STD_12 : 11872|13@1+ (0.01,0) [0|65] "m_per_s" MCU
 SG_ OBJ_Absolute_Speed_STD_V_12 : 11885|1@1+ (1,0) [0|1] "bool" MCU
 SG_ OBJ_Heading_12 : 11886|10@1+ (0.01,-3.14) [-3.14|3.14] "rad" MCU
 SG_ OBJ_Heading_V_12 : 11896|1@1+ (1,0) [0|1] "bool" MCU
 SG_ Reserved_15_12 : 11897|7@1+ (1,0) [0|0] "NA" MCU
 SG_ OBJ_Heading_STD_12 : 11904|15@1+ (0.0001,0) [0|3.14] "rad" MCU
 SG_ OBJ_Heading_STD_V_12 : 11919|1@1+ (1,0) [0|1] "bool" MCU
 SG_ OBJ_Angle_Rate_STD_12 : 11920|15@1+ (0.0001,0) [0|2.2318] "RPS" MCU
 SG_ OBJ_Angle_Rate_STD_V_12 : 11935|1@1+ (1,0) [0|1] "bool" MCU
 SG_ OBJ_Angle_Rate_12 : 11936|12@1+ (0.002,-2.234) [-2.234|2.2318] "RPS" MCU
 SG_ OBJ_Angle_Rate_V_12 : 11948|1@1+ (1,0) [0|1] "bool" MCU
 SG_ OBJ_Angle_Right_12 : 11949|14@1+ (0.0002,-1.571) [-1.571|1.571] "rad" MCU
 SG_ OBJ_Angle_Right_V_12 : 11963|1@1+ (1,0) [0|1] "bool" MCU
 SG_ Reserved_16_12 : 11964|4@1+ (1,0) [0|0] "NA" MCU
 SG_ OBJ_Angle_Right_STD_12 : 11968|14@1+ (0.0001,0) [0|1.571] "rad" MCU
 SG_ OBJ_Angle_Right_STD_V_12 : 11982|1@1+ (1,0) [0|1] "bool" MCU
 SG_ OBJ_Angle_Left_12 : 11983|14@1+ (0.0002,-1.571) [-1.571|1.571] "rad" MCU
 SG_ OBJ_Angle_Left_V_12 : 11997|1@1+ (1,0) [0|1] "bool" MCU
 SG_ Reserved_17_12 : 11998|2@1+ (1,0) [0|0] "NA" MCU
 SG_ OBJ_Angle_Left_STD_12 : 12000|14@1+ (0.0001,0) [0|1.571] "rad" MCU
 SG_ OBJ_Angle_Left_STD_V_12 : 12014|1@1+ (1,0) [0|1] "bool" MCU
 SG_ OBJ_Angle_Side_12 : 12015|14@1+ (0.0002,-1.571) [-1.571|1.571] "rad" MCU
 SG_ OBJ_Angle_Side_V_12 : 12029|1@1+ (1,0) [0|1] "bool" MCU
 SG_ Reserved_18_12 : 12030|2@1+ (1,0) [0|0] "NA" MCU
 SG_ OBJ_Angle_Side_STD_12 : 12032|14@1+ (0.0001,0) [0|1.571] "rad" MCU
 SG_ OBJ_Angle_Side_STD_V_12 : 12046|1@1+ (1,0) [0|1] "bool" MCU
 SG_ OBJ_Angle_Mid_V_12 : 12047|1@1+ (1,0) [0|1] "bool" MCU
 SG_ OBJ_Angle_Mid_12 : 12048|14@1+ (0.0002,-1.571) [-1.571|1.571] "rad" MCU
 SG_ Reserved_19_12 : 12062|2@1+ (1,0) [0|0] "NA" MCU
 SG_ OBJ_Angle_Mid_STD_12 : 12064|14@1+ (0.0001,0) [0|1.571] "rad" MCU
 SG_ OBJ_Angle_Mid_STD_V_12 : 12078|1@1+ (1,0) [0|1] "bool" MCU
 SG_ OBJ_Angle_Bottom_V_12 : 12079|1@1+ (1,0) [0|1] "bool" MCU
 SG_ OBJ_Angle_Bottom_12 : 12080|14@1+ (0.0002,-1.571) [-1.571|1.571] "rad" MCU
 SG_ Reserved_20_12 : 12094|2@1+ (1,0) [0|0] "NA" MCU
 SG_ OBJ_Angle_Bottom_STD_12 : 12096|14@1+ (0.0001,0) [0|1.571] "rad" MCU
 SG_ OBJ_Angle_Bottom_STD_V_12 : 12110|1@1+ (1,0) [0|1] "bool" MCU
 SG_ OBJ_Visibility_Side_V_12 : 12111|1@1+ (1,0) [0|1] "bool" MCU
 SG_ OBJ_Visibility_Side_12 : 12112|2@1+ (1,0) [0|2] "ENUM" MCU
 SG_ OBJ_Is_In_Drivable_Area_12 : 12114|1@1+ (1,0) [0|1] "bool" MCU
 SG_ OBJ_Is_In_Drivable_Area_V_12 : 12115|1@1+ (1,0) [0|1] "bool" MCU
 SG_ OBJ_Is_VeryClose_V_12 : 12116|1@1+ (1,0) [0|1] "bool" MCU
 SG_ OBJ_Is_VeryClose_12 : 12117|1@1+ (1,0) [0|1] "bool" MCU
 SG_ OBJ_Buffer_C4_12 : 12118|2@1+ (1,0) [0|2] "NA" MCU
 SG_ OBJ_Buffer_C5_12 : 12120|2@1+ (1,0) [0|2] "NA" MCU
 SG_ OBJ_Buffer_C6_12 : 12122|2@1+ (1,0) [0|2] "NA" MCU
 SG_ OBJ_Buffer_C7_12 : 12124|2@1+ (1,0) [0|2] "NA" MCU
 SG_ Reserved_21_12 : 12126|2@1+ (1,0) [0|0] "NA" MCU
 SG_ OBJ_OverlapAngleEgoLaneR_12 : 12128|10@1+ (0.01,-3.14) [-3.14|3.14] "rad" MCU
 SG_ OBJ_OverlapAngleEgoLaneR_V_12 : 12138|1@1+ (1,0) [0|1] "bool" MCU
 SG_ OBJ_OverlapAngleEgoLaneL_12 : 12139|10@1+ (0.01,-3.14) [-3.14|3.14] "rad" MCU
 SG_ OBJ_OverlapAngleEgoLaneL_V_12 : 12149|1@1+ (1,0) [0|1] "bool" MCU
 SG_ OBJ_Is_EMERGENCY_VCL_12 : 12150|1@1+ (1,0) [0|1] "bool" MCU
 SG_ OBJ_EMERGENCY_LIGHT_COLOR_12 : 12151|4@1+ (1,0) [0|15] "BITWIZE" MCU
 SG_ OBJ_EMERGENCY_V_12 : 12155|1@1+ (1,0) [0|1] "bool" MCU
 SG_ Reserved_22_12 : 12156|4@1+ (1,0) [0|0] "NA" MCU
 SG_ OBJ_Angle_Top_12 : 12160|14@1+ (0.0002,0) [0|3.1415] "rad" MCU
 SG_ OBJ_Angle_Top_V_12 : 12174|1@1+ (1,0) [0|1] "bool" MCU
 SG_ OBJ_Angle_Top_STD_12 : 12175|15@1+ (0.0001,0) [0|3.1415] "rad" MCU
 SG_ OBJ_Angle_Top_STD_V_12 : 12190|1@1+ (1,0) [0|1] "bool" MCU
 SG_ OBJ_Buffer_C14_12 : 12191|1@1+ (1,0) [0|1] "NA" MCU
 SG_ OBJ_Buffer_C15_12 : 12192|1@1+ (1,0) [0|1] "NA" MCU
 SG_ OBJ_Buffer_C18_12 : 12193|2@1+ (1,0) [0|2] "NA" MCU
 SG_ OBJ_Buffer_C19_12 : 12195|1@1+ (1,0) [0|1] "NA" MCU
 SG_ Reserved_23_12 : 12196|28@1+ (1,0) [0|0] "NA" MCU
 SG_ OBJ_CRC_13 : 12224|32@1+ (1,0) [0|4294967295] "NA" MCU
 SG_ OBJ_ID_13 : 12256|8@1+ (1,0) [0|255] "counter" MCU
 SG_ OBJ_Existence_Probability_13 : 12264|8@1+ (0.01,0) [0|1] "NA" MCU
 SG_ OBJ_Fusion_Source_13 : 12272|16@1+ (1,0) [0|65535] "BITWIZE" MCU
 SG_ OBJ_Triggered_SDM_13 : 12288|2@1+ (1,0) [0|2] "ENUM" MCU
 SG_ OBJ_Motion_Category_13 : 12290|4@1+ (1,0) [0|13] "ENUM" MCU
 SG_ OBJ_Buffer_C0_13 : 12294|7@1+ (0.01,0) [0|1] "NA" MCU
 SG_ OBJ_Object_Age_13 : 12301|11@1+ (1,0) [0|2047] "frames" MCU
 SG_ OBJ_Measuring_Status_13 : 12312|3@1+ (1,0) [0|7] "BITWIZE" MCU
 SG_ OBJ_Object_Class_13 : 12315|4@1+ (1,0) [0|8] "ENUM" MCU
 SG_ Reserved_4_13 : 12319|1@1+ (1,0) [0|0] "NA" MCU
 SG_ OBJ_Class_Probability_13 : 12320|7@1+ (0.01,0) [0|1] "NA" MCU
 SG_ OBJ_Car_Probability_13 : 12327|7@1+ (0.01,0) [0|1] "NA" MCU
 SG_ OBJ_Truck_Probability_13 : 12334|7@1+ (0.01,0) [0|1] "NA" MCU
 SG_ OBJ_Bike_Probability_13 : 12341|7@1+ (0.01,0) [0|1] "NA" MCU
 SG_ OBJ_Camera_Source_13 : 12348|4@1+ (1,0) [0|15] "ENUM" MCU
 SG_ OBJ_Motion_Status_13 : 12352|3@1+ (1,0) [0|5] "ENUM" MCU
 SG_ OBJ_Motion_Orientation_13 : 12355|4@1+ (1,0) [0|13] "ENUM" MCU
 SG_ OBJ_Has_Cut_Lane_13 : 12359|1@1+ (1,0) [0|1] "bool" MCU
 SG_ OBJ_Has_Cut_Path_13 : 12360|1@1+ (1,0) [0|1] "bool" MCU
 SG_ OBJ_Brake_Light_13 : 12361|1@1+ (1,0) [0|1] "bool" MCU
 SG_ OBJ_Turn_Indicator_Right_13 : 12362|1@1+ (1,0) [0|1] "bool" MCU
 SG_ OBJ_Turn_Indicator_Left_13 : 12363|1@1+ (1,0) [0|1] "bool" MCU
 SG_ OBJ_Light_Indicator_Validity_13 : 12364|1@1+ (1,0) [0|1] "bool" MCU
 SG_ OBJ_Right_Out_Of_Image_13 : 12365|1@1+ (1,0) [0|1] "bool" MCU
 SG_ OBJ_Left_Out_Of_Image_13 : 12366|1@1+ (1,0) [0|1] "bool" MCU
 SG_ OBJ_Right_Out_Of_Image_V_13 : 12367|1@1+ (1,0) [0|1] "bool" MCU
 SG_ OBJ_Left_Out_Of_Image_V_13 : 12368|1@1+ (1,0) [0|1] "bool" MCU
 SG_ OBJ_Top_Out_Of_Image_13 : 12369|1@1+ (1,0) [0|1] "bool" MCU
 SG_ OBJ_Bottom_Out_Of_Image_13 : 12370|1@1+ (1,0) [0|1] "bool" MCU
 SG_ OBJ_Top_Out_Of_Image_V_13 : 12371|1@1+ (1,0) [0|1] "bool" MCU
 SG_ OBJ_Bottom_Out_Of_Image_V_13 : 12372|1@1+ (1,0) [0|1] "bool" MCU
 SG_ OBJ_Lane_Assignment_13 : 12373|3@1+ (1,0) [0|5] "ENUM" MCU
 SG_ OBJ_Lane_Assignment_V_13 : 12376|1@1+ (1,0) [0|1] "bool" MCU
 SG_ OBJ_Age_Seconds_13 : 12377|7@1+ (1,0) [0|100] "s" MCU
 SG_ OBJ_Age_Seconds_V_13 : 12384|1@1+ (1,0) [0|1] "bool" MCU
 SG_ OBJ_Width_13 : 12385|9@1+ (0.01,0) [0.4|2.95] "m" MCU
 SG_ OBJ_Width_V_13 : 12394|1@1+ (1,0) [0|1] "bool" MCU
 SG_ OBJ_Width_STD_13 : 12395|11@1+ (0.001,0) [0|2] "m" MCU
 SG_ OBJ_Width_STD_V_13 : 12406|1@1+ (1,0) [0|1] "bool" MCU
 SG_ OBJ_Length_13 : 12407|9@1+ (0.05,0) [1.2|21] "m" MCU
 SG_ OBJ_Length_V_13 : 12416|1@1+ (1,0) [0|1] "bool" MCU
 SG_ OBJ_Length_STD_13 : 12417|10@1+ (0.01,0) [0|10] "m" MCU
 SG_ OBJ_Length_STD_V_13 : 12427|1@1+ (1,0) [0|1] "bool" MCU
 SG_ OBJ_Radar_ID_13 : 12428|8@1+ (1,0) [0|255] "counter" MCU
 SG_ OBJ_Height_13 : 12436|9@1+ (0.01,0) [0|2.95] "m" MCU
 SG_ OBJ_Height_V_13 : 12445|1@1+ (1,0) [0|1] "bool" MCU
 SG_ Reserved_5_13 : 12446|2@1+ (1,0) [0|0] "NA" MCU
 SG_ OBJ_Height_STD_13 : 12448|11@1+ (0.001,0) [0|2] "m" MCU
 SG_ OBJ_Height_STD_V_13 : 12459|1@1+ (1,0) [0|1] "bool" MCU
 SG_ OBJ_Abs_Long_Velocity_13 : 12460|12@1+ (0.05,-100) [-100|100] "m_per_s" MCU
 SG_ OBJ_Abs_Long_Velocity_V_13 : 12472|1@1+ (1,0) [0|1] "bool" MCU
 SG_ Reserved_6_13 : 12473|7@1+ (1,0) [0|0] "NA" MCU
 SG_ OBJ_Abs_Long_Velocity_STD_13 : 12480|13@1+ (0.01,0) [0|65] "m_per_s" MCU
 SG_ OBJ_Abs_Long_Vel_STD_V_13 : 12493|1@1+ (1,0) [0|1] "bool" MCU
 SG_ OBJ_Abs_Lat_Velocity_13 : 12494|11@1+ (0.05,-50) [-50|50] "m_per_s" MCU
 SG_ OBJ_Abs_Lat_Velocity_V_13 : 12505|1@1+ (1,0) [0|1] "bool" MCU
 SG_ Reserved_7_13 : 12506|6@1+ (1,0) [0|0] "NA" MCU
 SG_ OBJ_Abs_Lat_Velocity_STD_13 : 12512|13@1+ (0.01,0) [0|50] "m_per_s" MCU
 SG_ OBJ_Abs_Lat_Vel_STD_V_13 : 12525|1@1+ (1,0) [0|1] "bool" MCU
 SG_ OBJ_Abs_Long_Acc_13 : 12526|9@1+ (0.05,-10) [-10|10] "m_per_s2" MCU
 SG_ OBJ_Abs_Long_Acc_V_13 : 12535|1@1+ (1,0) [0|1] "bool" MCU
 SG_ Reserved_8_13 : 12536|8@1+ (1,0) [0|0] "NA" MCU
 SG_ OBJ_Abs_Long_Acc_STD_13 : 12544|10@1+ (0.01,0) [0|7.3] "m_per_s2" MCU
 SG_ OBJ_Abs_Long_Acc_STD_V_13 : 12554|1@1+ (1,0) [0|1] "bool" MCU
 SG_ OBJ_Abs_Lat_Acc_13 : 12555|9@1+ (0.05,-10) [-10|10] "m_per_s2" MCU
 SG_ OBJ_Abs_Lat_Acc_V_13 : 12564|1@1+ (1,0) [0|1] "bool" MCU
 SG_ OBJ_Abs_Lat_Acc_STD_13 : 12565|10@1+ (0.01,0) [0|7.3] "m_per_s2" MCU
 SG_ OBJ_Abs_Lat_Acc_STD_V_13 : 12575|1@1+ (1,0) [0|1] "bool" MCU
 SG_ OBJ_Abs_Acceleration_13 : 12576|9@1+ (0.05,-12.7) [-12.7|12.7] "m_per_s2" MCU
 SG_ OBJ_Abs_Acceleration_V_13 : 12585|1@1+ (1,0) [0|1] "bool" MCU
 SG_ OBJ_Abs_Acc_STD_13 : 12586|10@1+ (0.01,0) [0|7.3] "m_per_s2" MCU
 SG_ OBJ_Abs_Acc_STD_V_13 : 12596|1@1+ (1,0) [0|1] "bool" MCU
 SG_ OBJ_Inv_TTC_13 : 12597|11@1+ (0.01,-8) [-8|8] "INV(s)" MCU
 SG_ OBJ_Inv_TTC_V_13 : 12608|1@1+ (1,0) [0|1] "bool" MCU
 SG_ OBJ_Inv_TTC_STD_13 : 12609|12@1+ (0.001,0) [0|4] "INV(s)" MCU
 SG_ OBJ_Inv_TTC_STD_V_13 : 12621|1@1+ (1,0) [0|1] "bool" MCU
 SG_ OBJ_Relative_Long_Acc_13 : 12622|10@1+ (0.05,-20) [-20|20] "m_per_s2" MCU
 SG_ OBJ_Relative_Long_Acc_V_13 : 12632|1@1+ (1,0) [0|1] "bool" MCU
 SG_ Reserved_9_13 : 12633|7@1+ (1,0) [0|0] "NA" MCU
 SG_ OBJ_Relative_Long_Acc_STD_13 : 12640|10@1+ (0.01,0) [0|7.3] "m_per_s2" MCU
 SG_ OBJ_Rel_Long_Acc_STD_V_13 : 12650|1@1+ (1,0) [0|1] "bool" MCU
 SG_ OBJ_Relative_Long_Velocity_13 : 12651|13@1+ (0.05,-120) [-120|130] "m_per_s" MCU
 SG_ OBJ_Relative_Long_Velocity_V_13 : 12664|1@1+ (1,0) [0|1] "bool" MCU
 SG_ Reserved_10_13 : 12665|7@1+ (1,0) [0|0] "NA" MCU
 SG_ OBJ_Relative_Long_Vel_STD_13 : 12672|14@1+ (0.01,0) [0|130] "m_per_s" MCU
 SG_ OBJ_Rel_Long_Vel_STD_V_13 : 12686|1@1+ (1,0) [0|1] "bool" MCU
 SG_ OBJ_Relative_Lat_Velocity_13 : 12687|11@1+ (0.05,-50) [-50|50] "m_per_s" MCU
 SG_ OBJ_Relative_Lat_Velocity_V_13 : 12698|1@1+ (1,0) [0|1] "bool" MCU
 SG_ Reserved_11_13 : 12699|5@1+ (1,0) [0|0] "NA" MCU
 SG_ OBJ_Relative_Lat_Velocity_STD_13 : 12704|13@1+ (0.01,0) [0|50] "m_per_s" MCU
 SG_ OBJ_Rel_Lat_Vel_STD_V_13 : 12717|1@1+ (1,0) [0|1] "bool" MCU
 SG_ OBJ_Long_Distance_13 : 12718|14@1+ (0.05,-200) [-200|500] "m" MCU
 SG_ OBJ_Long_Distance_V_13 : 12732|1@1+ (1,0) [0|1] "bool" MCU
 SG_ Reserved_12_13 : 12733|3@1+ (1,0) [0|0] "NA" MCU
 SG_ OBJ_Long_Distance_STD_13 : 12736|15@1+ (0.01,0) [0|250] "m" MCU
 SG_ OBJ_Long_Distance_STD_V_13 : 12751|1@1+ (1,0) [0|1] "bool" MCU
 SG_ OBJ_Lat_Distance_13 : 12752|12@1+ (0.05,-100) [-100|100] "m" MCU
 SG_ OBJ_Lat_Distance_V_13 : 12764|1@1+ (1,0) [0|1] "bool" MCU
 SG_ Reserved_13_13 : 12765|3@1+ (1,0) [0|0] "NA" MCU
 SG_ OBJ_Lat_Distance_STD_13 : 12768|14@1+ (0.01,0) [0|100] "m" MCU
 SG_ OBJ_Lat_Distance_STD_V_13 : 12782|1@1+ (1,0) [0|1] "bool" MCU
 SG_ OBJ_Absolute_Speed_13 : 12783|12@1+ (0.05,-65) [-65|65] "m_per_s" MCU
 SG_ OBJ_Absolute_Speed_V_13 : 12795|1@1+ (1,0) [0|1] "bool" MCU
 SG_ Reserved_14_13 : 12796|4@1+ (1,0) [0|0] "NA" MCU
 SG_ OBJ_Absolute_Speed_STD_13 : 12800|13@1+ (0.01,0) [0|65] "m_per_s" MCU
 SG_ OBJ_Absolute_Speed_STD_V_13 : 12813|1@1+ (1,0) [0|1] "bool" MCU
 SG_ OBJ_Heading_13 : 12814|10@1+ (0.01,-3.14) [-3.14|3.14] "rad" MCU
 SG_ OBJ_Heading_V_13 : 12824|1@1+ (1,0) [0|1] "bool" MCU
 SG_ Reserved_15_13 : 12825|7@1+ (1,0) [0|0] "NA" MCU
 SG_ OBJ_Heading_STD_13 : 12832|15@1+ (0.0001,0) [0|3.14] "rad" MCU
 SG_ OBJ_Heading_STD_V_13 : 12847|1@1+ (1,0) [0|1] "bool" MCU
 SG_ OBJ_Angle_Rate_STD_13 : 12848|15@1+ (0.0001,0) [0|2.2318] "RPS" MCU
 SG_ OBJ_Angle_Rate_STD_V_13 : 12863|1@1+ (1,0) [0|1] "bool" MCU
 SG_ OBJ_Angle_Rate_13 : 12864|12@1+ (0.002,-2.234) [-2.234|2.2318] "RPS" MCU
 SG_ OBJ_Angle_Rate_V_13 : 12876|1@1+ (1,0) [0|1] "bool" MCU
 SG_ OBJ_Angle_Right_13 : 12877|14@1+ (0.0002,-1.571) [-1.571|1.571] "rad" MCU
 SG_ OBJ_Angle_Right_V_13 : 12891|1@1+ (1,0) [0|1] "bool" MCU
 SG_ Reserved_16_13 : 12892|4@1+ (1,0) [0|0] "NA" MCU
 SG_ OBJ_Angle_Right_STD_13 : 12896|14@1+ (0.0001,0) [0|1.571] "rad" MCU
 SG_ OBJ_Angle_Right_STD_V_13 : 12910|1@1+ (1,0) [0|1] "bool" MCU
 SG_ OBJ_Angle_Left_13 : 12911|14@1+ (0.0002,-1.571) [-1.571|1.571] "rad" MCU
 SG_ OBJ_Angle_Left_V_13 : 12925|1@1+ (1,0) [0|1] "bool" MCU
 SG_ Reserved_17_13 : 12926|2@1+ (1,0) [0|0] "NA" MCU
 SG_ OBJ_Angle_Left_STD_13 : 12928|14@1+ (0.0001,0) [0|1.571] "rad" MCU
 SG_ OBJ_Angle_Left_STD_V_13 : 12942|1@1+ (1,0) [0|1] "bool" MCU
 SG_ OBJ_Angle_Side_13 : 12943|14@1+ (0.0002,-1.571) [-1.571|1.571] "rad" MCU
 SG_ OBJ_Angle_Side_V_13 : 12957|1@1+ (1,0) [0|1] "bool" MCU
 SG_ Reserved_18_13 : 12958|2@1+ (1,0) [0|0] "NA" MCU
 SG_ OBJ_Angle_Side_STD_13 : 12960|14@1+ (0.0001,0) [0|1.571] "rad" MCU
 SG_ OBJ_Angle_Side_STD_V_13 : 12974|1@1+ (1,0) [0|1] "bool" MCU
 SG_ OBJ_Angle_Mid_V_13 : 12975|1@1+ (1,0) [0|1] "bool" MCU
 SG_ OBJ_Angle_Mid_13 : 12976|14@1+ (0.0002,-1.571) [-1.571|1.571] "rad" MCU
 SG_ Reserved_19_13 : 12990|2@1+ (1,0) [0|0] "NA" MCU
 SG_ OBJ_Angle_Mid_STD_13 : 12992|14@1+ (0.0001,0) [0|1.571] "rad" MCU
 SG_ OBJ_Angle_Mid_STD_V_13 : 13006|1@1+ (1,0) [0|1] "bool" MCU
 SG_ OBJ_Angle_Bottom_V_13 : 13007|1@1+ (1,0) [0|1] "bool" MCU
 SG_ OBJ_Angle_Bottom_13 : 13008|14@1+ (0.0002,-1.571) [-1.571|1.571] "rad" MCU
 SG_ Reserved_20_13 : 13022|2@1+ (1,0) [0|0] "NA" MCU
 SG_ OBJ_Angle_Bottom_STD_13 : 13024|14@1+ (0.0001,0) [0|1.571] "rad" MCU
 SG_ OBJ_Angle_Bottom_STD_V_13 : 13038|1@1+ (1,0) [0|1] "bool" MCU
 SG_ OBJ_Visibility_Side_V_13 : 13039|1@1+ (1,0) [0|1] "bool" MCU
 SG_ OBJ_Visibility_Side_13 : 13040|2@1+ (1,0) [0|2] "ENUM" MCU
 SG_ OBJ_Is_In_Drivable_Area_13 : 13042|1@1+ (1,0) [0|1] "bool" MCU
 SG_ OBJ_Is_In_Drivable_Area_V_13 : 13043|1@1+ (1,0) [0|1] "bool" MCU
 SG_ OBJ_Is_VeryClose_V_13 : 13044|1@1+ (1,0) [0|1] "bool" MCU
 SG_ OBJ_Is_VeryClose_13 : 13045|1@1+ (1,0) [0|1] "bool" MCU
 SG_ OBJ_Buffer_C4_13 : 13046|2@1+ (1,0) [0|2] "NA" MCU
 SG_ OBJ_Buffer_C5_13 : 13048|2@1+ (1,0) [0|2] "NA" MCU
 SG_ OBJ_Buffer_C6_13 : 13050|2@1+ (1,0) [0|2] "NA" MCU
 SG_ OBJ_Buffer_C7_13 : 13052|2@1+ (1,0) [0|2] "NA" MCU
 SG_ Reserved_21_13 : 13054|2@1+ (1,0) [0|0] "NA" MCU
 SG_ OBJ_OverlapAngleEgoLaneR_13 : 13056|10@1+ (0.01,-3.14) [-3.14|3.14] "rad" MCU
 SG_ OBJ_OverlapAngleEgoLaneR_V_13 : 13066|1@1+ (1,0) [0|1] "bool" MCU
 SG_ OBJ_OverlapAngleEgoLaneL_13 : 13067|10@1+ (0.01,-3.14) [-3.14|3.14] "rad" MCU
 SG_ OBJ_OverlapAngleEgoLaneL_V_13 : 13077|1@1+ (1,0) [0|1] "bool" MCU
 SG_ OBJ_Is_EMERGENCY_VCL_13 : 13078|1@1+ (1,0) [0|1] "bool" MCU
 SG_ OBJ_EMERGENCY_LIGHT_COLOR_13 : 13079|4@1+ (1,0) [0|15] "BITWIZE" MCU
 SG_ OBJ_EMERGENCY_V_13 : 13083|1@1+ (1,0) [0|1] "bool" MCU
 SG_ Reserved_22_13 : 13084|4@1+ (1,0) [0|0] "NA" MCU
 SG_ OBJ_Angle_Top_13 : 13088|14@1+ (0.0002,0) [0|3.1415] "rad" MCU
 SG_ OBJ_Angle_Top_V_13 : 13102|1@1+ (1,0) [0|1] "bool" MCU
 SG_ OBJ_Angle_Top_STD_13 : 13103|15@1+ (0.0001,0) [0|3.1415] "rad" MCU
 SG_ OBJ_Angle_Top_STD_V_13 : 13118|1@1+ (1,0) [0|1] "bool" MCU
 SG_ OBJ_Buffer_C14_13 : 13119|1@1+ (1,0) [0|1] "NA" MCU
 SG_ OBJ_Buffer_C15_13 : 13120|1@1+ (1,0) [0|1] "NA" MCU
 SG_ OBJ_Buffer_C18_13 : 13121|2@1+ (1,0) [0|2] "NA" MCU
 SG_ OBJ_Buffer_C19_13 : 13123|1@1+ (1,0) [0|1] "NA" MCU
 SG_ Reserved_23_13 : 13124|28@1+ (1,0) [0|0] "NA" MCU
 SG_ OBJ_CRC_14 : 13152|32@1+ (1,0) [0|4294967295] "NA" MCU
 SG_ OBJ_ID_14 : 13184|8@1+ (1,0) [0|255] "counter" MCU
 SG_ OBJ_Existence_Probability_14 : 13192|8@1+ (0.01,0) [0|1] "NA" MCU
 SG_ OBJ_Fusion_Source_14 : 13200|16@1+ (1,0) [0|65535] "BITWIZE" MCU
 SG_ OBJ_Triggered_SDM_14 : 13216|2@1+ (1,0) [0|2] "ENUM" MCU
 SG_ OBJ_Motion_Category_14 : 13218|4@1+ (1,0) [0|13] "ENUM" MCU
 SG_ OBJ_Buffer_C0_14 : 13222|7@1+ (0.01,0) [0|1] "NA" MCU
 SG_ OBJ_Object_Age_14 : 13229|11@1+ (1,0) [0|2047] "frames" MCU
 SG_ OBJ_Measuring_Status_14 : 13240|3@1+ (1,0) [0|7] "BITWIZE" MCU
 SG_ OBJ_Object_Class_14 : 13243|4@1+ (1,0) [0|8] "ENUM" MCU
 SG_ Reserved_4_14 : 13247|1@1+ (1,0) [0|0] "NA" MCU
 SG_ OBJ_Class_Probability_14 : 13248|7@1+ (0.01,0) [0|1] "NA" MCU
 SG_ OBJ_Car_Probability_14 : 13255|7@1+ (0.01,0) [0|1] "NA" MCU
 SG_ OBJ_Truck_Probability_14 : 13262|7@1+ (0.01,0) [0|1] "NA" MCU
 SG_ OBJ_Bike_Probability_14 : 13269|7@1+ (0.01,0) [0|1] "NA" MCU
 SG_ OBJ_Camera_Source_14 : 13276|4@1+ (1,0) [0|15] "ENUM" MCU
 SG_ OBJ_Motion_Status_14 : 13280|3@1+ (1,0) [0|5] "ENUM" MCU
 SG_ OBJ_Motion_Orientation_14 : 13283|4@1+ (1,0) [0|13] "ENUM" MCU
 SG_ OBJ_Has_Cut_Lane_14 : 13287|1@1+ (1,0) [0|1] "bool" MCU
 SG_ OBJ_Has_Cut_Path_14 : 13288|1@1+ (1,0) [0|1] "bool" MCU
 SG_ OBJ_Brake_Light_14 : 13289|1@1+ (1,0) [0|1] "bool" MCU
 SG_ OBJ_Turn_Indicator_Right_14 : 13290|1@1+ (1,0) [0|1] "bool" MCU
 SG_ OBJ_Turn_Indicator_Left_14 : 13291|1@1+ (1,0) [0|1] "bool" MCU
 SG_ OBJ_Light_Indicator_Validity_14 : 13292|1@1+ (1,0) [0|1] "bool" MCU
 SG_ OBJ_Right_Out_Of_Image_14 : 13293|1@1+ (1,0) [0|1] "bool" MCU
 SG_ OBJ_Left_Out_Of_Image_14 : 13294|1@1+ (1,0) [0|1] "bool" MCU
 SG_ OBJ_Right_Out_Of_Image_V_14 : 13295|1@1+ (1,0) [0|1] "bool" MCU
 SG_ OBJ_Left_Out_Of_Image_V_14 : 13296|1@1+ (1,0) [0|1] "bool" MCU
 SG_ OBJ_Top_Out_Of_Image_14 : 13297|1@1+ (1,0) [0|1] "bool" MCU
 SG_ OBJ_Bottom_Out_Of_Image_14 : 13298|1@1+ (1,0) [0|1] "bool" MCU
 SG_ OBJ_Top_Out_Of_Image_V_14 : 13299|1@1+ (1,0) [0|1] "bool" MCU
 SG_ OBJ_Bottom_Out_Of_Image_V_14 : 13300|1@1+ (1,0) [0|1] "bool" MCU
 SG_ OBJ_Lane_Assignment_14 : 13301|3@1+ (1,0) [0|5] "ENUM" MCU
 SG_ OBJ_Lane_Assignment_V_14 : 13304|1@1+ (1,0) [0|1] "bool" MCU
 SG_ OBJ_Age_Seconds_14 : 13305|7@1+ (1,0) [0|100] "s" MCU
 SG_ OBJ_Age_Seconds_V_14 : 13312|1@1+ (1,0) [0|1] "bool" MCU
 SG_ OBJ_Width_14 : 13313|9@1+ (0.01,0) [0.4|2.95] "m" MCU
 SG_ OBJ_Width_V_14 : 13322|1@1+ (1,0) [0|1] "bool" MCU
 SG_ OBJ_Width_STD_14 : 13323|11@1+ (0.001,0) [0|2] "m" MCU
 SG_ OBJ_Width_STD_V_14 : 13334|1@1+ (1,0) [0|1] "bool" MCU
 SG_ OBJ_Length_14 : 13335|9@1+ (0.05,0) [1.2|21] "m" MCU
 SG_ OBJ_Length_V_14 : 13344|1@1+ (1,0) [0|1] "bool" MCU
 SG_ OBJ_Length_STD_14 : 13345|10@1+ (0.01,0) [0|10] "m" MCU
 SG_ OBJ_Length_STD_V_14 : 13355|1@1+ (1,0) [0|1] "bool" MCU
 SG_ OBJ_Radar_ID_14 : 13356|8@1+ (1,0) [0|255] "counter" MCU
 SG_ OBJ_Height_14 : 13364|9@1+ (0.01,0) [0|2.95] "m" MCU
 SG_ OBJ_Height_V_14 : 13373|1@1+ (1,0) [0|1] "bool" MCU
 SG_ Reserved_5_14 : 13374|2@1+ (1,0) [0|0] "NA" MCU
 SG_ OBJ_Height_STD_14 : 13376|11@1+ (0.001,0) [0|2] "m" MCU
 SG_ OBJ_Height_STD_V_14 : 13387|1@1+ (1,0) [0|1] "bool" MCU
 SG_ OBJ_Abs_Long_Velocity_14 : 13388|12@1+ (0.05,-100) [-100|100] "m_per_s" MCU
 SG_ OBJ_Abs_Long_Velocity_V_14 : 13400|1@1+ (1,0) [0|1] "bool" MCU
 SG_ Reserved_6_14 : 13401|7@1+ (1,0) [0|0] "NA" MCU
 SG_ OBJ_Abs_Long_Velocity_STD_14 : 13408|13@1+ (0.01,0) [0|65] "m_per_s" MCU
 SG_ OBJ_Abs_Long_Vel_STD_V_14 : 13421|1@1+ (1,0) [0|1] "bool" MCU
 SG_ OBJ_Abs_Lat_Velocity_14 : 13422|11@1+ (0.05,-50) [-50|50] "m_per_s" MCU
 SG_ OBJ_Abs_Lat_Velocity_V_14 : 13433|1@1+ (1,0) [0|1] "bool" MCU
 SG_ Reserved_7_14 : 13434|6@1+ (1,0) [0|0] "NA" MCU
 SG_ OBJ_Abs_Lat_Velocity_STD_14 : 13440|13@1+ (0.01,0) [0|50] "m_per_s" MCU
 SG_ OBJ_Abs_Lat_Vel_STD_V_14 : 13453|1@1+ (1,0) [0|1] "bool" MCU
 SG_ OBJ_Abs_Long_Acc_14 : 13454|9@1+ (0.05,-10) [-10|10] "m_per_s2" MCU
 SG_ OBJ_Abs_Long_Acc_V_14 : 13463|1@1+ (1,0) [0|1] "bool" MCU
 SG_ Reserved_8_14 : 13464|8@1+ (1,0) [0|0] "NA" MCU
 SG_ OBJ_Abs_Long_Acc_STD_14 : 13472|10@1+ (0.01,0) [0|7.3] "m_per_s2" MCU
 SG_ OBJ_Abs_Long_Acc_STD_V_14 : 13482|1@1+ (1,0) [0|1] "bool" MCU
 SG_ OBJ_Abs_Lat_Acc_14 : 13483|9@1+ (0.05,-10) [-10|10] "m_per_s2" MCU
 SG_ OBJ_Abs_Lat_Acc_V_14 : 13492|1@1+ (1,0) [0|1] "bool" MCU
 SG_ OBJ_Abs_Lat_Acc_STD_14 : 13493|10@1+ (0.01,0) [0|7.3] "m_per_s2" MCU
 SG_ OBJ_Abs_Lat_Acc_STD_V_14 : 13503|1@1+ (1,0) [0|1] "bool" MCU
 SG_ OBJ_Abs_Acceleration_14 : 13504|9@1+ (0.05,-12.7) [-12.7|12.7] "m_per_s2" MCU
 SG_ OBJ_Abs_Acceleration_V_14 : 13513|1@1+ (1,0) [0|1] "bool" MCU
 SG_ OBJ_Abs_Acc_STD_14 : 13514|10@1+ (0.01,0) [0|7.3] "m_per_s2" MCU
 SG_ OBJ_Abs_Acc_STD_V_14 : 13524|1@1+ (1,0) [0|1] "bool" MCU
 SG_ OBJ_Inv_TTC_14 : 13525|11@1+ (0.01,-8) [-8|8] "INV(s)" MCU
 SG_ OBJ_Inv_TTC_V_14 : 13536|1@1+ (1,0) [0|1] "bool" MCU
 SG_ OBJ_Inv_TTC_STD_14 : 13537|12@1+ (0.001,0) [0|4] "INV(s)" MCU
 SG_ OBJ_Inv_TTC_STD_V_14 : 13549|1@1+ (1,0) [0|1] "bool" MCU
 SG_ OBJ_Relative_Long_Acc_14 : 13550|10@1+ (0.05,-20) [-20|20] "m_per_s2" MCU
 SG_ OBJ_Relative_Long_Acc_V_14 : 13560|1@1+ (1,0) [0|1] "bool" MCU
 SG_ Reserved_9_14 : 13561|7@1+ (1,0) [0|0] "NA" MCU
 SG_ OBJ_Relative_Long_Acc_STD_14 : 13568|10@1+ (0.01,0) [0|7.3] "m_per_s2" MCU
 SG_ OBJ_Rel_Long_Acc_STD_V_14 : 13578|1@1+ (1,0) [0|1] "bool" MCU
 SG_ OBJ_Relative_Long_Velocity_14 : 13579|13@1+ (0.05,-120) [-120|130] "m_per_s" MCU
 SG_ OBJ_Relative_Long_Velocity_V_14 : 13592|1@1+ (1,0) [0|1] "bool" MCU
 SG_ Reserved_10_14 : 13593|7@1+ (1,0) [0|0] "NA" MCU
 SG_ OBJ_Relative_Long_Vel_STD_14 : 13600|14@1+ (0.01,0) [0|130] "m_per_s" MCU
 SG_ OBJ_Rel_Long_Vel_STD_V_14 : 13614|1@1+ (1,0) [0|1] "bool" MCU
 SG_ OBJ_Relative_Lat_Velocity_14 : 13615|11@1+ (0.05,-50) [-50|50] "m_per_s" MCU
 SG_ OBJ_Relative_Lat_Velocity_V_14 : 13626|1@1+ (1,0) [0|1] "bool" MCU
 SG_ Reserved_11_14 : 13627|5@1+ (1,0) [0|0] "NA" MCU
 SG_ OBJ_Relative_Lat_Velocity_STD_14 : 13632|13@1+ (0.01,0) [0|50] "m_per_s" MCU
 SG_ OBJ_Rel_Lat_Vel_STD_V_14 : 13645|1@1+ (1,0) [0|1] "bool" MCU
 SG_ OBJ_Long_Distance_14 : 13646|14@1+ (0.05,-200) [-200|500] "m" MCU
 SG_ OBJ_Long_Distance_V_14 : 13660|1@1+ (1,0) [0|1] "bool" MCU
 SG_ Reserved_12_14 : 13661|3@1+ (1,0) [0|0] "NA" MCU
 SG_ OBJ_Long_Distance_STD_14 : 13664|15@1+ (0.01,0) [0|250] "m" MCU
 SG_ OBJ_Long_Distance_STD_V_14 : 13679|1@1+ (1,0) [0|1] "bool" MCU
 SG_ OBJ_Lat_Distance_14 : 13680|12@1+ (0.05,-100) [-100|100] "m" MCU
 SG_ OBJ_Lat_Distance_V_14 : 13692|1@1+ (1,0) [0|1] "bool" MCU
 SG_ Reserved_13_14 : 13693|3@1+ (1,0) [0|0] "NA" MCU
 SG_ OBJ_Lat_Distance_STD_14 : 13696|14@1+ (0.01,0) [0|100] "m" MCU
 SG_ OBJ_Lat_Distance_STD_V_14 : 13710|1@1+ (1,0) [0|1] "bool" MCU
 SG_ OBJ_Absolute_Speed_14 : 13711|12@1+ (0.05,-65) [-65|65] "m_per_s" MCU
 SG_ OBJ_Absolute_Speed_V_14 : 13723|1@1+ (1,0) [0|1] "bool" MCU
 SG_ Reserved_14_14 : 13724|4@1+ (1,0) [0|0] "NA" MCU
 SG_ OBJ_Absolute_Speed_STD_14 : 13728|13@1+ (0.01,0) [0|65] "m_per_s" MCU
 SG_ OBJ_Absolute_Speed_STD_V_14 : 13741|1@1+ (1,0) [0|1] "bool" MCU
 SG_ OBJ_Heading_14 : 13742|10@1+ (0.01,-3.14) [-3.14|3.14] "rad" MCU
 SG_ OBJ_Heading_V_14 : 13752|1@1+ (1,0) [0|1] "bool" MCU
 SG_ Reserved_15_14 : 13753|7@1+ (1,0) [0|0] "NA" MCU
 SG_ OBJ_Heading_STD_14 : 13760|15@1+ (0.0001,0) [0|3.14] "rad" MCU
 SG_ OBJ_Heading_STD_V_14 : 13775|1@1+ (1,0) [0|1] "bool" MCU
 SG_ OBJ_Angle_Rate_STD_14 : 13776|15@1+ (0.0001,0) [0|2.2318] "RPS" MCU
 SG_ OBJ_Angle_Rate_STD_V_14 : 13791|1@1+ (1,0) [0|1] "bool" MCU
 SG_ OBJ_Angle_Rate_14 : 13792|12@1+ (0.002,-2.234) [-2.234|2.2318] "RPS" MCU
 SG_ OBJ_Angle_Rate_V_14 : 13804|1@1+ (1,0) [0|1] "bool" MCU
 SG_ OBJ_Angle_Right_14 : 13805|14@1+ (0.0002,-1.571) [-1.571|1.571] "rad" MCU
 SG_ OBJ_Angle_Right_V_14 : 13819|1@1+ (1,0) [0|1] "bool" MCU
 SG_ Reserved_16_14 : 13820|4@1+ (1,0) [0|0] "NA" MCU
 SG_ OBJ_Angle_Right_STD_14 : 13824|14@1+ (0.0001,0) [0|1.571] "rad" MCU
 SG_ OBJ_Angle_Right_STD_V_14 : 13838|1@1+ (1,0) [0|1] "bool" MCU
 SG_ OBJ_Angle_Left_14 : 13839|14@1+ (0.0002,-1.571) [-1.571|1.571] "rad" MCU
 SG_ OBJ_Angle_Left_V_14 : 13853|1@1+ (1,0) [0|1] "bool" MCU
 SG_ Reserved_17_14 : 13854|2@1+ (1,0) [0|0] "NA" MCU
 SG_ OBJ_Angle_Left_STD_14 : 13856|14@1+ (0.0001,0) [0|1.571] "rad" MCU
 SG_ OBJ_Angle_Left_STD_V_14 : 13870|1@1+ (1,0) [0|1] "bool" MCU
 SG_ OBJ_Angle_Side_14 : 13871|14@1+ (0.0002,-1.571) [-1.571|1.571] "rad" MCU
 SG_ OBJ_Angle_Side_V_14 : 13885|1@1+ (1,0) [0|1] "bool" MCU
 SG_ Reserved_18_14 : 13886|2@1+ (1,0) [0|0] "NA" MCU
 SG_ OBJ_Angle_Side_STD_14 : 13888|14@1+ (0.0001,0) [0|1.571] "rad" MCU
 SG_ OBJ_Angle_Side_STD_V_14 : 13902|1@1+ (1,0) [0|1] "bool" MCU
 SG_ OBJ_Angle_Mid_V_14 : 13903|1@1+ (1,0) [0|1] "bool" MCU
 SG_ OBJ_Angle_Mid_14 : 13904|14@1+ (0.0002,-1.571) [-1.571|1.571] "rad" MCU
 SG_ Reserved_19_14 : 13918|2@1+ (1,0) [0|0] "NA" MCU
 SG_ OBJ_Angle_Mid_STD_14 : 13920|14@1+ (0.0001,0) [0|1.571] "rad" MCU
 SG_ OBJ_Angle_Mid_STD_V_14 : 13934|1@1+ (1,0) [0|1] "bool" MCU
 SG_ OBJ_Angle_Bottom_V_14 : 13935|1@1+ (1,0) [0|1] "bool" MCU
 SG_ OBJ_Angle_Bottom_14 : 13936|14@1+ (0.0002,-1.571) [-1.571|1.571] "rad" MCU
 SG_ Reserved_20_14 : 13950|2@1+ (1,0) [0|0] "NA" MCU
 SG_ OBJ_Angle_Bottom_STD_14 : 13952|14@1+ (0.0001,0) [0|1.571] "rad" MCU
 SG_ OBJ_Angle_Bottom_STD_V_14 : 13966|1@1+ (1,0) [0|1] "bool" MCU
 SG_ OBJ_Visibility_Side_V_14 : 13967|1@1+ (1,0) [0|1] "bool" MCU
 SG_ OBJ_Visibility_Side_14 : 13968|2@1+ (1,0) [0|2] "ENUM" MCU
 SG_ OBJ_Is_In_Drivable_Area_14 : 13970|1@1+ (1,0) [0|1] "bool" MCU
 SG_ OBJ_Is_In_Drivable_Area_V_14 : 13971|1@1+ (1,0) [0|1] "bool" MCU
 SG_ OBJ_Is_VeryClose_V_14 : 13972|1@1+ (1,0) [0|1] "bool" MCU
 SG_ OBJ_Is_VeryClose_14 : 13973|1@1+ (1,0) [0|1] "bool" MCU
 SG_ OBJ_Buffer_C4_14 : 13974|2@1+ (1,0) [0|2] "NA" MCU
 SG_ OBJ_Buffer_C5_14 : 13976|2@1+ (1,0) [0|2] "NA" MCU
 SG_ OBJ_Buffer_C6_14 : 13978|2@1+ (1,0) [0|2] "NA" MCU
 SG_ OBJ_Buffer_C7_14 : 13980|2@1+ (1,0) [0|2] "NA" MCU
 SG_ Reserved_21_14 : 13982|2@1+ (1,0) [0|0] "NA" MCU
 SG_ OBJ_OverlapAngleEgoLaneR_14 : 13984|10@1+ (0.01,-3.14) [-3.14|3.14] "rad" MCU
 SG_ OBJ_OverlapAngleEgoLaneR_V_14 : 13994|1@1+ (1,0) [0|1] "bool" MCU
 SG_ OBJ_OverlapAngleEgoLaneL_14 : 13995|10@1+ (0.01,-3.14) [-3.14|3.14] "rad" MCU
 SG_ OBJ_OverlapAngleEgoLaneL_V_14 : 14005|1@1+ (1,0) [0|1] "bool" MCU
 SG_ OBJ_Is_EMERGENCY_VCL_14 : 14006|1@1+ (1,0) [0|1] "bool" MCU
 SG_ OBJ_EMERGENCY_LIGHT_COLOR_14 : 14007|4@1+ (1,0) [0|15] "BITWIZE" MCU
 SG_ OBJ_EMERGENCY_V_14 : 14011|1@1+ (1,0) [0|1] "bool" MCU
 SG_ Reserved_22_14 : 14012|4@1+ (1,0) [0|0] "NA" MCU
 SG_ OBJ_Angle_Top_14 : 14016|14@1+ (0.0002,0) [0|3.1415] "rad" MCU
 SG_ OBJ_Angle_Top_V_14 : 14030|1@1+ (1,0) [0|1] "bool" MCU
 SG_ OBJ_Angle_Top_STD_14 : 14031|15@1+ (0.0001,0) [0|3.1415] "rad" MCU
 SG_ OBJ_Angle_Top_STD_V_14 : 14046|1@1+ (1,0) [0|1] "bool" MCU
 SG_ OBJ_Buffer_C14_14 : 14047|1@1+ (1,0) [0|1] "NA" MCU
 SG_ OBJ_Buffer_C15_14 : 14048|1@1+ (1,0) [0|1] "NA" MCU
 SG_ OBJ_Buffer_C18_14 : 14049|2@1+ (1,0) [0|2] "NA" MCU
 SG_ OBJ_Buffer_C19_14 : 14051|1@1+ (1,0) [0|1] "NA" MCU
 SG_ Reserved_23_14 : 14052|28@1+ (1,0) [0|0] "NA" MCU
 SG_ OBJ_CRC_15 : 14080|32@1+ (1,0) [0|4294967295] "NA" MCU
 SG_ OBJ_ID_15 : 14112|8@1+ (1,0) [0|255] "counter" MCU
 SG_ OBJ_Existence_Probability_15 : 14120|8@1+ (0.01,0) [0|1] "NA" MCU
 SG_ OBJ_Fusion_Source_15 : 14128|16@1+ (1,0) [0|65535] "BITWIZE" MCU
 SG_ OBJ_Triggered_SDM_15 : 14144|2@1+ (1,0) [0|2] "ENUM" MCU
 SG_ OBJ_Motion_Category_15 : 14146|4@1+ (1,0) [0|13] "ENUM" MCU
 SG_ OBJ_Buffer_C0_15 : 14150|7@1+ (0.01,0) [0|1] "NA" MCU
 SG_ OBJ_Object_Age_15 : 14157|11@1+ (1,0) [0|2047] "frames" MCU
 SG_ OBJ_Measuring_Status_15 : 14168|3@1+ (1,0) [0|7] "BITWIZE" MCU
 SG_ OBJ_Object_Class_15 : 14171|4@1+ (1,0) [0|8] "ENUM" MCU
 SG_ Reserved_4_15 : 14175|1@1+ (1,0) [0|0] "NA" MCU
 SG_ OBJ_Class_Probability_15 : 14176|7@1+ (0.01,0) [0|1] "NA" MCU
 SG_ OBJ_Car_Probability_15 : 14183|7@1+ (0.01,0) [0|1] "NA" MCU
 SG_ OBJ_Truck_Probability_15 : 14190|7@1+ (0.01,0) [0|1] "NA" MCU
 SG_ OBJ_Bike_Probability_15 : 14197|7@1+ (0.01,0) [0|1] "NA" MCU
 SG_ OBJ_Camera_Source_15 : 14204|4@1+ (1,0) [0|15] "ENUM" MCU
 SG_ OBJ_Motion_Status_15 : 14208|3@1+ (1,0) [0|5] "ENUM" MCU
 SG_ OBJ_Motion_Orientation_15 : 14211|4@1+ (1,0) [0|13] "ENUM" MCU
 SG_ OBJ_Has_Cut_Lane_15 : 14215|1@1+ (1,0) [0|1] "bool" MCU
 SG_ OBJ_Has_Cut_Path_15 : 14216|1@1+ (1,0) [0|1] "bool" MCU
 SG_ OBJ_Brake_Light_15 : 14217|1@1+ (1,0) [0|1] "bool" MCU
 SG_ OBJ_Turn_Indicator_Right_15 : 14218|1@1+ (1,0) [0|1] "bool" MCU
 SG_ OBJ_Turn_Indicator_Left_15 : 14219|1@1+ (1,0) [0|1] "bool" MCU
 SG_ OBJ_Light_Indicator_Validity_15 : 14220|1@1+ (1,0) [0|1] "bool" MCU
 SG_ OBJ_Right_Out_Of_Image_15 : 14221|1@1+ (1,0) [0|1] "bool" MCU
 SG_ OBJ_Left_Out_Of_Image_15 : 14222|1@1+ (1,0) [0|1] "bool" MCU
 SG_ OBJ_Right_Out_Of_Image_V_15 : 14223|1@1+ (1,0) [0|1] "bool" MCU
 SG_ OBJ_Left_Out_Of_Image_V_15 : 14224|1@1+ (1,0) [0|1] "bool" MCU
 SG_ OBJ_Top_Out_Of_Image_15 : 14225|1@1+ (1,0) [0|1] "bool" MCU
 SG_ OBJ_Bottom_Out_Of_Image_15 : 14226|1@1+ (1,0) [0|1] "bool" MCU
 SG_ OBJ_Top_Out_Of_Image_V_15 : 14227|1@1+ (1,0) [0|1] "bool" MCU
 SG_ OBJ_Bottom_Out_Of_Image_V_15 : 14228|1@1+ (1,0) [0|1] "bool" MCU
 SG_ OBJ_Lane_Assignment_15 : 14229|3@1+ (1,0) [0|5] "ENUM" MCU
 SG_ OBJ_Lane_Assignment_V_15 : 14232|1@1+ (1,0) [0|1] "bool" MCU
 SG_ OBJ_Age_Seconds_15 : 14233|7@1+ (1,0) [0|100] "s" MCU
 SG_ OBJ_Age_Seconds_V_15 : 14240|1@1+ (1,0) [0|1] "bool" MCU
 SG_ OBJ_Width_15 : 14241|9@1+ (0.01,0) [0.4|2.95] "m" MCU
 SG_ OBJ_Width_V_15 : 14250|1@1+ (1,0) [0|1] "bool" MCU
 SG_ OBJ_Width_STD_15 : 14251|11@1+ (0.001,0) [0|2] "m" MCU
 SG_ OBJ_Width_STD_V_15 : 14262|1@1+ (1,0) [0|1] "bool" MCU
 SG_ OBJ_Length_15 : 14263|9@1+ (0.05,0) [1.2|21] "m" MCU
 SG_ OBJ_Length_V_15 : 14272|1@1+ (1,0) [0|1] "bool" MCU
 SG_ OBJ_Length_STD_15 : 14273|10@1+ (0.01,0) [0|10] "m" MCU
 SG_ OBJ_Length_STD_V_15 : 14283|1@1+ (1,0) [0|1] "bool" MCU
 SG_ OBJ_Radar_ID_15 : 14284|8@1+ (1,0) [0|255] "counter" MCU
 SG_ OBJ_Height_15 : 14292|9@1+ (0.01,0) [0|2.95] "m" MCU
 SG_ OBJ_Height_V_15 : 14301|1@1+ (1,0) [0|1] "bool" MCU
 SG_ Reserved_5_15 : 14302|2@1+ (1,0) [0|0] "NA" MCU
 SG_ OBJ_Height_STD_15 : 14304|11@1+ (0.001,0) [0|2] "m" MCU
 SG_ OBJ_Height_STD_V_15 : 14315|1@1+ (1,0) [0|1] "bool" MCU
 SG_ OBJ_Abs_Long_Velocity_15 : 14316|12@1+ (0.05,-100) [-100|100] "m_per_s" MCU
 SG_ OBJ_Abs_Long_Velocity_V_15 : 14328|1@1+ (1,0) [0|1] "bool" MCU
 SG_ Reserved_6_15 : 14329|7@1+ (1,0) [0|0] "NA" MCU
 SG_ OBJ_Abs_Long_Velocity_STD_15 : 14336|13@1+ (0.01,0) [0|65] "m_per_s" MCU
 SG_ OBJ_Abs_Long_Vel_STD_V_15 : 14349|1@1+ (1,0) [0|1] "bool" MCU
 SG_ OBJ_Abs_Lat_Velocity_15 : 14350|11@1+ (0.05,-50) [-50|50] "m_per_s" MCU
 SG_ OBJ_Abs_Lat_Velocity_V_15 : 14361|1@1+ (1,0) [0|1] "bool" MCU
 SG_ Reserved_7_15 : 14362|6@1+ (1,0) [0|0] "NA" MCU
 SG_ OBJ_Abs_Lat_Velocity_STD_15 : 14368|13@1+ (0.01,0) [0|50] "m_per_s" MCU
 SG_ OBJ_Abs_Lat_Vel_STD_V_15 : 14381|1@1+ (1,0) [0|1] "bool" MCU
 SG_ OBJ_Abs_Long_Acc_15 : 14382|9@1+ (0.05,-10) [-10|10] "m_per_s2" MCU
 SG_ OBJ_Abs_Long_Acc_V_15 : 14391|1@1+ (1,0) [0|1] "bool" MCU
 SG_ Reserved_8_15 : 14392|8@1+ (1,0) [0|0] "NA" MCU
 SG_ OBJ_Abs_Long_Acc_STD_15 : 14400|10@1+ (0.01,0) [0|7.3] "m_per_s2" MCU
 SG_ OBJ_Abs_Long_Acc_STD_V_15 : 14410|1@1+ (1,0) [0|1] "bool" MCU
 SG_ OBJ_Abs_Lat_Acc_15 : 14411|9@1+ (0.05,-10) [-10|10] "m_per_s2" MCU
 SG_ OBJ_Abs_Lat_Acc_V_15 : 14420|1@1+ (1,0) [0|1] "bool" MCU
 SG_ OBJ_Abs_Lat_Acc_STD_15 : 14421|10@1+ (0.01,0) [0|7.3] "m_per_s2" MCU
 SG_ OBJ_Abs_Lat_Acc_STD_V_15 : 14431|1@1+ (1,0) [0|1] "bool" MCU
 SG_ OBJ_Abs_Acceleration_15 : 14432|9@1+ (0.05,-12.7) [-12.7|12.7] "m_per_s2" MCU
 SG_ OBJ_Abs_Acceleration_V_15 : 14441|1@1+ (1,0) [0|1] "bool" MCU
 SG_ OBJ_Abs_Acc_STD_15 : 14442|10@1+ (0.01,0) [0|7.3] "m_per_s2" MCU
 SG_ OBJ_Abs_Acc_STD_V_15 : 14452|1@1+ (1,0) [0|1] "bool" MCU
 SG_ OBJ_Inv_TTC_15 : 14453|11@1+ (0.01,-8) [-8|8] "INV(s)" MCU
 SG_ OBJ_Inv_TTC_V_15 : 14464|1@1+ (1,0) [0|1] "bool" MCU
 SG_ OBJ_Inv_TTC_STD_15 : 14465|12@1+ (0.001,0) [0|4] "INV(s)" MCU
 SG_ OBJ_Inv_TTC_STD_V_15 : 14477|1@1+ (1,0) [0|1] "bool" MCU
 SG_ OBJ_Relative_Long_Acc_15 : 14478|10@1+ (0.05,-20) [-20|20] "m_per_s2" MCU
 SG_ OBJ_Relative_Long_Acc_V_15 : 14488|1@1+ (1,0) [0|1] "bool" MCU
 SG_ Reserved_9_15 : 14489|7@1+ (1,0) [0|0] "NA" MCU
 SG_ OBJ_Relative_Long_Acc_STD_15 : 14496|10@1+ (0.01,0) [0|7.3] "m_per_s2" MCU
 SG_ OBJ_Rel_Long_Acc_STD_V_15 : 14506|1@1+ (1,0) [0|1] "bool" MCU
 SG_ OBJ_Relative_Long_Velocity_15 : 14507|13@1+ (0.05,-120) [-120|130] "m_per_s" MCU
 SG_ OBJ_Relative_Long_Velocity_V_15 : 14520|1@1+ (1,0) [0|1] "bool" MCU
 SG_ Reserved_10_15 : 14521|7@1+ (1,0) [0|0] "NA" MCU
 SG_ OBJ_Relative_Long_Vel_STD_15 : 14528|14@1+ (0.01,0) [0|130] "m_per_s" MCU
 SG_ OBJ_Rel_Long_Vel_STD_V_15 : 14542|1@1+ (1,0) [0|1] "bool" MCU
 SG_ OBJ_Relative_Lat_Velocity_15 : 14543|11@1+ (0.05,-50) [-50|50] "m_per_s" MCU
 SG_ OBJ_Relative_Lat_Velocity_V_15 : 14554|1@1+ (1,0) [0|1] "bool" MCU
 SG_ Reserved_11_15 : 14555|5@1+ (1,0) [0|0] "NA" MCU
 SG_ OBJ_Relative_Lat_Velocity_STD_15 : 14560|13@1+ (0.01,0) [0|50] "m_per_s" MCU
 SG_ OBJ_Rel_Lat_Vel_STD_V_15 : 14573|1@1+ (1,0) [0|1] "bool" MCU
 SG_ OBJ_Long_Distance_15 : 14574|14@1+ (0.05,-200) [-200|500] "m" MCU
 SG_ OBJ_Long_Distance_V_15 : 14588|1@1+ (1,0) [0|1] "bool" MCU
 SG_ Reserved_12_15 : 14589|3@1+ (1,0) [0|0] "NA" MCU
 SG_ OBJ_Long_Distance_STD_15 : 14592|15@1+ (0.01,0) [0|250] "m" MCU
 SG_ OBJ_Long_Distance_STD_V_15 : 14607|1@1+ (1,0) [0|1] "bool" MCU
 SG_ OBJ_Lat_Distance_15 : 14608|12@1+ (0.05,-100) [-100|100] "m" MCU
 SG_ OBJ_Lat_Distance_V_15 : 14620|1@1+ (1,0) [0|1] "bool" MCU
 SG_ Reserved_13_15 : 14621|3@1+ (1,0) [0|0] "NA" MCU
 SG_ OBJ_Lat_Distance_STD_15 : 14624|14@1+ (0.01,0) [0|100] "m" MCU
 SG_ OBJ_Lat_Distance_STD_V_15 : 14638|1@1+ (1,0) [0|1] "bool" MCU
 SG_ OBJ_Absolute_Speed_15 : 14639|12@1+ (0.05,-65) [-65|65] "m_per_s" MCU
 SG_ OBJ_Absolute_Speed_V_15 : 14651|1@1+ (1,0) [0|1] "bool" MCU
 SG_ Reserved_14_15 : 14652|4@1+ (1,0) [0|0] "NA" MCU
 SG_ OBJ_Absolute_Speed_STD_15 : 14656|13@1+ (0.01,0) [0|65] "m_per_s" MCU
 SG_ OBJ_Absolute_Speed_STD_V_15 : 14669|1@1+ (1,0) [0|1] "bool" MCU
 SG_ OBJ_Heading_15 : 14670|10@1+ (0.01,-3.14) [-3.14|3.14] "rad" MCU
 SG_ OBJ_Heading_V_15 : 14680|1@1+ (1,0) [0|1] "bool" MCU
 SG_ Reserved_15_15 : 14681|7@1+ (1,0) [0|0] "NA" MCU
 SG_ OBJ_Heading_STD_15 : 14688|15@1+ (0.0001,0) [0|3.14] "rad" MCU
 SG_ OBJ_Heading_STD_V_15 : 14703|1@1+ (1,0) [0|1] "bool" MCU
 SG_ OBJ_Angle_Rate_STD_15 : 14704|15@1+ (0.0001,0) [0|2.2318] "RPS" MCU
 SG_ OBJ_Angle_Rate_STD_V_15 : 14719|1@1+ (1,0) [0|1] "bool" MCU
 SG_ OBJ_Angle_Rate_15 : 14720|12@1+ (0.002,-2.234) [-2.234|2.2318] "RPS" MCU
 SG_ OBJ_Angle_Rate_V_15 : 14732|1@1+ (1,0) [0|1] "bool" MCU
 SG_ OBJ_Angle_Right_15 : 14733|14@1+ (0.0002,-1.571) [-1.571|1.571] "rad" MCU
 SG_ OBJ_Angle_Right_V_15 : 14747|1@1+ (1,0) [0|1] "bool" MCU
 SG_ Reserved_16_15 : 14748|4@1+ (1,0) [0|0] "NA" MCU
 SG_ OBJ_Angle_Right_STD_15 : 14752|14@1+ (0.0001,0) [0|1.571] "rad" MCU
 SG_ OBJ_Angle_Right_STD_V_15 : 14766|1@1+ (1,0) [0|1] "bool" MCU
 SG_ OBJ_Angle_Left_15 : 14767|14@1+ (0.0002,-1.571) [-1.571|1.571] "rad" MCU
 SG_ OBJ_Angle_Left_V_15 : 14781|1@1+ (1,0) [0|1] "bool" MCU
 SG_ Reserved_17_15 : 14782|2@1+ (1,0) [0|0] "NA" MCU
 SG_ OBJ_Angle_Left_STD_15 : 14784|14@1+ (0.0001,0) [0|1.571] "rad" MCU
 SG_ OBJ_Angle_Left_STD_V_15 : 14798|1@1+ (1,0) [0|1] "bool" MCU
 SG_ OBJ_Angle_Side_15 : 14799|14@1+ (0.0002,-1.571) [-1.571|1.571] "rad" MCU
 SG_ OBJ_Angle_Side_V_15 : 14813|1@1+ (1,0) [0|1] "bool" MCU
 SG_ Reserved_18_15 : 14814|2@1+ (1,0) [0|0] "NA" MCU
 SG_ OBJ_Angle_Side_STD_15 : 14816|14@1+ (0.0001,0) [0|1.571] "rad" MCU
 SG_ OBJ_Angle_Side_STD_V_15 : 14830|1@1+ (1,0) [0|1] "bool" MCU
 SG_ OBJ_Angle_Mid_V_15 : 14831|1@1+ (1,0) [0|1] "bool" MCU
 SG_ OBJ_Angle_Mid_15 : 14832|14@1+ (0.0002,-1.571) [-1.571|1.571] "rad" MCU
 SG_ Reserved_19_15 : 14846|2@1+ (1,0) [0|0] "NA" MCU
 SG_ OBJ_Angle_Mid_STD_15 : 14848|14@1+ (0.0001,0) [0|1.571] "rad" MCU
 SG_ OBJ_Angle_Mid_STD_V_15 : 14862|1@1+ (1,0) [0|1] "bool" MCU
 SG_ OBJ_Angle_Bottom_V_15 : 14863|1@1+ (1,0) [0|1] "bool" MCU
 SG_ OBJ_Angle_Bottom_15 : 14864|14@1+ (0.0002,-1.571) [-1.571|1.571] "rad" MCU
 SG_ Reserved_20_15 : 14878|2@1+ (1,0) [0|0] "NA" MCU
 SG_ OBJ_Angle_Bottom_STD_15 : 14880|14@1+ (0.0001,0) [0|1.571] "rad" MCU
 SG_ OBJ_Angle_Bottom_STD_V_15 : 14894|1@1+ (1,0) [0|1] "bool" MCU
 SG_ OBJ_Visibility_Side_V_15 : 14895|1@1+ (1,0) [0|1] "bool" MCU
 SG_ OBJ_Visibility_Side_15 : 14896|2@1+ (1,0) [0|2] "ENUM" MCU
 SG_ OBJ_Is_In_Drivable_Area_15 : 14898|1@1+ (1,0) [0|1] "bool" MCU
 SG_ OBJ_Is_In_Drivable_Area_V_15 : 14899|1@1+ (1,0) [0|1] "bool" MCU
 SG_ OBJ_Is_VeryClose_V_15 : 14900|1@1+ (1,0) [0|1] "bool" MCU
 SG_ OBJ_Is_VeryClose_15 : 14901|1@1+ (1,0) [0|1] "bool" MCU
 SG_ OBJ_Buffer_C4_15 : 14902|2@1+ (1,0) [0|2] "NA" MCU
 SG_ OBJ_Buffer_C5_15 : 14904|2@1+ (1,0) [0|2] "NA" MCU
 SG_ OBJ_Buffer_C6_15 : 14906|2@1+ (1,0) [0|2] "NA" MCU
 SG_ OBJ_Buffer_C7_15 : 14908|2@1+ (1,0) [0|2] "NA" MCU
 SG_ Reserved_21_15 : 14910|2@1+ (1,0) [0|0] "NA" MCU
 SG_ OBJ_OverlapAngleEgoLaneR_15 : 14912|10@1+ (0.01,-3.14) [-3.14|3.14] "rad" MCU
 SG_ OBJ_OverlapAngleEgoLaneR_V_15 : 14922|1@1+ (1,0) [0|1] "bool" MCU
 SG_ OBJ_OverlapAngleEgoLaneL_15 : 14923|10@1+ (0.01,-3.14) [-3.14|3.14] "rad" MCU
 SG_ OBJ_OverlapAngleEgoLaneL_V_15 : 14933|1@1+ (1,0) [0|1] "bool" MCU
 SG_ OBJ_Is_EMERGENCY_VCL_15 : 14934|1@1+ (1,0) [0|1] "bool" MCU
 SG_ OBJ_EMERGENCY_LIGHT_COLOR_15 : 14935|4@1+ (1,0) [0|15] "BITWIZE" MCU
 SG_ OBJ_EMERGENCY_V_15 : 14939|1@1+ (1,0) [0|1] "bool" MCU
 SG_ Reserved_22_15 : 14940|4@1+ (1,0) [0|0] "NA" MCU
 SG_ OBJ_Angle_Top_15 : 14944|14@1+ (0.0002,0) [0|3.1415] "rad" MCU
 SG_ OBJ_Angle_Top_V_15 : 14958|1@1+ (1,0) [0|1] "bool" MCU
 SG_ OBJ_Angle_Top_STD_15 : 14959|15@1+ (0.0001,0) [0|3.1415] "rad" MCU
 SG_ OBJ_Angle_Top_STD_V_15 : 14974|1@1+ (1,0) [0|1] "bool" MCU
 SG_ OBJ_Buffer_C14_15 : 14975|1@1+ (1,0) [0|1] "NA" MCU
 SG_ OBJ_Buffer_C15_15 : 14976|1@1+ (1,0) [0|1] "NA" MCU
 SG_ OBJ_Buffer_C18_15 : 14977|2@1+ (1,0) [0|2] "NA" MCU
 SG_ OBJ_Buffer_C19_15 : 14979|1@1+ (1,0) [0|1] "NA" MCU
 SG_ Reserved_23_15 : 14980|28@1+ (1,0) [0|0] "NA" MCU
 SG_ OBJ_CRC_16 : 15008|32@1+ (1,0) [0|4294967295] "NA" MCU
 SG_ OBJ_ID_16 : 15040|8@1+ (1,0) [0|255] "counter" MCU
 SG_ OBJ_Existence_Probability_16 : 15048|8@1+ (0.01,0) [0|1] "NA" MCU
 SG_ OBJ_Fusion_Source_16 : 15056|16@1+ (1,0) [0|65535] "BITWIZE" MCU
 SG_ OBJ_Triggered_SDM_16 : 15072|2@1+ (1,0) [0|2] "ENUM" MCU
 SG_ OBJ_Motion_Category_16 : 15074|4@1+ (1,0) [0|13] "ENUM" MCU
 SG_ OBJ_Buffer_C0_16 : 15078|7@1+ (0.01,0) [0|1] "NA" MCU
 SG_ OBJ_Object_Age_16 : 15085|11@1+ (1,0) [0|2047] "frames" MCU
 SG_ OBJ_Measuring_Status_16 : 15096|3@1+ (1,0) [0|7] "BITWIZE" MCU
 SG_ OBJ_Object_Class_16 : 15099|4@1+ (1,0) [0|8] "ENUM" MCU
 SG_ Reserved_4_16 : 15103|1@1+ (1,0) [0|0] "NA" MCU
 SG_ OBJ_Class_Probability_16 : 15104|7@1+ (0.01,0) [0|1] "NA" MCU
 SG_ OBJ_Car_Probability_16 : 15111|7@1+ (0.01,0) [0|1] "NA" MCU
 SG_ OBJ_Truck_Probability_16 : 15118|7@1+ (0.01,0) [0|1] "NA" MCU
 SG_ OBJ_Bike_Probability_16 : 15125|7@1+ (0.01,0) [0|1] "NA" MCU
 SG_ OBJ_Camera_Source_16 : 15132|4@1+ (1,0) [0|15] "ENUM" MCU
 SG_ OBJ_Motion_Status_16 : 15136|3@1+ (1,0) [0|5] "ENUM" MCU
 SG_ OBJ_Motion_Orientation_16 : 15139|4@1+ (1,0) [0|13] "ENUM" MCU
 SG_ OBJ_Has_Cut_Lane_16 : 15143|1@1+ (1,0) [0|1] "bool" MCU
 SG_ OBJ_Has_Cut_Path_16 : 15144|1@1+ (1,0) [0|1] "bool" MCU
 SG_ OBJ_Brake_Light_16 : 15145|1@1+ (1,0) [0|1] "bool" MCU
 SG_ OBJ_Turn_Indicator_Right_16 : 15146|1@1+ (1,0) [0|1] "bool" MCU
 SG_ OBJ_Turn_Indicator_Left_16 : 15147|1@1+ (1,0) [0|1] "bool" MCU
 SG_ OBJ_Light_Indicator_Validity_16 : 15148|1@1+ (1,0) [0|1] "bool" MCU
 SG_ OBJ_Right_Out_Of_Image_16 : 15149|1@1+ (1,0) [0|1] "bool" MCU
 SG_ OBJ_Left_Out_Of_Image_16 : 15150|1@1+ (1,0) [0|1] "bool" MCU
 SG_ OBJ_Right_Out_Of_Image_V_16 : 15151|1@1+ (1,0) [0|1] "bool" MCU
 SG_ OBJ_Left_Out_Of_Image_V_16 : 15152|1@1+ (1,0) [0|1] "bool" MCU
 SG_ OBJ_Top_Out_Of_Image_16 : 15153|1@1+ (1,0) [0|1] "bool" MCU
 SG_ OBJ_Bottom_Out_Of_Image_16 : 15154|1@1+ (1,0) [0|1] "bool" MCU
 SG_ OBJ_Top_Out_Of_Image_V_16 : 15155|1@1+ (1,0) [0|1] "bool" MCU
 SG_ OBJ_Bottom_Out_Of_Image_V_16 : 15156|1@1+ (1,0) [0|1] "bool" MCU
 SG_ OBJ_Lane_Assignment_16 : 15157|3@1+ (1,0) [0|5] "ENUM" MCU
 SG_ OBJ_Lane_Assignment_V_16 : 15160|1@1+ (1,0) [0|1] "bool" MCU
 SG_ OBJ_Age_Seconds_16 : 15161|7@1+ (1,0) [0|100] "s" MCU
 SG_ OBJ_Age_Seconds_V_16 : 15168|1@1+ (1,0) [0|1] "bool" MCU
 SG_ OBJ_Width_16 : 15169|9@1+ (0.01,0) [0.4|2.95] "m" MCU
 SG_ OBJ_Width_V_16 : 15178|1@1+ (1,0) [0|1] "bool" MCU
 SG_ OBJ_Width_STD_16 : 15179|11@1+ (0.001,0) [0|2] "m" MCU
 SG_ OBJ_Width_STD_V_16 : 15190|1@1+ (1,0) [0|1] "bool" MCU
 SG_ OBJ_Length_16 : 15191|9@1+ (0.05,0) [1.2|21] "m" MCU
 SG_ OBJ_Length_V_16 : 15200|1@1+ (1,0) [0|1] "bool" MCU
 SG_ OBJ_Length_STD_16 : 15201|10@1+ (0.01,0) [0|10] "m" MCU
 SG_ OBJ_Length_STD_V_16 : 15211|1@1+ (1,0) [0|1] "bool" MCU
 SG_ OBJ_Radar_ID_16 : 15212|8@1+ (1,0) [0|255] "counter" MCU
 SG_ OBJ_Height_16 : 15220|9@1+ (0.01,0) [0|2.95] "m" MCU
 SG_ OBJ_Height_V_16 : 15229|1@1+ (1,0) [0|1] "bool" MCU
 SG_ Reserved_5_16 : 15230|2@1+ (1,0) [0|0] "NA" MCU
 SG_ OBJ_Height_STD_16 : 15232|11@1+ (0.001,0) [0|2] "m" MCU
 SG_ OBJ_Height_STD_V_16 : 15243|1@1+ (1,0) [0|1] "bool" MCU
 SG_ OBJ_Abs_Long_Velocity_16 : 15244|12@1+ (0.05,-100) [-100|100] "m_per_s" MCU
 SG_ OBJ_Abs_Long_Velocity_V_16 : 15256|1@1+ (1,0) [0|1] "bool" MCU
 SG_ Reserved_6_16 : 15257|7@1+ (1,0) [0|0] "NA" MCU
 SG_ OBJ_Abs_Long_Velocity_STD_16 : 15264|13@1+ (0.01,0) [0|65] "m_per_s" MCU
 SG_ OBJ_Abs_Long_Vel_STD_V_16 : 15277|1@1+ (1,0) [0|1] "bool" MCU
 SG_ OBJ_Abs_Lat_Velocity_16 : 15278|11@1+ (0.05,-50) [-50|50] "m_per_s" MCU
 SG_ OBJ_Abs_Lat_Velocity_V_16 : 15289|1@1+ (1,0) [0|1] "bool" MCU
 SG_ Reserved_7_16 : 15290|6@1+ (1,0) [0|0] "NA" MCU
 SG_ OBJ_Abs_Lat_Velocity_STD_16 : 15296|13@1+ (0.01,0) [0|50] "m_per_s" MCU
 SG_ OBJ_Abs_Lat_Vel_STD_V_16 : 15309|1@1+ (1,0) [0|1] "bool" MCU
 SG_ OBJ_Abs_Long_Acc_16 : 15310|9@1+ (0.05,-10) [-10|10] "m_per_s2" MCU
 SG_ OBJ_Abs_Long_Acc_V_16 : 15319|1@1+ (1,0) [0|1] "bool" MCU
 SG_ Reserved_8_16 : 15320|8@1+ (1,0) [0|0] "NA" MCU
 SG_ OBJ_Abs_Long_Acc_STD_16 : 15328|10@1+ (0.01,0) [0|7.3] "m_per_s2" MCU
 SG_ OBJ_Abs_Long_Acc_STD_V_16 : 15338|1@1+ (1,0) [0|1] "bool" MCU
 SG_ OBJ_Abs_Lat_Acc_16 : 15339|9@1+ (0.05,-10) [-10|10] "m_per_s2" MCU
 SG_ OBJ_Abs_Lat_Acc_V_16 : 15348|1@1+ (1,0) [0|1] "bool" MCU
 SG_ OBJ_Abs_Lat_Acc_STD_16 : 15349|10@1+ (0.01,0) [0|7.3] "m_per_s2" MCU
 SG_ OBJ_Abs_Lat_Acc_STD_V_16 : 15359|1@1+ (1,0) [0|1] "bool" MCU
 SG_ OBJ_Abs_Acceleration_16 : 15360|9@1+ (0.05,-12.7) [-12.7|12.7] "m_per_s2" MCU
 SG_ OBJ_Abs_Acceleration_V_16 : 15369|1@1+ (1,0) [0|1] "bool" MCU
 SG_ OBJ_Abs_Acc_STD_16 : 15370|10@1+ (0.01,0) [0|7.3] "m_per_s2" MCU
 SG_ OBJ_Abs_Acc_STD_V_16 : 15380|1@1+ (1,0) [0|1] "bool" MCU
 SG_ OBJ_Inv_TTC_16 : 15381|11@1+ (0.01,-8) [-8|8] "INV(s)" MCU
 SG_ OBJ_Inv_TTC_V_16 : 15392|1@1+ (1,0) [0|1] "bool" MCU
 SG_ OBJ_Inv_TTC_STD_16 : 15393|12@1+ (0.001,0) [0|4] "INV(s)" MCU
 SG_ OBJ_Inv_TTC_STD_V_16 : 15405|1@1+ (1,0) [0|1] "bool" MCU
 SG_ OBJ_Relative_Long_Acc_16 : 15406|10@1+ (0.05,-20) [-20|20] "m_per_s2" MCU
 SG_ OBJ_Relative_Long_Acc_V_16 : 15416|1@1+ (1,0) [0|1] "bool" MCU
 SG_ Reserved_9_16 : 15417|7@1+ (1,0) [0|0] "NA" MCU
 SG_ OBJ_Relative_Long_Acc_STD_16 : 15424|10@1+ (0.01,0) [0|7.3] "m_per_s2" MCU
 SG_ OBJ_Rel_Long_Acc_STD_V_16 : 15434|1@1+ (1,0) [0|1] "bool" MCU
 SG_ OBJ_Relative_Long_Velocity_16 : 15435|13@1+ (0.05,-120) [-120|130] "m_per_s" MCU
 SG_ OBJ_Relative_Long_Velocity_V_16 : 15448|1@1+ (1,0) [0|1] "bool" MCU
 SG_ Reserved_10_16 : 15449|7@1+ (1,0) [0|0] "NA" MCU
 SG_ OBJ_Relative_Long_Vel_STD_16 : 15456|14@1+ (0.01,0) [0|130] "m_per_s" MCU
 SG_ OBJ_Rel_Long_Vel_STD_V_16 : 15470|1@1+ (1,0) [0|1] "bool" MCU
 SG_ OBJ_Relative_Lat_Velocity_16 : 15471|11@1+ (0.05,-50) [-50|50] "m_per_s" MCU
 SG_ OBJ_Relative_Lat_Velocity_V_16 : 15482|1@1+ (1,0) [0|1] "bool" MCU
 SG_ Reserved_11_16 : 15483|5@1+ (1,0) [0|0] "NA" MCU
 SG_ OBJ_Relative_Lat_Velocity_STD_16 : 15488|13@1+ (0.01,0) [0|50] "m_per_s" MCU
 SG_ OBJ_Rel_Lat_Vel_STD_V_16 : 15501|1@1+ (1,0) [0|1] "bool" MCU
 SG_ OBJ_Long_Distance_16 : 15502|14@1+ (0.05,-200) [-200|500] "m" MCU
 SG_ OBJ_Long_Distance_V_16 : 15516|1@1+ (1,0) [0|1] "bool" MCU
 SG_ Reserved_12_16 : 15517|3@1+ (1,0) [0|0] "NA" MCU
 SG_ OBJ_Long_Distance_STD_16 : 15520|15@1+ (0.01,0) [0|250] "m" MCU
 SG_ OBJ_Long_Distance_STD_V_16 : 15535|1@1+ (1,0) [0|1] "bool" MCU
 SG_ OBJ_Lat_Distance_16 : 15536|12@1+ (0.05,-100) [-100|100] "m" MCU
 SG_ OBJ_Lat_Distance_V_16 : 15548|1@1+ (1,0) [0|1] "bool" MCU
 SG_ Reserved_13_16 : 15549|3@1+ (1,0) [0|0] "NA" MCU
 SG_ OBJ_Lat_Distance_STD_16 : 15552|14@1+ (0.01,0) [0|100] "m" MCU
 SG_ OBJ_Lat_Distance_STD_V_16 : 15566|1@1+ (1,0) [0|1] "bool" MCU
 SG_ OBJ_Absolute_Speed_16 : 15567|12@1+ (0.05,-65) [-65|65] "m_per_s" MCU
 SG_ OBJ_Absolute_Speed_V_16 : 15579|1@1+ (1,0) [0|1] "bool" MCU
 SG_ Reserved_14_16 : 15580|4@1+ (1,0) [0|0] "NA" MCU
 SG_ OBJ_Absolute_Speed_STD_16 : 15584|13@1+ (0.01,0) [0|65] "m_per_s" MCU
 SG_ OBJ_Absolute_Speed_STD_V_16 : 15597|1@1+ (1,0) [0|1] "bool" MCU
 SG_ OBJ_Heading_16 : 15598|10@1+ (0.01,-3.14) [-3.14|3.14] "rad" MCU
 SG_ OBJ_Heading_V_16 : 15608|1@1+ (1,0) [0|1] "bool" MCU
 SG_ Reserved_15_16 : 15609|7@1+ (1,0) [0|0] "NA" MCU
 SG_ OBJ_Heading_STD_16 : 15616|15@1+ (0.0001,0) [0|3.14] "rad" MCU
 SG_ OBJ_Heading_STD_V_16 : 15631|1@1+ (1,0) [0|1] "bool" MCU
 SG_ OBJ_Angle_Rate_STD_16 : 15632|15@1+ (0.0001,0) [0|2.2318] "RPS" MCU
 SG_ OBJ_Angle_Rate_STD_V_16 : 15647|1@1+ (1,0) [0|1] "bool" MCU
 SG_ OBJ_Angle_Rate_16 : 15648|12@1+ (0.002,-2.234) [-2.234|2.2318] "RPS" MCU
 SG_ OBJ_Angle_Rate_V_16 : 15660|1@1+ (1,0) [0|1] "bool" MCU
 SG_ OBJ_Angle_Right_16 : 15661|14@1+ (0.0002,-1.571) [-1.571|1.571] "rad" MCU
 SG_ OBJ_Angle_Right_V_16 : 15675|1@1+ (1,0) [0|1] "bool" MCU
 SG_ Reserved_16_16 : 15676|4@1+ (1,0) [0|0] "NA" MCU
 SG_ OBJ_Angle_Right_STD_16 : 15680|14@1+ (0.0001,0) [0|1.571] "rad" MCU
 SG_ OBJ_Angle_Right_STD_V_16 : 15694|1@1+ (1,0) [0|1] "bool" MCU
 SG_ OBJ_Angle_Left_16 : 15695|14@1+ (0.0002,-1.571) [-1.571|1.571] "rad" MCU
 SG_ OBJ_Angle_Left_V_16 : 15709|1@1+ (1,0) [0|1] "bool" MCU
 SG_ Reserved_17_16 : 15710|2@1+ (1,0) [0|0] "NA" MCU
 SG_ OBJ_Angle_Left_STD_16 : 15712|14@1+ (0.0001,0) [0|1.571] "rad" MCU
 SG_ OBJ_Angle_Left_STD_V_16 : 15726|1@1+ (1,0) [0|1] "bool" MCU
 SG_ OBJ_Angle_Side_16 : 15727|14@1+ (0.0002,-1.571) [-1.571|1.571] "rad" MCU
 SG_ OBJ_Angle_Side_V_16 : 15741|1@1+ (1,0) [0|1] "bool" MCU
 SG_ Reserved_18_16 : 15742|2@1+ (1,0) [0|0] "NA" MCU
 SG_ OBJ_Angle_Side_STD_16 : 15744|14@1+ (0.0001,0) [0|1.571] "rad" MCU
 SG_ OBJ_Angle_Side_STD_V_16 : 15758|1@1+ (1,0) [0|1] "bool" MCU
 SG_ OBJ_Angle_Mid_V_16 : 15759|1@1+ (1,0) [0|1] "bool" MCU
 SG_ OBJ_Angle_Mid_16 : 15760|14@1+ (0.0002,-1.571) [-1.571|1.571] "rad" MCU
 SG_ Reserved_19_16 : 15774|2@1+ (1,0) [0|0] "NA" MCU
 SG_ OBJ_Angle_Mid_STD_16 : 15776|14@1+ (0.0001,0) [0|1.571] "rad" MCU
 SG_ OBJ_Angle_Mid_STD_V_16 : 15790|1@1+ (1,0) [0|1] "bool" MCU
 SG_ OBJ_Angle_Bottom_V_16 : 15791|1@1+ (1,0) [0|1] "bool" MCU
 SG_ OBJ_Angle_Bottom_16 : 15792|14@1+ (0.0002,-1.571) [-1.571|1.571] "rad" MCU
 SG_ Reserved_20_16 : 15806|2@1+ (1,0) [0|0] "NA" MCU
 SG_ OBJ_Angle_Bottom_STD_16 : 15808|14@1+ (0.0001,0) [0|1.571] "rad" MCU
 SG_ OBJ_Angle_Bottom_STD_V_16 : 15822|1@1+ (1,0) [0|1] "bool" MCU
 SG_ OBJ_Visibility_Side_V_16 : 15823|1@1+ (1,0) [0|1] "bool" MCU
 SG_ OBJ_Visibility_Side_16 : 15824|2@1+ (1,0) [0|2] "ENUM" MCU
 SG_ OBJ_Is_In_Drivable_Area_16 : 15826|1@1+ (1,0) [0|1] "bool" MCU
 SG_ OBJ_Is_In_Drivable_Area_V_16 : 15827|1@1+ (1,0) [0|1] "bool" MCU
 SG_ OBJ_Is_VeryClose_V_16 : 15828|1@1+ (1,0) [0|1] "bool" MCU
 SG_ OBJ_Is_VeryClose_16 : 15829|1@1+ (1,0) [0|1] "bool" MCU
 SG_ OBJ_Buffer_C4_16 : 15830|2@1+ (1,0) [0|2] "NA" MCU
 SG_ OBJ_Buffer_C5_16 : 15832|2@1+ (1,0) [0|2] "NA" MCU
 SG_ OBJ_Buffer_C6_16 : 15834|2@1+ (1,0) [0|2] "NA" MCU
 SG_ OBJ_Buffer_C7_16 : 15836|2@1+ (1,0) [0|2] "NA" MCU
 SG_ Reserved_21_16 : 15838|2@1+ (1,0) [0|0] "NA" MCU
 SG_ OBJ_OverlapAngleEgoLaneR_16 : 15840|10@1+ (0.01,-3.14) [-3.14|3.14] "rad" MCU
 SG_ OBJ_OverlapAngleEgoLaneR_V_16 : 15850|1@1+ (1,0) [0|1] "bool" MCU
 SG_ OBJ_OverlapAngleEgoLaneL_16 : 15851|10@1+ (0.01,-3.14) [-3.14|3.14] "rad" MCU
 SG_ OBJ_OverlapAngleEgoLaneL_V_16 : 15861|1@1+ (1,0) [0|1] "bool" MCU
 SG_ OBJ_Is_EMERGENCY_VCL_16 : 15862|1@1+ (1,0) [0|1] "bool" MCU
 SG_ OBJ_EMERGENCY_LIGHT_COLOR_16 : 15863|4@1+ (1,0) [0|15] "BITWIZE" MCU
 SG_ OBJ_EMERGENCY_V_16 : 15867|1@1+ (1,0) [0|1] "bool" MCU
 SG_ Reserved_22_16 : 15868|4@1+ (1,0) [0|0] "NA" MCU
 SG_ OBJ_Angle_Top_16 : 15872|14@1+ (0.0002,0) [0|3.1415] "rad" MCU
 SG_ OBJ_Angle_Top_V_16 : 15886|1@1+ (1,0) [0|1] "bool" MCU
 SG_ OBJ_Angle_Top_STD_16 : 15887|15@1+ (0.0001,0) [0|3.1415] "rad" MCU
 SG_ OBJ_Angle_Top_STD_V_16 : 15902|1@1+ (1,0) [0|1] "bool" MCU
 SG_ OBJ_Buffer_C14_16 : 15903|1@1+ (1,0) [0|1] "NA" MCU
 SG_ OBJ_Buffer_C15_16 : 15904|1@1+ (1,0) [0|1] "NA" MCU
 SG_ OBJ_Buffer_C18_16 : 15905|2@1+ (1,0) [0|2] "NA" MCU
 SG_ OBJ_Buffer_C19_16 : 15907|1@1+ (1,0) [0|1] "NA" MCU
 SG_ Reserved_23_16 : 15908|28@1+ (1,0) [0|0] "NA" MCU
 SG_ OBJ_CRC_17 : 15936|32@1+ (1,0) [0|4294967295] "NA" MCU
 SG_ OBJ_ID_17 : 15968|8@1+ (1,0) [0|255] "counter" MCU
 SG_ OBJ_Existence_Probability_17 : 15976|8@1+ (0.01,0) [0|1] "NA" MCU
 SG_ OBJ_Fusion_Source_17 : 15984|16@1+ (1,0) [0|65535] "BITWIZE" MCU
 SG_ OBJ_Triggered_SDM_17 : 16000|2@1+ (1,0) [0|2] "ENUM" MCU
 SG_ OBJ_Motion_Category_17 : 16002|4@1+ (1,0) [0|13] "ENUM" MCU
 SG_ OBJ_Buffer_C0_17 : 16006|7@1+ (0.01,0) [0|1] "NA" MCU
 SG_ OBJ_Object_Age_17 : 16013|11@1+ (1,0) [0|2047] "frames" MCU
 SG_ OBJ_Measuring_Status_17 : 16024|3@1+ (1,0) [0|7] "BITWIZE" MCU
 SG_ OBJ_Object_Class_17 : 16027|4@1+ (1,0) [0|8] "ENUM" MCU
 SG_ Reserved_4_17 : 16031|1@1+ (1,0) [0|0] "NA" MCU
 SG_ OBJ_Class_Probability_17 : 16032|7@1+ (0.01,0) [0|1] "NA" MCU
 SG_ OBJ_Car_Probability_17 : 16039|7@1+ (0.01,0) [0|1] "NA" MCU
 SG_ OBJ_Truck_Probability_17 : 16046|7@1+ (0.01,0) [0|1] "NA" MCU
 SG_ OBJ_Bike_Probability_17 : 16053|7@1+ (0.01,0) [0|1] "NA" MCU
 SG_ OBJ_Camera_Source_17 : 16060|4@1+ (1,0) [0|15] "ENUM" MCU
 SG_ OBJ_Motion_Status_17 : 16064|3@1+ (1,0) [0|5] "ENUM" MCU
 SG_ OBJ_Motion_Orientation_17 : 16067|4@1+ (1,0) [0|13] "ENUM" MCU
 SG_ OBJ_Has_Cut_Lane_17 : 16071|1@1+ (1,0) [0|1] "bool" MCU
 SG_ OBJ_Has_Cut_Path_17 : 16072|1@1+ (1,0) [0|1] "bool" MCU
 SG_ OBJ_Brake_Light_17 : 16073|1@1+ (1,0) [0|1] "bool" MCU
 SG_ OBJ_Turn_Indicator_Right_17 : 16074|1@1+ (1,0) [0|1] "bool" MCU
 SG_ OBJ_Turn_Indicator_Left_17 : 16075|1@1+ (1,0) [0|1] "bool" MCU
 SG_ OBJ_Light_Indicator_Validity_17 : 16076|1@1+ (1,0) [0|1] "bool" MCU
 SG_ OBJ_Right_Out_Of_Image_17 : 16077|1@1+ (1,0) [0|1] "bool" MCU
 SG_ OBJ_Left_Out_Of_Image_17 : 16078|1@1+ (1,0) [0|1] "bool" MCU
 SG_ OBJ_Right_Out_Of_Image_V_17 : 16079|1@1+ (1,0) [0|1] "bool" MCU
 SG_ OBJ_Left_Out_Of_Image_V_17 : 16080|1@1+ (1,0) [0|1] "bool" MCU
 SG_ OBJ_Top_Out_Of_Image_17 : 16081|1@1+ (1,0) [0|1] "bool" MCU
 SG_ OBJ_Bottom_Out_Of_Image_17 : 16082|1@1+ (1,0) [0|1] "bool" MCU
 SG_ OBJ_Top_Out_Of_Image_V_17 : 16083|1@1+ (1,0) [0|1] "bool" MCU
 SG_ OBJ_Bottom_Out_Of_Image_V_17 : 16084|1@1+ (1,0) [0|1] "bool" MCU
 SG_ OBJ_Lane_Assignment_17 : 16085|3@1+ (1,0) [0|5] "ENUM" MCU
 SG_ OBJ_Lane_Assignment_V_17 : 16088|1@1+ (1,0) [0|1] "bool" MCU
 SG_ OBJ_Age_Seconds_17 : 16089|7@1+ (1,0) [0|100] "s" MCU
 SG_ OBJ_Age_Seconds_V_17 : 16096|1@1+ (1,0) [0|1] "bool" MCU
 SG_ OBJ_Width_17 : 16097|9@1+ (0.01,0) [0.4|2.95] "m" MCU
 SG_ OBJ_Width_V_17 : 16106|1@1+ (1,0) [0|1] "bool" MCU
 SG_ OBJ_Width_STD_17 : 16107|11@1+ (0.001,0) [0|2] "m" MCU
 SG_ OBJ_Width_STD_V_17 : 16118|1@1+ (1,0) [0|1] "bool" MCU
 SG_ OBJ_Length_17 : 16119|9@1+ (0.05,0) [1.2|21] "m" MCU
 SG_ OBJ_Length_V_17 : 16128|1@1+ (1,0) [0|1] "bool" MCU
 SG_ OBJ_Length_STD_17 : 16129|10@1+ (0.01,0) [0|10] "m" MCU
 SG_ OBJ_Length_STD_V_17 : 16139|1@1+ (1,0) [0|1] "bool" MCU
 SG_ OBJ_Radar_ID_17 : 16140|8@1+ (1,0) [0|255] "counter" MCU
 SG_ OBJ_Height_17 : 16148|9@1+ (0.01,0) [0|2.95] "m" MCU
 SG_ OBJ_Height_V_17 : 16157|1@1+ (1,0) [0|1] "bool" MCU
 SG_ Reserved_5_17 : 16158|2@1+ (1,0) [0|0] "NA" MCU
 SG_ OBJ_Height_STD_17 : 16160|11@1+ (0.001,0) [0|2] "m" MCU
 SG_ OBJ_Height_STD_V_17 : 16171|1@1+ (1,0) [0|1] "bool" MCU
 SG_ OBJ_Abs_Long_Velocity_17 : 16172|12@1+ (0.05,-100) [-100|100] "m_per_s" MCU
 SG_ OBJ_Abs_Long_Velocity_V_17 : 16184|1@1+ (1,0) [0|1] "bool" MCU
 SG_ Reserved_6_17 : 16185|7@1+ (1,0) [0|0] "NA" MCU
 SG_ OBJ_Abs_Long_Velocity_STD_17 : 16192|13@1+ (0.01,0) [0|65] "m_per_s" MCU
 SG_ OBJ_Abs_Long_Vel_STD_V_17 : 16205|1@1+ (1,0) [0|1] "bool" MCU
 SG_ OBJ_Abs_Lat_Velocity_17 : 16206|11@1+ (0.05,-50) [-50|50] "m_per_s" MCU

CM_ SG_ 154 OBJ_Lat_Distance_11 "Lateral distance to the middle of the RL and RR corners.  ";
CM_ SG_ 154 OBJ_Lat_Distance_V_11 "Validator for the lateral distance of the object.";
CM_ SG_ 154 OBJ_Lat_Distance_STD_11 "STD of the lateral distance of the object.";
CM_ SG_ 154 OBJ_Lat_Distance_STD_V_11 "Validator for the STD of the lateral distance of the object.";
CM_ SG_ 154 OBJ_Absolute_Speed_11 "The absolute ground speed in the targets' heading direction.";
CM_ SG_ 154 OBJ_Absolute_Speed_V_11 "Validator for the absolute ground speed.";
CM_ SG_ 154 OBJ_Absolute_Speed_STD_11 "STD of the absolute ground speed.";
CM_ SG_ 154 OBJ_Absolute_Speed_STD_V_11 "Validator for the STD of the absolute ground speed.";
CM_ SG_ 154 OBJ_Heading_11 "The angle beetweenthe host longitudinal axis and target's heading (clockwise, e.g. PI/2 is a target crossing from left to right).";
CM_ SG_ 154 OBJ_Heading_V_11 "Validator for the object heading.";
CM_ SG_ 154 OBJ_Heading_STD_11 "STD of the object heading.";
CM_ SG_ 154 OBJ_Heading_STD_V_11 "Validator for the STD of the object heading.";
CM_ SG_ 154 OBJ_Angle_Rate_STD_11 "Standard deviation of the angular speed. (radians)";
CM_ SG_ 154 OBJ_Angle_Rate_STD_V_11 "Validator for the STD of the angular speed.";
CM_ SG_ 154 OBJ_Angle_Rate_11 "The momentary angular speed of the object. (radians)";
CM_ SG_ 154 OBJ_Angle_Rate_V_11 "Validator for the angular speed.";
CM_ SG_ 154 OBJ_Angle_Right_11 "The angle between the host longitudinal axis and the right side of the front / rear of the target (the visible one). The positive side is to the host's right.";
CM_ SG_ 154 OBJ_Angle_Right_V_11 "Validator for angleRight";
CM_ SG_ 154 OBJ_Angle_Right_STD_11 "Standard deviation of angleRight";
CM_ SG_ 154 OBJ_Angle_Right_STD_V_11 "Validator for the standard deviation of angleRight.";
CM_ SG_ 154 OBJ_Angle_Left_11 "The angle between the host longitudinal axis and the left side of the front / rear of the target (the visible one). The positive side is to the host's right.";
CM_ SG_ 154 OBJ_Angle_Left_V_11 "Validator for angleLeft.";
CM_ SG_ 154 OBJ_Angle_Left_STD_11 "Standard deviation of angleLeft.";
CM_ SG_ 154 OBJ_Angle_Left_STD_V_11 "Validator for the standard deviation of angleLeft.";
CM_ SG_ 154 OBJ_Angle_Side_11 "The angle between the host longitudinal axis and the far visible edge - the visible edge of the front / rear of the target that is not visible. Currently supported for vehicles only.";
CM_ SG_ 154 OBJ_Angle_Side_V_11 "Validator for angleSide.";
CM_ SG_ 154 OBJ_Angle_Side_STD_11 "Standard deviation of angleSide.";
CM_ SG_ 154 OBJ_Angle_Side_STD_V_11 "Validator for the STD of angleSide.";
CM_ SG_ 154 OBJ_Angle_Mid_V_11 "Validator for angleMid.";
CM_ SG_ 154 OBJ_Angle_Mid_11 "The angle between the host longitudinal axis and the middle of the front / rear of the target (the visible one). The positive side is to the host's right.";
CM_ SG_ 154 OBJ_Angle_Mid_STD_11 "Standard deviation of angleMid.";
CM_ SG_ 154 OBJ_Angle_Mid_STD_V_11 "Validator for the STD of angleMid.";
CM_ SG_ 154 OBJ_Angle_Bottom_V_11 "Validator for OBJAngle_Bottom. ";
CM_ SG_ 154 OBJ_Angle_Bottom_11 "The angle between the longitudinal axis and the Bottom of the front / rear of the target (the visible one). The positive side is to the host's bottom";
CM_ SG_ 154 OBJ_Angle_Bottom_STD_11 "STD for OBJAngle_Bottom. ";
CM_ SG_ 154 OBJ_Angle_Bottom_STD_V_11 "Validator for OBJAngle_Bottom_STD. ";
CM_ SG_ 154 OBJ_Visibility_Side_V_11 "Currently Supported for VD only";
CM_ SG_ 154 OBJ_Visibility_Side_11 "From what car  side is the object visible";
CM_ SG_ 154 OBJ_Is_In_Drivable_Area_11 "Indicates whether the target is in a driveable area.";
CM_ SG_ 154 OBJ_Is_In_Drivable_Area_V_11 "Validator for OBJ_Is_In_Drivable_Area.";
CM_ SG_ 154 OBJ_Is_VeryClose_V_11 "Validator for OBJ_Is_VeryClose. ";
CM_ SG_ 154 OBJ_Is_VeryClose_11 "Indicates whether the target is very close to the host such that it is hard to measure its distance. Currently relevant for peds only";
CM_ SG_ 154 OBJ_OverlapAngleEgoLaneR_11 "Lateral distance to the middle of the RL and RR corners.";
CM_ SG_ 154 OBJ_OverlapAngleEgoLaneR_V_11 "Validator for OBJ_OverlapAngleEgoLaneR";
CM_ SG_ 154 OBJ_OverlapAngleEgoLaneL_11 "Lateral distance to the middle of the RL and RR corners.  ";
CM_ SG_ 154 OBJ_OverlapAngleEgoLaneL_V_11 "Validator for OBJ_OverlapAngleEgoLaneL";
CM_ SG_ 154 OBJ_Is_EMERGENCY_VCL_11 "Is Object an Emergency Vehicle";
CM_ SG_ 154 OBJ_EMERGENCY_LIGHT_COLOR_11 "Emergency Color";
CM_ SG_ 154 OBJ_EMERGENCY_V_11 "Are OBJ_Is_EMERGENCY_VCL and OBJ_EMERGENCY_LIGHT_COLOR Valid";
CM_ SG_ 154 OBJ_Angle_Top_11 "From VD touching point on the ground till the roof of the car";
CM_ SG_ 154 OBJ_Angle_Top_V_11 "Validator for OBJ_Angle_Top ";
CM_ SG_ 154 OBJ_Angle_Top_STD_11 "STD for OBJ_Angle_Top";
CM_ SG_ 154 OBJ_Angle_Top_STD_V_11 "Validator for OBJ_Angle_Top_STD. ";
CM_ SG_ 154 OBJ_CRC_12 "Calculated over all element signals. From the signal after the CRC until the first signal in the next elements OBJ_CRC_N+1  not including";
CM_ SG_ 154 OBJ_ID_12 "The detected object ID. Range is 1-255, while 0 indicates that the field in unfilled.";
CM_ SG_ 154 OBJ_Existence_Probability_12 "The existence probability of the reported object";
CM_ SG_ 154 OBJ_Fusion_Source_12 "sources ids used for fusion";
CM_ SG_ 154 OBJ_Triggered_SDM_12 "Indicates whether the object has trigered the SDM (Safety Diagnostic Manager) alert.";
CM_ SG_ 154 OBJ_Motion_Category_12 "Relevant for VD only. Full description of values can be found at the ACC guide.";
CM_ SG_ 154 OBJ_Object_Age_12 "The number of frames in which the object was recognized.";
CM_ SG_ 154 OBJ_Measuring_Status_12 "Measurment status. Old vs New marks if this is the first frame in which the object is reported. Predicted vs Measured marks if the report is raw or has been predicted forward in time using the measured dynamics and ego motion.";
CM_ SG_ 154 OBJ_Object_Class_12 "Indicates the object type. Uncertain is outputted in case the probability that a vehicle is a truck is very similar to the probability that it is a car. ";
CM_ SG_ 154 OBJ_Class_Probability_12 "The probability of this type classification.";
CM_ SG_ 154 OBJ_Car_Probability_12 "The probability the object is a car";
CM_ SG_ 154 OBJ_Truck_Probability_12 "The probability the object is a Truck";
CM_ SG_ 154 OBJ_Bike_Probability_12 "The probability the object is a Bike";
CM_ SG_ 154 OBJ_Camera_Source_12 "The camera in which this object was detected (best choice).";
CM_ SG_ 154 OBJ_Motion_Status_12 "MOVING - the object is moving STATIONARY - the object was never seen moving STOPPED -  the object was moving and has stopped MOVING_SLOWLY - the object is moving very slowly";
CM_ SG_ 154 OBJ_Motion_Orientation_12 "The direction of the targets heading compared to the host. ";
CM_ SG_ 154 OBJ_Has_Cut_Lane_12 "Indicates whether the object cut the host's (right or left) lane. In case there are no lanes, indicates whether the objects is at most 1 meters away from the host.";
CM_ SG_ 154 OBJ_Has_Cut_Path_12 "Indicates whether the object is in the host's path.";
CM_ SG_ 154 OBJ_Brake_Light_12 "Indication for brake lights ";
CM_ SG_ 154 OBJ_Turn_Indicator_Right_12 "Indication for blinking right light.";
CM_ SG_ 154 OBJ_Turn_Indicator_Left_12 "Indication for blinking left light ";
CM_ SG_ 154 OBJ_Light_Indicator_Validity_12 "Validator for light indicators";
CM_ SG_ 154 OBJ_Right_Out_Of_Image_12 "Indicates whether the measurment are predicted out of the right side of the image bounderies.";
CM_ SG_ 154 OBJ_Left_Out_Of_Image_12 "Indicates whether if measurment are predicted out of  the left side of the image bounderies";
CM_ SG_ 154 OBJ_Right_Out_Of_Image_V_12 "validator";
CM_ SG_ 154 OBJ_Left_Out_Of_Image_V_12 "validator";
CM_ SG_ 154 OBJ_Top_Out_Of_Image_12 "Indicates whether if measurment are predicted out of  the top of the image bounderies";
CM_ SG_ 154 OBJ_Bottom_Out_Of_Image_12 "Indicates whether if measurment are predicted out of  the bottom of the image bounderies";
CM_ SG_ 154 OBJ_Top_Out_Of_Image_V_12 "validator";
CM_ SG_ 154 OBJ_Bottom_Out_Of_Image_V_12 "validator";
CM_ SG_ 154 OBJ_Lane_Assignment_12 "The object's lane relative to the host lane.";
CM_ SG_ 154 OBJ_Lane_Assignment_V_12 "Validator for lane assignment";
CM_ SG_ 154 OBJ_Age_Seconds_12 "Time in seconds in which the object was recognized. ";
CM_ SG_ 154 OBJ_Age_Seconds_V_12 "Validator for object age";
CM_ SG_ 154 OBJ_Width_12 "The width of the target vehicle in the world (not to be mistaken with the width of the visible part of the vehicle).";
CM_ SG_ 154 OBJ_Width_V_12 "Validator for object width";
CM_ SG_ 154 OBJ_Width_STD_12 "Standard deviation for object width";
CM_ SG_ 154 OBJ_Width_STD_V_12 "Validator for the standard deviation of object width";
CM_ SG_ 154 OBJ_Length_12 "The length of the vehicle in the world. For crossing bicycles it gives the viewed length of the bicycle.";
CM_ SG_ 154 OBJ_Length_V_12 "Validator for object length.";
CM_ SG_ 154 OBJ_Length_STD_12 "Standard deviation for object length.";
CM_ SG_ 154 OBJ_Length_STD_V_12 "Validator for the standard deviation of object length.";
CM_ SG_ 154 OBJ_Radar_ID_12 "Radar Object ID of the Fused Object, Only relvant when OBJ_Fusion_Source is not Camera only";
CM_ SG_ 154 OBJ_Height_12 "The height of the object in the world. ";
CM_ SG_ 154 OBJ_Height_V_12 "Validator for object height.";
CM_ SG_ 154 OBJ_Height_STD_12 "Standard deviation for object height.";
CM_ SG_ 154 OBJ_Height_STD_V_12 "Validator for the standard deviation of object height.";
CM_ SG_ 154 OBJ_Abs_Long_Velocity_12 "Absolute longitudinal velocity.";
CM_ SG_ 154 OBJ_Abs_Long_Velocity_V_12 "Validator for absolute longitudinal velocity.";
CM_ SG_ 154 OBJ_Abs_Long_Velocity_STD_12 "Standard deviation of absolute longitudinal velocity.";
CM_ SG_ 154 OBJ_Abs_Long_Vel_STD_V_12 "Validator for the standard deviation of the absolute longitudinal velocity.";
CM_ SG_ 154 OBJ_Abs_Lat_Velocity_12 "The lateral ground speed of the object.";
CM_ SG_ 154 OBJ_Abs_Lat_Velocity_V_12 "Validator for the lateral ground speed of the object.";
CM_ SG_ 154 OBJ_Abs_Lat_Velocity_STD_12 "STD of the lateral ground speed of the object.";
CM_ SG_ 154 OBJ_Abs_Lat_Vel_STD_V_12 "Validator for the STD of the lateral ground speed of the object.";
CM_ SG_ 154 OBJ_Abs_Long_Acc_12 "The longitudinal ground acceleration of the object.";
CM_ SG_ 154 OBJ_Abs_Long_Acc_V_12 "Validator for the longitudinal ground acceleration of the object.";
CM_ SG_ 154 OBJ_Abs_Long_Acc_STD_12 "STD of the longitudinal ground acceleration of the object.";
CM_ SG_ 154 OBJ_Abs_Long_Acc_STD_V_12 "Validator for the STD of the longitudinal ground acceleration of the object.";
CM_ SG_ 154 OBJ_Abs_Lat_Acc_12 "The lateral ground acceleration of the object.";
CM_ SG_ 154 OBJ_Abs_Lat_Acc_V_12 "Validator for the lateral ground acceleration of the object.";
CM_ SG_ 154 OBJ_Abs_Lat_Acc_STD_12 "STD of the lateral ground acceleration of the object.";
CM_ SG_ 154 OBJ_Abs_Lat_Acc_STD_V_12 "Validator for the STD of the lateral ground acceleration of the object.";
CM_ SG_ 154 OBJ_Abs_Acceleration_12 "The absolute ground acceleration in the target's heading direction.";
CM_ SG_ 154 OBJ_Abs_Acceleration_V_12 "Validator for the absolute ground acceleration.";
CM_ SG_ 154 OBJ_Abs_Acc_STD_12 "STD of the absolute ground acceleration.";
CM_ SG_ 154 OBJ_Abs_Acc_STD_V_12 "Validator for the STD of the absolute ground acceleration.";
CM_ SG_ 154 OBJ_Inv_TTC_12 "Inverse TTC (time to collision).";
CM_ SG_ 154 OBJ_Inv_TTC_STD_12 "STD for inverse TTC .";
CM_ SG_ 154 OBJ_Inv_TTC_STD_V_12 "Validator for the STD for inverse TTC .";
CM_ SG_ 154 OBJ_Relative_Long_Acc_12 "The relative lateral ground acceleration of the object.";
CM_ SG_ 154 OBJ_Relative_Long_Acc_V_12 "Validator for the relative lateral ground acceleration of the object.";
CM_ SG_ 154 OBJ_Relative_Long_Acc_STD_12 "STD of the relative lateral ground acceleration of the object.";
CM_ SG_ 154 OBJ_Rel_Long_Acc_STD_V_12 "Validator for the STD of the relative lateral ground acceleration.";
CM_ SG_ 154 OBJ_Relative_Long_Velocity_12 "The relative longtitudinal speed between the target and ego vehicle. ";
CM_ SG_ 154 OBJ_Relative_Long_Velocity_V_12 "Validator for the relative longtitudinal speed.";
CM_ SG_ 154 OBJ_Relative_Long_Vel_STD_12 "STD of the relative longtitudinal speed.";
CM_ SG_ 154 OBJ_Rel_Long_Vel_STD_V_12 "Validator for the STD of the relative longtitudinal speed.";
CM_ SG_ 154 OBJ_Relative_Lat_Velocity_12 "The relative lateral speed between the target and ego vehicle. ";
CM_ SG_ 154 OBJ_Relative_Lat_Velocity_V_12 "Validator for the relative lateral speed. ";
CM_ SG_ 154 OBJ_Relative_Lat_Velocity_STD_12 "STD of the relative lateral speed. ";
CM_ SG_ 154 OBJ_Rel_Lat_Vel_STD_V_12 "Validator for the STD of the relative lateral speed. ";
CM_ SG_ 154 OBJ_Long_Distance_12 "The longitudinal distance to middle of the rear bumper (middle of the RL and RR corners) of the target.";
CM_ SG_ 154 OBJ_Long_Distance_V_12 "Validator of the longtitudinal distance field";
CM_ SG_ 154 OBJ_Long_Distance_STD_12 "STD of the  longtitudinal distance.";
CM_ SG_ 154 OBJ_Long_Distance_STD_V_12 "Validator for the STD of the  longtitudinal distance.";
CM_ SG_ 154 OBJ_Lat_Distance_12 "Lateral distance to the middle of the RL and RR corners.  ";
CM_ SG_ 154 OBJ_Lat_Distance_V_12 "Validator for the lateral distance of the object.";
CM_ SG_ 154 OBJ_Lat_Distance_STD_12 "STD of the lateral distance of the object.";
CM_ SG_ 154 OBJ_Lat_Distance_STD_V_12 "Validator for the STD of the lateral distance of the object.";
CM_ SG_ 154 OBJ_Absolute_Speed_12 "The absolute ground speed in the targets' heading direction.";
CM_ SG_ 154 OBJ_Absolute_Speed_V_12 "Validator for the absolute ground speed.";
CM_ SG_ 154 OBJ_Absolute_Speed_STD_12 "STD of the absolute ground speed.";
CM_ SG_ 154 OBJ_Absolute_Speed_STD_V_12 "Validator for the STD of the absolute ground speed.";
CM_ SG_ 154 OBJ_Heading_12 "The angle beetweenthe host longitudinal axis and target's heading (clockwise, e.g. PI/2 is a target crossing from left to right).";
CM_ SG_ 154 OBJ_Heading_V_12 "Validator for the object heading.";
CM_ SG_ 154 OBJ_Heading_STD_12 "STD of the object heading.";
CM_ SG_ 154 OBJ_Heading_STD_V_12 "Validator for the STD of the object heading.";
CM_ SG_ 154 OBJ_Angle_Rate_STD_12 "Standard deviation of the angular speed. (radians)";
CM_ SG_ 154 OBJ_Angle_Rate_STD_V_12 "Validator for the STD of the angular speed.";
CM_ SG_ 154 OBJ_Angle_Rate_12 "The momentary angular speed of the object. (radians)";
CM_ SG_ 154 OBJ_Angle_Rate_V_12 "Validator for the angular speed.";
CM_ SG_ 154 OBJ_Angle_Right_12 "The angle between the host longitudinal axis and the right side of the front / rear of the target (the visible one). The positive side is to the host's right.";
CM_ SG_ 154 OBJ_Angle_Right_V_12 "Validator for angleRight";
CM_ SG_ 154 OBJ_Angle_Right_STD_12 "Standard deviation of angleRight";
CM_ SG_ 154 OBJ_Angle_Right_STD_V_12 "Validator for the standard deviation of angleRight.";
CM_ SG_ 154 OBJ_Angle_Left_12 "The angle between the host longitudinal axis and the left side of the front / rear of the target (the visible one). The positive side is to the host's right.";
CM_ SG_ 154 OBJ_Angle_Left_V_12 "Validator for angleLeft.";
CM_ SG_ 154 OBJ_Angle_Left_STD_12 "Standard deviation of angleLeft.";
CM_ SG_ 154 OBJ_Angle_Left_STD_V_12 "Validator for the standard deviation of angleLeft.";
CM_ SG_ 154 OBJ_Angle_Side_12 "The angle between the host longitudinal axis and the far visible edge - the visible edge of the front / rear of the target that is not visible. Currently supported for vehicles only.";
CM_ SG_ 154 OBJ_Angle_Side_V_12 "Validator for angleSide.";
CM_ SG_ 154 OBJ_Angle_Side_STD_12 "Standard deviation of angleSide.";
CM_ SG_ 154 OBJ_Angle_Side_STD_V_12 "Validator for the STD of angleSide.";
CM_ SG_ 154 OBJ_Angle_Mid_V_12 "Validator for angleMid.";
CM_ SG_ 154 OBJ_Angle_Mid_12 "The angle between the host longitudinal axis and the middle of the front / rear of the target (the visible one). The positive side is to the host's right.";
CM_ SG_ 154 OBJ_Angle_Mid_STD_12 "Standard deviation of angleMid.";
CM_ SG_ 154 OBJ_Angle_Mid_STD_V_12 "Validator for the STD of angleMid.";
CM_ SG_ 154 OBJ_Angle_Bottom_V_12 "Validator for OBJAngle_Bottom. ";
CM_ SG_ 154 OBJ_Angle_Bottom_12 "The angle between the longitudinal axis and the Bottom of the front / rear of the target (the visible one). The positive side is to the host's bottom";
CM_ SG_ 154 OBJ_Angle_Bottom_STD_12 "STD for OBJAngle_Bottom. ";
CM_ SG_ 154 OBJ_Angle_Bottom_STD_V_12 "Validator for OBJAngle_Bottom_STD. ";
CM_ SG_ 154 OBJ_Visibility_Side_V_12 "Currently Supported for VD only";
CM_ SG_ 154 OBJ_Visibility_Side_12 "From what car  side is the object visible";
CM_ SG_ 154 OBJ_Is_In_Drivable_Area_12 "Indicates whether the target is in a driveable area.";
CM_ SG_ 154 OBJ_Is_In_Drivable_Area_V_12 "Validator for OBJ_Is_In_Drivable_Area.";
CM_ SG_ 154 OBJ_Is_VeryClose_V_12 "Validator for OBJ_Is_VeryClose. ";
CM_ SG_ 154 OBJ_Is_VeryClose_12 "Indicates whether the target is very close to the host such that it is hard to measure its distance. Currently relevant for peds only";
CM_ SG_ 154 OBJ_OverlapAngleEgoLaneR_12 "Lateral distance to the middle of the RL and RR corners.";
CM_ SG_ 154 OBJ_OverlapAngleEgoLaneR_V_12 "Validator for OBJ_OverlapAngleEgoLaneR";
CM_ SG_ 154 OBJ_OverlapAngleEgoLaneL_12 "Lateral distance to the middle of the RL and RR corners.  ";
CM_ SG_ 154 OBJ_OverlapAngleEgoLaneL_V_12 "Validator for OBJ_OverlapAngleEgoLaneL";
CM_ SG_ 154 OBJ_Is_EMERGENCY_VCL_12 "Is Object an Emergency Vehicle";
CM_ SG_ 154 OBJ_EMERGENCY_LIGHT_COLOR_12 "Emergency Color";
CM_ SG_ 154 OBJ_EMERGENCY_V_12 "Are OBJ_Is_EMERGENCY_VCL and OBJ_EMERGENCY_LIGHT_COLOR Valid";
CM_ SG_ 154 OBJ_Angle_Top_12 "From VD touching point on the ground till the roof of the car";
CM_ SG_ 154 OBJ_Angle_Top_V_12 "Validator for OBJ_Angle_Top ";
CM_ SG_ 154 OBJ_Angle_Top_STD_12 "STD for OBJ_Angle_Top";
CM_ SG_ 154 OBJ_Angle_Top_STD_V_12 "Validator for OBJ_Angle_Top_STD. ";
CM_ SG_ 154 OBJ_CRC_13 "Calculated over all element signals. From the signal after the CRC until the first signal in the next elements OBJ_CRC_N+1  not including";
CM_ SG_ 154 OBJ_ID_13 "The detected object ID. Range is 1-255, while 0 indicates that the field in unfilled.";
CM_ SG_ 154 OBJ_Existence_Probability_13 "The existence probability of the reported object";
CM_ SG_ 154 OBJ_Fusion_Source_13 "sources ids used for fusion";
CM_ SG_ 154 OBJ_Triggered_SDM_13 "Indicates whether the object has trigered the SDM (Safety Diagnostic Manager) alert.";
CM_ SG_ 154 OBJ_Motion_Category_13 "Relevant for VD only. Full description of values can be found at the ACC guide.";
CM_ SG_ 154 OBJ_Object_Age_13 "The number of frames in which the object was recognized.";
CM_ SG_ 154 OBJ_Measuring_Status_13 "Measurment status. Old vs New marks if this is the first frame in which the object is reported. Predicted vs Measured marks if the report is raw or has been predicted forward in time using the measured dynamics and ego motion.";
CM_ SG_ 154 OBJ_Object_Class_13 "Indicates the object type. Uncertain is outputted in case the probability that a vehicle is a truck is very similar to the probability that it is a car. ";
CM_ SG_ 154 OBJ_Class_Probability_13 "The probability of this type classification.";
CM_ SG_ 154 OBJ_Car_Probability_13 "The probability the object is a car";
CM_ SG_ 154 OBJ_Truck_Probability_13 "The probability the object is a Truck";
CM_ SG_ 154 OBJ_Bike_Probability_13 "The probability the object is a Bike";
CM_ SG_ 154 OBJ_Camera_Source_13 "The camera in which this object was detected (best choice).";
CM_ SG_ 154 OBJ_Motion_Status_13 "MOVING - the object is moving STATIONARY - the object was never seen moving STOPPED -  the object was moving and has stopped MOVING_SLOWLY - the object is moving very slowly";
CM_ SG_ 154 OBJ_Motion_Orientation_13 "The direction of the targets heading compared to the host. ";
CM_ SG_ 154 OBJ_Has_Cut_Lane_13 "Indicates whether the object cut the host's (right or left) lane. In case there are no lanes, indicates whether the objects is at most 1 meters away from the host.";
CM_ SG_ 154 OBJ_Has_Cut_Path_13 "Indicates whether the object is in the host's path.";
CM_ SG_ 154 OBJ_Brake_Light_13 "Indication for brake lights ";
CM_ SG_ 154 OBJ_Turn_Indicator_Right_13 "Indication for blinking right light.";
CM_ SG_ 154 OBJ_Turn_Indicator_Left_13 "Indication for blinking left light ";
CM_ SG_ 154 OBJ_Light_Indicator_Validity_13 "Validator for light indicators";
CM_ SG_ 154 OBJ_Right_Out_Of_Image_13 "Indicates whether the measurment are predicted out of the right side of the image bounderies.";
CM_ SG_ 154 OBJ_Left_Out_Of_Image_13 "Indicates whether if measurment are predicted out of  the left side of the image bounderies";
CM_ SG_ 154 OBJ_Right_Out_Of_Image_V_13 "validator";
CM_ SG_ 154 OBJ_Left_Out_Of_Image_V_13 "validator";
CM_ SG_ 154 OBJ_Top_Out_Of_Image_13 "Indicates whether if measurment are predicted out of  the top of the image bounderies";
CM_ SG_ 154 OBJ_Bottom_Out_Of_Image_13 "Indicates whether if measurment are predicted out of  the bottom of the image bounderies";
CM_ SG_ 154 OBJ_Top_Out_Of_Image_V_13 "validator";
CM_ SG_ 154 OBJ_Bottom_Out_Of_Image_V_13 "validator";
CM_ SG_ 154 OBJ_Lane_Assignment_13 "The object's lane relative to the host lane.";
CM_ SG_ 154 OBJ_Lane_Assignment_V_13 "Validator for lane assignment";
CM_ SG_ 154 OBJ_Age_Seconds_13 "Time in seconds in which the object was recognized. ";
CM_ SG_ 154 OBJ_Age_Seconds_V_13 "Validator for object age";
CM_ SG_ 154 OBJ_Width_13 "The width of the target vehicle in the world (not to be mistaken with the width of the visible part of the vehicle).";
CM_ SG_ 154 OBJ_Width_V_13 "Validator for object width";
CM_ SG_ 154 OBJ_Width_STD_13 "Standard deviation for object width";
CM_ SG_ 154 OBJ_Width_STD_V_13 "Validator for the standard deviation of object width";
CM_ SG_ 154 OBJ_Length_13 "The length of the vehicle in the world. For crossing bicycles it gives the viewed length of the bicycle.";
CM_ SG_ 154 OBJ_Length_V_13 "Validator for object length.";
CM_ SG_ 154 OBJ_Length_STD_13 "Standard deviation for object length.";
CM_ SG_ 154 OBJ_Length_STD_V_13 "Validator for the standard deviation of object length.";
CM_ SG_ 154 OBJ_Radar_ID_13 "Radar Object ID of the Fused Object, Only relvant when OBJ_Fusion_Source is not Camera only";
CM_ SG_ 154 OBJ_Height_13 "The height of the object in the world. ";
CM_ SG_ 154 OBJ_Height_V_13 "Validator for object height.";
CM_ SG_ 154 OBJ_Height_STD_13 "Standard deviation for object height.";
CM_ SG_ 154 OBJ_Height_STD_V_13 "Validator for the standard deviation of object height.";
CM_ SG_ 154 OBJ_Abs_Long_Velocity_13 "Absolute longitudinal velocity.";
CM_ SG_ 154 OBJ_Abs_Long_Velocity_V_13 "Validator for absolute longitudinal velocity.";
CM_ SG_ 154 OBJ_Abs_Long_Velocity_STD_13 "Standard deviation of absolute longitudinal velocity.";
CM_ SG_ 154 OBJ_Abs_Long_Vel_STD_V_13 "Validator for the standard deviation of the absolute longitudinal velocity.";
CM_ SG_ 154 OBJ_Abs_Lat_Velocity_13 "The lateral ground speed of the object.";
CM_ SG_ 154 OBJ_Abs_Lat_Velocity_V_13 "Validator for the lateral ground speed of the object.";
CM_ SG_ 154 OBJ_Abs_Lat_Velocity_STD_13 "STD of the lateral ground speed of the object.";
CM_ SG_ 154 OBJ_Abs_Lat_Vel_STD_V_13 "Validator for the STD of the lateral ground speed of the object.";
CM_ SG_ 154 OBJ_Abs_Long_Acc_13 "The longitudinal ground acceleration of the object.";
CM_ SG_ 154 OBJ_Abs_Long_Acc_V_13 "Validator for the longitudinal ground acceleration of the object.";
CM_ SG_ 154 OBJ_Abs_Long_Acc_STD_13 "STD of the longitudinal ground acceleration of the object.";
CM_ SG_ 154 OBJ_Abs_Long_Acc_STD_V_13 "Validator for the STD of the longitudinal ground acceleration of the object.";
CM_ SG_ 154 OBJ_Abs_Lat_Acc_13 "The lateral ground acceleration of the object.";
CM_ SG_ 154 OBJ_Abs_Lat_Acc_V_13 "Validator for the lateral ground acceleration of the object.";
CM_ SG_ 154 OBJ_Abs_Lat_Acc_STD_13 "STD of the lateral ground acceleration of the object.";
CM_ SG_ 154 OBJ_Abs_Lat_Acc_STD_V_13 "Validator for the STD of the lateral ground acceleration of the object.";
CM_ SG_ 154 OBJ_Abs_Acceleration_13 "The absolute ground acceleration in the target's heading direction.";
CM_ SG_ 154 OBJ_Abs_Acceleration_V_13 "Validator for the absolute ground acceleration.";
CM_ SG_ 154 OBJ_Abs_Acc_STD_13 "STD of the absolute ground acceleration.";
CM_ SG_ 154 OBJ_Abs_Acc_STD_V_13 "Validator for the STD of the absolute ground acceleration.";
CM_ SG_ 154 OBJ_Inv_TTC_13 "Inverse TTC (time to collision).";
CM_ SG_ 154 OBJ_Inv_TTC_STD_13 "STD for inverse TTC .";
CM_ SG_ 154 OBJ_Inv_TTC_STD_V_13 "Validator for the STD for inverse TTC .";
CM_ SG_ 154 OBJ_Relative_Long_Acc_13 "The relative lateral ground acceleration of the object.";
CM_ SG_ 154 OBJ_Relative_Long_Acc_V_13 "Validator for the relative lateral ground acceleration of the object.";
CM_ SG_ 154 OBJ_Relative_Long_Acc_STD_13 "STD of the relative lateral ground acceleration of the object.";
CM_ SG_ 154 OBJ_Rel_Long_Acc_STD_V_13 "Validator for the STD of the relative lateral ground acceleration.";
CM_ SG_ 154 OBJ_Relative_Long_Velocity_13 "The relative longtitudinal speed between the target and ego vehicle. ";
CM_ SG_ 154 OBJ_Relative_Long_Velocity_V_13 "Validator for the relative longtitudinal speed.";
CM_ SG_ 154 OBJ_Relative_Long_Vel_STD_13 "STD of the relative longtitudinal speed.";
CM_ SG_ 154 OBJ_Rel_Long_Vel_STD_V_13 "Validator for the STD of the relative longtitudinal speed.";
CM_ SG_ 154 OBJ_Relative_Lat_Velocity_13 "The relative lateral speed between the target and ego vehicle. ";
CM_ SG_ 154 OBJ_Relative_Lat_Velocity_V_13 "Validator for the relative lateral speed. ";
CM_ SG_ 154 OBJ_Relative_Lat_Velocity_STD_13 "STD of the relative lateral speed. ";
CM_ SG_ 154 OBJ_Rel_Lat_Vel_STD_V_13 "Validator for the STD of the relative lateral speed. ";
CM_ SG_ 154 OBJ_Long_Distance_13 "The longitudinal distance to middle of the rear bumper (middle of the RL and RR corners) of the target.";
CM_ SG_ 154 OBJ_Long_Distance_V_13 "Validator of the longtitudinal distance field";
CM_ SG_ 154 OBJ_Long_Distance_STD_13 "STD of the  longtitudinal distance.";
CM_ SG_ 154 OBJ_Long_Distance_STD_V_13 "Validator for the STD of the  longtitudinal distance.";
CM_ SG_ 154 OBJ_Lat_Distance_13 "Lateral distance to the middle of the RL and RR corners.  ";
CM_ SG_ 154 OBJ_Lat_Distance_V_13 "Validator for the lateral distance of the object.";
CM_ SG_ 154 OBJ_Lat_Distance_STD_13 "STD of the lateral distance of the object.";
CM_ SG_ 154 OBJ_Lat_Distance_STD_V_13 "Validator for the STD of the lateral distance of the object.";
CM_ SG_ 154 OBJ_Absolute_Speed_13 "The absolute ground speed in the targets' heading direction.";
CM_ SG_ 154 OBJ_Absolute_Speed_V_13 "Validator for the absolute ground speed.";
CM_ SG_ 154 OBJ_Absolute_Speed_STD_13 "STD of the absolute ground speed.";
CM_ SG_ 154 OBJ_Absolute_Speed_STD_V_13 "Validator for the STD of the absolute ground speed.";
CM_ SG_ 154 OBJ_Heading_13 "The angle beetweenthe host longitudinal axis and target's heading (clockwise, e.g. PI/2 is a target crossing from left to right).";
CM_ SG_ 154 OBJ_Heading_V_13 "Validator for the object heading.";
CM_ SG_ 154 OBJ_Heading_STD_13 "STD of the object heading.";
CM_ SG_ 154 OBJ_Heading_STD_V_13 "Validator for the STD of the object heading.";
CM_ SG_ 154 OBJ_Angle_Rate_STD_13 "Standard deviation of the angular speed. (radians)";
CM_ SG_ 154 OBJ_Angle_Rate_STD_V_13 "Validator for the STD of the angular speed.";
CM_ SG_ 154 OBJ_Angle_Rate_13 "The momentary angular speed of the object. (radians)";
CM_ SG_ 154 OBJ_Angle_Rate_V_13 "Validator for the angular speed.";
CM_ SG_ 154 OBJ_Angle_Right_13 "The angle between the host longitudinal axis and the right side of the front / rear of the target (the visible one). The positive side is to the host's right.";
CM_ SG_ 154 OBJ_Angle_Right_V_13 "Validator for angleRight";
CM_ SG_ 154 OBJ_Angle_Right_STD_13 "Standard deviation of angleRight";
CM_ SG_ 154 OBJ_Angle_Right_STD_V_13 "Validator for the standard deviation of angleRight.";
CM_ SG_ 154 OBJ_Angle_Left_13 "The angle between the host longitudinal axis and the left side of the front / rear of the target (the visible one). The positive side is to the host's right.";
CM_ SG_ 154 OBJ_Angle_Left_V_13 "Validator for angleLeft.";
CM_ SG_ 154 OBJ_Angle_Left_STD_13 "Standard deviation of angleLeft.";
CM_ SG_ 154 OBJ_Angle_Left_STD_V_13 "Validator for the standard deviation of angleLeft.";
CM_ SG_ 154 OBJ_Angle_Side_13 "The angle between the host longitudinal axis and the far visible edge - the visible edge of the front / rear of the target that is not visible. Currently supported for vehicles only.";
CM_ SG_ 154 OBJ_Angle_Side_V_13 "Validator for angleSide.";
CM_ SG_ 154 OBJ_Angle_Side_STD_13 "Standard deviation of angleSide.";
CM_ SG_ 154 OBJ_Angle_Side_STD_V_13 "Validator for the STD of angleSide.";
CM_ SG_ 154 OBJ_Angle_Mid_V_13 "Validator for angleMid.";
CM_ SG_ 154 OBJ_Angle_Mid_13 "The angle between the host longitudinal axis and the middle of the front / rear of the target (the visible one). The positive side is to the host's right.";
CM_ SG_ 154 OBJ_Angle_Mid_STD_13 "Standard deviation of angleMid.";
CM_ SG_ 154 OBJ_Angle_Mid_STD_V_13 "Validator for the STD of angleMid.";
CM_ SG_ 154 OBJ_Angle_Bottom_V_13 "Validator for OBJAngle_Bottom. ";
CM_ SG_ 154 OBJ_Angle_Bottom_13 "The angle between the longitudinal axis and the Bottom of the front / rear of the target (the visible one). The positive side is to the host's bottom";
CM_ SG_ 154 OBJ_Angle_Bottom_STD_13 "STD for OBJAngle_Bottom. ";
CM_ SG_ 154 OBJ_Angle_Bottom_STD_V_13 "Validator for OBJAngle_Bottom_STD. ";
CM_ SG_ 154 OBJ_Visibility_Side_V_13 "Currently Supported for VD only";
CM_ SG_ 154 OBJ_Visibility_Side_13 "From what car  side is the object visible";
CM_ SG_ 154 OBJ_Is_In_Drivable_Area_13 "Indicates whether the target is in a driveable area.";
CM_ SG_ 154 OBJ_Is_In_Drivable_Area_V_13 "Validator for OBJ_Is_In_Drivable_Area.";
CM_ SG_ 154 OBJ_Is_VeryClose_V_13 "Validator for OBJ_Is_VeryClose. ";
CM_ SG_ 154 OBJ_Is_VeryClose_13 "Indicates whether the target is very close to the host such that it is hard to measure its distance. Currently relevant for peds only";
CM_ SG_ 154 OBJ_OverlapAngleEgoLaneR_13 "Lateral distance to the middle of the RL and RR corners.";
CM_ SG_ 154 OBJ_OverlapAngleEgoLaneR_V_13 "Validator for OBJ_OverlapAngleEgoLaneR";
CM_ SG_ 154 OBJ_OverlapAngleEgoLaneL_13 "Lateral distance to the middle of the RL and RR corners.  ";
CM_ SG_ 154 OBJ_OverlapAngleEgoLaneL_V_13 "Validator for OBJ_OverlapAngleEgoLaneL";
CM_ SG_ 154 OBJ_Is_EMERGENCY_VCL_13 "Is Object an Emergency Vehicle";
CM_ SG_ 154 OBJ_EMERGENCY_LIGHT_COLOR_13 "Emergency Color";
CM_ SG_ 154 OBJ_EMERGENCY_V_13 "Are OBJ_Is_EMERGENCY_VCL and OBJ_EMERGENCY_LIGHT_COLOR Valid";
CM_ SG_ 154 OBJ_Angle_Top_13 "From VD touching point on the ground till the roof of the car";
CM_ SG_ 154 OBJ_Angle_Top_V_13 "Validator for OBJ_Angle_Top ";
CM_ SG_ 154 OBJ_Angle_Top_STD_13 "STD for OBJ_Angle_Top";
CM_ SG_ 154 OBJ_Angle_Top_STD_V_13 "Validator for OBJ_Angle_Top_STD. ";
CM_ SG_ 154 OBJ_CRC_14 "Calculated over all element signals. From the signal after the CRC until the first signal in the next elements OBJ_CRC_N+1  not including";
CM_ SG_ 154 OBJ_ID_14 "The detected object ID. Range is 1-255, while 0 indicates that the field in unfilled.";
CM_ SG_ 154 OBJ_Existence_Probability_14 "The existence probability of the reported object";
CM_ SG_ 154 OBJ_Fusion_Source_14 "sources ids used for fusion";
CM_ SG_ 154 OBJ_Triggered_SDM_14 "Indicates whether the object has trigered the SDM (Safety Diagnostic Manager) alert.";
CM_ SG_ 154 OBJ_Motion_Category_14 "Relevant for VD only. Full description of values can be found at the ACC guide.";
CM_ SG_ 154 OBJ_Object_Age_14 "The number of frames in which the object was recognized.";
CM_ SG_ 154 OBJ_Measuring_Status_14 "Measurment status. Old vs New marks if this is the first frame in which the object is reported. Predicted vs Measured marks if the report is raw or has been predicted forward in time using the measured dynamics and ego motion.";
CM_ SG_ 154 OBJ_Object_Class_14 "Indicates the object type. Uncertain is outputted in case the probability that a vehicle is a truck is very similar to the probability that it is a car. ";
CM_ SG_ 154 OBJ_Class_Probability_14 "The probability of this type classification.";
CM_ SG_ 154 OBJ_Car_Probability_14 "The probability the object is a car";
CM_ SG_ 154 OBJ_Truck_Probability_14 "The probability the object is a Truck";
CM_ SG_ 154 OBJ_Bike_Probability_14 "The probability the object is a Bike";
CM_ SG_ 154 OBJ_Camera_Source_14 "The camera in which this object was detected (best choice).";
CM_ SG_ 154 OBJ_Motion_Status_14 "MOVING - the object is moving STATIONARY - the object was never seen moving STOPPED -  the object was moving and has stopped MOVING_SLOWLY - the object is moving very slowly";
CM_ SG_ 154 OBJ_Motion_Orientation_14 "The direction of the targets heading compared to the host. ";
CM_ SG_ 154 OBJ_Has_Cut_Lane_14 "Indicates whether the object cut the host's (right or left) lane. In case there are no lanes, indicates whether the objects is at most 1 meters away from the host.";
CM_ SG_ 154 OBJ_Has_Cut_Path_14 "Indicates whether the object is in the host's path.";
CM_ SG_ 154 OBJ_Brake_Light_14 "Indication for brake lights ";
CM_ SG_ 154 OBJ_Turn_Indicator_Right_14 "Indication for blinking right light.";
CM_ SG_ 154 OBJ_Turn_Indicator_Left_14 "Indication for blinking left light ";
CM_ SG_ 154 OBJ_Light_Indicator_Validity_14 "Validator for light indicators";
CM_ SG_ 154 OBJ_Right_Out_Of_Image_14 "Indicates whether the measurment are predicted out of the right side of the image bounderies.";
CM_ SG_ 154 OBJ_Left_Out_Of_Image_14 "Indicates whether if measurment are predicted out of  the left side of the image bounderies";
CM_ SG_ 154 OBJ_Right_Out_Of_Image_V_14 "validator";
CM_ SG_ 154 OBJ_Left_Out_Of_Image_V_14 "validator";
CM_ SG_ 154 OBJ_Top_Out_Of_Image_14 "Indicates whether if measurment are predicted out of  the top of the image bounderies";
CM_ SG_ 154 OBJ_Bottom_Out_Of_Image_14 "Indicates whether if measurment are predicted out of  the bottom of the image bounderies";
CM_ SG_ 154 OBJ_Top_Out_Of_Image_V_14 "validator";
CM_ SG_ 154 OBJ_Bottom_Out_Of_Image_V_14 "validator";
CM_ SG_ 154 OBJ_Lane_Assignment_14 "The object's lane relative to the host lane.";
CM_ SG_ 154 OBJ_Lane_Assignment_V_14 "Validator for lane assignment";
CM_ SG_ 154 OBJ_Age_Seconds_14 "Time in seconds in which the object was recognized. ";
CM_ SG_ 154 OBJ_Age_Seconds_V_14 "Validator for object age";
CM_ SG_ 154 OBJ_Width_14 "The width of the target vehicle in the world (not to be mistaken with the width of the visible part of the vehicle).";
CM_ SG_ 154 OBJ_Width_V_14 "Validator for object width";
CM_ SG_ 154 OBJ_Width_STD_14 "Standard deviation for object width";
CM_ SG_ 154 OBJ_Width_STD_V_14 "Validator for the standard deviation of object width";
CM_ SG_ 154 OBJ_Length_14 "The length of the vehicle in the world. For crossing bicycles it gives the viewed length of the bicycle.";
CM_ SG_ 154 OBJ_Length_V_14 "Validator for object length.";
CM_ SG_ 154 OBJ_Length_STD_14 "Standard deviation for object length.";
CM_ SG_ 154 OBJ_Length_STD_V_14 "Validator for the standard deviation of object length.";
CM_ SG_ 154 OBJ_Radar_ID_14 "Radar Object ID of the Fused Object, Only relvant when OBJ_Fusion_Source is not Camera only";
CM_ SG_ 154 OBJ_Height_14 "The height of the object in the world. ";
CM_ SG_ 154 OBJ_Height_V_14 "Validator for object height.";
CM_ SG_ 154 OBJ_Height_STD_14 "Standard deviation for object height.";
CM_ SG_ 154 OBJ_Height_STD_V_14 "Validator for the standard deviation of object height.";
CM_ SG_ 154 OBJ_Abs_Long_Velocity_14 "Absolute longitudinal velocity.";
CM_ SG_ 154 OBJ_Abs_Long_Velocity_V_14 "Validator for absolute longitudinal velocity.";
CM_ SG_ 154 OBJ_Abs_Long_Velocity_STD_14 "Standard deviation of absolute longitudinal velocity.";
CM_ SG_ 154 OBJ_Abs_Long_Vel_STD_V_14 "Validator for the standard deviation of the absolute longitudinal velocity.";
CM_ SG_ 154 OBJ_Abs_Lat_Velocity_14 "The lateral ground speed of the object.";
CM_ SG_ 154 OBJ_Abs_Lat_Velocity_V_14 "Validator for the lateral ground speed of the object.";
CM_ SG_ 154 OBJ_Abs_Lat_Velocity_STD_14 "STD of the lateral ground speed of the object.";
CM_ SG_ 154 OBJ_Abs_Lat_Vel_STD_V_14 "Validator for the STD of the lateral ground speed of the object.";
CM_ SG_ 154 OBJ_Abs_Long_Acc_14 "The longitudinal ground acceleration of the object.";
CM_ SG_ 154 OBJ_Abs_Long_Acc_V_14 "Validator for the longitudinal ground acceleration of the object.";
CM_ SG_ 154 OBJ_Abs_Long_Acc_STD_14 "STD of the longitudinal ground acceleration of the object.";
CM_ SG_ 154 OBJ_Abs_Long_Acc_STD_V_14 "Validator for the STD of the longitudinal ground acceleration of the object.";
CM_ SG_ 154 OBJ_Abs_Lat_Acc_14 "The lateral ground acceleration of the object.";
CM_ SG_ 154 OBJ_Abs_Lat_Acc_V_14 "Validator for the lateral ground acceleration of the object.";
CM_ SG_ 154 OBJ_Abs_Lat_Acc_STD_14 "STD of the lateral ground acceleration of the object.";
CM_ SG_ 154 OBJ_Abs_Lat_Acc_STD_V_14 "Validator for the STD of the lateral ground acceleration of the object.";
CM_ SG_ 154 OBJ_Abs_Acceleration_14 "The absolute ground acceleration in the target's heading direction.";
CM_ SG_ 154 OBJ_Abs_Acceleration_V_14 "Validator for the absolute ground acceleration.";
CM_ SG_ 154 OBJ_Abs_Acc_STD_14 "STD of the absolute ground acceleration.";
CM_ SG_ 154 OBJ_Abs_Acc_STD_V_14 "Validator for the STD of the absolute ground acceleration.";
CM_ SG_ 154 OBJ_Inv_TTC_14 "Inverse TTC (time to collision).";
CM_ SG_ 154 OBJ_Inv_TTC_STD_14 "STD for inverse TTC .";
CM_ SG_ 154 OBJ_Inv_TTC_STD_V_14 "Validator for the STD for inverse TTC .";
CM_ SG_ 154 OBJ_Relative_Long_Acc_14 "The relative lateral ground acceleration of the object.";
CM_ SG_ 154 OBJ_Relative_Long_Acc_V_14 "Validator for the relative lateral ground acceleration of the object.";
CM_ SG_ 154 OBJ_Relative_Long_Acc_STD_14 "STD of the relative lateral ground acceleration of the object.";
CM_ SG_ 154 OBJ_Rel_Long_Acc_STD_V_14 "Validator for the STD of the relative lateral ground acceleration.";
CM_ SG_ 154 OBJ_Relative_Long_Velocity_14 "The relative longtitudinal speed between the target and ego vehicle. ";
CM_ SG_ 154 OBJ_Relative_Long_Velocity_V_14 "Validator for the relative longtitudinal speed.";
CM_ SG_ 154 OBJ_Relative_Long_Vel_STD_14 "STD of the relative longtitudinal speed.";
CM_ SG_ 154 OBJ_Rel_Long_Vel_STD_V_14 "Validator for the STD of the relative longtitudinal speed.";
CM_ SG_ 154 OBJ_Relative_Lat_Velocity_14 "The relative lateral speed between the target and ego vehicle. ";
CM_ SG_ 154 OBJ_Relative_Lat_Velocity_V_14 "Validator for the relative lateral speed. ";
CM_ SG_ 154 OBJ_Relative_Lat_Velocity_STD_14 "STD of the relative lateral speed. ";
CM_ SG_ 154 OBJ_Rel_Lat_Vel_STD_V_14 "Validator for the STD of the relative lateral speed. ";
CM_ SG_ 154 OBJ_Long_Distance_14 "The longitudinal distance to middle of the rear bumper (middle of the RL and RR corners) of the target.";
CM_ SG_ 154 OBJ_Long_Distance_V_14 "Validator of the longtitudinal distance field";
CM_ SG_ 154 OBJ_Long_Distance_STD_14 "STD of the  longtitudinal distance.";
CM_ SG_ 154 OBJ_Long_Distance_STD_V_14 "Validator for the STD of the  longtitudinal distance.";
CM_ SG_ 154 OBJ_Lat_Distance_14 "Lateral distance to the middle of the RL and RR corners.  ";
CM_ SG_ 154 OBJ_Lat_Distance_V_14 "Validator for the lateral distance of the object.";
CM_ SG_ 154 OBJ_Lat_Distance_STD_14 "STD of the lateral distance of the object.";
CM_ SG_ 154 OBJ_Lat_Distance_STD_V_14 "Validator for the STD of the lateral distance of the object.";
CM_ SG_ 154 OBJ_Absolute_Speed_14 "The absolute ground speed in the targets' heading direction.";
CM_ SG_ 154 OBJ_Absolute_Speed_V_14 "Validator for the absolute ground speed.";
CM_ SG_ 154 OBJ_Absolute_Speed_STD_14 "STD of the absolute ground speed.";
CM_ SG_ 154 OBJ_Absolute_Speed_STD_V_14 "Validator for the STD of the absolute ground speed.";
CM_ SG_ 154 OBJ_Heading_14 "The angle beetweenthe host longitudinal axis and target's heading (clockwise, e.g. PI/2 is a target crossing from left to right).";
CM_ SG_ 154 OBJ_Heading_V_14 "Validator for the object heading.";
CM_ SG_ 154 OBJ_Heading_STD_14 "STD of the object heading.";
CM_ SG_ 154 OBJ_Heading_STD_V_14 "Validator for the STD of the object heading.";
CM_ SG_ 154 OBJ_Angle_Rate_STD_14 "Standard deviation of the angular speed. (radians)";
CM_ SG_ 154 OBJ_Angle_Rate_STD_V_14 "Validator for the STD of the angular speed.";
CM_ SG_ 154 OBJ_Angle_Rate_14 "The momentary angular speed of the object. (radians)";
CM_ SG_ 154 OBJ_Angle_Rate_V_14 "Validator for the angular speed.";
CM_ SG_ 154 OBJ_Angle_Right_14 "The angle between the host longitudinal axis and the right side of the front / rear of the target (the visible one). The positive side is to the host's right.";
CM_ SG_ 154 OBJ_Angle_Right_V_14 "Validator for angleRight";
CM_ SG_ 154 OBJ_Angle_Right_STD_14 "Standard deviation of angleRight";
CM_ SG_ 154 OBJ_Angle_Right_STD_V_14 "Validator for the standard deviation of angleRight.";
CM_ SG_ 154 OBJ_Angle_Left_14 "The angle between the host longitudinal axis and the left side of the front / rear of the target (the visible one). The positive side is to the host's right.";
CM_ SG_ 154 OBJ_Angle_Left_V_14 "Validator for angleLeft.";
CM_ SG_ 154 OBJ_Angle_Left_STD_14 "Standard deviation of angleLeft.";
CM_ SG_ 154 OBJ_Angle_Left_STD_V_14 "Validator for the standard deviation of angleLeft.";
CM_ SG_ 154 OBJ_Angle_Side_14 "The angle between the host longitudinal axis and the far visible edge - the visible edge of the front / rear of the target that is not visible. Currently supported for vehicles only.";
CM_ SG_ 154 OBJ_Angle_Side_V_14 "Validator for angleSide.";
CM_ SG_ 154 OBJ_Angle_Side_STD_14 "Standard deviation of angleSide.";
CM_ SG_ 154 OBJ_Angle_Side_STD_V_14 "Validator for the STD of angleSide.";
CM_ SG_ 154 OBJ_Angle_Mid_V_14 "Validator for angleMid.";
CM_ SG_ 154 OBJ_Angle_Mid_14 "The angle between the host longitudinal axis and the middle of the front / rear of the target (the visible one). The positive side is to the host's right.";
CM_ SG_ 154 OBJ_Angle_Mid_STD_14 "Standard deviation of angleMid.";
CM_ SG_ 154 OBJ_Angle_Mid_STD_V_14 "Validator for the STD of angleMid.";
CM_ SG_ 154 OBJ_Angle_Bottom_V_14 "Validator for OBJAngle_Bottom. ";
CM_ SG_ 154 OBJ_Angle_Bottom_14 "The angle between the longitudinal axis and the Bottom of the front / rear of the target (the visible one). The positive side is to the host's bottom";
CM_ SG_ 154 OBJ_Angle_Bottom_STD_14 "STD for OBJAngle_Bottom. ";
CM_ SG_ 154 OBJ_Angle_Bottom_STD_V_14 "Validator for OBJAngle_Bottom_STD. ";
CM_ SG_ 154 OBJ_Visibility_Side_V_14 "Currently Supported for VD only";
CM_ SG_ 154 OBJ_Visibility_Side_14 "From what car  side is the object visible";
CM_ SG_ 154 OBJ_Is_In_Drivable_Area_14 "Indicates whether the target is in a driveable area.";
CM_ SG_ 154 OBJ_Is_In_Drivable_Area_V_14 "Validator for OBJ_Is_In_Drivable_Area.";
CM_ SG_ 154 OBJ_Is_VeryClose_V_14 "Validator for OBJ_Is_VeryClose. ";
CM_ SG_ 154 OBJ_Is_VeryClose_14 "Indicates whether the target is very close to the host such that it is hard to measure its distance. Currently relevant for peds only";
CM_ SG_ 154 OBJ_OverlapAngleEgoLaneR_14 "Lateral distance to the middle of the RL and RR corners.";
CM_ SG_ 154 OBJ_OverlapAngleEgoLaneR_V_14 "Validator for OBJ_OverlapAngleEgoLaneR";
CM_ SG_ 154 OBJ_OverlapAngleEgoLaneL_14 "Lateral distance to the middle of the RL and RR corners.  ";
CM_ SG_ 154 OBJ_OverlapAngleEgoLaneL_V_14 "Validator for OBJ_OverlapAngleEgoLaneL";
CM_ SG_ 154 OBJ_Is_EMERGENCY_VCL_14 "Is Object an Emergency Vehicle";
CM_ SG_ 154 OBJ_EMERGENCY_LIGHT_COLOR_14 "Emergency Color";
CM_ SG_ 154 OBJ_EMERGENCY_V_14 "Are OBJ_Is_EMERGENCY_VCL and OBJ_EMERGENCY_LIGHT_COLOR Valid";
CM_ SG_ 154 OBJ_Angle_Top_14 "From VD touching point on the ground till the roof of the car";
CM_ SG_ 154 OBJ_Angle_Top_V_14 "Validator for OBJ_Angle_Top ";
CM_ SG_ 154 OBJ_Angle_Top_STD_14 "STD for OBJ_Angle_Top";
CM_ SG_ 154 OBJ_Angle_Top_STD_V_14 "Validator for OBJ_Angle_Top_STD. ";
CM_ SG_ 154 OBJ_CRC_15 "Calculated over all element signals. From the signal after the CRC until the first signal in the next elements OBJ_CRC_N+1  not including";
CM_ SG_ 154 OBJ_ID_15 "The detected object ID. Range is 1-255, while 0 indicates that the field in unfilled.";
CM_ SG_ 154 OBJ_Existence_Probability_15 "The existence probability of the reported object";
CM_ SG_ 154 OBJ_Fusion_Source_15 "sources ids used for fusion";
CM_ SG_ 154 OBJ_Triggered_SDM_15 "Indicates whether the object has trigered the SDM (Safety Diagnostic Manager) alert.";
CM_ SG_ 154 OBJ_Motion_Category_15 "Relevant for VD only. Full description of values can be found at the ACC guide.";
CM_ SG_ 154 OBJ_Object_Age_15 "The number of frames in which the object was recognized.";
CM_ SG_ 154 OBJ_Measuring_Status_15 "Measurment status. Old vs New marks if this is the first frame in which the object is reported. Predicted vs Measured marks if the report is raw or has been predicted forward in time using the measured dynamics and ego motion.";
CM_ SG_ 154 OBJ_Object_Class_15 "Indicates the object type. Uncertain is outputted in case the probability that a vehicle is a truck is very similar to the probability that it is a car. ";
CM_ SG_ 154 OBJ_Class_Probability_15 "The probability of this type classification.";
CM_ SG_ 154 OBJ_Car_Probability_15 "The probability the object is a car";
CM_ SG_ 154 OBJ_Truck_Probability_15 "The probability the object is a Truck";
CM_ SG_ 154 OBJ_Bike_Probability_15 "The probability the object is a Bike";
CM_ SG_ 154 OBJ_Camera_Source_15 "The camera in which this object was detected (best choice).";
CM_ SG_ 154 OBJ_Motion_Status_15 "MOVING - the object is moving STATIONARY - the object was never seen moving STOPPED -  the object was moving and has stopped MOVING_SLOWLY - the object is moving very slowly";
CM_ SG_ 154 OBJ_Motion_Orientation_15 "The direction of the targets heading compared to the host. ";
CM_ SG_ 154 OBJ_Has_Cut_Lane_15 "Indicates whether the object cut the host's (right or left) lane. In case there are no lanes, indicates whether the objects is at most 1 meters away from the host.";
CM_ SG_ 154 OBJ_Has_Cut_Path_15 "Indicates whether the object is in the host's path.";
CM_ SG_ 154 OBJ_Brake_Light_15 "Indication for brake lights ";
CM_ SG_ 154 OBJ_Turn_Indicator_Right_15 "Indication for blinking right light.";
CM_ SG_ 154 OBJ_Turn_Indicator_Left_15 "Indication for blinking left light ";
CM_ SG_ 154 OBJ_Light_Indicator_Validity_15 "Validator for light indicators";
CM_ SG_ 154 OBJ_Right_Out_Of_Image_15 "Indicates whether the measurment are predicted out of the right side of the image bounderies.";
CM_ SG_ 154 OBJ_Left_Out_Of_Image_15 "Indicates whether if measurment are predicted out of  the left side of the image bounderies";
CM_ SG_ 154 OBJ_Right_Out_Of_Image_V_15 "validator";
CM_ SG_ 154 OBJ_Left_Out_Of_Image_V_15 "validator";
CM_ SG_ 154 OBJ_Top_Out_Of_Image_15 "Indicates whether if measurment are predicted out of  the top of the image bounderies";
CM_ SG_ 154 OBJ_Bottom_Out_Of_Image_15 "Indicates whether if measurment are predicted out of  the bottom of the image bounderies";
CM_ SG_ 154 OBJ_Top_Out_Of_Image_V_15 "validator";
CM_ SG_ 154 OBJ_Bottom_Out_Of_Image_V_15 "validator";
CM_ SG_ 154 OBJ_Lane_Assignment_15 "The object's lane relative to the host lane.";
CM_ SG_ 154 OBJ_Lane_Assignment_V_15 "Validator for lane assignment";
CM_ SG_ 154 OBJ_Age_Seconds_15 "Time in seconds in which the object was recognized. ";
CM_ SG_ 154 OBJ_Age_Seconds_V_15 "Validator for object age";
CM_ SG_ 154 OBJ_Width_15 "The width of the target vehicle in the world (not to be mistaken with the width of the visible part of the vehicle).";
CM_ SG_ 154 OBJ_Width_V_15 "Validator for object width";
CM_ SG_ 154 OBJ_Width_STD_15 "Standard deviation for object width";
CM_ SG_ 154 OBJ_Width_STD_V_15 "Validator for the standard deviation of object width";
CM_ SG_ 154 OBJ_Length_15 "The length of the vehicle in the world. For crossing bicycles it gives the viewed length of the bicycle.";
CM_ SG_ 154 OBJ_Length_V_15 "Validator for object length.";
CM_ SG_ 154 OBJ_Length_STD_15 "Standard deviation for object length.";
CM_ SG_ 154 OBJ_Length_STD_V_15 "Validator for the standard deviation of object length.";
CM_ SG_ 154 OBJ_Radar_ID_15 "Radar Object ID of the Fused Object, Only relvant when OBJ_Fusion_Source is not Camera only";
CM_ SG_ 154 OBJ_Height_15 "The height of the object in the world. ";
CM_ SG_ 154 OBJ_Height_V_15 "Validator for object height.";
CM_ SG_ 154 OBJ_Height_STD_15 "Standard deviation for object height.";
CM_ SG_ 154 OBJ_Height_STD_V_15 "Validator for the standard deviation of object height.";
CM_ SG_ 154 OBJ_Abs_Long_Velocity_15 "Absolute longitudinal velocity.";
CM_ SG_ 154 OBJ_Abs_Long_Velocity_V_15 "Validator for absolute longitudinal velocity.";
CM_ SG_ 154 OBJ_Abs_Long_Velocity_STD_15 "Standard deviation of absolute longitudinal velocity.";
CM_ SG_ 154 OBJ_Abs_Long_Vel_STD_V_15 "Validator for the standard deviation of the absolute longitudinal velocity.";
CM_ SG_ 154 OBJ_Abs_Lat_Velocity_15 "The lateral ground speed of the object.";
CM_ SG_ 154 OBJ_Abs_Lat_Velocity_V_15 "Validator for the lateral ground speed of the object.";
CM_ SG_ 154 OBJ_Abs_Lat_Velocity_STD_15 "STD of the lateral ground speed of the object.";
CM_ SG_ 154 OBJ_Abs_Lat_Vel_STD_V_15 "Validator for the STD of the lateral ground speed of the object.";
CM_ SG_ 154 OBJ_Abs_Long_Acc_15 "The longitudinal ground acceleration of the object.";
CM_ SG_ 154 OBJ_Abs_Long_Acc_V_15 "Validator for the longitudinal ground acceleration of the object.";
CM_ SG_ 154 OBJ_Abs_Long_Acc_STD_15 "STD of the longitudinal ground acceleration of the object.";
CM_ SG_ 154 OBJ_Abs_Long_Acc_STD_V_15 "Validator for the STD of the longitudinal ground acceleration of the object.";
CM_ SG_ 154 OBJ_Abs_Lat_Acc_15 "The lateral ground acceleration of the object.";
CM_ SG_ 154 OBJ_Abs_Lat_Acc_V_15 "Validator for the lateral ground acceleration of the object.";
CM_ SG_ 154 OBJ_Abs_Lat_Acc_STD_15 "STD of the lateral ground acceleration of the object.";
CM_ SG_ 154 OBJ_Abs_Lat_Acc_STD_V_15 "Validator for the STD of the lateral ground acceleration of the object.";
CM_ SG_ 154 OBJ_Abs_Acceleration_15 "The absolute ground acceleration in the target's heading direction.";
CM_ SG_ 154 OBJ_Abs_Acceleration_V_15 "Validator for the absolute ground acceleration.";
CM_ SG_ 154 OBJ_Abs_Acc_STD_15 "STD of the absolute ground acceleration.";
CM_ SG_ 154 OBJ_Abs_Acc_STD_V_15 "Validator for the STD of the absolute ground acceleration.";
CM_ SG_ 154 OBJ_Inv_TTC_15 "Inverse TTC (time to collision).";
CM_ SG_ 154 OBJ_Inv_TTC_STD_15 "STD for inverse TTC .";
CM_ SG_ 154 OBJ_Inv_TTC_STD_V_15 "Validator for the STD for inverse TTC .";
CM_ SG_ 154 OBJ_Relative_Long_Acc_15 "The relative lateral ground acceleration of the object.";
CM_ SG_ 154 OBJ_Relative_Long_Acc_V_15 "Validator for the relative lateral ground acceleration of the object.";
CM_ SG_ 154 OBJ_Relative_Long_Acc_STD_15 "STD of the relative lateral ground acceleration of the object.";
CM_ SG_ 154 OBJ_Rel_Long_Acc_STD_V_15 "Validator for the STD of the relative lateral ground acceleration.";
CM_ SG_ 154 OBJ_Relative_Long_Velocity_15 "The relative longtitudinal speed between the target and ego vehicle. ";
CM_ SG_ 154 OBJ_Relative_Long_Velocity_V_15 "Validator for the relative longtitudinal speed.";
CM_ SG_ 154 OBJ_Relative_Long_Vel_STD_15 "STD of the relative longtitudinal speed.";
CM_ SG_ 154 OBJ_Rel_Long_Vel_STD_V_15 "Validator for the STD of the relative longtitudinal speed.";
CM_ SG_ 154 OBJ_Relative_Lat_Velocity_15 "The relative lateral speed between the target and ego vehicle. ";
CM_ SG_ 154 OBJ_Relative_Lat_Velocity_V_15 "Validator for the relative lateral speed. ";
CM_ SG_ 154 OBJ_Relative_Lat_Velocity_STD_15 "STD of the relative lateral speed. ";
CM_ SG_ 154 OBJ_Rel_Lat_Vel_STD_V_15 "Validator for the STD of the relative lateral speed. ";
CM_ SG_ 154 OBJ_Long_Distance_15 "The longitudinal distance to middle of the rear bumper (middle of the RL and RR corners) of the target.";
CM_ SG_ 154 OBJ_Long_Distance_V_15 "Validator of the longtitudinal distance field";
CM_ SG_ 154 OBJ_Long_Distance_STD_15 "STD of the  longtitudinal distance.";
CM_ SG_ 154 OBJ_Long_Distance_STD_V_15 "Validator for the STD of the  longtitudinal distance.";
CM_ SG_ 154 OBJ_Lat_Distance_15 "Lateral distance to the middle of the RL and RR corners.  ";
CM_ SG_ 154 OBJ_Lat_Distance_V_15 "Validator for the lateral distance of the object.";
CM_ SG_ 154 OBJ_Lat_Distance_STD_15 "STD of the lateral distance of the object.";
CM_ SG_ 154 OBJ_Lat_Distance_STD_V_15 "Validator for the STD of the lateral distance of the object.";
CM_ SG_ 154 OBJ_Absolute_Speed_15 "The absolute ground speed in the targets' heading direction.";
CM_ SG_ 154 OBJ_Absolute_Speed_V_15 "Validator for the absolute ground speed.";
CM_ SG_ 154 OBJ_Absolute_Speed_STD_15 "STD of the absolute ground speed.";
CM_ SG_ 154 OBJ_Absolute_Speed_STD_V_15 "Validator for the STD of the absolute ground speed.";
CM_ SG_ 154 OBJ_Heading_15 "The angle beetweenthe host longitudinal axis and target's heading (clockwise, e.g. PI/2 is a target crossing from left to right).";
CM_ SG_ 154 OBJ_Heading_V_15 "Validator for the object heading.";
CM_ SG_ 154 OBJ_Heading_STD_15 "STD of the object heading.";
CM_ SG_ 154 OBJ_Heading_STD_V_15 "Validator for the STD of the object heading.";
CM_ SG_ 154 OBJ_Angle_Rate_STD_15 "Standard deviation of the angular speed. (radians)";
CM_ SG_ 154 OBJ_Angle_Rate_STD_V_15 "Validator for the STD of the angular speed.";
CM_ SG_ 154 OBJ_Angle_Rate_15 "The momentary angular speed of the object. (radians)";
CM_ SG_ 154 OBJ_Angle_Rate_V_15 "Validator for the angular speed.";
CM_ SG_ 154 OBJ_Angle_Right_15 "The angle between the host longitudinal axis and the right side of the front / rear of the target (the visible one). The positive side is to the host's right.";
CM_ SG_ 154 OBJ_Angle_Right_V_15 "Validator for angleRight";
CM_ SG_ 154 OBJ_Angle_Right_STD_15 "Standard deviation of angleRight";
CM_ SG_ 154 OBJ_Angle_Right_STD_V_15 "Validator for the standard deviation of angleRight.";
CM_ SG_ 154 OBJ_Angle_Left_15 "The angle between the host longitudinal axis and the left side of the front / rear of the target (the visible one). The positive side is to the host's right.";
CM_ SG_ 154 OBJ_Angle_Left_V_15 "Validator for angleLeft.";
CM_ SG_ 154 OBJ_Angle_Left_STD_15 "Standard deviation of angleLeft.";
CM_ SG_ 154 OBJ_Angle_Left_STD_V_15 "Validator for the standard deviation of angleLeft.";
CM_ SG_ 154 OBJ_Angle_Side_15 "The angle between the host longitudinal axis and the far visible edge - the visible edge of the front / rear of the target that is not visible. Currently supported for vehicles only.";
CM_ SG_ 154 OBJ_Angle_Side_V_15 "Validator for angleSide.";
CM_ SG_ 154 OBJ_Angle_Side_STD_15 "Standard deviation of angleSide.";
CM_ SG_ 154 OBJ_Angle_Side_STD_V_15 "Validator for the STD of angleSide.";
CM_ SG_ 154 OBJ_Angle_Mid_V_15 "Validator for angleMid.";
CM_ SG_ 154 OBJ_Angle_Mid_15 "The angle between the host longitudinal axis and the middle of the front / rear of the target (the visible one). The positive side is to the host's right.";
CM_ SG_ 154 OBJ_Angle_Mid_STD_15 "Standard deviation of angleMid.";
CM_ SG_ 154 OBJ_Angle_Mid_STD_V_15 "Validator for the STD of angleMid.";
CM_ SG_ 154 OBJ_Angle_Bottom_V_15 "Validator for OBJAngle_Bottom. ";
CM_ SG_ 154 OBJ_Angle_Bottom_15 "The angle between the longitudinal axis and the Bottom of the front / rear of the target (the visible one). The positive side is to the host's bottom";
CM_ SG_ 154 OBJ_Angle_Bottom_STD_15 "STD for OBJAngle_Bottom. ";
CM_ SG_ 154 OBJ_Angle_Bottom_STD_V_15 "Validator for OBJAngle_Bottom_STD. ";
CM_ SG_ 154 OBJ_Visibility_Side_V_15 "Currently Supported for VD only";
CM_ SG_ 154 OBJ_Visibility_Side_15 "From what car  side is the object visible";
CM_ SG_ 154 OBJ_Is_In_Drivable_Area_15 "Indicates whether the target is in a driveable area.";
CM_ SG_ 154 OBJ_Is_In_Drivable_Area_V_15 "Validator for OBJ_Is_In_Drivable_Area.";
CM_ SG_ 154 OBJ_Is_VeryClose_V_15 "Validator for OBJ_Is_VeryClose. ";
CM_ SG_ 154 OBJ_Is_VeryClose_15 "Indicates whether the target is very close to the host such that it is hard to measure its distance. Currently relevant for peds only";
CM_ SG_ 154 OBJ_OverlapAngleEgoLaneR_15 "Lateral distance to the middle of the RL and RR corners.";
CM_ SG_ 154 OBJ_OverlapAngleEgoLaneR_V_15 "Validator for OBJ_OverlapAngleEgoLaneR";
CM_ SG_ 154 OBJ_OverlapAngleEgoLaneL_15 "Lateral distance to the middle of the RL and RR corners.  ";
CM_ SG_ 154 OBJ_OverlapAngleEgoLaneL_V_15 "Validator for OBJ_OverlapAngleEgoLaneL";
CM_ SG_ 154 OBJ_Is_EMERGENCY_VCL_15 "Is Object an Emergency Vehicle";
CM_ SG_ 154 OBJ_EMERGENCY_LIGHT_COLOR_15 "Emergency Color";
CM_ SG_ 154 OBJ_EMERGENCY_V_15 "Are OBJ_Is_EMERGENCY_VCL and OBJ_EMERGENCY_LIGHT_COLOR Valid";
CM_ SG_ 154 OBJ_Angle_Top_15 "From VD touching point on the ground till the roof of the car";
CM_ SG_ 154 OBJ_Angle_Top_V_15 "Validator for OBJ_Angle_Top ";
CM_ SG_ 154 OBJ_Angle_Top_STD_15 "STD for OBJ_Angle_Top";
CM_ SG_ 154 OBJ_Angle_Top_STD_V_15 "Validator for OBJ_Angle_Top_STD. ";
CM_ SG_ 154 OBJ_CRC_16 "Calculated over all element signals. From the signal after the CRC until the first signal in the next elements OBJ_CRC_N+1  not including";
CM_ SG_ 154 OBJ_ID_16 "The detected object ID. Range is 1-255, while 0 indicates that the field in unfilled.";
CM_ SG_ 154 OBJ_Existence_Probability_16 "The existence probability of the reported object";
CM_ SG_ 154 OBJ_Fusion_Source_16 "sources ids used for fusion";
CM_ SG_ 154 OBJ_Triggered_SDM_16 "Indicates whether the object has trigered the SDM (Safety Diagnostic Manager) alert.";
CM_ SG_ 154 OBJ_Motion_Category_16 "Relevant for VD only. Full description of values can be found at the ACC guide.";
CM_ SG_ 154 OBJ_Object_Age_16 "The number of frames in which the object was recognized.";
CM_ SG_ 154 OBJ_Measuring_Status_16 "Measurment status. Old vs New marks if this is the first frame in which the object is reported. Predicted vs Measured marks if the report is raw or has been predicted forward in time using the measured dynamics and ego motion.";
CM_ SG_ 154 OBJ_Object_Class_16 "Indicates the object type. Uncertain is outputted in case the probability that a vehicle is a truck is very similar to the probability that it is a car. ";
CM_ SG_ 154 OBJ_Class_Probability_16 "The probability of this type classification.";
CM_ SG_ 154 OBJ_Car_Probability_16 "The probability the object is a car";
CM_ SG_ 154 OBJ_Truck_Probability_16 "The probability the object is a Truck";
CM_ SG_ 154 OBJ_Bike_Probability_16 "The probability the object is a Bike";
CM_ SG_ 154 OBJ_Camera_Source_16 "The camera in which this object was detected (best choice).";
CM_ SG_ 154 OBJ_Motion_Status_16 "MOVING - the object is moving STATIONARY - the object was never seen moving STOPPED -  the object was moving and has stopped MOVING_SLOWLY - the object is moving very slowly";
CM_ SG_ 154 OBJ_Motion_Orientation_16 "The direction of the targets heading compared to the host. ";
CM_ SG_ 154 OBJ_Has_Cut_Lane_16 "Indicates whether the object cut the host's (right or left) lane. In case there are no lanes, indicates whether the objects is at most 1 meters away from the host.";
CM_ SG_ 154 OBJ_Has_Cut_Path_16 "Indicates whether the object is in the host's path.";
CM_ SG_ 154 OBJ_Brake_Light_16 "Indication for brake lights ";
CM_ SG_ 154 OBJ_Turn_Indicator_Right_16 "Indication for blinking right light.";
CM_ SG_ 154 OBJ_Turn_Indicator_Left_16 "Indication for blinking left light ";
CM_ SG_ 154 OBJ_Light_Indicator_Validity_16 "Validator for light indicators";
CM_ SG_ 154 OBJ_Right_Out_Of_Image_16 "Indicates whether the measurment are predicted out of the right side of the image bounderies.";
CM_ SG_ 154 OBJ_Left_Out_Of_Image_16 "Indicates whether if measurment are predicted out of  the left side of the image bounderies";
CM_ SG_ 154 OBJ_Right_Out_Of_Image_V_16 "validator";
CM_ SG_ 154 OBJ_Left_Out_Of_Image_V_16 "validator";
CM_ SG_ 154 OBJ_Top_Out_Of_Image_16 "Indicates whether if measurment are predicted out of  the top of the image bounderies";
CM_ SG_ 154 OBJ_Bottom_Out_Of_Image_16 "Indicates whether if measurment are predicted out of  the bottom of the image bounderies";
CM_ SG_ 154 OBJ_Top_Out_Of_Image_V_16 "validator";
CM_ SG_ 154 OBJ_Bottom_Out_Of_Image_V_16 "validator";
CM_ SG_ 154 OBJ_Lane_Assignment_16 "The object's lane relative to the host lane.";
CM_ SG_ 154 OBJ_Lane_Assignment_V_16 "Validator for lane assignment";
CM_ SG_ 154 OBJ_Age_Seconds_16 "Time in seconds in which the object was recognized. ";
CM_ SG_ 154 OBJ_Age_Seconds_V_16 "Validator for object age";
CM_ SG_ 154 OBJ_Width_16 "The width of the target vehicle in the world (not to be mistaken with the width of the visible part of the vehicle).";
CM_ SG_ 154 OBJ_Width_V_16 "Validator for object width";
CM_ SG_ 154 OBJ_Width_STD_16 "Standard deviation for object width";
CM_ SG_ 154 OBJ_Width_STD_V_16 "Validator for the standard deviation of object width";
CM_ SG_ 154 OBJ_Length_16 "The length of the vehicle in the world. For crossing bicycles it gives the viewed length of the bicycle.";
CM_ SG_ 154 OBJ_Length_V_16 "Validator for object length.";
CM_ SG_ 154 OBJ_Length_STD_16 "Standard deviation for object length.";
CM_ SG_ 154 OBJ_Length_STD_V_16 "Validator for the standard deviation of object length.";
CM_ SG_ 154 OBJ_Radar_ID_16 "Radar Object ID of the Fused Object, Only relvant when OBJ_Fusion_Source is not Camera only";
CM_ SG_ 154 OBJ_Height_16 "The height of the object in the world. ";
CM_ SG_ 154 OBJ_Height_V_16 "Validator for object height.";
CM_ SG_ 154 OBJ_Height_STD_16 "Standard deviation for object height.";
CM_ SG_ 154 OBJ_Height_STD_V_16 "Validator for the standard deviation of object height.";
CM_ SG_ 154 OBJ_Abs_Long_Velocity_16 "Absolute longitudinal velocity.";
CM_ SG_ 154 OBJ_Abs_Long_Velocity_V_16 "Validator for absolute longitudinal velocity.";
CM_ SG_ 154 OBJ_Abs_Long_Velocity_STD_16 "Standard deviation of absolute longitudinal velocity.";
CM_ SG_ 154 OBJ_Abs_Long_Vel_STD_V_16 "Validator for the standard deviation of the absolute longitudinal velocity.";
CM_ SG_ 154 OBJ_Abs_Lat_Velocity_16 "The lateral ground speed of the object.";
CM_ SG_ 154 OBJ_Abs_Lat_Velocity_V_16 "Validator for the lateral ground speed of the object.";
CM_ SG_ 154 OBJ_Abs_Lat_Velocity_STD_16 "STD of the lateral ground speed of the object.";
CM_ SG_ 154 OBJ_Abs_Lat_Vel_STD_V_16 "Validator for the STD of the lateral ground speed of the object.";
CM_ SG_ 154 OBJ_Abs_Long_Acc_16 "The longitudinal ground acceleration of the object.";
CM_ SG_ 154 OBJ_Abs_Long_Acc_V_16 "Validator for the longitudinal ground acceleration of the object.";
CM_ SG_ 154 OBJ_Abs_Long_Acc_STD_16 "STD of the longitudinal ground acceleration of the object.";
CM_ SG_ 154 OBJ_Abs_Long_Acc_STD_V_16 "Validator for the STD of the longitudinal ground acceleration of the object.";
CM_ SG_ 154 OBJ_Abs_Lat_Acc_16 "The lateral ground acceleration of the object.";
CM_ SG_ 154 OBJ_Abs_Lat_Acc_V_16 "Validator for the lateral ground acceleration of the object.";
CM_ SG_ 154 OBJ_Abs_Lat_Acc_STD_16 "STD of the lateral ground acceleration of the object.";
CM_ SG_ 154 OBJ_Abs_Lat_Acc_STD_V_16 "Validator for the STD of the lateral ground acceleration of the object.";
CM_ SG_ 154 OBJ_Abs_Acceleration_16 "The absolute ground acceleration in the target's heading direction.";
CM_ SG_ 154 OBJ_Abs_Acceleration_V_16 "Validator for the absolute ground acceleration.";
CM_ SG_ 154 OBJ_Abs_Acc_STD_16 "STD of the absolute ground acceleration.";
CM_ SG_ 154 OBJ_Abs_Acc_STD_V_16 "Validator for the STD of the absolute ground acceleration.";
CM_ SG_ 154 OBJ_Inv_TTC_16 "Inverse TTC (time to collision).";
CM_ SG_ 154 OBJ_Inv_TTC_STD_16 "STD for inverse TTC .";
CM_ SG_ 154 OBJ_Inv_TTC_STD_V_16 "Validator for the STD for inverse TTC .";
CM_ SG_ 154 OBJ_Relative_Long_Acc_16 "The relative lateral ground acceleration of the object.";
CM_ SG_ 154 OBJ_Relative_Long_Acc_V_16 "Validator for the relative lateral ground acceleration of the object.";
CM_ SG_ 154 OBJ_Relative_Long_Acc_STD_16 "STD of the relative lateral ground acceleration of the object.";
CM_ SG_ 154 OBJ_Rel_Long_Acc_STD_V_16 "Validator for the STD of the relative lateral ground acceleration.";
CM_ SG_ 154 OBJ_Relative_Long_Velocity_16 "The relative longtitudinal speed between the target and ego vehicle. ";
CM_ SG_ 154 OBJ_Relative_Long_Velocity_V_16 "Validator for the relative longtitudinal speed.";
CM_ SG_ 154 OBJ_Relative_Long_Vel_STD_16 "STD of the relative longtitudinal speed.";
CM_ SG_ 154 OBJ_Rel_Long_Vel_STD_V_16 "Validator for the STD of the relative longtitudinal speed.";
CM_ SG_ 154 OBJ_Relative_Lat_Velocity_16 "The relative lateral speed between the target and ego vehicle. ";
CM_ SG_ 154 OBJ_Relative_Lat_Velocity_V_16 "Validator for the relative lateral speed. ";
CM_ SG_ 154 OBJ_Relative_Lat_Velocity_STD_16 "STD of the relative lateral speed. ";
CM_ SG_ 154 OBJ_Rel_Lat_Vel_STD_V_16 "Validator for the STD of the relative lateral speed. ";
CM_ SG_ 154 OBJ_Long_Distance_16 "The longitudinal distance to middle of the rear bumper (middle of the RL and RR corners) of the target.";
CM_ SG_ 154 OBJ_Long_Distance_V_16 "Validator of the longtitudinal distance field";
CM_ SG_ 154 OBJ_Long_Distance_STD_16 "STD of the  longtitudinal distance.";
CM_ SG_ 154 OBJ_Long_Distance_STD_V_16 "Validator for the STD of the  longtitudinal distance.";
CM_ SG_ 154 OBJ_Lat_Distance_16 "Lateral distance to the middle of the RL and RR corners.  ";
CM_ SG_ 154 OBJ_Lat_Distance_V_16 "Validator for the lateral distance of the object.";
CM_ SG_ 154 OBJ_Lat_Distance_STD_16 "STD of the lateral distance of the object.";
CM_ SG_ 154 OBJ_Lat_Distance_STD_V_16 "Validator for the STD of the lateral distance of the object.";
CM_ SG_ 154 OBJ_Absolute_Speed_16 "The absolute ground speed in the targets' heading direction.";
CM_ SG_ 154 OBJ_Absolute_Speed_V_16 "Validator for the absolute ground speed.";
CM_ SG_ 154 OBJ_Absolute_Speed_STD_16 "STD of the absolute ground speed.";
CM_ SG_ 154 OBJ_Absolute_Speed_STD_V_16 "Validator for the STD of the absolute ground speed.";
CM_ SG_ 154 OBJ_Heading_16 "The angle beetweenthe host longitudinal axis and target's heading (clockwise, e.g. PI/2 is a target crossing from left to right).";
CM_ SG_ 154 OBJ_Heading_V_16 "Validator for the object heading.";
CM_ SG_ 154 OBJ_Heading_STD_16 "STD of the object heading.";
CM_ SG_ 154 OBJ_Heading_STD_V_16 "Validator for the STD of the object heading.";
CM_ SG_ 154 OBJ_Angle_Rate_STD_16 "Standard deviation of the angular speed. (radians)";
CM_ SG_ 154 OBJ_Angle_Rate_STD_V_16 "Validator for the STD of the angular speed.";
CM_ SG_ 154 OBJ_Angle_Rate_16 "The momentary angular speed of the object. (radians)";
CM_ SG_ 154 OBJ_Angle_Rate_V_16 "Validator for the angular speed.";
CM_ SG_ 154 OBJ_Angle_Right_16 "The angle between the host longitudinal axis and the right side of the front / rear of the target (the visible one). The positive side is to the host's right.";
CM_ SG_ 154 OBJ_Angle_Right_V_16 "Validator for angleRight";
CM_ SG_ 154 OBJ_Angle_Right_STD_16 "Standard deviation of angleRight";
CM_ SG_ 154 OBJ_Angle_Right_STD_V_16 "Validator for the standard deviation of angleRight.";
CM_ SG_ 154 OBJ_Angle_Left_16 "The angle between the host longitudinal axis and the left side of the front / rear of the target (the visible one). The positive side is to the host's right.";
CM_ SG_ 154 OBJ_Angle_Left_V_16 "Validator for angleLeft.";
CM_ SG_ 154 OBJ_Angle_Left_STD_16 "Standard deviation of angleLeft.";
CM_ SG_ 154 OBJ_Angle_Left_STD_V_16 "Validator for the standard deviation of angleLeft.";
CM_ SG_ 154 OBJ_Angle_Side_16 "The angle between the host longitudinal axis and the far visible edge - the visible edge of the front / rear of the target that is not visible. Currently supported for vehicles only.";
CM_ SG_ 154 OBJ_Angle_Side_V_16 "Validator for angleSide.";
CM_ SG_ 154 OBJ_Angle_Side_STD_16 "Standard deviation of angleSide.";
CM_ SG_ 154 OBJ_Angle_Side_STD_V_16 "Validator for the STD of angleSide.";
CM_ SG_ 154 OBJ_Angle_Mid_V_16 "Validator for angleMid.";
CM_ SG_ 154 OBJ_Angle_Mid_16 "The angle between the host longitudinal axis and the middle of the front / rear of the target (the visible one). The positive side is to the host's right.";
CM_ SG_ 154 OBJ_Angle_Mid_STD_16 "Standard deviation of angleMid.";
CM_ SG_ 154 OBJ_Angle_Mid_STD_V_16 "Validator for the STD of angleMid.";
CM_ SG_ 154 OBJ_Angle_Bottom_V_16 "Validator for OBJAngle_Bottom. ";
CM_ SG_ 154 OBJ_Angle_Bottom_16 "The angle between the longitudinal axis and the Bottom of the front / rear of the target (the visible one). The positive side is to the host's bottom";
CM_ SG_ 154 OBJ_Angle_Bottom_STD_16 "STD for OBJAngle_Bottom. ";
CM_ SG_ 154 OBJ_Angle_Bottom_STD_V_16 "Validator for OBJAngle_Bottom_STD. ";
CM_ SG_ 154 OBJ_Visibility_Side_V_16 "Currently Supported for VD only";
CM_ SG_ 154 OBJ_Visibility_Side_16 "From what car  side is the object visible";
CM_ SG_ 154 OBJ_Is_In_Drivable_Area_16 "Indicates whether the target is in a driveable area.";
CM_ SG_ 154 OBJ_Is_In_Drivable_Area_V_16 "Validator for OBJ_Is_In_Drivable_Area.";
CM_ SG_ 154 OBJ_Is_VeryClose_V_16 "Validator for OBJ_Is_VeryClose. ";
CM_ SG_ 154 OBJ_Is_VeryClose_16 "Indicates whether the target is very close to the host such that it is hard to measure its distance. Currently relevant for peds only";
CM_ SG_ 154 OBJ_OverlapAngleEgoLaneR_16 "Lateral distance to the middle of the RL and RR corners.";
CM_ SG_ 154 OBJ_OverlapAngleEgoLaneR_V_16 "Validator for OBJ_OverlapAngleEgoLaneR";
CM_ SG_ 154 OBJ_OverlapAngleEgoLaneL_16 "Lateral distance to the middle of the RL and RR corners.  ";
CM_ SG_ 154 OBJ_OverlapAngleEgoLaneL_V_16 "Validator for OBJ_OverlapAngleEgoLaneL";
CM_ SG_ 154 OBJ_Is_EMERGENCY_VCL_16 "Is Object an Emergency Vehicle";
CM_ SG_ 154 OBJ_EMERGENCY_LIGHT_COLOR_16 "Emergency Color";
CM_ SG_ 154 OBJ_EMERGENCY_V_16 "Are OBJ_Is_EMERGENCY_VCL and OBJ_EMERGENCY_LIGHT_COLOR Valid";
CM_ SG_ 154 OBJ_Angle_Top_16 "From VD touching point on the ground till the roof of the car";
CM_ SG_ 154 OBJ_Angle_Top_V_16 "Validator for OBJ_Angle_Top ";
CM_ SG_ 154 OBJ_Angle_Top_STD_16 "STD for OBJ_Angle_Top";
CM_ SG_ 154 OBJ_Angle_Top_STD_V_16 "Validator for OBJ_Angle_Top_STD. ";
CM_ SG_ 154 OBJ_CRC_17 "Calculated over all element signals. From the signal after the CRC until the first signal in the next elements OBJ_CRC_N+1  not including";
CM_ SG_ 154 OBJ_ID_17 "The detected object ID. Range is 1-255, while 0 indicates that the field in unfilled.";
CM_ SG_ 154 OBJ_Existence_Probability_17 "The existence probability of the reported object";
CM_ SG_ 154 OBJ_Fusion_Source_17 "sources ids used for fusion";
CM_ SG_ 154 OBJ_Triggered_SDM_17 "Indicates whether the object has trigered the SDM (Safety Diagnostic Manager) alert.";
CM_ SG_ 154 OBJ_Motion_Category_17 "Relevant for VD only. Full description of values can be found at the ACC guide.";
CM_ SG_ 154 OBJ_Object_Age_17 "The number of frames in which the object was recognized.";
CM_ SG_ 154 OBJ_Measuring_Status_17 "Measurment status. Old vs New marks if this is the first frame in which the object is reported. Predicted vs Measured marks if the report is raw or has been predicted forward in time using the measured dynamics and ego motion.";
CM_ SG_ 154 OBJ_Object_Class_17 "Indicates the object type. Uncertain is outputted in case the probability that a vehicle is a truck is very similar to the probability that it is a car. ";
CM_ SG_ 154 OBJ_Class_Probability_17 "The probability of this type classification.";
CM_ SG_ 154 OBJ_Car_Probability_17 "The probability the object is a car";
CM_ SG_ 154 OBJ_Truck_Probability_17 "The probability the object is a Truck";
CM_ SG_ 154 OBJ_Bike_Probability_17 "The probability the object is a Bike";
CM_ SG_ 154 OBJ_Camera_Source_17 "The camera in which this object was detected (best choice).";
CM_ SG_ 154 OBJ_Motion_Status_17 "MOVING - the object is moving STATIONARY - the object was never seen moving STOPPED -  the object was moving and has stopped MOVING_SLOWLY - the object is moving very slowly";
CM_ SG_ 154 OBJ_Motion_Orientation_17 "The direction of the targets heading compared to the host. ";
CM_ SG_ 154 OBJ_Has_Cut_Lane_17 "Indicates whether the object cut the host's (right or left) lane. In case there are no lanes, indicates whether the objects is at most 1 meters away from the host.";
CM_ SG_ 154 OBJ_Has_Cut_Path_17 "Indicates whether the object is in the host's path.";
CM_ SG_ 154 OBJ_Brake_Light_17 "Indication for brake lights ";
CM_ SG_ 154 OBJ_Turn_Indicator_Right_17 "Indication for blinking right light.";
CM_ SG_ 154 OBJ_Turn_Indicator_Left_17 "Indication for blinking left light ";
CM_ SG_ 154 OBJ_Light_Indicator_Validity_17 "Validator for light indicators";
CM_ SG_ 154 OBJ_Right_Out_Of_Image_17 "Indicates whether the measurment are predicted out of the right side of the image bounderies.";
CM_ SG_ 154 OBJ_Left_Out_Of_Image_17 "Indicates whether if measurment are predicted out of  the left side of the image bounderies";
CM_ SG_ 154 OBJ_Right_Out_Of_Image_V_17 "validator";
CM_ SG_ 154 OBJ_Left_Out_Of_Image_V_17 "validator";
CM_ SG_ 154 OBJ_Top_Out_Of_Image_17 "Indicates whether if measurment are predicted out of  the top of the image bounderies";
CM_ SG_ 154 OBJ_Bottom_Out_Of_Image_17 "Indicates whether if measurment are predicted out of  the bottom of the image bounderies";
CM_ SG_ 154 OBJ_Top_Out_Of_Image_V_17 "validator";
CM_ SG_ 154 OBJ_Bottom_Out_Of_Image_V_17 "validator";
CM_ SG_ 154 OBJ_Lane_Assignment_17 "The object's lane relative to the host lane.";
CM_ SG_ 154 OBJ_Lane_Assignment_V_17 "Validator for lane assignment";
CM_ SG_ 154 OBJ_Age_Seconds_17 "Time in seconds in which the object was recognized. ";
CM_ SG_ 154 OBJ_Age_Seconds_V_17 "Validator for object age";
CM_ SG_ 154 OBJ_Width_17 "The width of the target vehicle in the world (not to be mistaken with the width of the visible part of the vehicle).";
CM_ SG_ 154 OBJ_Width_V_17 "Validator for object width";
CM_ SG_ 154 OBJ_Width_STD_17 "Standard deviation for object width";
CM_ SG_ 154 OBJ_Width_STD_V_17 "Validator for the standard deviation of object width";
CM_ SG_ 154 OBJ_Length_17 "The length of the vehicle in the world. For crossing bicycles it gives the viewed length of the bicycle.";
CM_ SG_ 154 OBJ_Length_V_17 "Validator for object length.";
CM_ SG_ 154 OBJ_Length_STD_17 "Standard deviation for object length.";
CM_ SG_ 154 OBJ_Length_STD_V_17 "Validator for the standard deviation of object length.";
CM_ SG_ 154 OBJ_Radar_ID_17 "Radar Object ID of the Fused Object, Only relvant when OBJ_Fusion_Source is not Camera only";
CM_ SG_ 154 OBJ_Height_17 "The height of the object in the world. ";
CM_ SG_ 154 OBJ_Height_V_17 "Validator for object height.";
CM_ SG_ 154 OBJ_Height_STD_17 "Standard deviation for object height.";
CM_ SG_ 154 OBJ_Height_STD_V_17 "Validator for the standard deviation of object height.";
CM_ SG_ 154 OBJ_Abs_Long_Velocity_17 "Absolute longitudinal velocity.";
CM_ SG_ 154 OBJ_Abs_Long_Velocity_V_17 "Validator for absolute longitudinal velocity.";
CM_ SG_ 154 OBJ_Abs_Long_Velocity_STD_17 "Standard deviation of absolute longitudinal velocity.";
CM_ SG_ 154 OBJ_Abs_Long_Vel_STD_V_17 "Validator for the standard deviation of the absolute longitudinal velocity.";
CM_ SG_ 154 OBJ_Abs_Lat_Velocity_17 "The lateral ground speed of the object.";
BA_DEF_ SG_  "GenSigStartValue" INT 0 0;
BA_DEF_DEF_  "GenSigStartValue" 0;
BA_ "GenSigStartValue" SG_ 154 OBJ_Width_12 40;
BA_ "GenSigStartValue" SG_ 154 OBJ_Length_12 24;
BA_ "GenSigStartValue" SG_ 154 OBJ_Width_13 40;
BA_ "GenSigStartValue" SG_ 154 OBJ_Length_13 24;
BA_ "GenSigStartValue" SG_ 154 OBJ_Width_14 40;
BA_ "GenSigStartValue" SG_ 154 OBJ_Length_14 24;
BA_ "GenSigStartValue" SG_ 154 OBJ_Width_15 40;
BA_ "GenSigStartValue" SG_ 154 OBJ_Length_15 24;
BA_ "GenSigStartValue" SG_ 154 OBJ_Width_16 40;
BA_ "GenSigStartValue" SG_ 154 OBJ_Length_16 24;
BA_ "GenSigStartValue" SG_ 154 OBJ_Width_17 40;
BA_ "GenSigStartValue" SG_ 154 OBJ_Length_17 24;
VAL_ 154 OBJ_Lat_Distance_V_11 1 "VALID" 0 "INVALID" ;
VAL_ 154 OBJ_Lat_Distance_STD_V_11 1 "VALID" 0 "INVALID" ;
VAL_ 154 OBJ_Absolute_Speed_V_11 1 "VALID" 0 "INVALID" ;
VAL_ 154 OBJ_Absolute_Speed_STD_V_11 1 "VALID" 0 "INVALID" ;
VAL_ 154 OBJ_Heading_V_11 1 "VALID" 0 "INVALID" ;
VAL_ 154 OBJ_Heading_STD_V_11 1 "VALID" 0 "INVALID" ;
VAL_ 154 OBJ_Angle_Rate_STD_V_11 1 "VALID" 0 "INVALID" ;
VAL_ 154 OBJ_Angle_Rate_V_11 1 "VALID" 0 "INVALID" ;
VAL_ 154 OBJ_Angle_Right_V_11 1 "VALID" 0 "INVALID" ;
VAL_ 154 OBJ_Angle_Right_STD_V_11 1 "VALID" 0 "INVALID" ;
VAL_ 154 OBJ_Angle_Left_V_11 1 "VALID" 0 "INVALID" ;
VAL_ 154 OBJ_Angle_Left_STD_V_11 1 "VALID" 0 "INVALID" ;
VAL_ 154 OBJ_Angle_Side_V_11 1 "VALID" 0 "INVALID" ;
VAL_ 154 OBJ_Angle_Side_STD_V_11 1 "VALID" 0 "INVALID" ;
VAL_ 154 OBJ_Angle_Mid_V_11 1 "VALID" 0 "INVALID" ;
VAL_ 154 OBJ_Angle_Mid_STD_V_11 1 "VALID" 0 "INVALID" ;
VAL_ 154 OBJ_Angle_Bottom_V_11 1 "VALID" 0 "INVALID" ;
VAL_ 154 OBJ_Angle_Bottom_STD_V_11 1 "VALID" 0 "INVALID" ;
VAL_ 154 OBJ_Visibility_Side_V_11 1 "VALID" 0 "INVALID" ;
VAL_ 154 OBJ_Visibility_Side_11 2 "REAR" 1 "FRONT" 0 "NOT_VISIBLE" ;
VAL_ 154 OBJ_Is_In_Drivable_Area_11 1 "TRUE" 0 "FALSE" ;
VAL_ 154 OBJ_Is_In_Drivable_Area_V_11 1 "VALID" 0 "INVALID" ;
VAL_ 154 OBJ_Is_VeryClose_V_11 1 "VALID" 0 "INVALID" ;
VAL_ 154 OBJ_Is_VeryClose_11 1 "TRUE" 0 "FALSE" ;
VAL_ 154 OBJ_OverlapAngleEgoLaneR_V_11 1 "VALID" 0 "INVALID" ;
VAL_ 154 OBJ_OverlapAngleEgoLaneL_V_11 1 "VALID" 0 "INVALID" ;
VAL_ 154 OBJ_Is_EMERGENCY_VCL_11 1 "TRUE" 0 "FALSE" ;
VAL_ 154 OBJ_EMERGENCY_LIGHT_COLOR_11 3 "(1000)ORANGE" 2 "(0100)BLUE" 1 "(0010)RED" 0 "(0001)OTHER" ;
VAL_ 154 OBJ_EMERGENCY_V_11 1 "TRUE" 0 "FALSE" ;
VAL_ 154 OBJ_Angle_Top_V_11 1 "VALID" 0 "INVALID" ;
VAL_ 154 OBJ_Angle_Top_STD_V_11 1 "VALID" 0 "INVALID" ;
VAL_ 154 OBJ_Fusion_Source_12 2 "(BIT_2)RADAR2" 1 "(BIT_1)RADAR1" 0 "(BIT_0)CAMERA" ;
VAL_ 154 OBJ_Triggered_SDM_12 2 "NOT_TRIGGERED" 1 "TRIGGERED" 0 "NOT_AVAILABLE" ;
VAL_ 154 OBJ_Motion_Category_12 13 "ONCOMING" 12 "PRECEEDING" 11 "MOVING" 10 "RTAP" 9 "LTAP" 8 "CROSSING" 7 "MOVING_OUT" 6 "MOVING_IN" 5 "CLOSE_CUT_IN" 4 "PASSING_OUT" 3 "PASSING_IN" 2 "PASSING" 1 "UNDEFINED" 0 "UNFILLED" ;
VAL_ 154 OBJ_Measuring_Status_12 2 "(BIT_2)NOT_VALID_OR_VALID" 1 "(BIT_1)PREDICTED_OR_MEASURED" 0 "(BIT_0)OLD_OR_NEW" ;
VAL_ 154 OBJ_Object_Class_12 8 "UNCERTAIN_VCL" 7 "ANIMAL" 6 "GENERAL_OBJECT" 5 "PEDESTRIAN" 4 "BICYCLE" 3 "MOTORBIKE" 2 "TRUCK" 1 "CAR" 0 "UNFILLED" ;
VAL_ 154 OBJ_Camera_Source_12 11 "PARKING_RIGHT" 10 "PARKING_LEFT" 9 "PARKING_REAR" 8 "PARKING_FRONT" 7 "FRONT_CORNER_RIGHT" 6 "FRONT_CORNER_LEFT" 5 "REAR_CORNER_RIGHT" 4 "REAR_CORNER_LEFT" 3 "REAR" 2 "FRONT_FISHEYE" 1 "FRONT_NARROW" 0 "FRONT_MAIN" ;
VAL_ 154 OBJ_Motion_Status_12 5 "MOVING_SLOWLY" 4 "STOPPED" 3 "STATIONARY" 2 "MOVING" 1 "UNKNOWN" 0 "INVALID" ;
VAL_ 154 OBJ_Motion_Orientation_12 13 "INVALID" 12 "NORTH" 11 "NORTH_WEST" 9 "WEST" 7 "SOUTH_WEST" 6 "SOUTH" 5 "SOUTH_EAST" 3 "EAST" 1 "NORTH_EAST" 0 "UNKNOWN" ;
VAL_ 154 OBJ_Has_Cut_Lane_12 1 "TRUE" 0 "FALSE" ;
VAL_ 154 OBJ_Has_Cut_Path_12 1 "TRUE" 0 "FALSE" ;
VAL_ 154 OBJ_Brake_Light_12 1 "TRUE" 0 "FALSE" ;
VAL_ 154 OBJ_Turn_Indicator_Right_12 1 "TRUE" 0 "FALSE" ;
VAL_ 154 OBJ_Turn_Indicator_Left_12 1 "TRUE" 0 "FALSE" ;
VAL_ 154 OBJ_Light_Indicator_Validity_12 1 "TRUE" 0 "FALSE" ;
VAL_ 154 OBJ_Right_Out_Of_Image_12 1 "TRUE" 0 "FALSE" ;
VAL_ 154 OBJ_Left_Out_Of_Image_12 1 "TRUE" 0 "FALSE" ;
VAL_ 154 OBJ_Right_Out_Of_Image_V_12 1 "TRUE" 0 "FALSE" ;
VAL_ 154 OBJ_Left_Out_Of_Image_V_12 1 "TRUE" 0 "FALSE" ;
VAL_ 154 OBJ_Top_Out_Of_Image_12 1 "TRUE" 0 "FALSE" ;
VAL_ 154 OBJ_Bottom_Out_Of_Image_12 1 "TRUE" 0 "FALSE" ;
VAL_ 154 OBJ_Top_Out_Of_Image_V_12 1 "VALID" 0 "INVALID" ;
VAL_ 154 OBJ_Bottom_Out_Of_Image_V_12 1 "VALID" 0 "INVALID" ;
VAL_ 154 OBJ_Lane_Assignment_12 5 "RIGHT_RIGHT" 4 "RIGHT" 3 "HOST" 2 "LEFT" 1 "LEFT_LEFT" 0 "UNKNOWN" ;
VAL_ 154 OBJ_Lane_Assignment_V_12 1 "VALID" 0 "INVALID" ;
VAL_ 154 OBJ_Age_Seconds_V_12 1 "VALID" 0 "INVALID" ;
VAL_ 154 OBJ_Width_V_12 1 "VALID" 0 "INVALID" ;
VAL_ 154 OBJ_Width_STD_V_12 1 "VALID" 0 "INVALID" ;
VAL_ 154 OBJ_Length_V_12 1 "VALID" 0 "INVALID" ;
VAL_ 154 OBJ_Length_STD_V_12 1 "VALID" 0 "INVALID" ;
VAL_ 154 OBJ_Height_V_12 1 "VALID" 0 "INVALID" ;
VAL_ 154 OBJ_Height_STD_V_12 1 "VALID" 0 "INVALID" ;
VAL_ 154 OBJ_Abs_Long_Velocity_V_12 1 "VALID" 0 "INVALID" ;
VAL_ 154 OBJ_Abs_Long_Vel_STD_V_12 1 "VALID" 0 "INVALID" ;
VAL_ 154 OBJ_Abs_Lat_Velocity_V_12 1 "VALID" 0 "INVALID" ;
VAL_ 154 OBJ_Abs_Lat_Vel_STD_V_12 1 "VALID" 0 "INVALID" ;
VAL_ 154 OBJ_Abs_Long_Acc_V_12 1 "VALID" 0 "INVALID" ;
VAL_ 154 OBJ_Abs_Long_Acc_STD_V_12 1 "VALID" 0 "INVALID" ;
VAL_ 154 OBJ_Abs_Lat_Acc_V_12 1 "VALID" 0 "INVALID" ;
VAL_ 154 OBJ_Abs_Lat_Acc_STD_V_12 1 "VALID" 0 "INVALID" ;
VAL_ 154 OBJ_Abs_Acceleration_V_12 1 "VALID" 0 "INVALID" ;
VAL_ 154 OBJ_Abs_Acc_STD_V_12 1 "VALID" 0 "INVALID" ;
VAL_ 154 OBJ_Inv_TTC_V_12 1 "VALID" 0 "INVALID" ;
VAL_ 154 OBJ_Inv_TTC_STD_V_12 1 "VALID" 0 "INVALID" ;
VAL_ 154 OBJ_Relative_Long_Acc_V_12 1 "VALID" 0 "INVALID" ;
VAL_ 154 OBJ_Rel_Long_Acc_STD_V_12 1 "VALID" 0 "INVALID" ;
VAL_ 154 OBJ_Relative_Long_Velocity_V_12 1 "VALID" 0 "INVALID" ;
VAL_ 154 OBJ_Rel_Long_Vel_STD_V_12 1 "VALID" 0 "INVALID" ;
VAL_ 154 OBJ_Relative_Lat_Velocity_V_12 1 "VALID" 0 "INVALID" ;
VAL_ 154 OBJ_Rel_Lat_Vel_STD_V_12 1 "VALID" 0 "INVALID" ;
VAL_ 154 OBJ_Long_Distance_V_12 1 "VALID" 0 "INVALID" ;
VAL_ 154 OBJ_Long_Distance_STD_V_12 1 "VALID" 0 "INVALID" ;
VAL_ 154 OBJ_Lat_Distance_V_12 1 "VALID" 0 "INVALID" ;
VAL_ 154 OBJ_Lat_Distance_STD_V_12 1 "VALID" 0 "INVALID" ;
VAL_ 154 OBJ_Absolute_Speed_V_12 1 "VALID" 0 "INVALID" ;
VAL_ 154 OBJ_Absolute_Speed_STD_V_12 1 "VALID" 0 "INVALID" ;
VAL_ 154 OBJ_Heading_V_12 1 "VALID" 0 "INVALID" ;
VAL_ 154 OBJ_Heading_STD_V_12 1 "VALID" 0 "INVALID" ;
VAL_ 154 OBJ_Angle_Rate_STD_V_12 1 "VALID" 0 "INVALID" ;
VAL_ 154 OBJ_Angle_Rate_V_12 1 "VALID" 0 "INVALID" ;
VAL_ 154 OBJ_Angle_Right_V_12 1 "VALID" 0 "INVALID" ;
VAL_ 154 OBJ_Angle_Right_STD_V_12 1 "VALID" 0 "INVALID" ;
VAL_ 154 OBJ_Angle_Left_V_12 1 "VALID" 0 "INVALID" ;
VAL_ 154 OBJ_Angle_Left_STD_V_12 1 "VALID" 0 "INVALID" ;
VAL_ 154 OBJ_Angle_Side_V_12 1 "VALID" 0 "INVALID" ;
VAL_ 154 OBJ_Angle_Side_STD_V_12 1 "VALID" 0 "INVALID" ;
VAL_ 154 OBJ_Angle_Mid_V_12 1 "VALID" 0 "INVALID" ;
VAL_ 154 OBJ_Angle_Mid_STD_V_12 1 "VALID" 0 "INVALID" ;
VAL_ 154 OBJ_Angle_Bottom_V_12 1 "VALID" 0 "INVALID" ;
VAL_ 154 OBJ_Angle_Bottom_STD_V_12 1 "VALID" 0 "INVALID" ;
VAL_ 154 OBJ_Visibility_Side_V_12 1 "VALID" 0 "INVALID" ;
VAL_ 154 OBJ_Visibility_Side_12 2 "REAR" 1 "FRONT" 0 "NOT_VISIBLE" ;
VAL_ 154 OBJ_Is_In_Drivable_Area_12 1 "TRUE" 0 "FALSE" ;
VAL_ 154 OBJ_Is_In_Drivable_Area_V_12 1 "VALID" 0 "INVALID" ;
VAL_ 154 OBJ_Is_VeryClose_V_12 1 "VALID" 0 "INVALID" ;
VAL_ 154 OBJ_Is_VeryClose_12 1 "TRUE" 0 "FALSE" ;
VAL_ 154 OBJ_OverlapAngleEgoLaneR_V_12 1 "VALID" 0 "INVALID" ;
VAL_ 154 OBJ_OverlapAngleEgoLaneL_V_12 1 "VALID" 0 "INVALID" ;
VAL_ 154 OBJ_Is_EMERGENCY_VCL_12 1 "TRUE" 0 "FALSE" ;
VAL_ 154 OBJ_EMERGENCY_LIGHT_COLOR_12 3 "(1000)ORANGE" 2 "(0100)BLUE" 1 "(0010)RED" 0 "(0001)OTHER" ;
VAL_ 154 OBJ_EMERGENCY_V_12 1 "TRUE" 0 "FALSE" ;
VAL_ 154 OBJ_Angle_Top_V_12 1 "VALID" 0 "INVALID" ;
VAL_ 154 OBJ_Angle_Top_STD_V_12 1 "VALID" 0 "INVALID" ;
VAL_ 154 OBJ_Fusion_Source_13 2 "(BIT_2)RADAR2" 1 "(BIT_1)RADAR1" 0 "(BIT_0)CAMERA" ;
VAL_ 154 OBJ_Triggered_SDM_13 2 "NOT_TRIGGERED" 1 "TRIGGERED" 0 "NOT_AVAILABLE" ;
VAL_ 154 OBJ_Motion_Category_13 13 "ONCOMING" 12 "PRECEEDING" 11 "MOVING" 10 "RTAP" 9 "LTAP" 8 "CROSSING" 7 "MOVING_OUT" 6 "MOVING_IN" 5 "CLOSE_CUT_IN" 4 "PASSING_OUT" 3 "PASSING_IN" 2 "PASSING" 1 "UNDEFINED" 0 "UNFILLED" ;
VAL_ 154 OBJ_Measuring_Status_13 2 "(BIT_2)NOT_VALID_OR_VALID" 1 "(BIT_1)PREDICTED_OR_MEASURED" 0 "(BIT_0)OLD_OR_NEW" ;
VAL_ 154 OBJ_Object_Class_13 8 "UNCERTAIN_VCL" 7 "ANIMAL" 6 "GENERAL_OBJECT" 5 "PEDESTRIAN" 4 "BICYCLE" 3 "MOTORBIKE" 2 "TRUCK" 1 "CAR" 0 "UNFILLED" ;
VAL_ 154 OBJ_Camera_Source_13 11 "PARKING_RIGHT" 10 "PARKING_LEFT" 9 "PARKING_REAR" 8 "PARKING_FRONT" 7 "FRONT_CORNER_RIGHT" 6 "FRONT_CORNER_LEFT" 5 "REAR_CORNER_RIGHT" 4 "REAR_CORNER_LEFT" 3 "REAR" 2 "FRONT_FISHEYE" 1 "FRONT_NARROW" 0 "FRONT_MAIN" ;
VAL_ 154 OBJ_Motion_Status_13 5 "MOVING_SLOWLY" 4 "STOPPED" 3 "STATIONARY" 2 "MOVING" 1 "UNKNOWN" 0 "INVALID" ;
VAL_ 154 OBJ_Motion_Orientation_13 13 "INVALID" 12 "NORTH" 11 "NORTH_WEST" 9 "WEST" 7 "SOUTH_WEST" 6 "SOUTH" 5 "SOUTH_EAST" 3 "EAST" 1 "NORTH_EAST" 0 "UNKNOWN" ;
VAL_ 154 OBJ_Has_Cut_Lane_13 1 "TRUE" 0 "FALSE" ;
VAL_ 154 OBJ_Has_Cut_Path_13 1 "TRUE" 0 "FALSE" ;
VAL_ 154 OBJ_Brake_Light_13 1 "TRUE" 0 "FALSE" ;
VAL_ 154 OBJ_Turn_Indicator_Right_13 1 "TRUE" 0 "FALSE" ;
VAL_ 154 OBJ_Turn_Indicator_Left_13 1 "TRUE" 0 "FALSE" ;
VAL_ 154 OBJ_Light_Indicator_Validity_13 1 "TRUE" 0 "FALSE" ;
VAL_ 154 OBJ_Right_Out_Of_Image_13 1 "TRUE" 0 "FALSE" ;
VAL_ 154 OBJ_Left_Out_Of_Image_13 1 "TRUE" 0 "FALSE" ;
VAL_ 154 OBJ_Right_Out_Of_Image_V_13 1 "TRUE" 0 "FALSE" ;
VAL_ 154 OBJ_Left_Out_Of_Image_V_13 1 "TRUE" 0 "FALSE" ;
VAL_ 154 OBJ_Top_Out_Of_Image_13 1 "TRUE" 0 "FALSE" ;
VAL_ 154 OBJ_Bottom_Out_Of_Image_13 1 "TRUE" 0 "FALSE" ;
VAL_ 154 OBJ_Top_Out_Of_Image_V_13 1 "VALID" 0 "INVALID" ;
VAL_ 154 OBJ_Bottom_Out_Of_Image_V_13 1 "VALID" 0 "INVALID" ;
VAL_ 154 OBJ_Lane_Assignment_13 5 "RIGHT_RIGHT" 4 "RIGHT" 3 "HOST" 2 "LEFT" 1 "LEFT_LEFT" 0 "UNKNOWN" ;
VAL_ 154 OBJ_Lane_Assignment_V_13 1 "VALID" 0 "INVALID" ;
VAL_ 154 OBJ_Age_Seconds_V_13 1 "VALID" 0 "INVALID" ;
VAL_ 154 OBJ_Width_V_13 1 "VALID" 0 "INVALID" ;
VAL_ 154 OBJ_Width_STD_V_13 1 "VALID" 0 "INVALID" ;
VAL_ 154 OBJ_Length_V_13 1 "VALID" 0 "INVALID" ;
VAL_ 154 OBJ_Length_STD_V_13 1 "VALID" 0 "INVALID" ;
VAL_ 154 OBJ_Height_V_13 1 "VALID" 0 "INVALID" ;
VAL_ 154 OBJ_Height_STD_V_13 1 "VALID" 0 "INVALID" ;
VAL_ 154 OBJ_Abs_Long_Velocity_V_13 1 "VALID" 0 "INVALID" ;
VAL_ 154 OBJ_Abs_Long_Vel_STD_V_13 1 "VALID" 0 "INVALID" ;
VAL_ 154 OBJ_Abs_Lat_Velocity_V_13 1 "VALID" 0 "INVALID" ;
VAL_ 154 OBJ_Abs_Lat_Vel_STD_V_13 1 "VALID" 0 "INVALID" ;
VAL_ 154 OBJ_Abs_Long_Acc_V_13 1 "VALID" 0 "INVALID" ;
VAL_ 154 OBJ_Abs_Long_Acc_STD_V_13 1 "VALID" 0 "INVALID" ;
VAL_ 154 OBJ_Abs_Lat_Acc_V_13 1 "VALID" 0 "INVALID" ;
VAL_ 154 OBJ_Abs_Lat_Acc_STD_V_13 1 "VALID" 0 "INVALID" ;
VAL_ 154 OBJ_Abs_Acceleration_V_13 1 "VALID" 0 "INVALID" ;
VAL_ 154 OBJ_Abs_Acc_STD_V_13 1 "VALID" 0 "INVALID" ;
VAL_ 154 OBJ_Inv_TTC_V_13 1 "VALID" 0 "INVALID" ;
VAL_ 154 OBJ_Inv_TTC_STD_V_13 1 "VALID" 0 "INVALID" ;
VAL_ 154 OBJ_Relative_Long_Acc_V_13 1 "VALID" 0 "INVALID" ;
VAL_ 154 OBJ_Rel_Long_Acc_STD_V_13 1 "VALID" 0 "INVALID" ;
VAL_ 154 OBJ_Relative_Long_Velocity_V_13 1 "VALID" 0 "INVALID" ;
VAL_ 154 OBJ_Rel_Long_Vel_STD_V_13 1 "VALID" 0 "INVALID" ;
VAL_ 154 OBJ_Relative_Lat_Velocity_V_13 1 "VALID" 0 "INVALID" ;
VAL_ 154 OBJ_Rel_Lat_Vel_STD_V_13 1 "VALID" 0 "INVALID" ;
VAL_ 154 OBJ_Long_Distance_V_13 1 "VALID" 0 "INVALID" ;
VAL_ 154 OBJ_Long_Distance_STD_V_13 1 "VALID" 0 "INVALID" ;
VAL_ 154 OBJ_Lat_Distance_V_13 1 "VALID" 0 "INVALID" ;
VAL_ 154 OBJ_Lat_Distance_STD_V_13 1 "VALID" 0 "INVALID" ;
VAL_ 154 OBJ_Absolute_Speed_V_13 1 "VALID" 0 "INVALID" ;
VAL_ 154 OBJ_Absolute_Speed_STD_V_13 1 "VALID" 0 "INVALID" ;
VAL_ 154 OBJ_Heading_V_13 1 "VALID" 0 "INVALID" ;
VAL_ 154 OBJ_Heading_STD_V_13 1 "VALID" 0 "INVALID" ;
VAL_ 154 OBJ_Angle_Rate_STD_V_13 1 "VALID" 0 "INVALID" ;
VAL_ 154 OBJ_Angle_Rate_V_13 1 "VALID" 0 "INVALID" ;
VAL_ 154 OBJ_Angle_Right_V_13 1 "VALID" 0 "INVALID" ;
VAL_ 154 OBJ_Angle_Right_STD_V_13 1 "VALID" 0 "INVALID" ;
VAL_ 154 OBJ_Angle_Left_V_13 1 "VALID" 0 "INVALID" ;
VAL_ 154 OBJ_Angle_Left_STD_V_13 1 "VALID" 0 "INVALID" ;
VAL_ 154 OBJ_Angle_Side_V_13 1 "VALID" 0 "INVALID" ;
VAL_ 154 OBJ_Angle_Side_STD_V_13 1 "VALID" 0 "INVALID" ;
VAL_ 154 OBJ_Angle_Mid_V_13 1 "VALID" 0 "INVALID" ;
VAL_ 154 OBJ_Angle_Mid_STD_V_13 1 "VALID" 0 "INVALID" ;
VAL_ 154 OBJ_Angle_Bottom_V_13 1 "VALID" 0 "INVALID" ;
VAL_ 154 OBJ_Angle_Bottom_STD_V_13 1 "VALID" 0 "INVALID" ;
VAL_ 154 OBJ_Visibility_Side_V_13 1 "VALID" 0 "INVALID" ;
VAL_ 154 OBJ_Visibility_Side_13 2 "REAR" 1 "FRONT" 0 "NOT_VISIBLE" ;
VAL_ 154 OBJ_Is_In_Drivable_Area_13 1 "TRUE" 0 "FALSE" ;
VAL_ 154 OBJ_Is_In_Drivable_Area_V_13 1 "VALID" 0 "INVALID" ;
VAL_ 154 OBJ_Is_VeryClose_V_13 1 "VALID" 0 "INVALID" ;
VAL_ 154 OBJ_Is_VeryClose_13 1 "TRUE" 0 "FALSE" ;
VAL_ 154 OBJ_OverlapAngleEgoLaneR_V_13 1 "VALID" 0 "INVALID" ;
VAL_ 154 OBJ_OverlapAngleEgoLaneL_V_13 1 "VALID" 0 "INVALID" ;
VAL_ 154 OBJ_Is_EMERGENCY_VCL_13 1 "TRUE" 0 "FALSE" ;
VAL_ 154 OBJ_EMERGENCY_LIGHT_COLOR_13 3 "(1000)ORANGE" 2 "(0100)BLUE" 1 "(0010)RED" 0 "(0001)OTHER" ;
VAL_ 154 OBJ_EMERGENCY_V_13 1 "TRUE" 0 "FALSE" ;
VAL_ 154 OBJ_Angle_Top_V_13 1 "VALID" 0 "INVALID" ;
VAL_ 154 OBJ_Angle_Top_STD_V_13 1 "VALID" 0 "INVALID" ;
VAL_ 154 OBJ_Fusion_Source_14 2 "(BIT_2)RADAR2" 1 "(BIT_1)RADAR1" 0 "(BIT_0)CAMERA" ;
VAL_ 154 OBJ_Triggered_SDM_14 2 "NOT_TRIGGERED" 1 "TRIGGERED" 0 "NOT_AVAILABLE" ;
VAL_ 154 OBJ_Motion_Category_14 13 "ONCOMING" 12 "PRECEEDING" 11 "MOVING" 10 "RTAP" 9 "LTAP" 8 "CROSSING" 7 "MOVING_OUT" 6 "MOVING_IN" 5 "CLOSE_CUT_IN" 4 "PASSING_OUT" 3 "PASSING_IN" 2 "PASSING" 1 "UNDEFINED" 0 "UNFILLED" ;
VAL_ 154 OBJ_Measuring_Status_14 2 "(BIT_2)NOT_VALID_OR_VALID" 1 "(BIT_1)PREDICTED_OR_MEASURED" 0 "(BIT_0)OLD_OR_NEW" ;
VAL_ 154 OBJ_Object_Class_14 8 "UNCERTAIN_VCL" 7 "ANIMAL" 6 "GENERAL_OBJECT" 5 "PEDESTRIAN" 4 "BICYCLE" 3 "MOTORBIKE" 2 "TRUCK" 1 "CAR" 0 "UNFILLED" ;
VAL_ 154 OBJ_Camera_Source_14 11 "PARKING_RIGHT" 10 "PARKING_LEFT" 9 "PARKING_REAR" 8 "PARKING_FRONT" 7 "FRONT_CORNER_RIGHT" 6 "FRONT_CORNER_LEFT" 5 "REAR_CORNER_RIGHT" 4 "REAR_CORNER_LEFT" 3 "REAR" 2 "FRONT_FISHEYE" 1 "FRONT_NARROW" 0 "FRONT_MAIN" ;
VAL_ 154 OBJ_Motion_Status_14 5 "MOVING_SLOWLY" 4 "STOPPED" 3 "STATIONARY" 2 "MOVING" 1 "UNKNOWN" 0 "INVALID" ;
VAL_ 154 OBJ_Motion_Orientation_14 13 "INVALID" 12 "NORTH" 11 "NORTH_WEST" 9 "WEST" 7 "SOUTH_WEST" 6 "SOUTH" 5 "SOUTH_EAST" 3 "EAST" 1 "NORTH_EAST" 0 "UNKNOWN" ;
VAL_ 154 OBJ_Has_Cut_Lane_14 1 "TRUE" 0 "FALSE" ;
VAL_ 154 OBJ_Has_Cut_Path_14 1 "TRUE" 0 "FALSE" ;
VAL_ 154 OBJ_Brake_Light_14 1 "TRUE" 0 "FALSE" ;
VAL_ 154 OBJ_Turn_Indicator_Right_14 1 "TRUE" 0 "FALSE" ;
VAL_ 154 OBJ_Turn_Indicator_Left_14 1 "TRUE" 0 "FALSE" ;
VAL_ 154 OBJ_Light_Indicator_Validity_14 1 "TRUE" 0 "FALSE" ;
VAL_ 154 OBJ_Right_Out_Of_Image_14 1 "TRUE" 0 "FALSE" ;
VAL_ 154 OBJ_Left_Out_Of_Image_14 1 "TRUE" 0 "FALSE" ;
VAL_ 154 OBJ_Right_Out_Of_Image_V_14 1 "TRUE" 0 "FALSE" ;
VAL_ 154 OBJ_Left_Out_Of_Image_V_14 1 "TRUE" 0 "FALSE" ;
VAL_ 154 OBJ_Top_Out_Of_Image_14 1 "TRUE" 0 "FALSE" ;
VAL_ 154 OBJ_Bottom_Out_Of_Image_14 1 "TRUE" 0 "FALSE" ;
VAL_ 154 OBJ_Top_Out_Of_Image_V_14 1 "VALID" 0 "INVALID" ;
VAL_ 154 OBJ_Bottom_Out_Of_Image_V_14 1 "VALID" 0 "INVALID" ;
VAL_ 154 OBJ_Lane_Assignment_14 5 "RIGHT_RIGHT" 4 "RIGHT" 3 "HOST" 2 "LEFT" 1 "LEFT_LEFT" 0 "UNKNOWN" ;
VAL_ 154 OBJ_Lane_Assignment_V_14 1 "VALID" 0 "INVALID" ;
VAL_ 154 OBJ_Age_Seconds_V_14 1 "VALID" 0 "INVALID" ;
VAL_ 154 OBJ_Width_V_14 1 "VALID" 0 "INVALID" ;
VAL_ 154 OBJ_Width_STD_V_14 1 "VALID" 0 "INVALID" ;
VAL_ 154 OBJ_Length_V_14 1 "VALID" 0 "INVALID" ;
VAL_ 154 OBJ_Length_STD_V_14 1 "VALID" 0 "INVALID" ;
VAL_ 154 OBJ_Height_V_14 1 "VALID" 0 "INVALID" ;
VAL_ 154 OBJ_Height_STD_V_14 1 "VALID" 0 "INVALID" ;
VAL_ 154 OBJ_Abs_Long_Velocity_V_14 1 "VALID" 0 "INVALID" ;
VAL_ 154 OBJ_Abs_Long_Vel_STD_V_14 1 "VALID" 0 "INVALID" ;
VAL_ 154 OBJ_Abs_Lat_Velocity_V_14 1 "VALID" 0 "INVALID" ;
VAL_ 154 OBJ_Abs_Lat_Vel_STD_V_14 1 "VALID" 0 "INVALID" ;
VAL_ 154 OBJ_Abs_Long_Acc_V_14 1 "VALID" 0 "INVALID" ;
VAL_ 154 OBJ_Abs_Long_Acc_STD_V_14 1 "VALID" 0 "INVALID" ;
VAL_ 154 OBJ_Abs_Lat_Acc_V_14 1 "VALID" 0 "INVALID" ;
VAL_ 154 OBJ_Abs_Lat_Acc_STD_V_14 1 "VALID" 0 "INVALID" ;
VAL_ 154 OBJ_Abs_Acceleration_V_14 1 "VALID" 0 "INVALID" ;
VAL_ 154 OBJ_Abs_Acc_STD_V_14 1 "VALID" 0 "INVALID" ;
VAL_ 154 OBJ_Inv_TTC_V_14 1 "VALID" 0 "INVALID" ;
VAL_ 154 OBJ_Inv_TTC_STD_V_14 1 "VALID" 0 "INVALID" ;
VAL_ 154 OBJ_Relative_Long_Acc_V_14 1 "VALID" 0 "INVALID" ;
VAL_ 154 OBJ_Rel_Long_Acc_STD_V_14 1 "VALID" 0 "INVALID" ;
VAL_ 154 OBJ_Relative_Long_Velocity_V_14 1 "VALID" 0 "INVALID" ;
VAL_ 154 OBJ_Rel_Long_Vel_STD_V_14 1 "VALID" 0 "INVALID" ;
VAL_ 154 OBJ_Relative_Lat_Velocity_V_14 1 "VALID" 0 "INVALID" ;
VAL_ 154 OBJ_Rel_Lat_Vel_STD_V_14 1 "VALID" 0 "INVALID" ;
VAL_ 154 OBJ_Long_Distance_V_14 1 "VALID" 0 "INVALID" ;
VAL_ 154 OBJ_Long_Distance_STD_V_14 1 "VALID" 0 "INVALID" ;
VAL_ 154 OBJ_Lat_Distance_V_14 1 "VALID" 0 "INVALID" ;
VAL_ 154 OBJ_Lat_Distance_STD_V_14 1 "VALID" 0 "INVALID" ;
VAL_ 154 OBJ_Absolute_Speed_V_14 1 "VALID" 0 "INVALID" ;
VAL_ 154 OBJ_Absolute_Speed_STD_V_14 1 "VALID" 0 "INVALID" ;
VAL_ 154 OBJ_Heading_V_14 1 "VALID" 0 "INVALID" ;
VAL_ 154 OBJ_Heading_STD_V_14 1 "VALID" 0 "INVALID" ;
VAL_ 154 OBJ_Angle_Rate_STD_V_14 1 "VALID" 0 "INVALID" ;
VAL_ 154 OBJ_Angle_Rate_V_14 1 "VALID" 0 "INVALID" ;
VAL_ 154 OBJ_Angle_Right_V_14 1 "VALID" 0 "INVALID" ;
VAL_ 154 OBJ_Angle_Right_STD_V_14 1 "VALID" 0 "INVALID" ;
VAL_ 154 OBJ_Angle_Left_V_14 1 "VALID" 0 "INVALID" ;
VAL_ 154 OBJ_Angle_Left_STD_V_14 1 "VALID" 0 "INVALID" ;
VAL_ 154 OBJ_Angle_Side_V_14 1 "VALID" 0 "INVALID" ;
VAL_ 154 OBJ_Angle_Side_STD_V_14 1 "VALID" 0 "INVALID" ;
VAL_ 154 OBJ_Angle_Mid_V_14 1 "VALID" 0 "INVALID" ;
VAL_ 154 OBJ_Angle_Mid_STD_V_14 1 "VALID" 0 "INVALID" ;
VAL_ 154 OBJ_Angle_Bottom_V_14 1 "VALID" 0 "INVALID" ;
VAL_ 154 OBJ_Angle_Bottom_STD_V_14 1 "VALID" 0 "INVALID" ;
VAL_ 154 OBJ_Visibility_Side_V_14 1 "VALID" 0 "INVALID" ;
VAL_ 154 OBJ_Visibility_Side_14 2 "REAR" 1 "FRONT" 0 "NOT_VISIBLE" ;
VAL_ 154 OBJ_Is_In_Drivable_Area_14 1 "TRUE" 0 "FALSE" ;
VAL_ 154 OBJ_Is_In_Drivable_Area_V_14 1 "VALID" 0 "INVALID" ;
VAL_ 154 OBJ_Is_VeryClose_V_14 1 "VALID" 0 "INVALID" ;
VAL_ 154 OBJ_Is_VeryClose_14 1 "TRUE" 0 "FALSE" ;
VAL_ 154 OBJ_OverlapAngleEgoLaneR_V_14 1 "VALID" 0 "INVALID" ;
VAL_ 154 OBJ_OverlapAngleEgoLaneL_V_14 1 "VALID" 0 "INVALID" ;
VAL_ 154 OBJ_Is_EMERGENCY_VCL_14 1 "TRUE" 0 "FALSE" ;
VAL_ 154 OBJ_EMERGENCY_LIGHT_COLOR_14 3 "(1000)ORANGE" 2 "(0100)BLUE" 1 "(0010)RED" 0 "(0001)OTHER" ;
VAL_ 154 OBJ_EMERGENCY_V_14 1 "TRUE" 0 "FALSE" ;
VAL_ 154 OBJ_Angle_Top_V_14 1 "VALID" 0 "INVALID" ;
VAL_ 154 OBJ_Angle_Top_STD_V_14 1 "VALID" 0 "INVALID" ;
VAL_ 154 OBJ_Fusion_Source_15 2 "(BIT_2)RADAR2" 1 "(BIT_1)RADAR1" 0 "(BIT_0)CAMERA" ;
VAL_ 154 OBJ_Triggered_SDM_15 2 "NOT_TRIGGERED" 1 "TRIGGERED" 0 "NOT_AVAILABLE" ;
VAL_ 154 OBJ_Motion_Category_15 13 "ONCOMING" 12 "PRECEEDING" 11 "MOVING" 10 "RTAP" 9 "LTAP" 8 "CROSSING" 7 "MOVING_OUT" 6 "MOVING_IN" 5 "CLOSE_CUT_IN" 4 "PASSING_OUT" 3 "PASSING_IN" 2 "PASSING" 1 "UNDEFINED" 0 "UNFILLED" ;
VAL_ 154 OBJ_Measuring_Status_15 2 "(BIT_2)NOT_VALID_OR_VALID" 1 "(BIT_1)PREDICTED_OR_MEASURED" 0 "(BIT_0)OLD_OR_NEW" ;
VAL_ 154 OBJ_Object_Class_15 8 "UNCERTAIN_VCL" 7 "ANIMAL" 6 "GENERAL_OBJECT" 5 "PEDESTRIAN" 4 "BICYCLE" 3 "MOTORBIKE" 2 "TRUCK" 1 "CAR" 0 "UNFILLED" ;
VAL_ 154 OBJ_Camera_Source_15 11 "PARKING_RIGHT" 10 "PARKING_LEFT" 9 "PARKING_REAR" 8 "PARKING_FRONT" 7 "FRONT_CORNER_RIGHT" 6 "FRONT_CORNER_LEFT" 5 "REAR_CORNER_RIGHT" 4 "REAR_CORNER_LEFT" 3 "REAR" 2 "FRONT_FISHEYE" 1 "FRONT_NARROW" 0 "FRONT_MAIN" ;
VAL_ 154 OBJ_Motion_Status_15 5 "MOVING_SLOWLY" 4 "STOPPED" 3 "STATIONARY" 2 "MOVING" 1 "UNKNOWN" 0 "INVALID" ;
VAL_ 154 OBJ_Motion_Orientation_15 13 "INVALID" 12 "NORTH" 11 "NORTH_WEST" 9 "WEST" 7 "SOUTH_WEST" 6 "SOUTH" 5 "SOUTH_EAST" 3 "EAST" 1 "NORTH_EAST" 0 "UNKNOWN" ;
VAL_ 154 OBJ_Has_Cut_Lane_15 1 "TRUE" 0 "FALSE" ;
VAL_ 154 OBJ_Has_Cut_Path_15 1 "TRUE" 0 "FALSE" ;
VAL_ 154 OBJ_Brake_Light_15 1 "TRUE" 0 "FALSE" ;
VAL_ 154 OBJ_Turn_Indicator_Right_15 1 "TRUE" 0 "FALSE" ;
VAL_ 154 OBJ_Turn_Indicator_Left_15 1 "TRUE" 0 "FALSE" ;
VAL_ 154 OBJ_Light_Indicator_Validity_15 1 "TRUE" 0 "FALSE" ;
VAL_ 154 OBJ_Right_Out_Of_Image_15 1 "TRUE" 0 "FALSE" ;
VAL_ 154 OBJ_Left_Out_Of_Image_15 1 "TRUE" 0 "FALSE" ;
VAL_ 154 OBJ_Right_Out_Of_Image_V_15 1 "TRUE" 0 "FALSE" ;
VAL_ 154 OBJ_Left_Out_Of_Image_V_15 1 "TRUE" 0 "FALSE" ;
VAL_ 154 OBJ_Top_Out_Of_Image_15 1 "TRUE" 0 "FALSE" ;
VAL_ 154 OBJ_Bottom_Out_Of_Image_15 1 "TRUE" 0 "FALSE" ;
VAL_ 154 OBJ_Top_Out_Of_Image_V_15 1 "VALID" 0 "INVALID" ;
VAL_ 154 OBJ_Bottom_Out_Of_Image_V_15 1 "VALID" 0 "INVALID" ;
VAL_ 154 OBJ_Lane_Assignment_15 5 "RIGHT_RIGHT" 4 "RIGHT" 3 "HOST" 2 "LEFT" 1 "LEFT_LEFT" 0 "UNKNOWN" ;
VAL_ 154 OBJ_Lane_Assignment_V_15 1 "VALID" 0 "INVALID" ;
VAL_ 154 OBJ_Age_Seconds_V_15 1 "VALID" 0 "INVALID" ;
VAL_ 154 OBJ_Width_V_15 1 "VALID" 0 "INVALID" ;
VAL_ 154 OBJ_Width_STD_V_15 1 "VALID" 0 "INVALID" ;
VAL_ 154 OBJ_Length_V_15 1 "VALID" 0 "INVALID" ;
VAL_ 154 OBJ_Length_STD_V_15 1 "VALID" 0 "INVALID" ;
VAL_ 154 OBJ_Height_V_15 1 "VALID" 0 "INVALID" ;
VAL_ 154 OBJ_Height_STD_V_15 1 "VALID" 0 "INVALID" ;
VAL_ 154 OBJ_Abs_Long_Velocity_V_15 1 "VALID" 0 "INVALID" ;
VAL_ 154 OBJ_Abs_Long_Vel_STD_V_15 1 "VALID" 0 "INVALID" ;
VAL_ 154 OBJ_Abs_Lat_Velocity_V_15 1 "VALID" 0 "INVALID" ;
VAL_ 154 OBJ_Abs_Lat_Vel_STD_V_15 1 "VALID" 0 "INVALID" ;
VAL_ 154 OBJ_Abs_Long_Acc_V_15 1 "VALID" 0 "INVALID" ;
VAL_ 154 OBJ_Abs_Long_Acc_STD_V_15 1 "VALID" 0 "INVALID" ;
VAL_ 154 OBJ_Abs_Lat_Acc_V_15 1 "VALID" 0 "INVALID" ;
VAL_ 154 OBJ_Abs_Lat_Acc_STD_V_15 1 "VALID" 0 "INVALID" ;
VAL_ 154 OBJ_Abs_Acceleration_V_15 1 "VALID" 0 "INVALID" ;
VAL_ 154 OBJ_Abs_Acc_STD_V_15 1 "VALID" 0 "INVALID" ;
VAL_ 154 OBJ_Inv_TTC_V_15 1 "VALID" 0 "INVALID" ;
VAL_ 154 OBJ_Inv_TTC_STD_V_15 1 "VALID" 0 "INVALID" ;
VAL_ 154 OBJ_Relative_Long_Acc_V_15 1 "VALID" 0 "INVALID" ;
VAL_ 154 OBJ_Rel_Long_Acc_STD_V_15 1 "VALID" 0 "INVALID" ;
VAL_ 154 OBJ_Relative_Long_Velocity_V_15 1 "VALID" 0 "INVALID" ;
VAL_ 154 OBJ_Rel_Long_Vel_STD_V_15 1 "VALID" 0 "INVALID" ;
VAL_ 154 OBJ_Relative_Lat_Velocity_V_15 1 "VALID" 0 "INVALID" ;
VAL_ 154 OBJ_Rel_Lat_Vel_STD_V_15 1 "VALID" 0 "INVALID" ;
VAL_ 154 OBJ_Long_Distance_V_15 1 "VALID" 0 "INVALID" ;
VAL_ 154 OBJ_Long_Distance_STD_V_15 1 "VALID" 0 "INVALID" ;
VAL_ 154 OBJ_Lat_Distance_V_15 1 "VALID" 0 "INVALID" ;
VAL_ 154 OBJ_Lat_Distance_STD_V_15 1 "VALID" 0 "INVALID" ;
VAL_ 154 OBJ_Absolute_Speed_V_15 1 "VALID" 0 "INVALID" ;
VAL_ 154 OBJ_Absolute_Speed_STD_V_15 1 "VALID" 0 "INVALID" ;
VAL_ 154 OBJ_Heading_V_15 1 "VALID" 0 "INVALID" ;
VAL_ 154 OBJ_Heading_STD_V_15 1 "VALID" 0 "INVALID" ;
VAL_ 154 OBJ_Angle_Rate_STD_V_15 1 "VALID" 0 "INVALID" ;
VAL_ 154 OBJ_Angle_Rate_V_15 1 "VALID" 0 "INVALID" ;
VAL_ 154 OBJ_Angle_Right_V_15 1 "VALID" 0 "INVALID" ;
VAL_ 154 OBJ_Angle_Right_STD_V_15 1 "VALID" 0 "INVALID" ;
VAL_ 154 OBJ_Angle_Left_V_15 1 "VALID" 0 "INVALID" ;
VAL_ 154 OBJ_Angle_Left_STD_V_15 1 "VALID" 0 "INVALID" ;
VAL_ 154 OBJ_Angle_Side_V_15 1 "VALID" 0 "INVALID" ;
VAL_ 154 OBJ_Angle_Side_STD_V_15 1 "VALID" 0 "INVALID" ;
VAL_ 154 OBJ_Angle_Mid_V_15 1 "VALID" 0 "INVALID" ;
VAL_ 154 OBJ_Angle_Mid_STD_V_15 1 "VALID" 0 "INVALID" ;
VAL_ 154 OBJ_Angle_Bottom_V_15 1 "VALID" 0 "INVALID" ;
VAL_ 154 OBJ_Angle_Bottom_STD_V_15 1 "VALID" 0 "INVALID" ;
VAL_ 154 OBJ_Visibility_Side_V_15 1 "VALID" 0 "INVALID" ;
VAL_ 154 OBJ_Visibility_Side_15 2 "REAR" 1 "FRONT" 0 "NOT_VISIBLE" ;
VAL_ 154 OBJ_Is_In_Drivable_Area_15 1 "TRUE" 0 "FALSE" ;
VAL_ 154 OBJ_Is_In_Drivable_Area_V_15 1 "VALID" 0 "INVALID" ;
VAL_ 154 OBJ_Is_VeryClose_V_15 1 "VALID" 0 "INVALID" ;
VAL_ 154 OBJ_Is_VeryClose_15 1 "TRUE" 0 "FALSE" ;
VAL_ 154 OBJ_OverlapAngleEgoLaneR_V_15 1 "VALID" 0 "INVALID" ;
VAL_ 154 OBJ_OverlapAngleEgoLaneL_V_15 1 "VALID" 0 "INVALID" ;
VAL_ 154 OBJ_Is_EMERGENCY_VCL_15 1 "TRUE" 0 "FALSE" ;
VAL_ 154 OBJ_EMERGENCY_LIGHT_COLOR_15 3 "(1000)ORANGE" 2 "(0100)BLUE" 1 "(0010)RED" 0 "(0001)OTHER" ;
VAL_ 154 OBJ_EMERGENCY_V_15 1 "TRUE" 0 "FALSE" ;
VAL_ 154 OBJ_Angle_Top_V_15 1 "VALID" 0 "INVALID" ;
VAL_ 154 OBJ_Angle_Top_STD_V_15 1 "VALID" 0 "INVALID" ;
VAL_ 154 OBJ_Fusion_Source_16 2 "(BIT_2)RADAR2" 1 "(BIT_1)RADAR1" 0 "(BIT_0)CAMERA" ;
VAL_ 154 OBJ_Triggered_SDM_16 2 "NOT_TRIGGERED" 1 "TRIGGERED" 0 "NOT_AVAILABLE" ;
VAL_ 154 OBJ_Motion_Category_16 13 "ONCOMING" 12 "PRECEEDING" 11 "MOVING" 10 "RTAP" 9 "LTAP" 8 "CROSSING" 7 "MOVING_OUT" 6 "MOVING_IN" 5 "CLOSE_CUT_IN" 4 "PASSING_OUT" 3 "PASSING_IN" 2 "PASSING" 1 "UNDEFINED" 0 "UNFILLED" ;
VAL_ 154 OBJ_Measuring_Status_16 2 "(BIT_2)NOT_VALID_OR_VALID" 1 "(BIT_1)PREDICTED_OR_MEASURED" 0 "(BIT_0)OLD_OR_NEW" ;
VAL_ 154 OBJ_Object_Class_16 8 "UNCERTAIN_VCL" 7 "ANIMAL" 6 "GENERAL_OBJECT" 5 "PEDESTRIAN" 4 "BICYCLE" 3 "MOTORBIKE" 2 "TRUCK" 1 "CAR" 0 "UNFILLED" ;
VAL_ 154 OBJ_Camera_Source_16 11 "PARKING_RIGHT" 10 "PARKING_LEFT" 9 "PARKING_REAR" 8 "PARKING_FRONT" 7 "FRONT_CORNER_RIGHT" 6 "FRONT_CORNER_LEFT" 5 "REAR_CORNER_RIGHT" 4 "REAR_CORNER_LEFT" 3 "REAR" 2 "FRONT_FISHEYE" 1 "FRONT_NARROW" 0 "FRONT_MAIN" ;
VAL_ 154 OBJ_Motion_Status_16 5 "MOVING_SLOWLY" 4 "STOPPED" 3 "STATIONARY" 2 "MOVING" 1 "UNKNOWN" 0 "INVALID" ;
VAL_ 154 OBJ_Motion_Orientation_16 13 "INVALID" 12 "NORTH" 11 "NORTH_WEST" 9 "WEST" 7 "SOUTH_WEST" 6 "SOUTH" 5 "SOUTH_EAST" 3 "EAST" 1 "NORTH_EAST" 0 "UNKNOWN" ;
VAL_ 154 OBJ_Has_Cut_Lane_16 1 "TRUE" 0 "FALSE" ;
VAL_ 154 OBJ_Has_Cut_Path_16 1 "TRUE" 0 "FALSE" ;
VAL_ 154 OBJ_Brake_Light_16 1 "TRUE" 0 "FALSE" ;
VAL_ 154 OBJ_Turn_Indicator_Right_16 1 "TRUE" 0 "FALSE" ;
VAL_ 154 OBJ_Turn_Indicator_Left_16 1 "TRUE" 0 "FALSE" ;
VAL_ 154 OBJ_Light_Indicator_Validity_16 1 "TRUE" 0 "FALSE" ;
VAL_ 154 OBJ_Right_Out_Of_Image_16 1 "TRUE" 0 "FALSE" ;
VAL_ 154 OBJ_Left_Out_Of_Image_16 1 "TRUE" 0 "FALSE" ;
VAL_ 154 OBJ_Right_Out_Of_Image_V_16 1 "TRUE" 0 "FALSE" ;
VAL_ 154 OBJ_Left_Out_Of_Image_V_16 1 "TRUE" 0 "FALSE" ;
VAL_ 154 OBJ_Top_Out_Of_Image_16 1 "TRUE" 0 "FALSE" ;
VAL_ 154 OBJ_Bottom_Out_Of_Image_16 1 "TRUE" 0 "FALSE" ;
VAL_ 154 OBJ_Top_Out_Of_Image_V_16 1 "VALID" 0 "INVALID" ;
VAL_ 154 OBJ_Bottom_Out_Of_Image_V_16 1 "VALID" 0 "INVALID" ;
VAL_ 154 OBJ_Lane_Assignment_16 5 "RIGHT_RIGHT" 4 "RIGHT" 3 "HOST" 2 "LEFT" 1 "LEFT_LEFT" 0 "UNKNOWN" ;
VAL_ 154 OBJ_Lane_Assignment_V_16 1 "VALID" 0 "INVALID" ;
VAL_ 154 OBJ_Age_Seconds_V_16 1 "VALID" 0 "INVALID" ;
VAL_ 154 OBJ_Width_V_16 1 "VALID" 0 "INVALID" ;
VAL_ 154 OBJ_Width_STD_V_16 1 "VALID" 0 "INVALID" ;
VAL_ 154 OBJ_Length_V_16 1 "VALID" 0 "INVALID" ;
VAL_ 154 OBJ_Length_STD_V_16 1 "VALID" 0 "INVALID" ;
VAL_ 154 OBJ_Height_V_16 1 "VALID" 0 "INVALID" ;
VAL_ 154 OBJ_Height_STD_V_16 1 "VALID" 0 "INVALID" ;
VAL_ 154 OBJ_Abs_Long_Velocity_V_16 1 "VALID" 0 "INVALID" ;
VAL_ 154 OBJ_Abs_Long_Vel_STD_V_16 1 "VALID" 0 "INVALID" ;
VAL_ 154 OBJ_Abs_Lat_Velocity_V_16 1 "VALID" 0 "INVALID" ;
VAL_ 154 OBJ_Abs_Lat_Vel_STD_V_16 1 "VALID" 0 "INVALID" ;
VAL_ 154 OBJ_Abs_Long_Acc_V_16 1 "VALID" 0 "INVALID" ;
VAL_ 154 OBJ_Abs_Long_Acc_STD_V_16 1 "VALID" 0 "INVALID" ;
VAL_ 154 OBJ_Abs_Lat_Acc_V_16 1 "VALID" 0 "INVALID" ;
VAL_ 154 OBJ_Abs_Lat_Acc_STD_V_16 1 "VALID" 0 "INVALID" ;
VAL_ 154 OBJ_Abs_Acceleration_V_16 1 "VALID" 0 "INVALID" ;
VAL_ 154 OBJ_Abs_Acc_STD_V_16 1 "VALID" 0 "INVALID" ;
VAL_ 154 OBJ_Inv_TTC_V_16 1 "VALID" 0 "INVALID" ;
VAL_ 154 OBJ_Inv_TTC_STD_V_16 1 "VALID" 0 "INVALID" ;
VAL_ 154 OBJ_Relative_Long_Acc_V_16 1 "VALID" 0 "INVALID" ;
VAL_ 154 OBJ_Rel_Long_Acc_STD_V_16 1 "VALID" 0 "INVALID" ;
VAL_ 154 OBJ_Relative_Long_Velocity_V_16 1 "VALID" 0 "INVALID" ;
VAL_ 154 OBJ_Rel_Long_Vel_STD_V_16 1 "VALID" 0 "INVALID" ;
VAL_ 154 OBJ_Relative_Lat_Velocity_V_16 1 "VALID" 0 "INVALID" ;
VAL_ 154 OBJ_Rel_Lat_Vel_STD_V_16 1 "VALID" 0 "INVALID" ;
VAL_ 154 OBJ_Long_Distance_V_16 1 "VALID" 0 "INVALID" ;
VAL_ 154 OBJ_Long_Distance_STD_V_16 1 "VALID" 0 "INVALID" ;
VAL_ 154 OBJ_Lat_Distance_V_16 1 "VALID" 0 "INVALID" ;
VAL_ 154 OBJ_Lat_Distance_STD_V_16 1 "VALID" 0 "INVALID" ;
VAL_ 154 OBJ_Absolute_Speed_V_16 1 "VALID" 0 "INVALID" ;
VAL_ 154 OBJ_Absolute_Speed_STD_V_16 1 "VALID" 0 "INVALID" ;
VAL_ 154 OBJ_Heading_V_16 1 "VALID" 0 "INVALID" ;
VAL_ 154 OBJ_Heading_STD_V_16 1 "VALID" 0 "INVALID" ;
VAL_ 154 OBJ_Angle_Rate_STD_V_16 1 "VALID" 0 "INVALID" ;
VAL_ 154 OBJ_Angle_Rate_V_16 1 "VALID" 0 "INVALID" ;
VAL_ 154 OBJ_Angle_Right_V_16 1 "VALID" 0 "INVALID" ;
VAL_ 154 OBJ_Angle_Right_STD_V_16 1 "VALID" 0 "INVALID" ;
VAL_ 154 OBJ_Angle_Left_V_16 1 "VALID" 0 "INVALID" ;
VAL_ 154 OBJ_Angle_Left_STD_V_16 1 "VALID" 0 "INVALID" ;
VAL_ 154 OBJ_Angle_Side_V_16 1 "VALID" 0 "INVALID" ;
VAL_ 154 OBJ_Angle_Side_STD_V_16 1 "VALID" 0 "INVALID" ;
VAL_ 154 OBJ_Angle_Mid_V_16 1 "VALID" 0 "INVALID" ;
VAL_ 154 OBJ_Angle_Mid_STD_V_16 1 "VALID" 0 "INVALID" ;
VAL_ 154 OBJ_Angle_Bottom_V_16 1 "VALID" 0 "INVALID" ;
VAL_ 154 OBJ_Angle_Bottom_STD_V_16 1 "VALID" 0 "INVALID" ;
VAL_ 154 OBJ_Visibility_Side_V_16 1 "VALID" 0 "INVALID" ;
VAL_ 154 OBJ_Visibility_Side_16 2 "REAR" 1 "FRONT" 0 "NOT_VISIBLE" ;
VAL_ 154 OBJ_Is_In_Drivable_Area_16 1 "TRUE" 0 "FALSE" ;
VAL_ 154 OBJ_Is_In_Drivable_Area_V_16 1 "VALID" 0 "INVALID" ;
VAL_ 154 OBJ_Is_VeryClose_V_16 1 "VALID" 0 "INVALID" ;
VAL_ 154 OBJ_Is_VeryClose_16 1 "TRUE" 0 "FALSE" ;
VAL_ 154 OBJ_OverlapAngleEgoLaneR_V_16 1 "VALID" 0 "INVALID" ;
VAL_ 154 OBJ_OverlapAngleEgoLaneL_V_16 1 "VALID" 0 "INVALID" ;
VAL_ 154 OBJ_Is_EMERGENCY_VCL_16 1 "TRUE" 0 "FALSE" ;
VAL_ 154 OBJ_EMERGENCY_LIGHT_COLOR_16 3 "(1000)ORANGE" 2 "(0100)BLUE" 1 "(0010)RED" 0 "(0001)OTHER" ;
VAL_ 154 OBJ_EMERGENCY_V_16 1 "TRUE" 0 "FALSE" ;
VAL_ 154 OBJ_Angle_Top_V_16 1 "VALID" 0 "INVALID" ;
VAL_ 154 OBJ_Angle_Top_STD_V_16 1 "VALID" 0 "INVALID" ;
VAL_ 154 OBJ_Fusion_Source_17 2 "(BIT_2)RADAR2" 1 "(BIT_1)RADAR1" 0 "(BIT_0)CAMERA" ;
VAL_ 154 OBJ_Triggered_SDM_17 2 "NOT_TRIGGERED" 1 "TRIGGERED" 0 "NOT_AVAILABLE" ;
VAL_ 154 OBJ_Motion_Category_17 13 "ONCOMING" 12 "PRECEEDING" 11 "MOVING" 10 "RTAP" 9 "LTAP" 8 "CROSSING" 7 "MOVING_OUT" 6 "MOVING_IN" 5 "CLOSE_CUT_IN" 4 "PASSING_OUT" 3 "PASSING_IN" 2 "PASSING" 1 "UNDEFINED" 0 "UNFILLED" ;
VAL_ 154 OBJ_Measuring_Status_17 2 "(BIT_2)NOT_VALID_OR_VALID" 1 "(BIT_1)PREDICTED_OR_MEASURED" 0 "(BIT_0)OLD_OR_NEW" ;
VAL_ 154 OBJ_Object_Class_17 8 "UNCERTAIN_VCL" 7 "ANIMAL" 6 "GENERAL_OBJECT" 5 "PEDESTRIAN" 4 "BICYCLE" 3 "MOTORBIKE" 2 "TRUCK" 1 "CAR" 0 "UNFILLED" ;
VAL_ 154 OBJ_Camera_Source_17 11 "PARKING_RIGHT" 10 "PARKING_LEFT" 9 "PARKING_REAR" 8 "PARKING_FRONT" 7 "FRONT_CORNER_RIGHT" 6 "FRONT_CORNER_LEFT" 5 "REAR_CORNER_RIGHT" 4 "REAR_CORNER_LEFT" 3 "REAR" 2 "FRONT_FISHEYE" 1 "FRONT_NARROW" 0 "FRONT_MAIN" ;
VAL_ 154 OBJ_Motion_Status_17 5 "MOVING_SLOWLY" 4 "STOPPED" 3 "STATIONARY" 2 "MOVING" 1 "UNKNOWN" 0 "INVALID" ;
VAL_ 154 OBJ_Motion_Orientation_17 13 "INVALID" 12 "NORTH" 11 "NORTH_WEST" 9 "WEST" 7 "SOUTH_WEST" 6 "SOUTH" 5 "SOUTH_EAST" 3 "EAST" 1 "NORTH_EAST" 0 "UNKNOWN" ;
VAL_ 154 OBJ_Has_Cut_Lane_17 1 "TRUE" 0 "FALSE" ;
VAL_ 154 OBJ_Has_Cut_Path_17 1 "TRUE" 0 "FALSE" ;
VAL_ 154 OBJ_Brake_Light_17 1 "TRUE" 0 "FALSE" ;
VAL_ 154 OBJ_Turn_Indicator_Right_17 1 "TRUE" 0 "FALSE" ;
VAL_ 154 OBJ_Turn_Indicator_Left_17 1 "TRUE" 0 "FALSE" ;
VAL_ 154 OBJ_Light_Indicator_Validity_17 1 "TRUE" 0 "FALSE" ;
VAL_ 154 OBJ_Right_Out_Of_Image_17 1 "TRUE" 0 "FALSE" ;
VAL_ 154 OBJ_Left_Out_Of_Image_17 1 "TRUE" 0 "FALSE" ;
VAL_ 154 OBJ_Right_Out_Of_Image_V_17 1 "TRUE" 0 "FALSE" ;
VAL_ 154 OBJ_Left_Out_Of_Image_V_17 1 "TRUE" 0 "FALSE" ;
VAL_ 154 OBJ_Top_Out_Of_Image_17 1 "TRUE" 0 "FALSE" ;
VAL_ 154 OBJ_Bottom_Out_Of_Image_17 1 "TRUE" 0 "FALSE" ;
VAL_ 154 OBJ_Top_Out_Of_Image_V_17 1 "VALID" 0 "INVALID" ;
VAL_ 154 OBJ_Bottom_Out_Of_Image_V_17 1 "VALID" 0 "INVALID" ;
VAL_ 154 OBJ_Lane_Assignment_17 5 "RIGHT_RIGHT" 4 "RIGHT" 3 "HOST" 2 "LEFT" 1 "LEFT_LEFT" 0 "UNKNOWN" ;
VAL_ 154 OBJ_Lane_Assignment_V_17 1 "VALID" 0 "INVALID" ;
VAL_ 154 OBJ_Age_Seconds_V_17 1 "VALID" 0 "INVALID" ;
VAL_ 154 OBJ_Width_V_17 1 "VALID" 0 "INVALID" ;
VAL_ 154 OBJ_Width_STD_V_17 1 "VALID" 0 "INVALID" ;
VAL_ 154 OBJ_Length_V_17 1 "VALID" 0 "INVALID" ;
VAL_ 154 OBJ_Length_STD_V_17 1 "VALID" 0 "INVALID" ;
VAL_ 154 OBJ_Height_V_17 1 "VALID" 0 "INVALID" ;
VAL_ 154 OBJ_Height_STD_V_17 1 "VALID" 0 "INVALID" ;
VAL_ 154 OBJ_Abs_Long_Velocity_V_17 1 "VALID" 0 "INVALID" ;
VAL_ 154 OBJ_Abs_Long_Vel_STD_V_17 1 "VALID" 0 "INVALID" ;
