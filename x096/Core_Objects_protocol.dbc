VERSION "14"
// BundelVersion=v4.20.10_RC1
NS_ :

BS_:

BU_: EyeQ4 MCU

BO_ 154 Core_Objects_protocol: 4660 EyeQ4
 SG_ OBJ_Angle_Left_STD_V_5 : 5518|1@1+ (1,0) [0|1] "bool" MCU
 SG_ OBJ_Angle_Side_5 : 5519|14@1+ (0.0002,-1.571) [-1.571|1.571] "rad" MCU
 SG_ OBJ_Angle_Side_V_5 : 5533|1@1+ (1,0) [0|1] "bool" MCU
 SG_ Reserved_18_5 : 5534|2@1+ (1,0) [0|0] "NA" MCU
 SG_ OBJ_Angle_Side_STD_5 : 5536|14@1+ (0.0001,0) [0|1.571] "rad" MCU
 SG_ OBJ_Angle_Side_STD_V_5 : 5550|1@1+ (1,0) [0|1] "bool" MCU
 SG_ OBJ_Angle_Mid_V_5 : 5551|1@1+ (1,0) [0|1] "bool" MCU
 SG_ OBJ_Angle_Mid_5 : 5552|14@1+ (0.0002,-1.571) [-1.571|1.571] "rad" MCU
 SG_ Reserved_19_5 : 5566|2@1+ (1,0) [0|0] "NA" MCU
 SG_ OBJ_Angle_Mid_STD_5 : 5568|14@1+ (0.0001,0) [0|1.571] "rad" MCU
 SG_ OBJ_Angle_Mid_STD_V_5 : 5582|1@1+ (1,0) [0|1] "bool" MCU
 SG_ OBJ_Angle_Bottom_V_5 : 5583|1@1+ (1,0) [0|1] "bool" MCU
 SG_ OBJ_Angle_Bottom_5 : 5584|14@1+ (0.0002,-1.571) [-1.571|1.571] "rad" MCU
 SG_ Reserved_20_5 : 5598|2@1+ (1,0) [0|0] "NA" MCU
 SG_ OBJ_Angle_Bottom_STD_5 : 5600|14@1+ (0.0001,0) [0|1.571] "rad" MCU
 SG_ OBJ_Angle_Bottom_STD_V_5 : 5614|1@1+ (1,0) [0|1] "bool" MCU
 SG_ OBJ_Visibility_Side_V_5 : 5615|1@1+ (1,0) [0|1] "bool" MCU
 SG_ OBJ_Visibility_Side_5 : 5616|2@1+ (1,0) [0|2] "ENUM" MCU
 SG_ OBJ_Is_In_Drivable_Area_5 : 5618|1@1+ (1,0) [0|1] "bool" MCU
 SG_ OBJ_Is_In_Drivable_Area_V_5 : 5619|1@1+ (1,0) [0|1] "bool" MCU
 SG_ OBJ_Is_VeryClose_V_5 : 5620|1@1+ (1,0) [0|1] "bool" MCU
 SG_ OBJ_Is_VeryClose_5 : 5621|1@1+ (1,0) [0|1] "bool" MCU
 SG_ OBJ_Buffer_C4_5 : 5622|2@1+ (1,0) [0|2] "NA" MCU
 SG_ OBJ_Buffer_C5_5 : 5624|2@1+ (1,0) [0|2] "NA" MCU
 SG_ OBJ_Buffer_C6_5 : 5626|2@1+ (1,0) [0|2] "NA" MCU
 SG_ OBJ_Buffer_C7_5 : 5628|2@1+ (1,0) [0|2] "NA" MCU
 SG_ Reserved_21_5 : 5630|2@1+ (1,0) [0|0] "NA" MCU
 SG_ OBJ_OverlapAngleEgoLaneR_5 : 5632|10@1+ (0.01,-3.14) [-3.14|3.14] "rad" MCU
 SG_ OBJ_OverlapAngleEgoLaneR_V_5 : 5642|1@1+ (1,0) [0|1] "bool" MCU
 SG_ OBJ_OverlapAngleEgoLaneL_5 : 5643|10@1+ (0.01,-3.14) [-3.14|3.14] "rad" MCU
 SG_ OBJ_OverlapAngleEgoLaneL_V_5 : 5653|1@1+ (1,0) [0|1] "bool" MCU
 SG_ OBJ_Is_EMERGENCY_VCL_5 : 5654|1@1+ (1,0) [0|1] "bool" MCU
 SG_ OBJ_EMERGENCY_LIGHT_COLOR_5 : 5655|4@1+ (1,0) [0|15] "BITWIZE" MCU
 SG_ OBJ_EMERGENCY_V_5 : 5659|1@1+ (1,0) [0|1] "bool" MCU
 SG_ Reserved_22_5 : 5660|4@1+ (1,0) [0|0] "NA" MCU
 SG_ OBJ_Angle_Top_5 : 5664|14@1+ (0.0002,0) [0|3.1415] "rad" MCU
 SG_ OBJ_Angle_Top_V_5 : 5678|1@1+ (1,0) [0|1] "bool" MCU
 SG_ OBJ_Angle_Top_STD_5 : 5679|15@1+ (0.0001,0) [0|3.1415] "rad" MCU
 SG_ OBJ_Angle_Top_STD_V_5 : 5694|1@1+ (1,0) [0|1] "bool" MCU
 SG_ OBJ_Buffer_C14_5 : 5695|1@1+ (1,0) [0|1] "NA" MCU
 SG_ OBJ_Buffer_C15_5 : 5696|1@1+ (1,0) [0|1] "NA" MCU
 SG_ OBJ_Buffer_C18_5 : 5697|2@1+ (1,0) [0|2] "NA" MCU
 SG_ OBJ_Buffer_C19_5 : 5699|1@1+ (1,0) [0|1] "NA" MCU
 SG_ Reserved_23_5 : 5700|28@1+ (1,0) [0|0] "NA" MCU
 SG_ OBJ_CRC_6 : 5728|32@1+ (1,0) [0|4294967295] "NA" MCU
 SG_ OBJ_ID_6 : 5760|8@1+ (1,0) [0|255] "counter" MCU
 SG_ OBJ_Existence_Probability_6 : 5768|8@1+ (0.01,0) [0|1] "NA" MCU
 SG_ OBJ_Fusion_Source_6 : 5776|16@1+ (1,0) [0|65535] "BITWIZE" MCU
 SG_ OBJ_Triggered_SDM_6 : 5792|2@1+ (1,0) [0|2] "ENUM" MCU
 SG_ OBJ_Motion_Category_6 : 5794|4@1+ (1,0) [0|13] "ENUM" MCU
 SG_ OBJ_Buffer_C0_6 : 5798|7@1+ (0.01,0) [0|1] "NA" MCU
 SG_ OBJ_Object_Age_6 : 5805|11@1+ (1,0) [0|2047] "frames" MCU
 SG_ OBJ_Measuring_Status_6 : 5816|3@1+ (1,0) [0|7] "BITWIZE" MCU
 SG_ OBJ_Object_Class_6 : 5819|4@1+ (1,0) [0|8] "ENUM" MCU
 SG_ Reserved_4_6 : 5823|1@1+ (1,0) [0|0] "NA" MCU
 SG_ OBJ_Class_Probability_6 : 5824|7@1+ (0.01,0) [0|1] "NA" MCU
 SG_ OBJ_Car_Probability_6 : 5831|7@1+ (0.01,0) [0|1] "NA" MCU
 SG_ OBJ_Truck_Probability_6 : 5838|7@1+ (0.01,0) [0|1] "NA" MCU
 SG_ OBJ_Bike_Probability_6 : 5845|7@1+ (0.01,0) [0|1] "NA" MCU
 SG_ OBJ_Camera_Source_6 : 5852|4@1+ (1,0) [0|15] "ENUM" MCU
 SG_ OBJ_Motion_Status_6 : 5856|3@1+ (1,0) [0|5] "ENUM" MCU
 SG_ OBJ_Motion_Orientation_6 : 5859|4@1+ (1,0) [0|13] "ENUM" MCU
 SG_ OBJ_Has_Cut_Lane_6 : 5863|1@1+ (1,0) [0|1] "bool" MCU
 SG_ OBJ_Has_Cut_Path_6 : 5864|1@1+ (1,0) [0|1] "bool" MCU
 SG_ OBJ_Brake_Light_6 : 5865|1@1+ (1,0) [0|1] "bool" MCU
 SG_ OBJ_Turn_Indicator_Right_6 : 5866|1@1+ (1,0) [0|1] "bool" MCU
 SG_ OBJ_Turn_Indicator_Left_6 : 5867|1@1+ (1,0) [0|1] "bool" MCU
 SG_ OBJ_Light_Indicator_Validity_6 : 5868|1@1+ (1,0) [0|1] "bool" MCU
 SG_ OBJ_Right_Out_Of_Image_6 : 5869|1@1+ (1,0) [0|1] "bool" MCU
 SG_ OBJ_Left_Out_Of_Image_6 : 5870|1@1+ (1,0) [0|1] "bool" MCU
 SG_ OBJ_Right_Out_Of_Image_V_6 : 5871|1@1+ (1,0) [0|1] "bool" MCU
 SG_ OBJ_Left_Out_Of_Image_V_6 : 5872|1@1+ (1,0) [0|1] "bool" MCU
 SG_ OBJ_Top_Out_Of_Image_6 : 5873|1@1+ (1,0) [0|1] "bool" MCU
 SG_ OBJ_Bottom_Out_Of_Image_6 : 5874|1@1+ (1,0) [0|1] "bool" MCU
 SG_ OBJ_Top_Out_Of_Image_V_6 : 5875|1@1+ (1,0) [0|1] "bool" MCU
 SG_ OBJ_Bottom_Out_Of_Image_V_6 : 5876|1@1+ (1,0) [0|1] "bool" MCU
 SG_ OBJ_Lane_Assignment_6 : 5877|3@1+ (1,0) [0|5] "ENUM" MCU
 SG_ OBJ_Lane_Assignment_V_6 : 5880|1@1+ (1,0) [0|1] "bool" MCU
 SG_ OBJ_Age_Seconds_6 : 5881|7@1+ (1,0) [0|100] "s" MCU
 SG_ OBJ_Age_Seconds_V_6 : 5888|1@1+ (1,0) [0|1] "bool" MCU
 SG_ OBJ_Width_6 : 5889|9@1+ (0.01,0) [0.4|2.95] "m" MCU
 SG_ OBJ_Width_V_6 : 5898|1@1+ (1,0) [0|1] "bool" MCU
 SG_ OBJ_Width_STD_6 : 5899|11@1+ (0.001,0) [0|2] "m" MCU
 SG_ OBJ_Width_STD_V_6 : 5910|1@1+ (1,0) [0|1] "bool" MCU
 SG_ OBJ_Length_6 : 5911|9@1+ (0.05,0) [1.2|21] "m" MCU
 SG_ OBJ_Length_V_6 : 5920|1@1+ (1,0) [0|1] "bool" MCU
 SG_ OBJ_Length_STD_6 : 5921|10@1+ (0.01,0) [0|10] "m" MCU
 SG_ OBJ_Length_STD_V_6 : 5931|1@1+ (1,0) [0|1] "bool" MCU
 SG_ OBJ_Radar_ID_6 : 5932|8@1+ (1,0) [0|255] "counter" MCU
 SG_ OBJ_Height_6 : 5940|9@1+ (0.01,0) [0|2.95] "m" MCU
 SG_ OBJ_Height_V_6 : 5949|1@1+ (1,0) [0|1] "bool" MCU
 SG_ Reserved_5_6 : 5950|2@1+ (1,0) [0|0] "NA" MCU
 SG_ OBJ_Height_STD_6 : 5952|11@1+ (0.001,0) [0|2] "m" MCU
 SG_ OBJ_Height_STD_V_6 : 5963|1@1+ (1,0) [0|1] "bool" MCU
 SG_ OBJ_Abs_Long_Velocity_6 : 5964|12@1+ (0.05,-100) [-100|100] "m_per_s" MCU
 SG_ OBJ_Abs_Long_Velocity_V_6 : 5976|1@1+ (1,0) [0|1] "bool" MCU
 SG_ Reserved_6_6 : 5977|7@1+ (1,0) [0|0] "NA" MCU
 SG_ OBJ_Abs_Long_Velocity_STD_6 : 5984|13@1+ (0.01,0) [0|65] "m_per_s" MCU
 SG_ OBJ_Abs_Long_Vel_STD_V_6 : 5997|1@1+ (1,0) [0|1] "bool" MCU
 SG_ OBJ_Abs_Lat_Velocity_6 : 5998|11@1+ (0.05,-50) [-50|50] "m_per_s" MCU
 SG_ OBJ_Abs_Lat_Velocity_V_6 : 6009|1@1+ (1,0) [0|1] "bool" MCU
 SG_ Reserved_7_6 : 6010|6@1+ (1,0) [0|0] "NA" MCU
 SG_ OBJ_Abs_Lat_Velocity_STD_6 : 6016|13@1+ (0.01,0) [0|50] "m_per_s" MCU
 SG_ OBJ_Abs_Lat_Vel_STD_V_6 : 6029|1@1+ (1,0) [0|1] "bool" MCU
 SG_ OBJ_Abs_Long_Acc_6 : 6030|9@1+ (0.05,-10) [-10|10] "m_per_s2" MCU
 SG_ OBJ_Abs_Long_Acc_V_6 : 6039|1@1+ (1,0) [0|1] "bool" MCU
 SG_ Reserved_8_6 : 6040|8@1+ (1,0) [0|0] "NA" MCU
 SG_ OBJ_Abs_Long_Acc_STD_6 : 6048|10@1+ (0.01,0) [0|7.3] "m_per_s2" MCU
 SG_ OBJ_Abs_Long_Acc_STD_V_6 : 6058|1@1+ (1,0) [0|1] "bool" MCU
 SG_ OBJ_Abs_Lat_Acc_6 : 6059|9@1+ (0.05,-10) [-10|10] "m_per_s2" MCU
 SG_ OBJ_Abs_Lat_Acc_V_6 : 6068|1@1+ (1,0) [0|1] "bool" MCU
 SG_ OBJ_Abs_Lat_Acc_STD_6 : 6069|10@1+ (0.01,0) [0|7.3] "m_per_s2" MCU
 SG_ OBJ_Abs_Lat_Acc_STD_V_6 : 6079|1@1+ (1,0) [0|1] "bool" MCU
 SG_ OBJ_Abs_Acceleration_6 : 6080|9@1+ (0.05,-12.7) [-12.7|12.7] "m_per_s2" MCU
 SG_ OBJ_Abs_Acceleration_V_6 : 6089|1@1+ (1,0) [0|1] "bool" MCU
 SG_ OBJ_Abs_Acc_STD_6 : 6090|10@1+ (0.01,0) [0|7.3] "m_per_s2" MCU
 SG_ OBJ_Abs_Acc_STD_V_6 : 6100|1@1+ (1,0) [0|1] "bool" MCU
 SG_ OBJ_Inv_TTC_6 : 6101|11@1+ (0.01,-8) [-8|8] "INV(s)" MCU
 SG_ OBJ_Inv_TTC_V_6 : 6112|1@1+ (1,0) [0|1] "bool" MCU
 SG_ OBJ_Inv_TTC_STD_6 : 6113|12@1+ (0.001,0) [0|4] "INV(s)" MCU
 SG_ OBJ_Inv_TTC_STD_V_6 : 6125|1@1+ (1,0) [0|1] "bool" MCU
 SG_ OBJ_Relative_Long_Acc_6 : 6126|10@1+ (0.05,-20) [-20|20] "m_per_s2" MCU
 SG_ OBJ_Relative_Long_Acc_V_6 : 6136|1@1+ (1,0) [0|1] "bool" MCU
 SG_ Reserved_9_6 : 6137|7@1+ (1,0) [0|0] "NA" MCU
 SG_ OBJ_Relative_Long_Acc_STD_6 : 6144|10@1+ (0.01,0) [0|7.3] "m_per_s2" MCU
 SG_ OBJ_Rel_Long_Acc_STD_V_6 : 6154|1@1+ (1,0) [0|1] "bool" MCU
 SG_ OBJ_Relative_Long_Velocity_6 : 6155|13@1+ (0.05,-120) [-120|130] "m_per_s" MCU
 SG_ OBJ_Relative_Long_Velocity_V_6 : 6168|1@1+ (1,0) [0|1] "bool" MCU
 SG_ Reserved_10_6 : 6169|7@1+ (1,0) [0|0] "NA" MCU
 SG_ OBJ_Relative_Long_Vel_STD_6 : 6176|14@1+ (0.01,0) [0|130] "m_per_s" MCU
 SG_ OBJ_Rel_Long_Vel_STD_V_6 : 6190|1@1+ (1,0) [0|1] "bool" MCU
 SG_ OBJ_Relative_Lat_Velocity_6 : 6191|11@1+ (0.05,-50) [-50|50] "m_per_s" MCU
 SG_ OBJ_Relative_Lat_Velocity_V_6 : 6202|1@1+ (1,0) [0|1] "bool" MCU
 SG_ Reserved_11_6 : 6203|5@1+ (1,0) [0|0] "NA" MCU
 SG_ OBJ_Relative_Lat_Velocity_STD_6 : 6208|13@1+ (0.01,0) [0|50] "m_per_s" MCU
 SG_ OBJ_Rel_Lat_Vel_STD_V_6 : 6221|1@1+ (1,0) [0|1] "bool" MCU
 SG_ OBJ_Long_Distance_6 : 6222|14@1+ (0.05,-200) [-200|500] "m" MCU
 SG_ OBJ_Long_Distance_V_6 : 6236|1@1+ (1,0) [0|1] "bool" MCU
 SG_ Reserved_12_6 : 6237|3@1+ (1,0) [0|0] "NA" MCU
 SG_ OBJ_Long_Distance_STD_6 : 6240|15@1+ (0.01,0) [0|250] "m" MCU
 SG_ OBJ_Long_Distance_STD_V_6 : 6255|1@1+ (1,0) [0|1] "bool" MCU
 SG_ OBJ_Lat_Distance_6 : 6256|12@1+ (0.05,-100) [-100|100] "m" MCU
 SG_ OBJ_Lat_Distance_V_6 : 6268|1@1+ (1,0) [0|1] "bool" MCU
 SG_ Reserved_13_6 : 6269|3@1+ (1,0) [0|0] "NA" MCU
 SG_ OBJ_Lat_Distance_STD_6 : 6272|14@1+ (0.01,0) [0|100] "m" MCU
 SG_ OBJ_Lat_Distance_STD_V_6 : 6286|1@1+ (1,0) [0|1] "bool" MCU
 SG_ OBJ_Absolute_Speed_6 : 6287|12@1+ (0.05,-65) [-65|65] "m_per_s" MCU
 SG_ OBJ_Absolute_Speed_V_6 : 6299|1@1+ (1,0) [0|1] "bool" MCU
 SG_ Reserved_14_6 : 6300|4@1+ (1,0) [0|0] "NA" MCU
 SG_ OBJ_Absolute_Speed_STD_6 : 6304|13@1+ (0.01,0) [0|65] "m_per_s" MCU
 SG_ OBJ_Absolute_Speed_STD_V_6 : 6317|1@1+ (1,0) [0|1] "bool" MCU
 SG_ OBJ_Heading_6 : 6318|10@1+ (0.01,-3.14) [-3.14|3.14] "rad" MCU
 SG_ OBJ_Heading_V_6 : 6328|1@1+ (1,0) [0|1] "bool" MCU
 SG_ Reserved_15_6 : 6329|7@1+ (1,0) [0|0] "NA" MCU
 SG_ OBJ_Heading_STD_6 : 6336|15@1+ (0.0001,0) [0|3.14] "rad" MCU
 SG_ OBJ_Heading_STD_V_6 : 6351|1@1+ (1,0) [0|1] "bool" MCU
 SG_ OBJ_Angle_Rate_STD_6 : 6352|15@1+ (0.0001,0) [0|2.2318] "RPS" MCU
 SG_ OBJ_Angle_Rate_STD_V_6 : 6367|1@1+ (1,0) [0|1] "bool" MCU
 SG_ OBJ_Angle_Rate_6 : 6368|12@1+ (0.002,-2.234) [-2.234|2.2318] "RPS" MCU
 SG_ OBJ_Angle_Rate_V_6 : 6380|1@1+ (1,0) [0|1] "bool" MCU
 SG_ OBJ_Angle_Right_6 : 6381|14@1+ (0.0002,-1.571) [-1.571|1.571] "rad" MCU
 SG_ OBJ_Angle_Right_V_6 : 6395|1@1+ (1,0) [0|1] "bool" MCU
 SG_ Reserved_16_6 : 6396|4@1+ (1,0) [0|0] "NA" MCU
 SG_ OBJ_Angle_Right_STD_6 : 6400|14@1+ (0.0001,0) [0|1.571] "rad" MCU
 SG_ OBJ_Angle_Right_STD_V_6 : 6414|1@1+ (1,0) [0|1] "bool" MCU
 SG_ OBJ_Angle_Left_6 : 6415|14@1+ (0.0002,-1.571) [-1.571|1.571] "rad" MCU
 SG_ OBJ_Angle_Left_V_6 : 6429|1@1+ (1,0) [0|1] "bool" MCU
 SG_ Reserved_17_6 : 6430|2@1+ (1,0) [0|0] "NA" MCU
 SG_ OBJ_Angle_Left_STD_6 : 6432|14@1+ (0.0001,0) [0|1.571] "rad" MCU
 SG_ OBJ_Angle_Left_STD_V_6 : 6446|1@1+ (1,0) [0|1] "bool" MCU
 SG_ OBJ_Angle_Side_6 : 6447|14@1+ (0.0002,-1.571) [-1.571|1.571] "rad" MCU
 SG_ OBJ_Angle_Side_V_6 : 6461|1@1+ (1,0) [0|1] "bool" MCU
 SG_ Reserved_18_6 : 6462|2@1+ (1,0) [0|0] "NA" MCU
 SG_ OBJ_Angle_Side_STD_6 : 6464|14@1+ (0.0001,0) [0|1.571] "rad" MCU
 SG_ OBJ_Angle_Side_STD_V_6 : 6478|1@1+ (1,0) [0|1] "bool" MCU
 SG_ OBJ_Angle_Mid_V_6 : 6479|1@1+ (1,0) [0|1] "bool" MCU
 SG_ OBJ_Angle_Mid_6 : 6480|14@1+ (0.0002,-1.571) [-1.571|1.571] "rad" MCU
 SG_ Reserved_19_6 : 6494|2@1+ (1,0) [0|0] "NA" MCU
 SG_ OBJ_Angle_Mid_STD_6 : 6496|14@1+ (0.0001,0) [0|1.571] "rad" MCU
 SG_ OBJ_Angle_Mid_STD_V_6 : 6510|1@1+ (1,0) [0|1] "bool" MCU
 SG_ OBJ_Angle_Bottom_V_6 : 6511|1@1+ (1,0) [0|1] "bool" MCU
 SG_ OBJ_Angle_Bottom_6 : 6512|14@1+ (0.0002,-1.571) [-1.571|1.571] "rad" MCU
 SG_ Reserved_20_6 : 6526|2@1+ (1,0) [0|0] "NA" MCU
 SG_ OBJ_Angle_Bottom_STD_6 : 6528|14@1+ (0.0001,0) [0|1.571] "rad" MCU
 SG_ OBJ_Angle_Bottom_STD_V_6 : 6542|1@1+ (1,0) [0|1] "bool" MCU
 SG_ OBJ_Visibility_Side_V_6 : 6543|1@1+ (1,0) [0|1] "bool" MCU
 SG_ OBJ_Visibility_Side_6 : 6544|2@1+ (1,0) [0|2] "ENUM" MCU
 SG_ OBJ_Is_In_Drivable_Area_6 : 6546|1@1+ (1,0) [0|1] "bool" MCU
 SG_ OBJ_Is_In_Drivable_Area_V_6 : 6547|1@1+ (1,0) [0|1] "bool" MCU
 SG_ OBJ_Is_VeryClose_V_6 : 6548|1@1+ (1,0) [0|1] "bool" MCU
 SG_ OBJ_Is_VeryClose_6 : 6549|1@1+ (1,0) [0|1] "bool" MCU
 SG_ OBJ_Buffer_C4_6 : 6550|2@1+ (1,0) [0|2] "NA" MCU
 SG_ OBJ_Buffer_C5_6 : 6552|2@1+ (1,0) [0|2] "NA" MCU
 SG_ OBJ_Buffer_C6_6 : 6554|2@1+ (1,0) [0|2] "NA" MCU
 SG_ OBJ_Buffer_C7_6 : 6556|2@1+ (1,0) [0|2] "NA" MCU
 SG_ Reserved_21_6 : 6558|2@1+ (1,0) [0|0] "NA" MCU
 SG_ OBJ_OverlapAngleEgoLaneR_6 : 6560|10@1+ (0.01,-3.14) [-3.14|3.14] "rad" MCU
 SG_ OBJ_OverlapAngleEgoLaneR_V_6 : 6570|1@1+ (1,0) [0|1] "bool" MCU
 SG_ OBJ_OverlapAngleEgoLaneL_6 : 6571|10@1+ (0.01,-3.14) [-3.14|3.14] "rad" MCU
 SG_ OBJ_OverlapAngleEgoLaneL_V_6 : 6581|1@1+ (1,0) [0|1] "bool" MCU
 SG_ OBJ_Is_EMERGENCY_VCL_6 : 6582|1@1+ (1,0) [0|1] "bool" MCU
 SG_ OBJ_EMERGENCY_LIGHT_COLOR_6 : 6583|4@1+ (1,0) [0|15] "BITWIZE" MCU
 SG_ OBJ_EMERGENCY_V_6 : 6587|1@1+ (1,0) [0|1] "bool" MCU
 SG_ Reserved_22_6 : 6588|4@1+ (1,0) [0|0] "NA" MCU
 SG_ OBJ_Angle_Top_6 : 6592|14@1+ (0.0002,0) [0|3.1415] "rad" MCU
 SG_ OBJ_Angle_Top_V_6 : 6606|1@1+ (1,0) [0|1] "bool" MCU
 SG_ OBJ_Angle_Top_STD_6 : 6607|15@1+ (0.0001,0) [0|3.1415] "rad" MCU
 SG_ OBJ_Angle_Top_STD_V_6 : 6622|1@1+ (1,0) [0|1] "bool" MCU
 SG_ OBJ_Buffer_C14_6 : 6623|1@1+ (1,0) [0|1] "NA" MCU
 SG_ OBJ_Buffer_C15_6 : 6624|1@1+ (1,0) [0|1] "NA" MCU
 SG_ OBJ_Buffer_C18_6 : 6625|2@1+ (1,0) [0|2] "NA" MCU
 SG_ OBJ_Buffer_C19_6 : 6627|1@1+ (1,0) [0|1] "NA" MCU
 SG_ Reserved_23_6 : 6628|28@1+ (1,0) [0|0] "NA" MCU
 SG_ OBJ_CRC_7 : 6656|32@1+ (1,0) [0|4294967295] "NA" MCU
 SG_ OBJ_ID_7 : 6688|8@1+ (1,0) [0|255] "counter" MCU
 SG_ OBJ_Existence_Probability_7 : 6696|8@1+ (0.01,0) [0|1] "NA" MCU
 SG_ OBJ_Fusion_Source_7 : 6704|16@1+ (1,0) [0|65535] "BITWIZE" MCU
 SG_ OBJ_Triggered_SDM_7 : 6720|2@1+ (1,0) [0|2] "ENUM" MCU
 SG_ OBJ_Motion_Category_7 : 6722|4@1+ (1,0) [0|13] "ENUM" MCU
 SG_ OBJ_Buffer_C0_7 : 6726|7@1+ (0.01,0) [0|1] "NA" MCU
 SG_ OBJ_Object_Age_7 : 6733|11@1+ (1,0) [0|2047] "frames" MCU
 SG_ OBJ_Measuring_Status_7 : 6744|3@1+ (1,0) [0|7] "BITWIZE" MCU
 SG_ OBJ_Object_Class_7 : 6747|4@1+ (1,0) [0|8] "ENUM" MCU
 SG_ Reserved_4_7 : 6751|1@1+ (1,0) [0|0] "NA" MCU
 SG_ OBJ_Class_Probability_7 : 6752|7@1+ (0.01,0) [0|1] "NA" MCU
 SG_ OBJ_Car_Probability_7 : 6759|7@1+ (0.01,0) [0|1] "NA" MCU
 SG_ OBJ_Truck_Probability_7 : 6766|7@1+ (0.01,0) [0|1] "NA" MCU
 SG_ OBJ_Bike_Probability_7 : 6773|7@1+ (0.01,0) [0|1] "NA" MCU
 SG_ OBJ_Camera_Source_7 : 6780|4@1+ (1,0) [0|15] "ENUM" MCU
 SG_ OBJ_Motion_Status_7 : 6784|3@1+ (1,0) [0|5] "ENUM" MCU
 SG_ OBJ_Motion_Orientation_7 : 6787|4@1+ (1,0) [0|13] "ENUM" MCU
 SG_ OBJ_Has_Cut_Lane_7 : 6791|1@1+ (1,0) [0|1] "bool" MCU
 SG_ OBJ_Has_Cut_Path_7 : 6792|1@1+ (1,0) [0|1] "bool" MCU
 SG_ OBJ_Brake_Light_7 : 6793|1@1+ (1,0) [0|1] "bool" MCU
 SG_ OBJ_Turn_Indicator_Right_7 : 6794|1@1+ (1,0) [0|1] "bool" MCU
 SG_ OBJ_Turn_Indicator_Left_7 : 6795|1@1+ (1,0) [0|1] "bool" MCU
 SG_ OBJ_Light_Indicator_Validity_7 : 6796|1@1+ (1,0) [0|1] "bool" MCU
 SG_ OBJ_Right_Out_Of_Image_7 : 6797|1@1+ (1,0) [0|1] "bool" MCU
 SG_ OBJ_Left_Out_Of_Image_7 : 6798|1@1+ (1,0) [0|1] "bool" MCU
 SG_ OBJ_Right_Out_Of_Image_V_7 : 6799|1@1+ (1,0) [0|1] "bool" MCU
 SG_ OBJ_Left_Out_Of_Image_V_7 : 6800|1@1+ (1,0) [0|1] "bool" MCU
 SG_ OBJ_Top_Out_Of_Image_7 : 6801|1@1+ (1,0) [0|1] "bool" MCU
 SG_ OBJ_Bottom_Out_Of_Image_7 : 6802|1@1+ (1,0) [0|1] "bool" MCU
 SG_ OBJ_Top_Out_Of_Image_V_7 : 6803|1@1+ (1,0) [0|1] "bool" MCU
 SG_ OBJ_Bottom_Out_Of_Image_V_7 : 6804|1@1+ (1,0) [0|1] "bool" MCU
 SG_ OBJ_Lane_Assignment_7 : 6805|3@1+ (1,0) [0|5] "ENUM" MCU
 SG_ OBJ_Lane_Assignment_V_7 : 6808|1@1+ (1,0) [0|1] "bool" MCU
 SG_ OBJ_Age_Seconds_7 : 6809|7@1+ (1,0) [0|100] "s" MCU
 SG_ OBJ_Age_Seconds_V_7 : 6816|1@1+ (1,0) [0|1] "bool" MCU
 SG_ OBJ_Width_7 : 6817|9@1+ (0.01,0) [0.4|2.95] "m" MCU
 SG_ OBJ_Width_V_7 : 6826|1@1+ (1,0) [0|1] "bool" MCU
 SG_ OBJ_Width_STD_7 : 6827|11@1+ (0.001,0) [0|2] "m" MCU
 SG_ OBJ_Width_STD_V_7 : 6838|1@1+ (1,0) [0|1] "bool" MCU
 SG_ OBJ_Length_7 : 6839|9@1+ (0.05,0) [1.2|21] "m" MCU
 SG_ OBJ_Length_V_7 : 6848|1@1+ (1,0) [0|1] "bool" MCU
 SG_ OBJ_Length_STD_7 : 6849|10@1+ (0.01,0) [0|10] "m" MCU
 SG_ OBJ_Length_STD_V_7 : 6859|1@1+ (1,0) [0|1] "bool" MCU
 SG_ OBJ_Radar_ID_7 : 6860|8@1+ (1,0) [0|255] "counter" MCU
 SG_ OBJ_Height_7 : 6868|9@1+ (0.01,0) [0|2.95] "m" MCU
 SG_ OBJ_Height_V_7 : 6877|1@1+ (1,0) [0|1] "bool" MCU
 SG_ Reserved_5_7 : 6878|2@1+ (1,0) [0|0] "NA" MCU
 SG_ OBJ_Height_STD_7 : 6880|11@1+ (0.001,0) [0|2] "m" MCU
 SG_ OBJ_Height_STD_V_7 : 6891|1@1+ (1,0) [0|1] "bool" MCU
 SG_ OBJ_Abs_Long_Velocity_7 : 6892|12@1+ (0.05,-100) [-100|100] "m_per_s" MCU
 SG_ OBJ_Abs_Long_Velocity_V_7 : 6904|1@1+ (1,0) [0|1] "bool" MCU
 SG_ Reserved_6_7 : 6905|7@1+ (1,0) [0|0] "NA" MCU
 SG_ OBJ_Abs_Long_Velocity_STD_7 : 6912|13@1+ (0.01,0) [0|65] "m_per_s" MCU
 SG_ OBJ_Abs_Long_Vel_STD_V_7 : 6925|1@1+ (1,0) [0|1] "bool" MCU
 SG_ OBJ_Abs_Lat_Velocity_7 : 6926|11@1+ (0.05,-50) [-50|50] "m_per_s" MCU
 SG_ OBJ_Abs_Lat_Velocity_V_7 : 6937|1@1+ (1,0) [0|1] "bool" MCU
 SG_ Reserved_7_7 : 6938|6@1+ (1,0) [0|0] "NA" MCU
 SG_ OBJ_Abs_Lat_Velocity_STD_7 : 6944|13@1+ (0.01,0) [0|50] "m_per_s" MCU
 SG_ OBJ_Abs_Lat_Vel_STD_V_7 : 6957|1@1+ (1,0) [0|1] "bool" MCU
 SG_ OBJ_Abs_Long_Acc_7 : 6958|9@1+ (0.05,-10) [-10|10] "m_per_s2" MCU
 SG_ OBJ_Abs_Long_Acc_V_7 : 6967|1@1+ (1,0) [0|1] "bool" MCU
 SG_ Reserved_8_7 : 6968|8@1+ (1,0) [0|0] "NA" MCU
 SG_ OBJ_Abs_Long_Acc_STD_7 : 6976|10@1+ (0.01,0) [0|7.3] "m_per_s2" MCU
 SG_ OBJ_Abs_Long_Acc_STD_V_7 : 6986|1@1+ (1,0) [0|1] "bool" MCU
 SG_ OBJ_Abs_Lat_Acc_7 : 6987|9@1+ (0.05,-10) [-10|10] "m_per_s2" MCU
 SG_ OBJ_Abs_Lat_Acc_V_7 : 6996|1@1+ (1,0) [0|1] "bool" MCU
 SG_ OBJ_Abs_Lat_Acc_STD_7 : 6997|10@1+ (0.01,0) [0|7.3] "m_per_s2" MCU
 SG_ OBJ_Abs_Lat_Acc_STD_V_7 : 7007|1@1+ (1,0) [0|1] "bool" MCU
 SG_ OBJ_Abs_Acceleration_7 : 7008|9@1+ (0.05,-12.7) [-12.7|12.7] "m_per_s2" MCU
 SG_ OBJ_Abs_Acceleration_V_7 : 7017|1@1+ (1,0) [0|1] "bool" MCU
 SG_ OBJ_Abs_Acc_STD_7 : 7018|10@1+ (0.01,0) [0|7.3] "m_per_s2" MCU
 SG_ OBJ_Abs_Acc_STD_V_7 : 7028|1@1+ (1,0) [0|1] "bool" MCU
 SG_ OBJ_Inv_TTC_7 : 7029|11@1+ (0.01,-8) [-8|8] "INV(s)" MCU
 SG_ OBJ_Inv_TTC_V_7 : 7040|1@1+ (1,0) [0|1] "bool" MCU
 SG_ OBJ_Inv_TTC_STD_7 : 7041|12@1+ (0.001,0) [0|4] "INV(s)" MCU
 SG_ OBJ_Inv_TTC_STD_V_7 : 7053|1@1+ (1,0) [0|1] "bool" MCU
 SG_ OBJ_Relative_Long_Acc_7 : 7054|10@1+ (0.05,-20) [-20|20] "m_per_s2" MCU
 SG_ OBJ_Relative_Long_Acc_V_7 : 7064|1@1+ (1,0) [0|1] "bool" MCU
 SG_ Reserved_9_7 : 7065|7@1+ (1,0) [0|0] "NA" MCU
 SG_ OBJ_Relative_Long_Acc_STD_7 : 7072|10@1+ (0.01,0) [0|7.3] "m_per_s2" MCU
 SG_ OBJ_Rel_Long_Acc_STD_V_7 : 7082|1@1+ (1,0) [0|1] "bool" MCU
 SG_ OBJ_Relative_Long_Velocity_7 : 7083|13@1+ (0.05,-120) [-120|130] "m_per_s" MCU
 SG_ OBJ_Relative_Long_Velocity_V_7 : 7096|1@1+ (1,0) [0|1] "bool" MCU
 SG_ Reserved_10_7 : 7097|7@1+ (1,0) [0|0] "NA" MCU
 SG_ OBJ_Relative_Long_Vel_STD_7 : 7104|14@1+ (0.01,0) [0|130] "m_per_s" MCU
 SG_ OBJ_Rel_Long_Vel_STD_V_7 : 7118|1@1+ (1,0) [0|1] "bool" MCU
 SG_ OBJ_Relative_Lat_Velocity_7 : 7119|11@1+ (0.05,-50) [-50|50] "m_per_s" MCU
 SG_ OBJ_Relative_Lat_Velocity_V_7 : 7130|1@1+ (1,0) [0|1] "bool" MCU
 SG_ Reserved_11_7 : 7131|5@1+ (1,0) [0|0] "NA" MCU
 SG_ OBJ_Relative_Lat_Velocity_STD_7 : 7136|13@1+ (0.01,0) [0|50] "m_per_s" MCU
 SG_ OBJ_Rel_Lat_Vel_STD_V_7 : 7149|1@1+ (1,0) [0|1] "bool" MCU
 SG_ OBJ_Long_Distance_7 : 7150|14@1+ (0.05,-200) [-200|500] "m" MCU
 SG_ OBJ_Long_Distance_V_7 : 7164|1@1+ (1,0) [0|1] "bool" MCU
 SG_ Reserved_12_7 : 7165|3@1+ (1,0) [0|0] "NA" MCU
 SG_ OBJ_Long_Distance_STD_7 : 7168|15@1+ (0.01,0) [0|250] "m" MCU
 SG_ OBJ_Long_Distance_STD_V_7 : 7183|1@1+ (1,0) [0|1] "bool" MCU
 SG_ OBJ_Lat_Distance_7 : 7184|12@1+ (0.05,-100) [-100|100] "m" MCU
 SG_ OBJ_Lat_Distance_V_7 : 7196|1@1+ (1,0) [0|1] "bool" MCU
 SG_ Reserved_13_7 : 7197|3@1+ (1,0) [0|0] "NA" MCU
 SG_ OBJ_Lat_Distance_STD_7 : 7200|14@1+ (0.01,0) [0|100] "m" MCU
 SG_ OBJ_Lat_Distance_STD_V_7 : 7214|1@1+ (1,0) [0|1] "bool" MCU
 SG_ OBJ_Absolute_Speed_7 : 7215|12@1+ (0.05,-65) [-65|65] "m_per_s" MCU
 SG_ OBJ_Absolute_Speed_V_7 : 7227|1@1+ (1,0) [0|1] "bool" MCU
 SG_ Reserved_14_7 : 7228|4@1+ (1,0) [0|0] "NA" MCU
 SG_ OBJ_Absolute_Speed_STD_7 : 7232|13@1+ (0.01,0) [0|65] "m_per_s" MCU
 SG_ OBJ_Absolute_Speed_STD_V_7 : 7245|1@1+ (1,0) [0|1] "bool" MCU
 SG_ OBJ_Heading_7 : 7246|10@1+ (0.01,-3.14) [-3.14|3.14] "rad" MCU
 SG_ OBJ_Heading_V_7 : 7256|1@1+ (1,0) [0|1] "bool" MCU
 SG_ Reserved_15_7 : 7257|7@1+ (1,0) [0|0] "NA" MCU
 SG_ OBJ_Heading_STD_7 : 7264|15@1+ (0.0001,0) [0|3.14] "rad" MCU
 SG_ OBJ_Heading_STD_V_7 : 7279|1@1+ (1,0) [0|1] "bool" MCU
 SG_ OBJ_Angle_Rate_STD_7 : 7280|15@1+ (0.0001,0) [0|2.2318] "RPS" MCU
 SG_ OBJ_Angle_Rate_STD_V_7 : 7295|1@1+ (1,0) [0|1] "bool" MCU
 SG_ OBJ_Angle_Rate_7 : 7296|12@1+ (0.002,-2.234) [-2.234|2.2318] "RPS" MCU
 SG_ OBJ_Angle_Rate_V_7 : 7308|1@1+ (1,0) [0|1] "bool" MCU
 SG_ OBJ_Angle_Right_7 : 7309|14@1+ (0.0002,-1.571) [-1.571|1.571] "rad" MCU
 SG_ OBJ_Angle_Right_V_7 : 7323|1@1+ (1,0) [0|1] "bool" MCU
 SG_ Reserved_16_7 : 7324|4@1+ (1,0) [0|0] "NA" MCU
 SG_ OBJ_Angle_Right_STD_7 : 7328|14@1+ (0.0001,0) [0|1.571] "rad" MCU
 SG_ OBJ_Angle_Right_STD_V_7 : 7342|1@1+ (1,0) [0|1] "bool" MCU
 SG_ OBJ_Angle_Left_7 : 7343|14@1+ (0.0002,-1.571) [-1.571|1.571] "rad" MCU
 SG_ OBJ_Angle_Left_V_7 : 7357|1@1+ (1,0) [0|1] "bool" MCU
 SG_ Reserved_17_7 : 7358|2@1+ (1,0) [0|0] "NA" MCU
 SG_ OBJ_Angle_Left_STD_7 : 7360|14@1+ (0.0001,0) [0|1.571] "rad" MCU
 SG_ OBJ_Angle_Left_STD_V_7 : 7374|1@1+ (1,0) [0|1] "bool" MCU
 SG_ OBJ_Angle_Side_7 : 7375|14@1+ (0.0002,-1.571) [-1.571|1.571] "rad" MCU
 SG_ OBJ_Angle_Side_V_7 : 7389|1@1+ (1,0) [0|1] "bool" MCU
 SG_ Reserved_18_7 : 7390|2@1+ (1,0) [0|0] "NA" MCU
 SG_ OBJ_Angle_Side_STD_7 : 7392|14@1+ (0.0001,0) [0|1.571] "rad" MCU
 SG_ OBJ_Angle_Side_STD_V_7 : 7406|1@1+ (1,0) [0|1] "bool" MCU
 SG_ OBJ_Angle_Mid_V_7 : 7407|1@1+ (1,0) [0|1] "bool" MCU
 SG_ OBJ_Angle_Mid_7 : 7408|14@1+ (0.0002,-1.571) [-1.571|1.571] "rad" MCU
 SG_ Reserved_19_7 : 7422|2@1+ (1,0) [0|0] "NA" MCU
 SG_ OBJ_Angle_Mid_STD_7 : 7424|14@1+ (0.0001,0) [0|1.571] "rad" MCU
 SG_ OBJ_Angle_Mid_STD_V_7 : 7438|1@1+ (1,0) [0|1] "bool" MCU
 SG_ OBJ_Angle_Bottom_V_7 : 7439|1@1+ (1,0) [0|1] "bool" MCU
 SG_ OBJ_Angle_Bottom_7 : 7440|14@1+ (0.0002,-1.571) [-1.571|1.571] "rad" MCU
 SG_ Reserved_20_7 : 7454|2@1+ (1,0) [0|0] "NA" MCU
 SG_ OBJ_Angle_Bottom_STD_7 : 7456|14@1+ (0.0001,0) [0|1.571] "rad" MCU
 SG_ OBJ_Angle_Bottom_STD_V_7 : 7470|1@1+ (1,0) [0|1] "bool" MCU
 SG_ OBJ_Visibility_Side_V_7 : 7471|1@1+ (1,0) [0|1] "bool" MCU
 SG_ OBJ_Visibility_Side_7 : 7472|2@1+ (1,0) [0|2] "ENUM" MCU
 SG_ OBJ_Is_In_Drivable_Area_7 : 7474|1@1+ (1,0) [0|1] "bool" MCU
 SG_ OBJ_Is_In_Drivable_Area_V_7 : 7475|1@1+ (1,0) [0|1] "bool" MCU
 SG_ OBJ_Is_VeryClose_V_7 : 7476|1@1+ (1,0) [0|1] "bool" MCU
 SG_ OBJ_Is_VeryClose_7 : 7477|1@1+ (1,0) [0|1] "bool" MCU
 SG_ OBJ_Buffer_C4_7 : 7478|2@1+ (1,0) [0|2] "NA" MCU
 SG_ OBJ_Buffer_C5_7 : 7480|2@1+ (1,0) [0|2] "NA" MCU
 SG_ OBJ_Buffer_C6_7 : 7482|2@1+ (1,0) [0|2] "NA" MCU
 SG_ OBJ_Buffer_C7_7 : 7484|2@1+ (1,0) [0|2] "NA" MCU
 SG_ Reserved_21_7 : 7486|2@1+ (1,0) [0|0] "NA" MCU
 SG_ OBJ_OverlapAngleEgoLaneR_7 : 7488|10@1+ (0.01,-3.14) [-3.14|3.14] "rad" MCU
 SG_ OBJ_OverlapAngleEgoLaneR_V_7 : 7498|1@1+ (1,0) [0|1] "bool" MCU
 SG_ OBJ_OverlapAngleEgoLaneL_7 : 7499|10@1+ (0.01,-3.14) [-3.14|3.14] "rad" MCU
 SG_ OBJ_OverlapAngleEgoLaneL_V_7 : 7509|1@1+ (1,0) [0|1] "bool" MCU
 SG_ OBJ_Is_EMERGENCY_VCL_7 : 7510|1@1+ (1,0) [0|1] "bool" MCU
 SG_ OBJ_EMERGENCY_LIGHT_COLOR_7 : 7511|4@1+ (1,0) [0|15] "BITWIZE" MCU
 SG_ OBJ_EMERGENCY_V_7 : 7515|1@1+ (1,0) [0|1] "bool" MCU
 SG_ Reserved_22_7 : 7516|4@1+ (1,0) [0|0] "NA" MCU
 SG_ OBJ_Angle_Top_7 : 7520|14@1+ (0.0002,0) [0|3.1415] "rad" MCU
 SG_ OBJ_Angle_Top_V_7 : 7534|1@1+ (1,0) [0|1] "bool" MCU
 SG_ OBJ_Angle_Top_STD_7 : 7535|15@1+ (0.0001,0) [0|3.1415] "rad" MCU
 SG_ OBJ_Angle_Top_STD_V_7 : 7550|1@1+ (1,0) [0|1] "bool" MCU
 SG_ OBJ_Buffer_C14_7 : 7551|1@1+ (1,0) [0|1] "NA" MCU
 SG_ OBJ_Buffer_C15_7 : 7552|1@1+ (1,0) [0|1] "NA" MCU
 SG_ OBJ_Buffer_C18_7 : 7553|2@1+ (1,0) [0|2] "NA" MCU
 SG_ OBJ_Buffer_C19_7 : 7555|1@1+ (1,0) [0|1] "NA" MCU
 SG_ Reserved_23_7 : 7556|28@1+ (1,0) [0|0] "NA" MCU
 SG_ OBJ_CRC_8 : 7584|32@1+ (1,0) [0|4294967295] "NA" MCU
 SG_ OBJ_ID_8 : 7616|8@1+ (1,0) [0|255] "counter" MCU
 SG_ OBJ_Existence_Probability_8 : 7624|8@1+ (0.01,0) [0|1] "NA" MCU
 SG_ OBJ_Fusion_Source_8 : 7632|16@1+ (1,0) [0|65535] "BITWIZE" MCU
 SG_ OBJ_Triggered_SDM_8 : 7648|2@1+ (1,0) [0|2] "ENUM" MCU
 SG_ OBJ_Motion_Category_8 : 7650|4@1+ (1,0) [0|13] "ENUM" MCU
 SG_ OBJ_Buffer_C0_8 : 7654|7@1+ (0.01,0) [0|1] "NA" MCU
 SG_ OBJ_Object_Age_8 : 7661|11@1+ (1,0) [0|2047] "frames" MCU
 SG_ OBJ_Measuring_Status_8 : 7672|3@1+ (1,0) [0|7] "BITWIZE" MCU
 SG_ OBJ_Object_Class_8 : 7675|4@1+ (1,0) [0|8] "ENUM" MCU
 SG_ Reserved_4_8 : 7679|1@1+ (1,0) [0|0] "NA" MCU
 SG_ OBJ_Class_Probability_8 : 7680|7@1+ (0.01,0) [0|1] "NA" MCU
 SG_ OBJ_Car_Probability_8 : 7687|7@1+ (0.01,0) [0|1] "NA" MCU
 SG_ OBJ_Truck_Probability_8 : 7694|7@1+ (0.01,0) [0|1] "NA" MCU
 SG_ OBJ_Bike_Probability_8 : 7701|7@1+ (0.01,0) [0|1] "NA" MCU
 SG_ OBJ_Camera_Source_8 : 7708|4@1+ (1,0) [0|15] "ENUM" MCU
 SG_ OBJ_Motion_Status_8 : 7712|3@1+ (1,0) [0|5] "ENUM" MCU
 SG_ OBJ_Motion_Orientation_8 : 7715|4@1+ (1,0) [0|13] "ENUM" MCU
 SG_ OBJ_Has_Cut_Lane_8 : 7719|1@1+ (1,0) [0|1] "bool" MCU
 SG_ OBJ_Has_Cut_Path_8 : 7720|1@1+ (1,0) [0|1] "bool" MCU
 SG_ OBJ_Brake_Light_8 : 7721|1@1+ (1,0) [0|1] "bool" MCU
 SG_ OBJ_Turn_Indicator_Right_8 : 7722|1@1+ (1,0) [0|1] "bool" MCU
 SG_ OBJ_Turn_Indicator_Left_8 : 7723|1@1+ (1,0) [0|1] "bool" MCU
 SG_ OBJ_Light_Indicator_Validity_8 : 7724|1@1+ (1,0) [0|1] "bool" MCU
 SG_ OBJ_Right_Out_Of_Image_8 : 7725|1@1+ (1,0) [0|1] "bool" MCU
 SG_ OBJ_Left_Out_Of_Image_8 : 7726|1@1+ (1,0) [0|1] "bool" MCU
 SG_ OBJ_Right_Out_Of_Image_V_8 : 7727|1@1+ (1,0) [0|1] "bool" MCU
 SG_ OBJ_Left_Out_Of_Image_V_8 : 7728|1@1+ (1,0) [0|1] "bool" MCU
 SG_ OBJ_Top_Out_Of_Image_8 : 7729|1@1+ (1,0) [0|1] "bool" MCU
 SG_ OBJ_Bottom_Out_Of_Image_8 : 7730|1@1+ (1,0) [0|1] "bool" MCU
 SG_ OBJ_Top_Out_Of_Image_V_8 : 7731|1@1+ (1,0) [0|1] "bool" MCU
 SG_ OBJ_Bottom_Out_Of_Image_V_8 : 7732|1@1+ (1,0) [0|1] "bool" MCU
 SG_ OBJ_Lane_Assignment_8 : 7733|3@1+ (1,0) [0|5] "ENUM" MCU
 SG_ OBJ_Lane_Assignment_V_8 : 7736|1@1+ (1,0) [0|1] "bool" MCU
 SG_ OBJ_Age_Seconds_8 : 7737|7@1+ (1,0) [0|100] "s" MCU
 SG_ OBJ_Age_Seconds_V_8 : 7744|1@1+ (1,0) [0|1] "bool" MCU
 SG_ OBJ_Width_8 : 7745|9@1+ (0.01,0) [0.4|2.95] "m" MCU
 SG_ OBJ_Width_V_8 : 7754|1@1+ (1,0) [0|1] "bool" MCU
 SG_ OBJ_Width_STD_8 : 7755|11@1+ (0.001,0) [0|2] "m" MCU
 SG_ OBJ_Width_STD_V_8 : 7766|1@1+ (1,0) [0|1] "bool" MCU
 SG_ OBJ_Length_8 : 7767|9@1+ (0.05,0) [1.2|21] "m" MCU
 SG_ OBJ_Length_V_8 : 7776|1@1+ (1,0) [0|1] "bool" MCU
 SG_ OBJ_Length_STD_8 : 7777|10@1+ (0.01,0) [0|10] "m" MCU
 SG_ OBJ_Length_STD_V_8 : 7787|1@1+ (1,0) [0|1] "bool" MCU
 SG_ OBJ_Radar_ID_8 : 7788|8@1+ (1,0) [0|255] "counter" MCU
 SG_ OBJ_Height_8 : 7796|9@1+ (0.01,0) [0|2.95] "m" MCU
 SG_ OBJ_Height_V_8 : 7805|1@1+ (1,0) [0|1] "bool" MCU
 SG_ Reserved_5_8 : 7806|2@1+ (1,0) [0|0] "NA" MCU
 SG_ OBJ_Height_STD_8 : 7808|11@1+ (0.001,0) [0|2] "m" MCU
 SG_ OBJ_Height_STD_V_8 : 7819|1@1+ (1,0) [0|1] "bool" MCU
 SG_ OBJ_Abs_Long_Velocity_8 : 7820|12@1+ (0.05,-100) [-100|100] "m_per_s" MCU
 SG_ OBJ_Abs_Long_Velocity_V_8 : 7832|1@1+ (1,0) [0|1] "bool" MCU
 SG_ Reserved_6_8 : 7833|7@1+ (1,0) [0|0] "NA" MCU
 SG_ OBJ_Abs_Long_Velocity_STD_8 : 7840|13@1+ (0.01,0) [0|65] "m_per_s" MCU
 SG_ OBJ_Abs_Long_Vel_STD_V_8 : 7853|1@1+ (1,0) [0|1] "bool" MCU
 SG_ OBJ_Abs_Lat_Velocity_8 : 7854|11@1+ (0.05,-50) [-50|50] "m_per_s" MCU
 SG_ OBJ_Abs_Lat_Velocity_V_8 : 7865|1@1+ (1,0) [0|1] "bool" MCU
 SG_ Reserved_7_8 : 7866|6@1+ (1,0) [0|0] "NA" MCU
 SG_ OBJ_Abs_Lat_Velocity_STD_8 : 7872|13@1+ (0.01,0) [0|50] "m_per_s" MCU
 SG_ OBJ_Abs_Lat_Vel_STD_V_8 : 7885|1@1+ (1,0) [0|1] "bool" MCU
 SG_ OBJ_Abs_Long_Acc_8 : 7886|9@1+ (0.05,-10) [-10|10] "m_per_s2" MCU
 SG_ OBJ_Abs_Long_Acc_V_8 : 7895|1@1+ (1,0) [0|1] "bool" MCU
 SG_ Reserved_8_8 : 7896|8@1+ (1,0) [0|0] "NA" MCU
 SG_ OBJ_Abs_Long_Acc_STD_8 : 7904|10@1+ (0.01,0) [0|7.3] "m_per_s2" MCU
 SG_ OBJ_Abs_Long_Acc_STD_V_8 : 7914|1@1+ (1,0) [0|1] "bool" MCU
 SG_ OBJ_Abs_Lat_Acc_8 : 7915|9@1+ (0.05,-10) [-10|10] "m_per_s2" MCU
 SG_ OBJ_Abs_Lat_Acc_V_8 : 7924|1@1+ (1,0) [0|1] "bool" MCU
 SG_ OBJ_Abs_Lat_Acc_STD_8 : 7925|10@1+ (0.01,0) [0|7.3] "m_per_s2" MCU
 SG_ OBJ_Abs_Lat_Acc_STD_V_8 : 7935|1@1+ (1,0) [0|1] "bool" MCU
 SG_ OBJ_Abs_Acceleration_8 : 7936|9@1+ (0.05,-12.7) [-12.7|12.7] "m_per_s2" MCU
 SG_ OBJ_Abs_Acceleration_V_8 : 7945|1@1+ (1,0) [0|1] "bool" MCU
 SG_ OBJ_Abs_Acc_STD_8 : 7946|10@1+ (0.01,0) [0|7.3] "m_per_s2" MCU
 SG_ OBJ_Abs_Acc_STD_V_8 : 7956|1@1+ (1,0) [0|1] "bool" MCU
 SG_ OBJ_Inv_TTC_8 : 7957|11@1+ (0.01,-8) [-8|8] "INV(s)" MCU
 SG_ OBJ_Inv_TTC_V_8 : 7968|1@1+ (1,0) [0|1] "bool" MCU
 SG_ OBJ_Inv_TTC_STD_8 : 7969|12@1+ (0.001,0) [0|4] "INV(s)" MCU
 SG_ OBJ_Inv_TTC_STD_V_8 : 7981|1@1+ (1,0) [0|1] "bool" MCU
 SG_ OBJ_Relative_Long_Acc_8 : 7982|10@1+ (0.05,-20) [-20|20] "m_per_s2" MCU
 SG_ OBJ_Relative_Long_Acc_V_8 : 7992|1@1+ (1,0) [0|1] "bool" MCU
 SG_ Reserved_9_8 : 7993|7@1+ (1,0) [0|0] "NA" MCU
 SG_ OBJ_Relative_Long_Acc_STD_8 : 8000|10@1+ (0.01,0) [0|7.3] "m_per_s2" MCU
 SG_ OBJ_Rel_Long_Acc_STD_V_8 : 8010|1@1+ (1,0) [0|1] "bool" MCU
 SG_ OBJ_Relative_Long_Velocity_8 : 8011|13@1+ (0.05,-120) [-120|130] "m_per_s" MCU
 SG_ OBJ_Relative_Long_Velocity_V_8 : 8024|1@1+ (1,0) [0|1] "bool" MCU
 SG_ Reserved_10_8 : 8025|7@1+ (1,0) [0|0] "NA" MCU
 SG_ OBJ_Relative_Long_Vel_STD_8 : 8032|14@1+ (0.01,0) [0|130] "m_per_s" MCU
 SG_ OBJ_Rel_Long_Vel_STD_V_8 : 8046|1@1+ (1,0) [0|1] "bool" MCU
 SG_ OBJ_Relative_Lat_Velocity_8 : 8047|11@1+ (0.05,-50) [-50|50] "m_per_s" MCU
 SG_ OBJ_Relative_Lat_Velocity_V_8 : 8058|1@1+ (1,0) [0|1] "bool" MCU
 SG_ Reserved_11_8 : 8059|5@1+ (1,0) [0|0] "NA" MCU
 SG_ OBJ_Relative_Lat_Velocity_STD_8 : 8064|13@1+ (0.01,0) [0|50] "m_per_s" MCU
 SG_ OBJ_Rel_Lat_Vel_STD_V_8 : 8077|1@1+ (1,0) [0|1] "bool" MCU
 SG_ OBJ_Long_Distance_8 : 8078|14@1+ (0.05,-200) [-200|500] "m" MCU
 SG_ OBJ_Long_Distance_V_8 : 8092|1@1+ (1,0) [0|1] "bool" MCU
 SG_ Reserved_12_8 : 8093|3@1+ (1,0) [0|0] "NA" MCU
 SG_ OBJ_Long_Distance_STD_8 : 8096|15@1+ (0.01,0) [0|250] "m" MCU
 SG_ OBJ_Long_Distance_STD_V_8 : 8111|1@1+ (1,0) [0|1] "bool" MCU
 SG_ OBJ_Lat_Distance_8 : 8112|12@1+ (0.05,-100) [-100|100] "m" MCU
 SG_ OBJ_Lat_Distance_V_8 : 8124|1@1+ (1,0) [0|1] "bool" MCU
 SG_ Reserved_13_8 : 8125|3@1+ (1,0) [0|0] "NA" MCU
 SG_ OBJ_Lat_Distance_STD_8 : 8128|14@1+ (0.01,0) [0|100] "m" MCU
 SG_ OBJ_Lat_Distance_STD_V_8 : 8142|1@1+ (1,0) [0|1] "bool" MCU
 SG_ OBJ_Absolute_Speed_8 : 8143|12@1+ (0.05,-65) [-65|65] "m_per_s" MCU
 SG_ OBJ_Absolute_Speed_V_8 : 8155|1@1+ (1,0) [0|1] "bool" MCU
 SG_ Reserved_14_8 : 8156|4@1+ (1,0) [0|0] "NA" MCU
 SG_ OBJ_Absolute_Speed_STD_8 : 8160|13@1+ (0.01,0) [0|65] "m_per_s" MCU
 SG_ OBJ_Absolute_Speed_STD_V_8 : 8173|1@1+ (1,0) [0|1] "bool" MCU
 SG_ OBJ_Heading_8 : 8174|10@1+ (0.01,-3.14) [-3.14|3.14] "rad" MCU
 SG_ OBJ_Heading_V_8 : 8184|1@1+ (1,0) [0|1] "bool" MCU
 SG_ Reserved_15_8 : 8185|7@1+ (1,0) [0|0] "NA" MCU
 SG_ OBJ_Heading_STD_8 : 8192|15@1+ (0.0001,0) [0|3.14] "rad" MCU
 SG_ OBJ_Heading_STD_V_8 : 8207|1@1+ (1,0) [0|1] "bool" MCU
 SG_ OBJ_Angle_Rate_STD_8 : 8208|15@1+ (0.0001,0) [0|2.2318] "RPS" MCU
 SG_ OBJ_Angle_Rate_STD_V_8 : 8223|1@1+ (1,0) [0|1] "bool" MCU
 SG_ OBJ_Angle_Rate_8 : 8224|12@1+ (0.002,-2.234) [-2.234|2.2318] "RPS" MCU
 SG_ OBJ_Angle_Rate_V_8 : 8236|1@1+ (1,0) [0|1] "bool" MCU
 SG_ OBJ_Angle_Right_8 : 8237|14@1+ (0.0002,-1.571) [-1.571|1.571] "rad" MCU
 SG_ OBJ_Angle_Right_V_8 : 8251|1@1+ (1,0) [0|1] "bool" MCU
 SG_ Reserved_16_8 : 8252|4@1+ (1,0) [0|0] "NA" MCU
 SG_ OBJ_Angle_Right_STD_8 : 8256|14@1+ (0.0001,0) [0|1.571] "rad" MCU
 SG_ OBJ_Angle_Right_STD_V_8 : 8270|1@1+ (1,0) [0|1] "bool" MCU
 SG_ OBJ_Angle_Left_8 : 8271|14@1+ (0.0002,-1.571) [-1.571|1.571] "rad" MCU
 SG_ OBJ_Angle_Left_V_8 : 8285|1@1+ (1,0) [0|1] "bool" MCU
 SG_ Reserved_17_8 : 8286|2@1+ (1,0) [0|0] "NA" MCU
 SG_ OBJ_Angle_Left_STD_8 : 8288|14@1+ (0.0001,0) [0|1.571] "rad" MCU
 SG_ OBJ_Angle_Left_STD_V_8 : 8302|1@1+ (1,0) [0|1] "bool" MCU
 SG_ OBJ_Angle_Side_8 : 8303|14@1+ (0.0002,-1.571) [-1.571|1.571] "rad" MCU
 SG_ OBJ_Angle_Side_V_8 : 8317|1@1+ (1,0) [0|1] "bool" MCU
 SG_ Reserved_18_8 : 8318|2@1+ (1,0) [0|0] "NA" MCU
 SG_ OBJ_Angle_Side_STD_8 : 8320|14@1+ (0.0001,0) [0|1.571] "rad" MCU
 SG_ OBJ_Angle_Side_STD_V_8 : 8334|1@1+ (1,0) [0|1] "bool" MCU
 SG_ OBJ_Angle_Mid_V_8 : 8335|1@1+ (1,0) [0|1] "bool" MCU
 SG_ OBJ_Angle_Mid_8 : 8336|14@1+ (0.0002,-1.571) [-1.571|1.571] "rad" MCU
 SG_ Reserved_19_8 : 8350|2@1+ (1,0) [0|0] "NA" MCU
 SG_ OBJ_Angle_Mid_STD_8 : 8352|14@1+ (0.0001,0) [0|1.571] "rad" MCU
 SG_ OBJ_Angle_Mid_STD_V_8 : 8366|1@1+ (1,0) [0|1] "bool" MCU
 SG_ OBJ_Angle_Bottom_V_8 : 8367|1@1+ (1,0) [0|1] "bool" MCU
 SG_ OBJ_Angle_Bottom_8 : 8368|14@1+ (0.0002,-1.571) [-1.571|1.571] "rad" MCU
 SG_ Reserved_20_8 : 8382|2@1+ (1,0) [0|0] "NA" MCU
 SG_ OBJ_Angle_Bottom_STD_8 : 8384|14@1+ (0.0001,0) [0|1.571] "rad" MCU
 SG_ OBJ_Angle_Bottom_STD_V_8 : 8398|1@1+ (1,0) [0|1] "bool" MCU
 SG_ OBJ_Visibility_Side_V_8 : 8399|1@1+ (1,0) [0|1] "bool" MCU
 SG_ OBJ_Visibility_Side_8 : 8400|2@1+ (1,0) [0|2] "ENUM" MCU
 SG_ OBJ_Is_In_Drivable_Area_8 : 8402|1@1+ (1,0) [0|1] "bool" MCU
 SG_ OBJ_Is_In_Drivable_Area_V_8 : 8403|1@1+ (1,0) [0|1] "bool" MCU
 SG_ OBJ_Is_VeryClose_V_8 : 8404|1@1+ (1,0) [0|1] "bool" MCU
 SG_ OBJ_Is_VeryClose_8 : 8405|1@1+ (1,0) [0|1] "bool" MCU
 SG_ OBJ_Buffer_C4_8 : 8406|2@1+ (1,0) [0|2] "NA" MCU
 SG_ OBJ_Buffer_C5_8 : 8408|2@1+ (1,0) [0|2] "NA" MCU
 SG_ OBJ_Buffer_C6_8 : 8410|2@1+ (1,0) [0|2] "NA" MCU
 SG_ OBJ_Buffer_C7_8 : 8412|2@1+ (1,0) [0|2] "NA" MCU
 SG_ Reserved_21_8 : 8414|2@1+ (1,0) [0|0] "NA" MCU
 SG_ OBJ_OverlapAngleEgoLaneR_8 : 8416|10@1+ (0.01,-3.14) [-3.14|3.14] "rad" MCU
 SG_ OBJ_OverlapAngleEgoLaneR_V_8 : 8426|1@1+ (1,0) [0|1] "bool" MCU
 SG_ OBJ_OverlapAngleEgoLaneL_8 : 8427|10@1+ (0.01,-3.14) [-3.14|3.14] "rad" MCU
 SG_ OBJ_OverlapAngleEgoLaneL_V_8 : 8437|1@1+ (1,0) [0|1] "bool" MCU
 SG_ OBJ_Is_EMERGENCY_VCL_8 : 8438|1@1+ (1,0) [0|1] "bool" MCU
 SG_ OBJ_EMERGENCY_LIGHT_COLOR_8 : 8439|4@1+ (1,0) [0|15] "BITWIZE" MCU
 SG_ OBJ_EMERGENCY_V_8 : 8443|1@1+ (1,0) [0|1] "bool" MCU
 SG_ Reserved_22_8 : 8444|4@1+ (1,0) [0|0] "NA" MCU
 SG_ OBJ_Angle_Top_8 : 8448|14@1+ (0.0002,0) [0|3.1415] "rad" MCU
 SG_ OBJ_Angle_Top_V_8 : 8462|1@1+ (1,0) [0|1] "bool" MCU
 SG_ OBJ_Angle_Top_STD_8 : 8463|15@1+ (0.0001,0) [0|3.1415] "rad" MCU
 SG_ OBJ_Angle_Top_STD_V_8 : 8478|1@1+ (1,0) [0|1] "bool" MCU
 SG_ OBJ_Buffer_C14_8 : 8479|1@1+ (1,0) [0|1] "NA" MCU
 SG_ OBJ_Buffer_C15_8 : 8480|1@1+ (1,0) [0|1] "NA" MCU
 SG_ OBJ_Buffer_C18_8 : 8481|2@1+ (1,0) [0|2] "NA" MCU
 SG_ OBJ_Buffer_C19_8 : 8483|1@1+ (1,0) [0|1] "NA" MCU
 SG_ Reserved_23_8 : 8484|28@1+ (1,0) [0|0] "NA" MCU
 SG_ OBJ_CRC_9 : 8512|32@1+ (1,0) [0|4294967295] "NA" MCU
 SG_ OBJ_ID_9 : 8544|8@1+ (1,0) [0|255] "counter" MCU
 SG_ OBJ_Existence_Probability_9 : 8552|8@1+ (0.01,0) [0|1] "NA" MCU
 SG_ OBJ_Fusion_Source_9 : 8560|16@1+ (1,0) [0|65535] "BITWIZE" MCU
 SG_ OBJ_Triggered_SDM_9 : 8576|2@1+ (1,0) [0|2] "ENUM" MCU
 SG_ OBJ_Motion_Category_9 : 8578|4@1+ (1,0) [0|13] "ENUM" MCU
 SG_ OBJ_Buffer_C0_9 : 8582|7@1+ (0.01,0) [0|1] "NA" MCU
 SG_ OBJ_Object_Age_9 : 8589|11@1+ (1,0) [0|2047] "frames" MCU
 SG_ OBJ_Measuring_Status_9 : 8600|3@1+ (1,0) [0|7] "BITWIZE" MCU
 SG_ OBJ_Object_Class_9 : 8603|4@1+ (1,0) [0|8] "ENUM" MCU
 SG_ Reserved_4_9 : 8607|1@1+ (1,0) [0|0] "NA" MCU
 SG_ OBJ_Class_Probability_9 : 8608|7@1+ (0.01,0) [0|1] "NA" MCU
 SG_ OBJ_Car_Probability_9 : 8615|7@1+ (0.01,0) [0|1] "NA" MCU
 SG_ OBJ_Truck_Probability_9 : 8622|7@1+ (0.01,0) [0|1] "NA" MCU
 SG_ OBJ_Bike_Probability_9 : 8629|7@1+ (0.01,0) [0|1] "NA" MCU
 SG_ OBJ_Camera_Source_9 : 8636|4@1+ (1,0) [0|15] "ENUM" MCU
 SG_ OBJ_Motion_Status_9 : 8640|3@1+ (1,0) [0|5] "ENUM" MCU
 SG_ OBJ_Motion_Orientation_9 : 8643|4@1+ (1,0) [0|13] "ENUM" MCU
 SG_ OBJ_Has_Cut_Lane_9 : 8647|1@1+ (1,0) [0|1] "bool" MCU
 SG_ OBJ_Has_Cut_Path_9 : 8648|1@1+ (1,0) [0|1] "bool" MCU
 SG_ OBJ_Brake_Light_9 : 8649|1@1+ (1,0) [0|1] "bool" MCU
 SG_ OBJ_Turn_Indicator_Right_9 : 8650|1@1+ (1,0) [0|1] "bool" MCU
 SG_ OBJ_Turn_Indicator_Left_9 : 8651|1@1+ (1,0) [0|1] "bool" MCU
 SG_ OBJ_Light_Indicator_Validity_9 : 8652|1@1+ (1,0) [0|1] "bool" MCU
 SG_ OBJ_Right_Out_Of_Image_9 : 8653|1@1+ (1,0) [0|1] "bool" MCU
 SG_ OBJ_Left_Out_Of_Image_9 : 8654|1@1+ (1,0) [0|1] "bool" MCU
 SG_ OBJ_Right_Out_Of_Image_V_9 : 8655|1@1+ (1,0) [0|1] "bool" MCU
 SG_ OBJ_Left_Out_Of_Image_V_9 : 8656|1@1+ (1,0) [0|1] "bool" MCU
 SG_ OBJ_Top_Out_Of_Image_9 : 8657|1@1+ (1,0) [0|1] "bool" MCU
 SG_ OBJ_Bottom_Out_Of_Image_9 : 8658|1@1+ (1,0) [0|1] "bool" MCU
 SG_ OBJ_Top_Out_Of_Image_V_9 : 8659|1@1+ (1,0) [0|1] "bool" MCU
 SG_ OBJ_Bottom_Out_Of_Image_V_9 : 8660|1@1+ (1,0) [0|1] "bool" MCU
 SG_ OBJ_Lane_Assignment_9 : 8661|3@1+ (1,0) [0|5] "ENUM" MCU
 SG_ OBJ_Lane_Assignment_V_9 : 8664|1@1+ (1,0) [0|1] "bool" MCU
 SG_ OBJ_Age_Seconds_9 : 8665|7@1+ (1,0) [0|100] "s" MCU
 SG_ OBJ_Age_Seconds_V_9 : 8672|1@1+ (1,0) [0|1] "bool" MCU
 SG_ OBJ_Width_9 : 8673|9@1+ (0.01,0) [0.4|2.95] "m" MCU
 SG_ OBJ_Width_V_9 : 8682|1@1+ (1,0) [0|1] "bool" MCU
 SG_ OBJ_Width_STD_9 : 8683|11@1+ (0.001,0) [0|2] "m" MCU
 SG_ OBJ_Width_STD_V_9 : 8694|1@1+ (1,0) [0|1] "bool" MCU
 SG_ OBJ_Length_9 : 8695|9@1+ (0.05,0) [1.2|21] "m" MCU
 SG_ OBJ_Length_V_9 : 8704|1@1+ (1,0) [0|1] "bool" MCU
 SG_ OBJ_Length_STD_9 : 8705|10@1+ (0.01,0) [0|10] "m" MCU
 SG_ OBJ_Length_STD_V_9 : 8715|1@1+ (1,0) [0|1] "bool" MCU
 SG_ OBJ_Radar_ID_9 : 8716|8@1+ (1,0) [0|255] "counter" MCU
 SG_ OBJ_Height_9 : 8724|9@1+ (0.01,0) [0|2.95] "m" MCU
 SG_ OBJ_Height_V_9 : 8733|1@1+ (1,0) [0|1] "bool" MCU
 SG_ Reserved_5_9 : 8734|2@1+ (1,0) [0|0] "NA" MCU
 SG_ OBJ_Height_STD_9 : 8736|11@1+ (0.001,0) [0|2] "m" MCU
 SG_ OBJ_Height_STD_V_9 : 8747|1@1+ (1,0) [0|1] "bool" MCU
 SG_ OBJ_Abs_Long_Velocity_9 : 8748|12@1+ (0.05,-100) [-100|100] "m_per_s" MCU
 SG_ OBJ_Abs_Long_Velocity_V_9 : 8760|1@1+ (1,0) [0|1] "bool" MCU
 SG_ Reserved_6_9 : 8761|7@1+ (1,0) [0|0] "NA" MCU
 SG_ OBJ_Abs_Long_Velocity_STD_9 : 8768|13@1+ (0.01,0) [0|65] "m_per_s" MCU
 SG_ OBJ_Abs_Long_Vel_STD_V_9 : 8781|1@1+ (1,0) [0|1] "bool" MCU
 SG_ OBJ_Abs_Lat_Velocity_9 : 8782|11@1+ (0.05,-50) [-50|50] "m_per_s" MCU
 SG_ OBJ_Abs_Lat_Velocity_V_9 : 8793|1@1+ (1,0) [0|1] "bool" MCU
 SG_ Reserved_7_9 : 8794|6@1+ (1,0) [0|0] "NA" MCU
 SG_ OBJ_Abs_Lat_Velocity_STD_9 : 8800|13@1+ (0.01,0) [0|50] "m_per_s" MCU
 SG_ OBJ_Abs_Lat_Vel_STD_V_9 : 8813|1@1+ (1,0) [0|1] "bool" MCU
 SG_ OBJ_Abs_Long_Acc_9 : 8814|9@1+ (0.05,-10) [-10|10] "m_per_s2" MCU
 SG_ OBJ_Abs_Long_Acc_V_9 : 8823|1@1+ (1,0) [0|1] "bool" MCU
 SG_ Reserved_8_9 : 8824|8@1+ (1,0) [0|0] "NA" MCU
 SG_ OBJ_Abs_Long_Acc_STD_9 : 8832|10@1+ (0.01,0) [0|7.3] "m_per_s2" MCU
 SG_ OBJ_Abs_Long_Acc_STD_V_9 : 8842|1@1+ (1,0) [0|1] "bool" MCU
 SG_ OBJ_Abs_Lat_Acc_9 : 8843|9@1+ (0.05,-10) [-10|10] "m_per_s2" MCU
 SG_ OBJ_Abs_Lat_Acc_V_9 : 8852|1@1+ (1,0) [0|1] "bool" MCU
 SG_ OBJ_Abs_Lat_Acc_STD_9 : 8853|10@1+ (0.01,0) [0|7.3] "m_per_s2" MCU
 SG_ OBJ_Abs_Lat_Acc_STD_V_9 : 8863|1@1+ (1,0) [0|1] "bool" MCU
 SG_ OBJ_Abs_Acceleration_9 : 8864|9@1+ (0.05,-12.7) [-12.7|12.7] "m_per_s2" MCU
 SG_ OBJ_Abs_Acceleration_V_9 : 8873|1@1+ (1,0) [0|1] "bool" MCU
 SG_ OBJ_Abs_Acc_STD_9 : 8874|10@1+ (0.01,0) [0|7.3] "m_per_s2" MCU
 SG_ OBJ_Abs_Acc_STD_V_9 : 8884|1@1+ (1,0) [0|1] "bool" MCU
 SG_ OBJ_Inv_TTC_9 : 8885|11@1+ (0.01,-8) [-8|8] "INV(s)" MCU
 SG_ OBJ_Inv_TTC_V_9 : 8896|1@1+ (1,0) [0|1] "bool" MCU
 SG_ OBJ_Inv_TTC_STD_9 : 8897|12@1+ (0.001,0) [0|4] "INV(s)" MCU
 SG_ OBJ_Inv_TTC_STD_V_9 : 8909|1@1+ (1,0) [0|1] "bool" MCU
 SG_ OBJ_Relative_Long_Acc_9 : 8910|10@1+ (0.05,-20) [-20|20] "m_per_s2" MCU
 SG_ OBJ_Relative_Long_Acc_V_9 : 8920|1@1+ (1,0) [0|1] "bool" MCU
 SG_ Reserved_9_9 : 8921|7@1+ (1,0) [0|0] "NA" MCU
 SG_ OBJ_Relative_Long_Acc_STD_9 : 8928|10@1+ (0.01,0) [0|7.3] "m_per_s2" MCU
 SG_ OBJ_Rel_Long_Acc_STD_V_9 : 8938|1@1+ (1,0) [0|1] "bool" MCU
 SG_ OBJ_Relative_Long_Velocity_9 : 8939|13@1+ (0.05,-120) [-120|130] "m_per_s" MCU
 SG_ OBJ_Relative_Long_Velocity_V_9 : 8952|1@1+ (1,0) [0|1] "bool" MCU
 SG_ Reserved_10_9 : 8953|7@1+ (1,0) [0|0] "NA" MCU
 SG_ OBJ_Relative_Long_Vel_STD_9 : 8960|14@1+ (0.01,0) [0|130] "m_per_s" MCU
 SG_ OBJ_Rel_Long_Vel_STD_V_9 : 8974|1@1+ (1,0) [0|1] "bool" MCU
 SG_ OBJ_Relative_Lat_Velocity_9 : 8975|11@1+ (0.05,-50) [-50|50] "m_per_s" MCU
 SG_ OBJ_Relative_Lat_Velocity_V_9 : 8986|1@1+ (1,0) [0|1] "bool" MCU
 SG_ Reserved_11_9 : 8987|5@1+ (1,0) [0|0] "NA" MCU
 SG_ OBJ_Relative_Lat_Velocity_STD_9 : 8992|13@1+ (0.01,0) [0|50] "m_per_s" MCU
 SG_ OBJ_Rel_Lat_Vel_STD_V_9 : 9005|1@1+ (1,0) [0|1] "bool" MCU
 SG_ OBJ_Long_Distance_9 : 9006|14@1+ (0.05,-200) [-200|500] "m" MCU
 SG_ OBJ_Long_Distance_V_9 : 9020|1@1+ (1,0) [0|1] "bool" MCU
 SG_ Reserved_12_9 : 9021|3@1+ (1,0) [0|0] "NA" MCU
 SG_ OBJ_Long_Distance_STD_9 : 9024|15@1+ (0.01,0) [0|250] "m" MCU
 SG_ OBJ_Long_Distance_STD_V_9 : 9039|1@1+ (1,0) [0|1] "bool" MCU
 SG_ OBJ_Lat_Distance_9 : 9040|12@1+ (0.05,-100) [-100|100] "m" MCU
 SG_ OBJ_Lat_Distance_V_9 : 9052|1@1+ (1,0) [0|1] "bool" MCU
 SG_ Reserved_13_9 : 9053|3@1+ (1,0) [0|0] "NA" MCU
 SG_ OBJ_Lat_Distance_STD_9 : 9056|14@1+ (0.01,0) [0|100] "m" MCU
 SG_ OBJ_Lat_Distance_STD_V_9 : 9070|1@1+ (1,0) [0|1] "bool" MCU
 SG_ OBJ_Absolute_Speed_9 : 9071|12@1+ (0.05,-65) [-65|65] "m_per_s" MCU
 SG_ OBJ_Absolute_Speed_V_9 : 9083|1@1+ (1,0) [0|1] "bool" MCU
 SG_ Reserved_14_9 : 9084|4@1+ (1,0) [0|0] "NA" MCU
 SG_ OBJ_Absolute_Speed_STD_9 : 9088|13@1+ (0.01,0) [0|65] "m_per_s" MCU
 SG_ OBJ_Absolute_Speed_STD_V_9 : 9101|1@1+ (1,0) [0|1] "bool" MCU
 SG_ OBJ_Heading_9 : 9102|10@1+ (0.01,-3.14) [-3.14|3.14] "rad" MCU
 SG_ OBJ_Heading_V_9 : 9112|1@1+ (1,0) [0|1] "bool" MCU
 SG_ Reserved_15_9 : 9113|7@1+ (1,0) [0|0] "NA" MCU
 SG_ OBJ_Heading_STD_9 : 9120|15@1+ (0.0001,0) [0|3.14] "rad" MCU
 SG_ OBJ_Heading_STD_V_9 : 9135|1@1+ (1,0) [0|1] "bool" MCU
 SG_ OBJ_Angle_Rate_STD_9 : 9136|15@1+ (0.0001,0) [0|2.2318] "RPS" MCU
 SG_ OBJ_Angle_Rate_STD_V_9 : 9151|1@1+ (1,0) [0|1] "bool" MCU
 SG_ OBJ_Angle_Rate_9 : 9152|12@1+ (0.002,-2.234) [-2.234|2.2318] "RPS" MCU
 SG_ OBJ_Angle_Rate_V_9 : 9164|1@1+ (1,0) [0|1] "bool" MCU
 SG_ OBJ_Angle_Right_9 : 9165|14@1+ (0.0002,-1.571) [-1.571|1.571] "rad" MCU
 SG_ OBJ_Angle_Right_V_9 : 9179|1@1+ (1,0) [0|1] "bool" MCU
 SG_ Reserved_16_9 : 9180|4@1+ (1,0) [0|0] "NA" MCU
 SG_ OBJ_Angle_Right_STD_9 : 9184|14@1+ (0.0001,0) [0|1.571] "rad" MCU
 SG_ OBJ_Angle_Right_STD_V_9 : 9198|1@1+ (1,0) [0|1] "bool" MCU
 SG_ OBJ_Angle_Left_9 : 9199|14@1+ (0.0002,-1.571) [-1.571|1.571] "rad" MCU
 SG_ OBJ_Angle_Left_V_9 : 9213|1@1+ (1,0) [0|1] "bool" MCU
 SG_ Reserved_17_9 : 9214|2@1+ (1,0) [0|0] "NA" MCU
 SG_ OBJ_Angle_Left_STD_9 : 9216|14@1+ (0.0001,0) [0|1.571] "rad" MCU
 SG_ OBJ_Angle_Left_STD_V_9 : 9230|1@1+ (1,0) [0|1] "bool" MCU
 SG_ OBJ_Angle_Side_9 : 9231|14@1+ (0.0002,-1.571) [-1.571|1.571] "rad" MCU
 SG_ OBJ_Angle_Side_V_9 : 9245|1@1+ (1,0) [0|1] "bool" MCU
 SG_ Reserved_18_9 : 9246|2@1+ (1,0) [0|0] "NA" MCU
 SG_ OBJ_Angle_Side_STD_9 : 9248|14@1+ (0.0001,0) [0|1.571] "rad" MCU
 SG_ OBJ_Angle_Side_STD_V_9 : 9262|1@1+ (1,0) [0|1] "bool" MCU
 SG_ OBJ_Angle_Mid_V_9 : 9263|1@1+ (1,0) [0|1] "bool" MCU
 SG_ OBJ_Angle_Mid_9 : 9264|14@1+ (0.0002,-1.571) [-1.571|1.571] "rad" MCU
 SG_ Reserved_19_9 : 9278|2@1+ (1,0) [0|0] "NA" MCU
 SG_ OBJ_Angle_Mid_STD_9 : 9280|14@1+ (0.0001,0) [0|1.571] "rad" MCU
 SG_ OBJ_Angle_Mid_STD_V_9 : 9294|1@1+ (1,0) [0|1] "bool" MCU
 SG_ OBJ_Angle_Bottom_V_9 : 9295|1@1+ (1,0) [0|1] "bool" MCU
 SG_ OBJ_Angle_Bottom_9 : 9296|14@1+ (0.0002,-1.571) [-1.571|1.571] "rad" MCU
 SG_ Reserved_20_9 : 9310|2@1+ (1,0) [0|0] "NA" MCU
 SG_ OBJ_Angle_Bottom_STD_9 : 9312|14@1+ (0.0001,0) [0|1.571] "rad" MCU
 SG_ OBJ_Angle_Bottom_STD_V_9 : 9326|1@1+ (1,0) [0|1] "bool" MCU
 SG_ OBJ_Visibility_Side_V_9 : 9327|1@1+ (1,0) [0|1] "bool" MCU
 SG_ OBJ_Visibility_Side_9 : 9328|2@1+ (1,0) [0|2] "ENUM" MCU
 SG_ OBJ_Is_In_Drivable_Area_9 : 9330|1@1+ (1,0) [0|1] "bool" MCU
 SG_ OBJ_Is_In_Drivable_Area_V_9 : 9331|1@1+ (1,0) [0|1] "bool" MCU
 SG_ OBJ_Is_VeryClose_V_9 : 9332|1@1+ (1,0) [0|1] "bool" MCU
 SG_ OBJ_Is_VeryClose_9 : 9333|1@1+ (1,0) [0|1] "bool" MCU
 SG_ OBJ_Buffer_C4_9 : 9334|2@1+ (1,0) [0|2] "NA" MCU
 SG_ OBJ_Buffer_C5_9 : 9336|2@1+ (1,0) [0|2] "NA" MCU
 SG_ OBJ_Buffer_C6_9 : 9338|2@1+ (1,0) [0|2] "NA" MCU
 SG_ OBJ_Buffer_C7_9 : 9340|2@1+ (1,0) [0|2] "NA" MCU
 SG_ Reserved_21_9 : 9342|2@1+ (1,0) [0|0] "NA" MCU
 SG_ OBJ_OverlapAngleEgoLaneR_9 : 9344|10@1+ (0.01,-3.14) [-3.14|3.14] "rad" MCU
 SG_ OBJ_OverlapAngleEgoLaneR_V_9 : 9354|1@1+ (1,0) [0|1] "bool" MCU
 SG_ OBJ_OverlapAngleEgoLaneL_9 : 9355|10@1+ (0.01,-3.14) [-3.14|3.14] "rad" MCU
 SG_ OBJ_OverlapAngleEgoLaneL_V_9 : 9365|1@1+ (1,0) [0|1] "bool" MCU
 SG_ OBJ_Is_EMERGENCY_VCL_9 : 9366|1@1+ (1,0) [0|1] "bool" MCU
 SG_ OBJ_EMERGENCY_LIGHT_COLOR_9 : 9367|4@1+ (1,0) [0|15] "BITWIZE" MCU
 SG_ OBJ_EMERGENCY_V_9 : 9371|1@1+ (1,0) [0|1] "bool" MCU
 SG_ Reserved_22_9 : 9372|4@1+ (1,0) [0|0] "NA" MCU
 SG_ OBJ_Angle_Top_9 : 9376|14@1+ (0.0002,0) [0|3.1415] "rad" MCU
 SG_ OBJ_Angle_Top_V_9 : 9390|1@1+ (1,0) [0|1] "bool" MCU
 SG_ OBJ_Angle_Top_STD_9 : 9391|15@1+ (0.0001,0) [0|3.1415] "rad" MCU
 SG_ OBJ_Angle_Top_STD_V_9 : 9406|1@1+ (1,0) [0|1] "bool" MCU
 SG_ OBJ_Buffer_C14_9 : 9407|1@1+ (1,0) [0|1] "NA" MCU
 SG_ OBJ_Buffer_C15_9 : 9408|1@1+ (1,0) [0|1] "NA" MCU
 SG_ OBJ_Buffer_C18_9 : 9409|2@1+ (1,0) [0|2] "NA" MCU
 SG_ OBJ_Buffer_C19_9 : 9411|1@1+ (1,0) [0|1] "NA" MCU
 SG_ Reserved_23_9 : 9412|28@1+ (1,0) [0|0] "NA" MCU
 SG_ OBJ_CRC_10 : 9440|32@1+ (1,0) [0|4294967295] "NA" MCU
 SG_ OBJ_ID_10 : 9472|8@1+ (1,0) [0|255] "counter" MCU
 SG_ OBJ_Existence_Probability_10 : 9480|8@1+ (0.01,0) [0|1] "NA" MCU
 SG_ OBJ_Fusion_Source_10 : 9488|16@1+ (1,0) [0|65535] "BITWIZE" MCU
 SG_ OBJ_Triggered_SDM_10 : 9504|2@1+ (1,0) [0|2] "ENUM" MCU
 SG_ OBJ_Motion_Category_10 : 9506|4@1+ (1,0) [0|13] "ENUM" MCU
 SG_ OBJ_Buffer_C0_10 : 9510|7@1+ (0.01,0) [0|1] "NA" MCU
 SG_ OBJ_Object_Age_10 : 9517|11@1+ (1,0) [0|2047] "frames" MCU
 SG_ OBJ_Measuring_Status_10 : 9528|3@1+ (1,0) [0|7] "BITWIZE" MCU
 SG_ OBJ_Object_Class_10 : 9531|4@1+ (1,0) [0|8] "ENUM" MCU
 SG_ Reserved_4_10 : 9535|1@1+ (1,0) [0|0] "NA" MCU
 SG_ OBJ_Class_Probability_10 : 9536|7@1+ (0.01,0) [0|1] "NA" MCU
 SG_ OBJ_Car_Probability_10 : 9543|7@1+ (0.01,0) [0|1] "NA" MCU
 SG_ OBJ_Truck_Probability_10 : 9550|7@1+ (0.01,0) [0|1] "NA" MCU
 SG_ OBJ_Bike_Probability_10 : 9557|7@1+ (0.01,0) [0|1] "NA" MCU
 SG_ OBJ_Camera_Source_10 : 9564|4@1+ (1,0) [0|15] "ENUM" MCU
 SG_ OBJ_Motion_Status_10 : 9568|3@1+ (1,0) [0|5] "ENUM" MCU
 SG_ OBJ_Motion_Orientation_10 : 9571|4@1+ (1,0) [0|13] "ENUM" MCU
 SG_ OBJ_Has_Cut_Lane_10 : 9575|1@1+ (1,0) [0|1] "bool" MCU
 SG_ OBJ_Has_Cut_Path_10 : 9576|1@1+ (1,0) [0|1] "bool" MCU
 SG_ OBJ_Brake_Light_10 : 9577|1@1+ (1,0) [0|1] "bool" MCU
 SG_ OBJ_Turn_Indicator_Right_10 : 9578|1@1+ (1,0) [0|1] "bool" MCU
 SG_ OBJ_Turn_Indicator_Left_10 : 9579|1@1+ (1,0) [0|1] "bool" MCU
 SG_ OBJ_Light_Indicator_Validity_10 : 9580|1@1+ (1,0) [0|1] "bool" MCU
 SG_ OBJ_Right_Out_Of_Image_10 : 9581|1@1+ (1,0) [0|1] "bool" MCU
 SG_ OBJ_Left_Out_Of_Image_10 : 9582|1@1+ (1,0) [0|1] "bool" MCU
 SG_ OBJ_Right_Out_Of_Image_V_10 : 9583|1@1+ (1,0) [0|1] "bool" MCU
 SG_ OBJ_Left_Out_Of_Image_V_10 : 9584|1@1+ (1,0) [0|1] "bool" MCU
 SG_ OBJ_Top_Out_Of_Image_10 : 9585|1@1+ (1,0) [0|1] "bool" MCU
 SG_ OBJ_Bottom_Out_Of_Image_10 : 9586|1@1+ (1,0) [0|1] "bool" MCU
 SG_ OBJ_Top_Out_Of_Image_V_10 : 9587|1@1+ (1,0) [0|1] "bool" MCU
 SG_ OBJ_Bottom_Out_Of_Image_V_10 : 9588|1@1+ (1,0) [0|1] "bool" MCU
 SG_ OBJ_Lane_Assignment_10 : 9589|3@1+ (1,0) [0|5] "ENUM" MCU
 SG_ OBJ_Lane_Assignment_V_10 : 9592|1@1+ (1,0) [0|1] "bool" MCU
 SG_ OBJ_Age_Seconds_10 : 9593|7@1+ (1,0) [0|100] "s" MCU
 SG_ OBJ_Age_Seconds_V_10 : 9600|1@1+ (1,0) [0|1] "bool" MCU
 SG_ OBJ_Width_10 : 9601|9@1+ (0.01,0) [0.4|2.95] "m" MCU
 SG_ OBJ_Width_V_10 : 9610|1@1+ (1,0) [0|1] "bool" MCU
 SG_ OBJ_Width_STD_10 : 9611|11@1+ (0.001,0) [0|2] "m" MCU
 SG_ OBJ_Width_STD_V_10 : 9622|1@1+ (1,0) [0|1] "bool" MCU
 SG_ OBJ_Length_10 : 9623|9@1+ (0.05,0) [1.2|21] "m" MCU
 SG_ OBJ_Length_V_10 : 9632|1@1+ (1,0) [0|1] "bool" MCU
 SG_ OBJ_Length_STD_10 : 9633|10@1+ (0.01,0) [0|10] "m" MCU
 SG_ OBJ_Length_STD_V_10 : 9643|1@1+ (1,0) [0|1] "bool" MCU
 SG_ OBJ_Radar_ID_10 : 9644|8@1+ (1,0) [0|255] "counter" MCU
 SG_ OBJ_Height_10 : 9652|9@1+ (0.01,0) [0|2.95] "m" MCU
 SG_ OBJ_Height_V_10 : 9661|1@1+ (1,0) [0|1] "bool" MCU
 SG_ Reserved_5_10 : 9662|2@1+ (1,0) [0|0] "NA" MCU
 SG_ OBJ_Height_STD_10 : 9664|11@1+ (0.001,0) [0|2] "m" MCU
 SG_ OBJ_Height_STD_V_10 : 9675|1@1+ (1,0) [0|1] "bool" MCU
 SG_ OBJ_Abs_Long_Velocity_10 : 9676|12@1+ (0.05,-100) [-100|100] "m_per_s" MCU
 SG_ OBJ_Abs_Long_Velocity_V_10 : 9688|1@1+ (1,0) [0|1] "bool" MCU
 SG_ Reserved_6_10 : 9689|7@1+ (1,0) [0|0] "NA" MCU
 SG_ OBJ_Abs_Long_Velocity_STD_10 : 9696|13@1+ (0.01,0) [0|65] "m_per_s" MCU
 SG_ OBJ_Abs_Long_Vel_STD_V_10 : 9709|1@1+ (1,0) [0|1] "bool" MCU
 SG_ OBJ_Abs_Lat_Velocity_10 : 9710|11@1+ (0.05,-50) [-50|50] "m_per_s" MCU
 SG_ OBJ_Abs_Lat_Velocity_V_10 : 9721|1@1+ (1,0) [0|1] "bool" MCU
 SG_ Reserved_7_10 : 9722|6@1+ (1,0) [0|0] "NA" MCU
 SG_ OBJ_Abs_Lat_Velocity_STD_10 : 9728|13@1+ (0.01,0) [0|50] "m_per_s" MCU
 SG_ OBJ_Abs_Lat_Vel_STD_V_10 : 9741|1@1+ (1,0) [0|1] "bool" MCU
 SG_ OBJ_Abs_Long_Acc_10 : 9742|9@1+ (0.05,-10) [-10|10] "m_per_s2" MCU
 SG_ OBJ_Abs_Long_Acc_V_10 : 9751|1@1+ (1,0) [0|1] "bool" MCU
 SG_ Reserved_8_10 : 9752|8@1+ (1,0) [0|0] "NA" MCU
 SG_ OBJ_Abs_Long_Acc_STD_10 : 9760|10@1+ (0.01,0) [0|7.3] "m_per_s2" MCU
 SG_ OBJ_Abs_Long_Acc_STD_V_10 : 9770|1@1+ (1,0) [0|1] "bool" MCU
 SG_ OBJ_Abs_Lat_Acc_10 : 9771|9@1+ (0.05,-10) [-10|10] "m_per_s2" MCU
 SG_ OBJ_Abs_Lat_Acc_V_10 : 9780|1@1+ (1,0) [0|1] "bool" MCU
 SG_ OBJ_Abs_Lat_Acc_STD_10 : 9781|10@1+ (0.01,0) [0|7.3] "m_per_s2" MCU
 SG_ OBJ_Abs_Lat_Acc_STD_V_10 : 9791|1@1+ (1,0) [0|1] "bool" MCU
 SG_ OBJ_Abs_Acceleration_10 : 9792|9@1+ (0.05,-12.7) [-12.7|12.7] "m_per_s2" MCU
 SG_ OBJ_Abs_Acceleration_V_10 : 9801|1@1+ (1,0) [0|1] "bool" MCU
 SG_ OBJ_Abs_Acc_STD_10 : 9802|10@1+ (0.01,0) [0|7.3] "m_per_s2" MCU
 SG_ OBJ_Abs_Acc_STD_V_10 : 9812|1@1+ (1,0) [0|1] "bool" MCU
 SG_ OBJ_Inv_TTC_10 : 9813|11@1+ (0.01,-8) [-8|8] "INV(s)" MCU
 SG_ OBJ_Inv_TTC_V_10 : 9824|1@1+ (1,0) [0|1] "bool" MCU
 SG_ OBJ_Inv_TTC_STD_10 : 9825|12@1+ (0.001,0) [0|4] "INV(s)" MCU
 SG_ OBJ_Inv_TTC_STD_V_10 : 9837|1@1+ (1,0) [0|1] "bool" MCU
 SG_ OBJ_Relative_Long_Acc_10 : 9838|10@1+ (0.05,-20) [-20|20] "m_per_s2" MCU
 SG_ OBJ_Relative_Long_Acc_V_10 : 9848|1@1+ (1,0) [0|1] "bool" MCU
 SG_ Reserved_9_10 : 9849|7@1+ (1,0) [0|0] "NA" MCU
 SG_ OBJ_Relative_Long_Acc_STD_10 : 9856|10@1+ (0.01,0) [0|7.3] "m_per_s2" MCU
 SG_ OBJ_Rel_Long_Acc_STD_V_10 : 9866|1@1+ (1,0) [0|1] "bool" MCU
 SG_ OBJ_Relative_Long_Velocity_10 : 9867|13@1+ (0.05,-120) [-120|130] "m_per_s" MCU
 SG_ OBJ_Relative_Long_Velocity_V_10 : 9880|1@1+ (1,0) [0|1] "bool" MCU
 SG_ Reserved_10_10 : 9881|7@1+ (1,0) [0|0] "NA" MCU
 SG_ OBJ_Relative_Long_Vel_STD_10 : 9888|14@1+ (0.01,0) [0|130] "m_per_s" MCU
 SG_ OBJ_Rel_Long_Vel_STD_V_10 : 9902|1@1+ (1,0) [0|1] "bool" MCU
 SG_ OBJ_Relative_Lat_Velocity_10 : 9903|11@1+ (0.05,-50) [-50|50] "m_per_s" MCU
 SG_ OBJ_Relative_Lat_Velocity_V_10 : 9914|1@1+ (1,0) [0|1] "bool" MCU
 SG_ Reserved_11_10 : 9915|5@1+ (1,0) [0|0] "NA" MCU
 SG_ OBJ_Relative_Lat_Velocity_STD_10 : 9920|13@1+ (0.01,0) [0|50] "m_per_s" MCU
 SG_ OBJ_Rel_Lat_Vel_STD_V_10 : 9933|1@1+ (1,0) [0|1] "bool" MCU
 SG_ OBJ_Long_Distance_10 : 9934|14@1+ (0.05,-200) [-200|500] "m" MCU
 SG_ OBJ_Long_Distance_V_10 : 9948|1@1+ (1,0) [0|1] "bool" MCU
 SG_ Reserved_12_10 : 9949|3@1+ (1,0) [0|0] "NA" MCU
 SG_ OBJ_Long_Distance_STD_10 : 9952|15@1+ (0.01,0) [0|250] "m" MCU
 SG_ OBJ_Long_Distance_STD_V_10 : 9967|1@1+ (1,0) [0|1] "bool" MCU
 SG_ OBJ_Lat_Distance_10 : 9968|12@1+ (0.05,-100) [-100|100] "m" MCU
 SG_ OBJ_Lat_Distance_V_10 : 9980|1@1+ (1,0) [0|1] "bool" MCU
 SG_ Reserved_13_10 : 9981|3@1+ (1,0) [0|0] "NA" MCU
 SG_ OBJ_Lat_Distance_STD_10 : 9984|14@1+ (0.01,0) [0|100] "m" MCU
 SG_ OBJ_Lat_Distance_STD_V_10 : 9998|1@1+ (1,0) [0|1] "bool" MCU
 SG_ OBJ_Absolute_Speed_10 : 9999|12@1+ (0.05,-65) [-65|65] "m_per_s" MCU
 SG_ OBJ_Absolute_Speed_V_10 : 10011|1@1+ (1,0) [0|1] "bool" MCU
 SG_ Reserved_14_10 : 10012|4@1+ (1,0) [0|0] "NA" MCU
 SG_ OBJ_Absolute_Speed_STD_10 : 10016|13@1+ (0.01,0) [0|65] "m_per_s" MCU
 SG_ OBJ_Absolute_Speed_STD_V_10 : 10029|1@1+ (1,0) [0|1] "bool" MCU
 SG_ OBJ_Heading_10 : 10030|10@1+ (0.01,-3.14) [-3.14|3.14] "rad" MCU
 SG_ OBJ_Heading_V_10 : 10040|1@1+ (1,0) [0|1] "bool" MCU
 SG_ Reserved_15_10 : 10041|7@1+ (1,0) [0|0] "NA" MCU
 SG_ OBJ_Heading_STD_10 : 10048|15@1+ (0.0001,0) [0|3.14] "rad" MCU
 SG_ OBJ_Heading_STD_V_10 : 10063|1@1+ (1,0) [0|1] "bool" MCU
 SG_ OBJ_Angle_Rate_STD_10 : 10064|15@1+ (0.0001,0) [0|2.2318] "RPS" MCU
 SG_ OBJ_Angle_Rate_STD_V_10 : 10079|1@1+ (1,0) [0|1] "bool" MCU
 SG_ OBJ_Angle_Rate_10 : 10080|12@1+ (0.002,-2.234) [-2.234|2.2318] "RPS" MCU
 SG_ OBJ_Angle_Rate_V_10 : 10092|1@1+ (1,0) [0|1] "bool" MCU
 SG_ OBJ_Angle_Right_10 : 10093|14@1+ (0.0002,-1.571) [-1.571|1.571] "rad" MCU
 SG_ OBJ_Angle_Right_V_10 : 10107|1@1+ (1,0) [0|1] "bool" MCU
 SG_ Reserved_16_10 : 10108|4@1+ (1,0) [0|0] "NA" MCU
 SG_ OBJ_Angle_Right_STD_10 : 10112|14@1+ (0.0001,0) [0|1.571] "rad" MCU
 SG_ OBJ_Angle_Right_STD_V_10 : 10126|1@1+ (1,0) [0|1] "bool" MCU
 SG_ OBJ_Angle_Left_10 : 10127|14@1+ (0.0002,-1.571) [-1.571|1.571] "rad" MCU
 SG_ OBJ_Angle_Left_V_10 : 10141|1@1+ (1,0) [0|1] "bool" MCU
 SG_ Reserved_17_10 : 10142|2@1+ (1,0) [0|0] "NA" MCU
 SG_ OBJ_Angle_Left_STD_10 : 10144|14@1+ (0.0001,0) [0|1.571] "rad" MCU
 SG_ OBJ_Angle_Left_STD_V_10 : 10158|1@1+ (1,0) [0|1] "bool" MCU
 SG_ OBJ_Angle_Side_10 : 10159|14@1+ (0.0002,-1.571) [-1.571|1.571] "rad" MCU
 SG_ OBJ_Angle_Side_V_10 : 10173|1@1+ (1,0) [0|1] "bool" MCU
 SG_ Reserved_18_10 : 10174|2@1+ (1,0) [0|0] "NA" MCU
 SG_ OBJ_Angle_Side_STD_10 : 10176|14@1+ (0.0001,0) [0|1.571] "rad" MCU
 SG_ OBJ_Angle_Side_STD_V_10 : 10190|1@1+ (1,0) [0|1] "bool" MCU
 SG_ OBJ_Angle_Mid_V_10 : 10191|1@1+ (1,0) [0|1] "bool" MCU
 SG_ OBJ_Angle_Mid_10 : 10192|14@1+ (0.0002,-1.571) [-1.571|1.571] "rad" MCU
 SG_ Reserved_19_10 : 10206|2@1+ (1,0) [0|0] "NA" MCU
 SG_ OBJ_Angle_Mid_STD_10 : 10208|14@1+ (0.0001,0) [0|1.571] "rad" MCU
 SG_ OBJ_Angle_Mid_STD_V_10 : 10222|1@1+ (1,0) [0|1] "bool" MCU
 SG_ OBJ_Angle_Bottom_V_10 : 10223|1@1+ (1,0) [0|1] "bool" MCU
 SG_ OBJ_Angle_Bottom_10 : 10224|14@1+ (0.0002,-1.571) [-1.571|1.571] "rad" MCU
 SG_ Reserved_20_10 : 10238|2@1+ (1,0) [0|0] "NA" MCU
 SG_ OBJ_Angle_Bottom_STD_10 : 10240|14@1+ (0.0001,0) [0|1.571] "rad" MCU
 SG_ OBJ_Angle_Bottom_STD_V_10 : 10254|1@1+ (1,0) [0|1] "bool" MCU
 SG_ OBJ_Visibility_Side_V_10 : 10255|1@1+ (1,0) [0|1] "bool" MCU
 SG_ OBJ_Visibility_Side_10 : 10256|2@1+ (1,0) [0|2] "ENUM" MCU
 SG_ OBJ_Is_In_Drivable_Area_10 : 10258|1@1+ (1,0) [0|1] "bool" MCU
 SG_ OBJ_Is_In_Drivable_Area_V_10 : 10259|1@1+ (1,0) [0|1] "bool" MCU
 SG_ OBJ_Is_VeryClose_V_10 : 10260|1@1+ (1,0) [0|1] "bool" MCU
 SG_ OBJ_Is_VeryClose_10 : 10261|1@1+ (1,0) [0|1] "bool" MCU
 SG_ OBJ_Buffer_C4_10 : 10262|2@1+ (1,0) [0|2] "NA" MCU
 SG_ OBJ_Buffer_C5_10 : 10264|2@1+ (1,0) [0|2] "NA" MCU
 SG_ OBJ_Buffer_C6_10 : 10266|2@1+ (1,0) [0|2] "NA" MCU
 SG_ OBJ_Buffer_C7_10 : 10268|2@1+ (1,0) [0|2] "NA" MCU
 SG_ Reserved_21_10 : 10270|2@1+ (1,0) [0|0] "NA" MCU
 SG_ OBJ_OverlapAngleEgoLaneR_10 : 10272|10@1+ (0.01,-3.14) [-3.14|3.14] "rad" MCU
 SG_ OBJ_OverlapAngleEgoLaneR_V_10 : 10282|1@1+ (1,0) [0|1] "bool" MCU
 SG_ OBJ_OverlapAngleEgoLaneL_10 : 10283|10@1+ (0.01,-3.14) [-3.14|3.14] "rad" MCU
 SG_ OBJ_OverlapAngleEgoLaneL_V_10 : 10293|1@1+ (1,0) [0|1] "bool" MCU
 SG_ OBJ_Is_EMERGENCY_VCL_10 : 10294|1@1+ (1,0) [0|1] "bool" MCU
 SG_ OBJ_EMERGENCY_LIGHT_COLOR_10 : 10295|4@1+ (1,0) [0|15] "BITWIZE" MCU
 SG_ OBJ_EMERGENCY_V_10 : 10299|1@1+ (1,0) [0|1] "bool" MCU
 SG_ Reserved_22_10 : 10300|4@1+ (1,0) [0|0] "NA" MCU
 SG_ OBJ_Angle_Top_10 : 10304|14@1+ (0.0002,0) [0|3.1415] "rad" MCU
 SG_ OBJ_Angle_Top_V_10 : 10318|1@1+ (1,0) [0|1] "bool" MCU
 SG_ OBJ_Angle_Top_STD_10 : 10319|15@1+ (0.0001,0) [0|3.1415] "rad" MCU
 SG_ OBJ_Angle_Top_STD_V_10 : 10334|1@1+ (1,0) [0|1] "bool" MCU
 SG_ OBJ_Buffer_C14_10 : 10335|1@1+ (1,0) [0|1] "NA" MCU
 SG_ OBJ_Buffer_C15_10 : 10336|1@1+ (1,0) [0|1] "NA" MCU
 SG_ OBJ_Buffer_C18_10 : 10337|2@1+ (1,0) [0|2] "NA" MCU
 SG_ OBJ_Buffer_C19_10 : 10339|1@1+ (1,0) [0|1] "NA" MCU
 SG_ Reserved_23_10 : 10340|28@1+ (1,0) [0|0] "NA" MCU
 SG_ OBJ_CRC_11 : 10368|32@1+ (1,0) [0|4294967295] "NA" MCU
 SG_ OBJ_ID_11 : 10400|8@1+ (1,0) [0|255] "counter" MCU
 SG_ OBJ_Existence_Probability_11 : 10408|8@1+ (0.01,0) [0|1] "NA" MCU
 SG_ OBJ_Fusion_Source_11 : 10416|16@1+ (1,0) [0|65535] "BITWIZE" MCU
 SG_ OBJ_Triggered_SDM_11 : 10432|2@1+ (1,0) [0|2] "ENUM" MCU
 SG_ OBJ_Motion_Category_11 : 10434|4@1+ (1,0) [0|13] "ENUM" MCU
 SG_ OBJ_Buffer_C0_11 : 10438|7@1+ (0.01,0) [0|1] "NA" MCU
 SG_ OBJ_Object_Age_11 : 10445|11@1+ (1,0) [0|2047] "frames" MCU
 SG_ OBJ_Measuring_Status_11 : 10456|3@1+ (1,0) [0|7] "BITWIZE" MCU
 SG_ OBJ_Object_Class_11 : 10459|4@1+ (1,0) [0|8] "ENUM" MCU
 SG_ Reserved_4_11 : 10463|1@1+ (1,0) [0|0] "NA" MCU
 SG_ OBJ_Class_Probability_11 : 10464|7@1+ (0.01,0) [0|1] "NA" MCU
 SG_ OBJ_Car_Probability_11 : 10471|7@1+ (0.01,0) [0|1] "NA" MCU
 SG_ OBJ_Truck_Probability_11 : 10478|7@1+ (0.01,0) [0|1] "NA" MCU
 SG_ OBJ_Bike_Probability_11 : 10485|7@1+ (0.01,0) [0|1] "NA" MCU
 SG_ OBJ_Camera_Source_11 : 10492|4@1+ (1,0) [0|15] "ENUM" MCU
 SG_ OBJ_Motion_Status_11 : 10496|3@1+ (1,0) [0|5] "ENUM" MCU
 SG_ OBJ_Motion_Orientation_11 : 10499|4@1+ (1,0) [0|13] "ENUM" MCU
 SG_ OBJ_Has_Cut_Lane_11 : 10503|1@1+ (1,0) [0|1] "bool" MCU
 SG_ OBJ_Has_Cut_Path_11 : 10504|1@1+ (1,0) [0|1] "bool" MCU
 SG_ OBJ_Brake_Light_11 : 10505|1@1+ (1,0) [0|1] "bool" MCU
 SG_ OBJ_Turn_Indicator_Right_11 : 10506|1@1+ (1,0) [0|1] "bool" MCU
 SG_ OBJ_Turn_Indicator_Left_11 : 10507|1@1+ (1,0) [0|1] "bool" MCU
 SG_ OBJ_Light_Indicator_Validity_11 : 10508|1@1+ (1,0) [0|1] "bool" MCU
 SG_ OBJ_Right_Out_Of_Image_11 : 10509|1@1+ (1,0) [0|1] "bool" MCU
 SG_ OBJ_Left_Out_Of_Image_11 : 10510|1@1+ (1,0) [0|1] "bool" MCU
 SG_ OBJ_Right_Out_Of_Image_V_11 : 10511|1@1+ (1,0) [0|1] "bool" MCU
 SG_ OBJ_Left_Out_Of_Image_V_11 : 10512|1@1+ (1,0) [0|1] "bool" MCU
 SG_ OBJ_Top_Out_Of_Image_11 : 10513|1@1+ (1,0) [0|1] "bool" MCU
 SG_ OBJ_Bottom_Out_Of_Image_11 : 10514|1@1+ (1,0) [0|1] "bool" MCU
 SG_ OBJ_Top_Out_Of_Image_V_11 : 10515|1@1+ (1,0) [0|1] "bool" MCU
 SG_ OBJ_Bottom_Out_Of_Image_V_11 : 10516|1@1+ (1,0) [0|1] "bool" MCU
 SG_ OBJ_Lane_Assignment_11 : 10517|3@1+ (1,0) [0|5] "ENUM" MCU
 SG_ OBJ_Lane_Assignment_V_11 : 10520|1@1+ (1,0) [0|1] "bool" MCU
 SG_ OBJ_Age_Seconds_11 : 10521|7@1+ (1,0) [0|100] "s" MCU
 SG_ OBJ_Age_Seconds_V_11 : 10528|1@1+ (1,0) [0|1] "bool" MCU
 SG_ OBJ_Width_11 : 10529|9@1+ (0.01,0) [0.4|2.95] "m" MCU
 SG_ OBJ_Width_V_11 : 10538|1@1+ (1,0) [0|1] "bool" MCU
 SG_ OBJ_Width_STD_11 : 10539|11@1+ (0.001,0) [0|2] "m" MCU
 SG_ OBJ_Width_STD_V_11 : 10550|1@1+ (1,0) [0|1] "bool" MCU
 SG_ OBJ_Length_11 : 10551|9@1+ (0.05,0) [1.2|21] "m" MCU
 SG_ OBJ_Length_V_11 : 10560|1@1+ (1,0) [0|1] "bool" MCU
 SG_ OBJ_Length_STD_11 : 10561|10@1+ (0.01,0) [0|10] "m" MCU
 SG_ OBJ_Length_STD_V_11 : 10571|1@1+ (1,0) [0|1] "bool" MCU
 SG_ OBJ_Radar_ID_11 : 10572|8@1+ (1,0) [0|255] "counter" MCU
 SG_ OBJ_Height_11 : 10580|9@1+ (0.01,0) [0|2.95] "m" MCU
 SG_ OBJ_Height_V_11 : 10589|1@1+ (1,0) [0|1] "bool" MCU
 SG_ Reserved_5_11 : 10590|2@1+ (1,0) [0|0] "NA" MCU
 SG_ OBJ_Height_STD_11 : 10592|11@1+ (0.001,0) [0|2] "m" MCU
 SG_ OBJ_Height_STD_V_11 : 10603|1@1+ (1,0) [0|1] "bool" MCU
 SG_ OBJ_Abs_Long_Velocity_11 : 10604|12@1+ (0.05,-100) [-100|100] "m_per_s" MCU
 SG_ OBJ_Abs_Long_Velocity_V_11 : 10616|1@1+ (1,0) [0|1] "bool" MCU
 SG_ Reserved_6_11 : 10617|7@1+ (1,0) [0|0] "NA" MCU
 SG_ OBJ_Abs_Long_Velocity_STD_11 : 10624|13@1+ (0.01,0) [0|65] "m_per_s" MCU
 SG_ OBJ_Abs_Long_Vel_STD_V_11 : 10637|1@1+ (1,0) [0|1] "bool" MCU
 SG_ OBJ_Abs_Lat_Velocity_11 : 10638|11@1+ (0.05,-50) [-50|50] "m_per_s" MCU
 SG_ OBJ_Abs_Lat_Velocity_V_11 : 10649|1@1+ (1,0) [0|1] "bool" MCU
 SG_ Reserved_7_11 : 10650|6@1+ (1,0) [0|0] "NA" MCU
 SG_ OBJ_Abs_Lat_Velocity_STD_11 : 10656|13@1+ (0.01,0) [0|50] "m_per_s" MCU
 SG_ OBJ_Abs_Lat_Vel_STD_V_11 : 10669|1@1+ (1,0) [0|1] "bool" MCU
 SG_ OBJ_Abs_Long_Acc_11 : 10670|9@1+ (0.05,-10) [-10|10] "m_per_s2" MCU
 SG_ OBJ_Abs_Long_Acc_V_11 : 10679|1@1+ (1,0) [0|1] "bool" MCU
 SG_ Reserved_8_11 : 10680|8@1+ (1,0) [0|0] "NA" MCU
 SG_ OBJ_Abs_Long_Acc_STD_11 : 10688|10@1+ (0.01,0) [0|7.3] "m_per_s2" MCU
 SG_ OBJ_Abs_Long_Acc_STD_V_11 : 10698|1@1+ (1,0) [0|1] "bool" MCU
 SG_ OBJ_Abs_Lat_Acc_11 : 10699|9@1+ (0.05,-10) [-10|10] "m_per_s2" MCU
 SG_ OBJ_Abs_Lat_Acc_V_11 : 10708|1@1+ (1,0) [0|1] "bool" MCU
 SG_ OBJ_Abs_Lat_Acc_STD_11 : 10709|10@1+ (0.01,0) [0|7.3] "m_per_s2" MCU
 SG_ OBJ_Abs_Lat_Acc_STD_V_11 : 10719|1@1+ (1,0) [0|1] "bool" MCU
 SG_ OBJ_Abs_Acceleration_11 : 10720|9@1+ (0.05,-12.7) [-12.7|12.7] "m_per_s2" MCU
 SG_ OBJ_Abs_Acceleration_V_11 : 10729|1@1+ (1,0) [0|1] "bool" MCU
 SG_ OBJ_Abs_Acc_STD_11 : 10730|10@1+ (0.01,0) [0|7.3] "m_per_s2" MCU
 SG_ OBJ_Abs_Acc_STD_V_11 : 10740|1@1+ (1,0) [0|1] "bool" MCU
 SG_ OBJ_Inv_TTC_11 : 10741|11@1+ (0.01,-8) [-8|8] "INV(s)" MCU
 SG_ OBJ_Inv_TTC_V_11 : 10752|1@1+ (1,0) [0|1] "bool" MCU
 SG_ OBJ_Inv_TTC_STD_11 : 10753|12@1+ (0.001,0) [0|4] "INV(s)" MCU
 SG_ OBJ_Inv_TTC_STD_V_11 : 10765|1@1+ (1,0) [0|1] "bool" MCU
 SG_ OBJ_Relative_Long_Acc_11 : 10766|10@1+ (0.05,-20) [-20|20] "m_per_s2" MCU
 SG_ OBJ_Relative_Long_Acc_V_11 : 10776|1@1+ (1,0) [0|1] "bool" MCU
 SG_ Reserved_9_11 : 10777|7@1+ (1,0) [0|0] "NA" MCU
 SG_ OBJ_Relative_Long_Acc_STD_11 : 10784|10@1+ (0.01,0) [0|7.3] "m_per_s2" MCU
 SG_ OBJ_Rel_Long_Acc_STD_V_11 : 10794|1@1+ (1,0) [0|1] "bool" MCU
 SG_ OBJ_Relative_Long_Velocity_11 : 10795|13@1+ (0.05,-120) [-120|130] "m_per_s" MCU
 SG_ OBJ_Relative_Long_Velocity_V_11 : 10808|1@1+ (1,0) [0|1] "bool" MCU
 SG_ Reserved_10_11 : 10809|7@1+ (1,0) [0|0] "NA" MCU
 SG_ OBJ_Relative_Long_Vel_STD_11 : 10816|14@1+ (0.01,0) [0|130] "m_per_s" MCU
 SG_ OBJ_Rel_Long_Vel_STD_V_11 : 10830|1@1+ (1,0) [0|1] "bool" MCU
 SG_ OBJ_Relative_Lat_Velocity_11 : 10831|11@1+ (0.05,-50) [-50|50] "m_per_s" MCU
 SG_ OBJ_Relative_Lat_Velocity_V_11 : 10842|1@1+ (1,0) [0|1] "bool" MCU
 SG_ Reserved_11_11 : 10843|5@1+ (1,0) [0|0] "NA" MCU
 SG_ OBJ_Relative_Lat_Velocity_STD_11 : 10848|13@1+ (0.01,0) [0|50] "m_per_s" MCU
 SG_ OBJ_Rel_Lat_Vel_STD_V_11 : 10861|1@1+ (1,0) [0|1] "bool" MCU
 SG_ OBJ_Long_Distance_11 : 10862|14@1+ (0.05,-200) [-200|500] "m" MCU
 SG_ OBJ_Long_Distance_V_11 : 10876|1@1+ (1,0) [0|1] "bool" MCU
 SG_ Reserved_12_11 : 10877|3@1+ (1,0) [0|0] "NA" MCU
 SG_ OBJ_Long_Distance_STD_11 : 10880|15@1+ (0.01,0) [0|250] "m" MCU
 SG_ OBJ_Long_Distance_STD_V_11 : 10895|1@1+ (1,0) [0|1] "bool" MCU

CM_ SG_ 154 OBJ_Angle_Left_STD_V_5 "Validator for the standard deviation of angleLeft.";
CM_ SG_ 154 OBJ_Angle_Side_5 "The angle between the host longitudinal axis and the far visible edge - the visible edge of the front / rear of the target that is not visible. Currently supported for vehicles only.";
CM_ SG_ 154 OBJ_Angle_Side_V_5 "Validator for angleSide.";
CM_ SG_ 154 OBJ_Angle_Side_STD_5 "Standard deviation of angleSide.";
CM_ SG_ 154 OBJ_Angle_Side_STD_V_5 "Validator for the STD of angleSide.";
CM_ SG_ 154 OBJ_Angle_Mid_V_5 "Validator for angleMid.";
CM_ SG_ 154 OBJ_Angle_Mid_5 "The angle between the host longitudinal axis and the middle of the front / rear of the target (the visible one). The positive side is to the host's right.";
CM_ SG_ 154 OBJ_Angle_Mid_STD_5 "Standard deviation of angleMid.";
CM_ SG_ 154 OBJ_Angle_Mid_STD_V_5 "Validator for the STD of angleMid.";
CM_ SG_ 154 OBJ_Angle_Bottom_V_5 "Validator for OBJAngle_Bottom. ";
CM_ SG_ 154 OBJ_Angle_Bottom_5 "The angle between the longitudinal axis and the Bottom of the front / rear of the target (the visible one). The positive side is to the host's bottom";
CM_ SG_ 154 OBJ_Angle_Bottom_STD_5 "STD for OBJAngle_Bottom. ";
CM_ SG_ 154 OBJ_Angle_Bottom_STD_V_5 "Validator for OBJAngle_Bottom_STD. ";
CM_ SG_ 154 OBJ_Visibility_Side_V_5 "Currently Supported for VD only";
CM_ SG_ 154 OBJ_Visibility_Side_5 "From what car  side is the object visible";
CM_ SG_ 154 OBJ_Is_In_Drivable_Area_5 "Indicates whether the target is in a driveable area.";
CM_ SG_ 154 OBJ_Is_In_Drivable_Area_V_5 "Validator for OBJ_Is_In_Drivable_Area.";
CM_ SG_ 154 OBJ_Is_VeryClose_V_5 "Validator for OBJ_Is_VeryClose. ";
CM_ SG_ 154 OBJ_Is_VeryClose_5 "Indicates whether the target is very close to the host such that it is hard to measure its distance. Currently relevant for peds only";
CM_ SG_ 154 OBJ_OverlapAngleEgoLaneR_5 "Lateral distance to the middle of the RL and RR corners.";
CM_ SG_ 154 OBJ_OverlapAngleEgoLaneR_V_5 "Validator for OBJ_OverlapAngleEgoLaneR";
CM_ SG_ 154 OBJ_OverlapAngleEgoLaneL_5 "Lateral distance to the middle of the RL and RR corners.  ";
CM_ SG_ 154 OBJ_OverlapAngleEgoLaneL_V_5 "Validator for OBJ_OverlapAngleEgoLaneL";
CM_ SG_ 154 OBJ_Is_EMERGENCY_VCL_5 "Is Object an Emergency Vehicle";
CM_ SG_ 154 OBJ_EMERGENCY_LIGHT_COLOR_5 "Emergency Color";
CM_ SG_ 154 OBJ_EMERGENCY_V_5 "Are OBJ_Is_EMERGENCY_VCL and OBJ_EMERGENCY_LIGHT_COLOR Valid";
CM_ SG_ 154 OBJ_Angle_Top_5 "From VD touching point on the ground till the roof of the car";
CM_ SG_ 154 OBJ_Angle_Top_V_5 "Validator for OBJ_Angle_Top ";
CM_ SG_ 154 OBJ_Angle_Top_STD_5 "STD for OBJ_Angle_Top";
CM_ SG_ 154 OBJ_Angle_Top_STD_V_5 "Validator for OBJ_Angle_Top_STD. ";
CM_ SG_ 154 OBJ_CRC_6 "Calculated over all element signals. From the signal after the CRC until the first signal in the next elements OBJ_CRC_N+1  not including";
CM_ SG_ 154 OBJ_ID_6 "The detected object ID. Range is 1-255, while 0 indicates that the field in unfilled.";
CM_ SG_ 154 OBJ_Existence_Probability_6 "The existence probability of the reported object";
CM_ SG_ 154 OBJ_Fusion_Source_6 "sources ids used for fusion";
CM_ SG_ 154 OBJ_Triggered_SDM_6 "Indicates whether the object has trigered the SDM (Safety Diagnostic Manager) alert.";
CM_ SG_ 154 OBJ_Motion_Category_6 "Relevant for VD only. Full description of values can be found at the ACC guide.";
CM_ SG_ 154 OBJ_Object_Age_6 "The number of frames in which the object was recognized.";
CM_ SG_ 154 OBJ_Measuring_Status_6 "Measurment status. Old vs New marks if this is the first frame in which the object is reported. Predicted vs Measured marks if the report is raw or has been predicted forward in time using the measured dynamics and ego motion.";
CM_ SG_ 154 OBJ_Object_Class_6 "Indicates the object type. Uncertain is outputted in case the probability that a vehicle is a truck is very similar to the probability that it is a car. ";
CM_ SG_ 154 OBJ_Class_Probability_6 "The probability of this type classification.";
CM_ SG_ 154 OBJ_Car_Probability_6 "The probability the object is a car";
CM_ SG_ 154 OBJ_Truck_Probability_6 "The probability the object is a Truck";
CM_ SG_ 154 OBJ_Bike_Probability_6 "The probability the object is a Bike";
CM_ SG_ 154 OBJ_Camera_Source_6 "The camera in which this object was detected (best choice).";
CM_ SG_ 154 OBJ_Motion_Status_6 "MOVING - the object is moving STATIONARY - the object was never seen moving STOPPED -  the object was moving and has stopped MOVING_SLOWLY - the object is moving very slowly";
CM_ SG_ 154 OBJ_Motion_Orientation_6 "The direction of the targets heading compared to the host. ";
CM_ SG_ 154 OBJ_Has_Cut_Lane_6 "Indicates whether the object cut the host's (right or left) lane. In case there are no lanes, indicates whether the objects is at most 1 meters away from the host.";
CM_ SG_ 154 OBJ_Has_Cut_Path_6 "Indicates whether the object is in the host's path.";
CM_ SG_ 154 OBJ_Brake_Light_6 "Indication for brake lights ";
CM_ SG_ 154 OBJ_Turn_Indicator_Right_6 "Indication for blinking right light.";
CM_ SG_ 154 OBJ_Turn_Indicator_Left_6 "Indication for blinking left light ";
CM_ SG_ 154 OBJ_Light_Indicator_Validity_6 "Validator for light indicators";
CM_ SG_ 154 OBJ_Right_Out_Of_Image_6 "Indicates whether the measurment are predicted out of the right side of the image bounderies.";
CM_ SG_ 154 OBJ_Left_Out_Of_Image_6 "Indicates whether if measurment are predicted out of  the left side of the image bounderies";
CM_ SG_ 154 OBJ_Right_Out_Of_Image_V_6 "validator";
CM_ SG_ 154 OBJ_Left_Out_Of_Image_V_6 "validator";
CM_ SG_ 154 OBJ_Top_Out_Of_Image_6 "Indicates whether if measurment are predicted out of  the top of the image bounderies";
CM_ SG_ 154 OBJ_Bottom_Out_Of_Image_6 "Indicates whether if measurment are predicted out of  the bottom of the image bounderies";
CM_ SG_ 154 OBJ_Top_Out_Of_Image_V_6 "validator";
CM_ SG_ 154 OBJ_Bottom_Out_Of_Image_V_6 "validator";
CM_ SG_ 154 OBJ_Lane_Assignment_6 "The object's lane relative to the host lane.";
CM_ SG_ 154 OBJ_Lane_Assignment_V_6 "Validator for lane assignment";
CM_ SG_ 154 OBJ_Age_Seconds_6 "Time in seconds in which the object was recognized. ";
CM_ SG_ 154 OBJ_Age_Seconds_V_6 "Validator for object age";
CM_ SG_ 154 OBJ_Width_6 "The width of the target vehicle in the world (not to be mistaken with the width of the visible part of the vehicle).";
CM_ SG_ 154 OBJ_Width_V_6 "Validator for object width";
CM_ SG_ 154 OBJ_Width_STD_6 "Standard deviation for object width";
CM_ SG_ 154 OBJ_Width_STD_V_6 "Validator for the standard deviation of object width";
CM_ SG_ 154 OBJ_Length_6 "The length of the vehicle in the world. For crossing bicycles it gives the viewed length of the bicycle.";
CM_ SG_ 154 OBJ_Length_V_6 "Validator for object length.";
CM_ SG_ 154 OBJ_Length_STD_6 "Standard deviation for object length.";
CM_ SG_ 154 OBJ_Length_STD_V_6 "Validator for the standard deviation of object length.";
CM_ SG_ 154 OBJ_Radar_ID_6 "Radar Object ID of the Fused Object, Only relvant when OBJ_Fusion_Source is not Camera only";
CM_ SG_ 154 OBJ_Height_6 "The height of the object in the world. ";
CM_ SG_ 154 OBJ_Height_V_6 "Validator for object height.";
CM_ SG_ 154 OBJ_Height_STD_6 "Standard deviation for object height.";
CM_ SG_ 154 OBJ_Height_STD_V_6 "Validator for the standard deviation of object height.";
CM_ SG_ 154 OBJ_Abs_Long_Velocity_6 "Absolute longitudinal velocity.";
CM_ SG_ 154 OBJ_Abs_Long_Velocity_V_6 "Validator for absolute longitudinal velocity.";
CM_ SG_ 154 OBJ_Abs_Long_Velocity_STD_6 "Standard deviation of absolute longitudinal velocity.";
CM_ SG_ 154 OBJ_Abs_Long_Vel_STD_V_6 "Validator for the standard deviation of the absolute longitudinal velocity.";
CM_ SG_ 154 OBJ_Abs_Lat_Velocity_6 "The lateral ground speed of the object.";
CM_ SG_ 154 OBJ_Abs_Lat_Velocity_V_6 "Validator for the lateral ground speed of the object.";
CM_ SG_ 154 OBJ_Abs_Lat_Velocity_STD_6 "STD of the lateral ground speed of the object.";
CM_ SG_ 154 OBJ_Abs_Lat_Vel_STD_V_6 "Validator for the STD of the lateral ground speed of the object.";
CM_ SG_ 154 OBJ_Abs_Long_Acc_6 "The longitudinal ground acceleration of the object.";
CM_ SG_ 154 OBJ_Abs_Long_Acc_V_6 "Validator for the longitudinal ground acceleration of the object.";
CM_ SG_ 154 OBJ_Abs_Long_Acc_STD_6 "STD of the longitudinal ground acceleration of the object.";
CM_ SG_ 154 OBJ_Abs_Long_Acc_STD_V_6 "Validator for the STD of the longitudinal ground acceleration of the object.";
CM_ SG_ 154 OBJ_Abs_Lat_Acc_6 "The lateral ground acceleration of the object.";
CM_ SG_ 154 OBJ_Abs_Lat_Acc_V_6 "Validator for the lateral ground acceleration of the object.";
CM_ SG_ 154 OBJ_Abs_Lat_Acc_STD_6 "STD of the lateral ground acceleration of the object.";
CM_ SG_ 154 OBJ_Abs_Lat_Acc_STD_V_6 "Validator for the STD of the lateral ground acceleration of the object.";
CM_ SG_ 154 OBJ_Abs_Acceleration_6 "The absolute ground acceleration in the target's heading direction.";
CM_ SG_ 154 OBJ_Abs_Acceleration_V_6 "Validator for the absolute ground acceleration.";
CM_ SG_ 154 OBJ_Abs_Acc_STD_6 "STD of the absolute ground acceleration.";
CM_ SG_ 154 OBJ_Abs_Acc_STD_V_6 "Validator for the STD of the absolute ground acceleration.";
CM_ SG_ 154 OBJ_Inv_TTC_6 "Inverse TTC (time to collision).";
CM_ SG_ 154 OBJ_Inv_TTC_STD_6 "STD for inverse TTC .";
CM_ SG_ 154 OBJ_Inv_TTC_STD_V_6 "Validator for the STD for inverse TTC .";
CM_ SG_ 154 OBJ_Relative_Long_Acc_6 "The relative lateral ground acceleration of the object.";
CM_ SG_ 154 OBJ_Relative_Long_Acc_V_6 "Validator for the relative lateral ground acceleration of the object.";
CM_ SG_ 154 OBJ_Relative_Long_Acc_STD_6 "STD of the relative lateral ground acceleration of the object.";
CM_ SG_ 154 OBJ_Rel_Long_Acc_STD_V_6 "Validator for the STD of the relative lateral ground acceleration.";
CM_ SG_ 154 OBJ_Relative_Long_Velocity_6 "The relative longtitudinal speed between the target and ego vehicle. ";
CM_ SG_ 154 OBJ_Relative_Long_Velocity_V_6 "Validator for the relative longtitudinal speed.";
CM_ SG_ 154 OBJ_Relative_Long_Vel_STD_6 "STD of the relative longtitudinal speed.";
CM_ SG_ 154 OBJ_Rel_Long_Vel_STD_V_6 "Validator for the STD of the relative longtitudinal speed.";
CM_ SG_ 154 OBJ_Relative_Lat_Velocity_6 "The relative lateral speed between the target and ego vehicle. ";
CM_ SG_ 154 OBJ_Relative_Lat_Velocity_V_6 "Validator for the relative lateral speed. ";
CM_ SG_ 154 OBJ_Relative_Lat_Velocity_STD_6 "STD of the relative lateral speed. ";
CM_ SG_ 154 OBJ_Rel_Lat_Vel_STD_V_6 "Validator for the STD of the relative lateral speed. ";
CM_ SG_ 154 OBJ_Long_Distance_6 "The longitudinal distance to middle of the rear bumper (middle of the RL and RR corners) of the target.";
CM_ SG_ 154 OBJ_Long_Distance_V_6 "Validator of the longtitudinal distance field";
CM_ SG_ 154 OBJ_Long_Distance_STD_6 "STD of the  longtitudinal distance.";
CM_ SG_ 154 OBJ_Long_Distance_STD_V_6 "Validator for the STD of the  longtitudinal distance.";
CM_ SG_ 154 OBJ_Lat_Distance_6 "Lateral distance to the middle of the RL and RR corners.  ";
CM_ SG_ 154 OBJ_Lat_Distance_V_6 "Validator for the lateral distance of the object.";
CM_ SG_ 154 OBJ_Lat_Distance_STD_6 "STD of the lateral distance of the object.";
CM_ SG_ 154 OBJ_Lat_Distance_STD_V_6 "Validator for the STD of the lateral distance of the object.";
CM_ SG_ 154 OBJ_Absolute_Speed_6 "The absolute ground speed in the targets' heading direction.";
CM_ SG_ 154 OBJ_Absolute_Speed_V_6 "Validator for the absolute ground speed.";
CM_ SG_ 154 OBJ_Absolute_Speed_STD_6 "STD of the absolute ground speed.";
CM_ SG_ 154 OBJ_Absolute_Speed_STD_V_6 "Validator for the STD of the absolute ground speed.";
CM_ SG_ 154 OBJ_Heading_6 "The angle beetweenthe host longitudinal axis and target's heading (clockwise, e.g. PI/2 is a target crossing from left to right).";
CM_ SG_ 154 OBJ_Heading_V_6 "Validator for the object heading.";
CM_ SG_ 154 OBJ_Heading_STD_6 "STD of the object heading.";
CM_ SG_ 154 OBJ_Heading_STD_V_6 "Validator for the STD of the object heading.";
CM_ SG_ 154 OBJ_Angle_Rate_STD_6 "Standard deviation of the angular speed. (radians)";
CM_ SG_ 154 OBJ_Angle_Rate_STD_V_6 "Validator for the STD of the angular speed.";
CM_ SG_ 154 OBJ_Angle_Rate_6 "The momentary angular speed of the object. (radians)";
CM_ SG_ 154 OBJ_Angle_Rate_V_6 "Validator for the angular speed.";
CM_ SG_ 154 OBJ_Angle_Right_6 "The angle between the host longitudinal axis and the right side of the front / rear of the target (the visible one). The positive side is to the host's right.";
CM_ SG_ 154 OBJ_Angle_Right_V_6 "Validator for angleRight";
CM_ SG_ 154 OBJ_Angle_Right_STD_6 "Standard deviation of angleRight";
CM_ SG_ 154 OBJ_Angle_Right_STD_V_6 "Validator for the standard deviation of angleRight.";
CM_ SG_ 154 OBJ_Angle_Left_6 "The angle between the host longitudinal axis and the left side of the front / rear of the target (the visible one). The positive side is to the host's right.";
CM_ SG_ 154 OBJ_Angle_Left_V_6 "Validator for angleLeft.";
CM_ SG_ 154 OBJ_Angle_Left_STD_6 "Standard deviation of angleLeft.";
CM_ SG_ 154 OBJ_Angle_Left_STD_V_6 "Validator for the standard deviation of angleLeft.";
CM_ SG_ 154 OBJ_Angle_Side_6 "The angle between the host longitudinal axis and the far visible edge - the visible edge of the front / rear of the target that is not visible. Currently supported for vehicles only.";
CM_ SG_ 154 OBJ_Angle_Side_V_6 "Validator for angleSide.";
CM_ SG_ 154 OBJ_Angle_Side_STD_6 "Standard deviation of angleSide.";
CM_ SG_ 154 OBJ_Angle_Side_STD_V_6 "Validator for the STD of angleSide.";
CM_ SG_ 154 OBJ_Angle_Mid_V_6 "Validator for angleMid.";
CM_ SG_ 154 OBJ_Angle_Mid_6 "The angle between the host longitudinal axis and the middle of the front / rear of the target (the visible one). The positive side is to the host's right.";
CM_ SG_ 154 OBJ_Angle_Mid_STD_6 "Standard deviation of angleMid.";
CM_ SG_ 154 OBJ_Angle_Mid_STD_V_6 "Validator for the STD of angleMid.";
CM_ SG_ 154 OBJ_Angle_Bottom_V_6 "Validator for OBJAngle_Bottom. ";
CM_ SG_ 154 OBJ_Angle_Bottom_6 "The angle between the longitudinal axis and the Bottom of the front / rear of the target (the visible one). The positive side is to the host's bottom";
CM_ SG_ 154 OBJ_Angle_Bottom_STD_6 "STD for OBJAngle_Bottom. ";
CM_ SG_ 154 OBJ_Angle_Bottom_STD_V_6 "Validator for OBJAngle_Bottom_STD. ";
CM_ SG_ 154 OBJ_Visibility_Side_V_6 "Currently Supported for VD only";
CM_ SG_ 154 OBJ_Visibility_Side_6 "From what car  side is the object visible";
CM_ SG_ 154 OBJ_Is_In_Drivable_Area_6 "Indicates whether the target is in a driveable area.";
CM_ SG_ 154 OBJ_Is_In_Drivable_Area_V_6 "Validator for OBJ_Is_In_Drivable_Area.";
CM_ SG_ 154 OBJ_Is_VeryClose_V_6 "Validator for OBJ_Is_VeryClose. ";
CM_ SG_ 154 OBJ_Is_VeryClose_6 "Indicates whether the target is very close to the host such that it is hard to measure its distance. Currently relevant for peds only";
CM_ SG_ 154 OBJ_OverlapAngleEgoLaneR_6 "Lateral distance to the middle of the RL and RR corners.";
CM_ SG_ 154 OBJ_OverlapAngleEgoLaneR_V_6 "Validator for OBJ_OverlapAngleEgoLaneR";
CM_ SG_ 154 OBJ_OverlapAngleEgoLaneL_6 "Lateral distance to the middle of the RL and RR corners.  ";
CM_ SG_ 154 OBJ_OverlapAngleEgoLaneL_V_6 "Validator for OBJ_OverlapAngleEgoLaneL";
CM_ SG_ 154 OBJ_Is_EMERGENCY_VCL_6 "Is Object an Emergency Vehicle";
CM_ SG_ 154 OBJ_EMERGENCY_LIGHT_COLOR_6 "Emergency Color";
CM_ SG_ 154 OBJ_EMERGENCY_V_6 "Are OBJ_Is_EMERGENCY_VCL and OBJ_EMERGENCY_LIGHT_COLOR Valid";
CM_ SG_ 154 OBJ_Angle_Top_6 "From VD touching point on the ground till the roof of the car";
CM_ SG_ 154 OBJ_Angle_Top_V_6 "Validator for OBJ_Angle_Top ";
CM_ SG_ 154 OBJ_Angle_Top_STD_6 "STD for OBJ_Angle_Top";
CM_ SG_ 154 OBJ_Angle_Top_STD_V_6 "Validator for OBJ_Angle_Top_STD. ";
CM_ SG_ 154 OBJ_CRC_7 "Calculated over all element signals. From the signal after the CRC until the first signal in the next elements OBJ_CRC_N+1  not including";
CM_ SG_ 154 OBJ_ID_7 "The detected object ID. Range is 1-255, while 0 indicates that the field in unfilled.";
CM_ SG_ 154 OBJ_Existence_Probability_7 "The existence probability of the reported object";
CM_ SG_ 154 OBJ_Fusion_Source_7 "sources ids used for fusion";
CM_ SG_ 154 OBJ_Triggered_SDM_7 "Indicates whether the object has trigered the SDM (Safety Diagnostic Manager) alert.";
CM_ SG_ 154 OBJ_Motion_Category_7 "Relevant for VD only. Full description of values can be found at the ACC guide.";
CM_ SG_ 154 OBJ_Object_Age_7 "The number of frames in which the object was recognized.";
CM_ SG_ 154 OBJ_Measuring_Status_7 "Measurment status. Old vs New marks if this is the first frame in which the object is reported. Predicted vs Measured marks if the report is raw or has been predicted forward in time using the measured dynamics and ego motion.";
CM_ SG_ 154 OBJ_Object_Class_7 "Indicates the object type. Uncertain is outputted in case the probability that a vehicle is a truck is very similar to the probability that it is a car. ";
CM_ SG_ 154 OBJ_Class_Probability_7 "The probability of this type classification.";
CM_ SG_ 154 OBJ_Car_Probability_7 "The probability the object is a car";
CM_ SG_ 154 OBJ_Truck_Probability_7 "The probability the object is a Truck";
CM_ SG_ 154 OBJ_Bike_Probability_7 "The probability the object is a Bike";
CM_ SG_ 154 OBJ_Camera_Source_7 "The camera in which this object was detected (best choice).";
CM_ SG_ 154 OBJ_Motion_Status_7 "MOVING - the object is moving STATIONARY - the object was never seen moving STOPPED -  the object was moving and has stopped MOVING_SLOWLY - the object is moving very slowly";
CM_ SG_ 154 OBJ_Motion_Orientation_7 "The direction of the targets heading compared to the host. ";
CM_ SG_ 154 OBJ_Has_Cut_Lane_7 "Indicates whether the object cut the host's (right or left) lane. In case there are no lanes, indicates whether the objects is at most 1 meters away from the host.";
CM_ SG_ 154 OBJ_Has_Cut_Path_7 "Indicates whether the object is in the host's path.";
CM_ SG_ 154 OBJ_Brake_Light_7 "Indication for brake lights ";
CM_ SG_ 154 OBJ_Turn_Indicator_Right_7 "Indication for blinking right light.";
CM_ SG_ 154 OBJ_Turn_Indicator_Left_7 "Indication for blinking left light ";
CM_ SG_ 154 OBJ_Light_Indicator_Validity_7 "Validator for light indicators";
CM_ SG_ 154 OBJ_Right_Out_Of_Image_7 "Indicates whether the measurment are predicted out of the right side of the image bounderies.";
CM_ SG_ 154 OBJ_Left_Out_Of_Image_7 "Indicates whether if measurment are predicted out of  the left side of the image bounderies";
CM_ SG_ 154 OBJ_Right_Out_Of_Image_V_7 "validator";
CM_ SG_ 154 OBJ_Left_Out_Of_Image_V_7 "validator";
CM_ SG_ 154 OBJ_Top_Out_Of_Image_7 "Indicates whether if measurment are predicted out of  the top of the image bounderies";
CM_ SG_ 154 OBJ_Bottom_Out_Of_Image_7 "Indicates whether if measurment are predicted out of  the bottom of the image bounderies";
CM_ SG_ 154 OBJ_Top_Out_Of_Image_V_7 "validator";
CM_ SG_ 154 OBJ_Bottom_Out_Of_Image_V_7 "validator";
CM_ SG_ 154 OBJ_Lane_Assignment_7 "The object's lane relative to the host lane.";
CM_ SG_ 154 OBJ_Lane_Assignment_V_7 "Validator for lane assignment";
CM_ SG_ 154 OBJ_Age_Seconds_7 "Time in seconds in which the object was recognized. ";
CM_ SG_ 154 OBJ_Age_Seconds_V_7 "Validator for object age";
CM_ SG_ 154 OBJ_Width_7 "The width of the target vehicle in the world (not to be mistaken with the width of the visible part of the vehicle).";
CM_ SG_ 154 OBJ_Width_V_7 "Validator for object width";
CM_ SG_ 154 OBJ_Width_STD_7 "Standard deviation for object width";
CM_ SG_ 154 OBJ_Width_STD_V_7 "Validator for the standard deviation of object width";
CM_ SG_ 154 OBJ_Length_7 "The length of the vehicle in the world. For crossing bicycles it gives the viewed length of the bicycle.";
CM_ SG_ 154 OBJ_Length_V_7 "Validator for object length.";
CM_ SG_ 154 OBJ_Length_STD_7 "Standard deviation for object length.";
CM_ SG_ 154 OBJ_Length_STD_V_7 "Validator for the standard deviation of object length.";
CM_ SG_ 154 OBJ_Radar_ID_7 "Radar Object ID of the Fused Object, Only relvant when OBJ_Fusion_Source is not Camera only";
CM_ SG_ 154 OBJ_Height_7 "The height of the object in the world. ";
CM_ SG_ 154 OBJ_Height_V_7 "Validator for object height.";
CM_ SG_ 154 OBJ_Height_STD_7 "Standard deviation for object height.";
CM_ SG_ 154 OBJ_Height_STD_V_7 "Validator for the standard deviation of object height.";
CM_ SG_ 154 OBJ_Abs_Long_Velocity_7 "Absolute longitudinal velocity.";
CM_ SG_ 154 OBJ_Abs_Long_Velocity_V_7 "Validator for absolute longitudinal velocity.";
CM_ SG_ 154 OBJ_Abs_Long_Velocity_STD_7 "Standard deviation of absolute longitudinal velocity.";
CM_ SG_ 154 OBJ_Abs_Long_Vel_STD_V_7 "Validator for the standard deviation of the absolute longitudinal velocity.";
CM_ SG_ 154 OBJ_Abs_Lat_Velocity_7 "The lateral ground speed of the object.";
CM_ SG_ 154 OBJ_Abs_Lat_Velocity_V_7 "Validator for the lateral ground speed of the object.";
CM_ SG_ 154 OBJ_Abs_Lat_Velocity_STD_7 "STD of the lateral ground speed of the object.";
CM_ SG_ 154 OBJ_Abs_Lat_Vel_STD_V_7 "Validator for the STD of the lateral ground speed of the object.";
CM_ SG_ 154 OBJ_Abs_Long_Acc_7 "The longitudinal ground acceleration of the object.";
CM_ SG_ 154 OBJ_Abs_Long_Acc_V_7 "Validator for the longitudinal ground acceleration of the object.";
CM_ SG_ 154 OBJ_Abs_Long_Acc_STD_7 "STD of the longitudinal ground acceleration of the object.";
CM_ SG_ 154 OBJ_Abs_Long_Acc_STD_V_7 "Validator for the STD of the longitudinal ground acceleration of the object.";
CM_ SG_ 154 OBJ_Abs_Lat_Acc_7 "The lateral ground acceleration of the object.";
CM_ SG_ 154 OBJ_Abs_Lat_Acc_V_7 "Validator for the lateral ground acceleration of the object.";
CM_ SG_ 154 OBJ_Abs_Lat_Acc_STD_7 "STD of the lateral ground acceleration of the object.";
CM_ SG_ 154 OBJ_Abs_Lat_Acc_STD_V_7 "Validator for the STD of the lateral ground acceleration of the object.";
CM_ SG_ 154 OBJ_Abs_Acceleration_7 "The absolute ground acceleration in the target's heading direction.";
CM_ SG_ 154 OBJ_Abs_Acceleration_V_7 "Validator for the absolute ground acceleration.";
CM_ SG_ 154 OBJ_Abs_Acc_STD_7 "STD of the absolute ground acceleration.";
CM_ SG_ 154 OBJ_Abs_Acc_STD_V_7 "Validator for the STD of the absolute ground acceleration.";
CM_ SG_ 154 OBJ_Inv_TTC_7 "Inverse TTC (time to collision).";
CM_ SG_ 154 OBJ_Inv_TTC_STD_7 "STD for inverse TTC .";
CM_ SG_ 154 OBJ_Inv_TTC_STD_V_7 "Validator for the STD for inverse TTC .";
CM_ SG_ 154 OBJ_Relative_Long_Acc_7 "The relative lateral ground acceleration of the object.";
CM_ SG_ 154 OBJ_Relative_Long_Acc_V_7 "Validator for the relative lateral ground acceleration of the object.";
CM_ SG_ 154 OBJ_Relative_Long_Acc_STD_7 "STD of the relative lateral ground acceleration of the object.";
CM_ SG_ 154 OBJ_Rel_Long_Acc_STD_V_7 "Validator for the STD of the relative lateral ground acceleration.";
CM_ SG_ 154 OBJ_Relative_Long_Velocity_7 "The relative longtitudinal speed between the target and ego vehicle. ";
CM_ SG_ 154 OBJ_Relative_Long_Velocity_V_7 "Validator for the relative longtitudinal speed.";
CM_ SG_ 154 OBJ_Relative_Long_Vel_STD_7 "STD of the relative longtitudinal speed.";
CM_ SG_ 154 OBJ_Rel_Long_Vel_STD_V_7 "Validator for the STD of the relative longtitudinal speed.";
CM_ SG_ 154 OBJ_Relative_Lat_Velocity_7 "The relative lateral speed between the target and ego vehicle. ";
CM_ SG_ 154 OBJ_Relative_Lat_Velocity_V_7 "Validator for the relative lateral speed. ";
CM_ SG_ 154 OBJ_Relative_Lat_Velocity_STD_7 "STD of the relative lateral speed. ";
CM_ SG_ 154 OBJ_Rel_Lat_Vel_STD_V_7 "Validator for the STD of the relative lateral speed. ";
CM_ SG_ 154 OBJ_Long_Distance_7 "The longitudinal distance to middle of the rear bumper (middle of the RL and RR corners) of the target.";
CM_ SG_ 154 OBJ_Long_Distance_V_7 "Validator of the longtitudinal distance field";
CM_ SG_ 154 OBJ_Long_Distance_STD_7 "STD of the  longtitudinal distance.";
CM_ SG_ 154 OBJ_Long_Distance_STD_V_7 "Validator for the STD of the  longtitudinal distance.";
CM_ SG_ 154 OBJ_Lat_Distance_7 "Lateral distance to the middle of the RL and RR corners.  ";
CM_ SG_ 154 OBJ_Lat_Distance_V_7 "Validator for the lateral distance of the object.";
CM_ SG_ 154 OBJ_Lat_Distance_STD_7 "STD of the lateral distance of the object.";
CM_ SG_ 154 OBJ_Lat_Distance_STD_V_7 "Validator for the STD of the lateral distance of the object.";
CM_ SG_ 154 OBJ_Absolute_Speed_7 "The absolute ground speed in the targets' heading direction.";
CM_ SG_ 154 OBJ_Absolute_Speed_V_7 "Validator for the absolute ground speed.";
CM_ SG_ 154 OBJ_Absolute_Speed_STD_7 "STD of the absolute ground speed.";
CM_ SG_ 154 OBJ_Absolute_Speed_STD_V_7 "Validator for the STD of the absolute ground speed.";
CM_ SG_ 154 OBJ_Heading_7 "The angle beetweenthe host longitudinal axis and target's heading (clockwise, e.g. PI/2 is a target crossing from left to right).";
CM_ SG_ 154 OBJ_Heading_V_7 "Validator for the object heading.";
CM_ SG_ 154 OBJ_Heading_STD_7 "STD of the object heading.";
CM_ SG_ 154 OBJ_Heading_STD_V_7 "Validator for the STD of the object heading.";
CM_ SG_ 154 OBJ_Angle_Rate_STD_7 "Standard deviation of the angular speed. (radians)";
CM_ SG_ 154 OBJ_Angle_Rate_STD_V_7 "Validator for the STD of the angular speed.";
CM_ SG_ 154 OBJ_Angle_Rate_7 "The momentary angular speed of the object. (radians)";
CM_ SG_ 154 OBJ_Angle_Rate_V_7 "Validator for the angular speed.";
CM_ SG_ 154 OBJ_Angle_Right_7 "The angle between the host longitudinal axis and the right side of the front / rear of the target (the visible one). The positive side is to the host's right.";
CM_ SG_ 154 OBJ_Angle_Right_V_7 "Validator for angleRight";
CM_ SG_ 154 OBJ_Angle_Right_STD_7 "Standard deviation of angleRight";
CM_ SG_ 154 OBJ_Angle_Right_STD_V_7 "Validator for the standard deviation of angleRight.";
CM_ SG_ 154 OBJ_Angle_Left_7 "The angle between the host longitudinal axis and the left side of the front / rear of the target (the visible one). The positive side is to the host's right.";
CM_ SG_ 154 OBJ_Angle_Left_V_7 "Validator for angleLeft.";
CM_ SG_ 154 OBJ_Angle_Left_STD_7 "Standard deviation of angleLeft.";
CM_ SG_ 154 OBJ_Angle_Left_STD_V_7 "Validator for the standard deviation of angleLeft.";
CM_ SG_ 154 OBJ_Angle_Side_7 "The angle between the host longitudinal axis and the far visible edge - the visible edge of the front / rear of the target that is not visible. Currently supported for vehicles only.";
CM_ SG_ 154 OBJ_Angle_Side_V_7 "Validator for angleSide.";
CM_ SG_ 154 OBJ_Angle_Side_STD_7 "Standard deviation of angleSide.";
CM_ SG_ 154 OBJ_Angle_Side_STD_V_7 "Validator for the STD of angleSide.";
CM_ SG_ 154 OBJ_Angle_Mid_V_7 "Validator for angleMid.";
CM_ SG_ 154 OBJ_Angle_Mid_7 "The angle between the host longitudinal axis and the middle of the front / rear of the target (the visible one). The positive side is to the host's right.";
CM_ SG_ 154 OBJ_Angle_Mid_STD_7 "Standard deviation of angleMid.";
CM_ SG_ 154 OBJ_Angle_Mid_STD_V_7 "Validator for the STD of angleMid.";
CM_ SG_ 154 OBJ_Angle_Bottom_V_7 "Validator for OBJAngle_Bottom. ";
CM_ SG_ 154 OBJ_Angle_Bottom_7 "The angle between the longitudinal axis and the Bottom of the front / rear of the target (the visible one). The positive side is to the host's bottom";
CM_ SG_ 154 OBJ_Angle_Bottom_STD_7 "STD for OBJAngle_Bottom. ";
CM_ SG_ 154 OBJ_Angle_Bottom_STD_V_7 "Validator for OBJAngle_Bottom_STD. ";
CM_ SG_ 154 OBJ_Visibility_Side_V_7 "Currently Supported for VD only";
CM_ SG_ 154 OBJ_Visibility_Side_7 "From what car  side is the object visible";
CM_ SG_ 154 OBJ_Is_In_Drivable_Area_7 "Indicates whether the target is in a driveable area.";
CM_ SG_ 154 OBJ_Is_In_Drivable_Area_V_7 "Validator for OBJ_Is_In_Drivable_Area.";
CM_ SG_ 154 OBJ_Is_VeryClose_V_7 "Validator for OBJ_Is_VeryClose. ";
CM_ SG_ 154 OBJ_Is_VeryClose_7 "Indicates whether the target is very close to the host such that it is hard to measure its distance. Currently relevant for peds only";
CM_ SG_ 154 OBJ_OverlapAngleEgoLaneR_7 "Lateral distance to the middle of the RL and RR corners.";
CM_ SG_ 154 OBJ_OverlapAngleEgoLaneR_V_7 "Validator for OBJ_OverlapAngleEgoLaneR";
CM_ SG_ 154 OBJ_OverlapAngleEgoLaneL_7 "Lateral distance to the middle of the RL and RR corners.  ";
CM_ SG_ 154 OBJ_OverlapAngleEgoLaneL_V_7 "Validator for OBJ_OverlapAngleEgoLaneL";
CM_ SG_ 154 OBJ_Is_EMERGENCY_VCL_7 "Is Object an Emergency Vehicle";
CM_ SG_ 154 OBJ_EMERGENCY_LIGHT_COLOR_7 "Emergency Color";
CM_ SG_ 154 OBJ_EMERGENCY_V_7 "Are OBJ_Is_EMERGENCY_VCL and OBJ_EMERGENCY_LIGHT_COLOR Valid";
CM_ SG_ 154 OBJ_Angle_Top_7 "From VD touching point on the ground till the roof of the car";
CM_ SG_ 154 OBJ_Angle_Top_V_7 "Validator for OBJ_Angle_Top ";
CM_ SG_ 154 OBJ_Angle_Top_STD_7 "STD for OBJ_Angle_Top";
CM_ SG_ 154 OBJ_Angle_Top_STD_V_7 "Validator for OBJ_Angle_Top_STD. ";
CM_ SG_ 154 OBJ_CRC_8 "Calculated over all element signals. From the signal after the CRC until the first signal in the next elements OBJ_CRC_N+1  not including";
CM_ SG_ 154 OBJ_ID_8 "The detected object ID. Range is 1-255, while 0 indicates that the field in unfilled.";
CM_ SG_ 154 OBJ_Existence_Probability_8 "The existence probability of the reported object";
CM_ SG_ 154 OBJ_Fusion_Source_8 "sources ids used for fusion";
CM_ SG_ 154 OBJ_Triggered_SDM_8 "Indicates whether the object has trigered the SDM (Safety Diagnostic Manager) alert.";
CM_ SG_ 154 OBJ_Motion_Category_8 "Relevant for VD only. Full description of values can be found at the ACC guide.";
CM_ SG_ 154 OBJ_Object_Age_8 "The number of frames in which the object was recognized.";
CM_ SG_ 154 OBJ_Measuring_Status_8 "Measurment status. Old vs New marks if this is the first frame in which the object is reported. Predicted vs Measured marks if the report is raw or has been predicted forward in time using the measured dynamics and ego motion.";
CM_ SG_ 154 OBJ_Object_Class_8 "Indicates the object type. Uncertain is outputted in case the probability that a vehicle is a truck is very similar to the probability that it is a car. ";
CM_ SG_ 154 OBJ_Class_Probability_8 "The probability of this type classification.";
CM_ SG_ 154 OBJ_Car_Probability_8 "The probability the object is a car";
CM_ SG_ 154 OBJ_Truck_Probability_8 "The probability the object is a Truck";
CM_ SG_ 154 OBJ_Bike_Probability_8 "The probability the object is a Bike";
CM_ SG_ 154 OBJ_Camera_Source_8 "The camera in which this object was detected (best choice).";
CM_ SG_ 154 OBJ_Motion_Status_8 "MOVING - the object is moving STATIONARY - the object was never seen moving STOPPED -  the object was moving and has stopped MOVING_SLOWLY - the object is moving very slowly";
CM_ SG_ 154 OBJ_Motion_Orientation_8 "The direction of the targets heading compared to the host. ";
CM_ SG_ 154 OBJ_Has_Cut_Lane_8 "Indicates whether the object cut the host's (right or left) lane. In case there are no lanes, indicates whether the objects is at most 1 meters away from the host.";
CM_ SG_ 154 OBJ_Has_Cut_Path_8 "Indicates whether the object is in the host's path.";
CM_ SG_ 154 OBJ_Brake_Light_8 "Indication for brake lights ";
CM_ SG_ 154 OBJ_Turn_Indicator_Right_8 "Indication for blinking right light.";
CM_ SG_ 154 OBJ_Turn_Indicator_Left_8 "Indication for blinking left light ";
CM_ SG_ 154 OBJ_Light_Indicator_Validity_8 "Validator for light indicators";
CM_ SG_ 154 OBJ_Right_Out_Of_Image_8 "Indicates whether the measurment are predicted out of the right side of the image bounderies.";
CM_ SG_ 154 OBJ_Left_Out_Of_Image_8 "Indicates whether if measurment are predicted out of  the left side of the image bounderies";
CM_ SG_ 154 OBJ_Right_Out_Of_Image_V_8 "validator";
CM_ SG_ 154 OBJ_Left_Out_Of_Image_V_8 "validator";
CM_ SG_ 154 OBJ_Top_Out_Of_Image_8 "Indicates whether if measurment are predicted out of  the top of the image bounderies";
CM_ SG_ 154 OBJ_Bottom_Out_Of_Image_8 "Indicates whether if measurment are predicted out of  the bottom of the image bounderies";
CM_ SG_ 154 OBJ_Top_Out_Of_Image_V_8 "validator";
CM_ SG_ 154 OBJ_Bottom_Out_Of_Image_V_8 "validator";
CM_ SG_ 154 OBJ_Lane_Assignment_8 "The object's lane relative to the host lane.";
CM_ SG_ 154 OBJ_Lane_Assignment_V_8 "Validator for lane assignment";
CM_ SG_ 154 OBJ_Age_Seconds_8 "Time in seconds in which the object was recognized. ";
CM_ SG_ 154 OBJ_Age_Seconds_V_8 "Validator for object age";
CM_ SG_ 154 OBJ_Width_8 "The width of the target vehicle in the world (not to be mistaken with the width of the visible part of the vehicle).";
CM_ SG_ 154 OBJ_Width_V_8 "Validator for object width";
CM_ SG_ 154 OBJ_Width_STD_8 "Standard deviation for object width";
CM_ SG_ 154 OBJ_Width_STD_V_8 "Validator for the standard deviation of object width";
CM_ SG_ 154 OBJ_Length_8 "The length of the vehicle in the world. For crossing bicycles it gives the viewed length of the bicycle.";
CM_ SG_ 154 OBJ_Length_V_8 "Validator for object length.";
CM_ SG_ 154 OBJ_Length_STD_8 "Standard deviation for object length.";
CM_ SG_ 154 OBJ_Length_STD_V_8 "Validator for the standard deviation of object length.";
CM_ SG_ 154 OBJ_Radar_ID_8 "Radar Object ID of the Fused Object, Only relvant when OBJ_Fusion_Source is not Camera only";
CM_ SG_ 154 OBJ_Height_8 "The height of the object in the world. ";
CM_ SG_ 154 OBJ_Height_V_8 "Validator for object height.";
CM_ SG_ 154 OBJ_Height_STD_8 "Standard deviation for object height.";
CM_ SG_ 154 OBJ_Height_STD_V_8 "Validator for the standard deviation of object height.";
CM_ SG_ 154 OBJ_Abs_Long_Velocity_8 "Absolute longitudinal velocity.";
CM_ SG_ 154 OBJ_Abs_Long_Velocity_V_8 "Validator for absolute longitudinal velocity.";
CM_ SG_ 154 OBJ_Abs_Long_Velocity_STD_8 "Standard deviation of absolute longitudinal velocity.";
CM_ SG_ 154 OBJ_Abs_Long_Vel_STD_V_8 "Validator for the standard deviation of the absolute longitudinal velocity.";
CM_ SG_ 154 OBJ_Abs_Lat_Velocity_8 "The lateral ground speed of the object.";
CM_ SG_ 154 OBJ_Abs_Lat_Velocity_V_8 "Validator for the lateral ground speed of the object.";
CM_ SG_ 154 OBJ_Abs_Lat_Velocity_STD_8 "STD of the lateral ground speed of the object.";
CM_ SG_ 154 OBJ_Abs_Lat_Vel_STD_V_8 "Validator for the STD of the lateral ground speed of the object.";
CM_ SG_ 154 OBJ_Abs_Long_Acc_8 "The longitudinal ground acceleration of the object.";
CM_ SG_ 154 OBJ_Abs_Long_Acc_V_8 "Validator for the longitudinal ground acceleration of the object.";
CM_ SG_ 154 OBJ_Abs_Long_Acc_STD_8 "STD of the longitudinal ground acceleration of the object.";
CM_ SG_ 154 OBJ_Abs_Long_Acc_STD_V_8 "Validator for the STD of the longitudinal ground acceleration of the object.";
CM_ SG_ 154 OBJ_Abs_Lat_Acc_8 "The lateral ground acceleration of the object.";
CM_ SG_ 154 OBJ_Abs_Lat_Acc_V_8 "Validator for the lateral ground acceleration of the object.";
CM_ SG_ 154 OBJ_Abs_Lat_Acc_STD_8 "STD of the lateral ground acceleration of the object.";
CM_ SG_ 154 OBJ_Abs_Lat_Acc_STD_V_8 "Validator for the STD of the lateral ground acceleration of the object.";
CM_ SG_ 154 OBJ_Abs_Acceleration_8 "The absolute ground acceleration in the target's heading direction.";
CM_ SG_ 154 OBJ_Abs_Acceleration_V_8 "Validator for the absolute ground acceleration.";
CM_ SG_ 154 OBJ_Abs_Acc_STD_8 "STD of the absolute ground acceleration.";
CM_ SG_ 154 OBJ_Abs_Acc_STD_V_8 "Validator for the STD of the absolute ground acceleration.";
CM_ SG_ 154 OBJ_Inv_TTC_8 "Inverse TTC (time to collision).";
CM_ SG_ 154 OBJ_Inv_TTC_STD_8 "STD for inverse TTC .";
CM_ SG_ 154 OBJ_Inv_TTC_STD_V_8 "Validator for the STD for inverse TTC .";
CM_ SG_ 154 OBJ_Relative_Long_Acc_8 "The relative lateral ground acceleration of the object.";
CM_ SG_ 154 OBJ_Relative_Long_Acc_V_8 "Validator for the relative lateral ground acceleration of the object.";
CM_ SG_ 154 OBJ_Relative_Long_Acc_STD_8 "STD of the relative lateral ground acceleration of the object.";
CM_ SG_ 154 OBJ_Rel_Long_Acc_STD_V_8 "Validator for the STD of the relative lateral ground acceleration.";
CM_ SG_ 154 OBJ_Relative_Long_Velocity_8 "The relative longtitudinal speed between the target and ego vehicle. ";
CM_ SG_ 154 OBJ_Relative_Long_Velocity_V_8 "Validator for the relative longtitudinal speed.";
CM_ SG_ 154 OBJ_Relative_Long_Vel_STD_8 "STD of the relative longtitudinal speed.";
CM_ SG_ 154 OBJ_Rel_Long_Vel_STD_V_8 "Validator for the STD of the relative longtitudinal speed.";
CM_ SG_ 154 OBJ_Relative_Lat_Velocity_8 "The relative lateral speed between the target and ego vehicle. ";
CM_ SG_ 154 OBJ_Relative_Lat_Velocity_V_8 "Validator for the relative lateral speed. ";
CM_ SG_ 154 OBJ_Relative_Lat_Velocity_STD_8 "STD of the relative lateral speed. ";
CM_ SG_ 154 OBJ_Rel_Lat_Vel_STD_V_8 "Validator for the STD of the relative lateral speed. ";
CM_ SG_ 154 OBJ_Long_Distance_8 "The longitudinal distance to middle of the rear bumper (middle of the RL and RR corners) of the target.";
CM_ SG_ 154 OBJ_Long_Distance_V_8 "Validator of the longtitudinal distance field";
CM_ SG_ 154 OBJ_Long_Distance_STD_8 "STD of the  longtitudinal distance.";
CM_ SG_ 154 OBJ_Long_Distance_STD_V_8 "Validator for the STD of the  longtitudinal distance.";
CM_ SG_ 154 OBJ_Lat_Distance_8 "Lateral distance to the middle of the RL and RR corners.  ";
CM_ SG_ 154 OBJ_Lat_Distance_V_8 "Validator for the lateral distance of the object.";
CM_ SG_ 154 OBJ_Lat_Distance_STD_8 "STD of the lateral distance of the object.";
CM_ SG_ 154 OBJ_Lat_Distance_STD_V_8 "Validator for the STD of the lateral distance of the object.";
CM_ SG_ 154 OBJ_Absolute_Speed_8 "The absolute ground speed in the targets' heading direction.";
CM_ SG_ 154 OBJ_Absolute_Speed_V_8 "Validator for the absolute ground speed.";
CM_ SG_ 154 OBJ_Absolute_Speed_STD_8 "STD of the absolute ground speed.";
CM_ SG_ 154 OBJ_Absolute_Speed_STD_V_8 "Validator for the STD of the absolute ground speed.";
CM_ SG_ 154 OBJ_Heading_8 "The angle beetweenthe host longitudinal axis and target's heading (clockwise, e.g. PI/2 is a target crossing from left to right).";
CM_ SG_ 154 OBJ_Heading_V_8 "Validator for the object heading.";
CM_ SG_ 154 OBJ_Heading_STD_8 "STD of the object heading.";
CM_ SG_ 154 OBJ_Heading_STD_V_8 "Validator for the STD of the object heading.";
CM_ SG_ 154 OBJ_Angle_Rate_STD_8 "Standard deviation of the angular speed. (radians)";
CM_ SG_ 154 OBJ_Angle_Rate_STD_V_8 "Validator for the STD of the angular speed.";
CM_ SG_ 154 OBJ_Angle_Rate_8 "The momentary angular speed of the object. (radians)";
CM_ SG_ 154 OBJ_Angle_Rate_V_8 "Validator for the angular speed.";
CM_ SG_ 154 OBJ_Angle_Right_8 "The angle between the host longitudinal axis and the right side of the front / rear of the target (the visible one). The positive side is to the host's right.";
CM_ SG_ 154 OBJ_Angle_Right_V_8 "Validator for angleRight";
CM_ SG_ 154 OBJ_Angle_Right_STD_8 "Standard deviation of angleRight";
CM_ SG_ 154 OBJ_Angle_Right_STD_V_8 "Validator for the standard deviation of angleRight.";
CM_ SG_ 154 OBJ_Angle_Left_8 "The angle between the host longitudinal axis and the left side of the front / rear of the target (the visible one). The positive side is to the host's right.";
CM_ SG_ 154 OBJ_Angle_Left_V_8 "Validator for angleLeft.";
CM_ SG_ 154 OBJ_Angle_Left_STD_8 "Standard deviation of angleLeft.";
CM_ SG_ 154 OBJ_Angle_Left_STD_V_8 "Validator for the standard deviation of angleLeft.";
CM_ SG_ 154 OBJ_Angle_Side_8 "The angle between the host longitudinal axis and the far visible edge - the visible edge of the front / rear of the target that is not visible. Currently supported for vehicles only.";
CM_ SG_ 154 OBJ_Angle_Side_V_8 "Validator for angleSide.";
CM_ SG_ 154 OBJ_Angle_Side_STD_8 "Standard deviation of angleSide.";
CM_ SG_ 154 OBJ_Angle_Side_STD_V_8 "Validator for the STD of angleSide.";
CM_ SG_ 154 OBJ_Angle_Mid_V_8 "Validator for angleMid.";
CM_ SG_ 154 OBJ_Angle_Mid_8 "The angle between the host longitudinal axis and the middle of the front / rear of the target (the visible one). The positive side is to the host's right.";
CM_ SG_ 154 OBJ_Angle_Mid_STD_8 "Standard deviation of angleMid.";
CM_ SG_ 154 OBJ_Angle_Mid_STD_V_8 "Validator for the STD of angleMid.";
CM_ SG_ 154 OBJ_Angle_Bottom_V_8 "Validator for OBJAngle_Bottom. ";
CM_ SG_ 154 OBJ_Angle_Bottom_8 "The angle between the longitudinal axis and the Bottom of the front / rear of the target (the visible one). The positive side is to the host's bottom";
CM_ SG_ 154 OBJ_Angle_Bottom_STD_8 "STD for OBJAngle_Bottom. ";
CM_ SG_ 154 OBJ_Angle_Bottom_STD_V_8 "Validator for OBJAngle_Bottom_STD. ";
CM_ SG_ 154 OBJ_Visibility_Side_V_8 "Currently Supported for VD only";
CM_ SG_ 154 OBJ_Visibility_Side_8 "From what car  side is the object visible";
CM_ SG_ 154 OBJ_Is_In_Drivable_Area_8 "Indicates whether the target is in a driveable area.";
CM_ SG_ 154 OBJ_Is_In_Drivable_Area_V_8 "Validator for OBJ_Is_In_Drivable_Area.";
CM_ SG_ 154 OBJ_Is_VeryClose_V_8 "Validator for OBJ_Is_VeryClose. ";
CM_ SG_ 154 OBJ_Is_VeryClose_8 "Indicates whether the target is very close to the host such that it is hard to measure its distance. Currently relevant for peds only";
CM_ SG_ 154 OBJ_OverlapAngleEgoLaneR_8 "Lateral distance to the middle of the RL and RR corners.";
CM_ SG_ 154 OBJ_OverlapAngleEgoLaneR_V_8 "Validator for OBJ_OverlapAngleEgoLaneR";
CM_ SG_ 154 OBJ_OverlapAngleEgoLaneL_8 "Lateral distance to the middle of the RL and RR corners.  ";
CM_ SG_ 154 OBJ_OverlapAngleEgoLaneL_V_8 "Validator for OBJ_OverlapAngleEgoLaneL";
CM_ SG_ 154 OBJ_Is_EMERGENCY_VCL_8 "Is Object an Emergency Vehicle";
CM_ SG_ 154 OBJ_EMERGENCY_LIGHT_COLOR_8 "Emergency Color";
CM_ SG_ 154 OBJ_EMERGENCY_V_8 "Are OBJ_Is_EMERGENCY_VCL and OBJ_EMERGENCY_LIGHT_COLOR Valid";
CM_ SG_ 154 OBJ_Angle_Top_8 "From VD touching point on the ground till the roof of the car";
CM_ SG_ 154 OBJ_Angle_Top_V_8 "Validator for OBJ_Angle_Top ";
CM_ SG_ 154 OBJ_Angle_Top_STD_8 "STD for OBJ_Angle_Top";
CM_ SG_ 154 OBJ_Angle_Top_STD_V_8 "Validator for OBJ_Angle_Top_STD. ";
CM_ SG_ 154 OBJ_CRC_9 "Calculated over all element signals. From the signal after the CRC until the first signal in the next elements OBJ_CRC_N+1  not including";
CM_ SG_ 154 OBJ_ID_9 "The detected object ID. Range is 1-255, while 0 indicates that the field in unfilled.";
CM_ SG_ 154 OBJ_Existence_Probability_9 "The existence probability of the reported object";
CM_ SG_ 154 OBJ_Fusion_Source_9 "sources ids used for fusion";
CM_ SG_ 154 OBJ_Triggered_SDM_9 "Indicates whether the object has trigered the SDM (Safety Diagnostic Manager) alert.";
CM_ SG_ 154 OBJ_Motion_Category_9 "Relevant for VD only. Full description of values can be found at the ACC guide.";
CM_ SG_ 154 OBJ_Object_Age_9 "The number of frames in which the object was recognized.";
CM_ SG_ 154 OBJ_Measuring_Status_9 "Measurment status. Old vs New marks if this is the first frame in which the object is reported. Predicted vs Measured marks if the report is raw or has been predicted forward in time using the measured dynamics and ego motion.";
CM_ SG_ 154 OBJ_Object_Class_9 "Indicates the object type. Uncertain is outputted in case the probability that a vehicle is a truck is very similar to the probability that it is a car. ";
CM_ SG_ 154 OBJ_Class_Probability_9 "The probability of this type classification.";
CM_ SG_ 154 OBJ_Car_Probability_9 "The probability the object is a car";
CM_ SG_ 154 OBJ_Truck_Probability_9 "The probability the object is a Truck";
CM_ SG_ 154 OBJ_Bike_Probability_9 "The probability the object is a Bike";
CM_ SG_ 154 OBJ_Camera_Source_9 "The camera in which this object was detected (best choice).";
CM_ SG_ 154 OBJ_Motion_Status_9 "MOVING - the object is moving STATIONARY - the object was never seen moving STOPPED -  the object was moving and has stopped MOVING_SLOWLY - the object is moving very slowly";
CM_ SG_ 154 OBJ_Motion_Orientation_9 "The direction of the targets heading compared to the host. ";
CM_ SG_ 154 OBJ_Has_Cut_Lane_9 "Indicates whether the object cut the host's (right or left) lane. In case there are no lanes, indicates whether the objects is at most 1 meters away from the host.";
CM_ SG_ 154 OBJ_Has_Cut_Path_9 "Indicates whether the object is in the host's path.";
CM_ SG_ 154 OBJ_Brake_Light_9 "Indication for brake lights ";
CM_ SG_ 154 OBJ_Turn_Indicator_Right_9 "Indication for blinking right light.";
CM_ SG_ 154 OBJ_Turn_Indicator_Left_9 "Indication for blinking left light ";
CM_ SG_ 154 OBJ_Light_Indicator_Validity_9 "Validator for light indicators";
CM_ SG_ 154 OBJ_Right_Out_Of_Image_9 "Indicates whether the measurment are predicted out of the right side of the image bounderies.";
CM_ SG_ 154 OBJ_Left_Out_Of_Image_9 "Indicates whether if measurment are predicted out of  the left side of the image bounderies";
CM_ SG_ 154 OBJ_Right_Out_Of_Image_V_9 "validator";
CM_ SG_ 154 OBJ_Left_Out_Of_Image_V_9 "validator";
CM_ SG_ 154 OBJ_Top_Out_Of_Image_9 "Indicates whether if measurment are predicted out of  the top of the image bounderies";
CM_ SG_ 154 OBJ_Bottom_Out_Of_Image_9 "Indicates whether if measurment are predicted out of  the bottom of the image bounderies";
CM_ SG_ 154 OBJ_Top_Out_Of_Image_V_9 "validator";
CM_ SG_ 154 OBJ_Bottom_Out_Of_Image_V_9 "validator";
CM_ SG_ 154 OBJ_Lane_Assignment_9 "The object's lane relative to the host lane.";
CM_ SG_ 154 OBJ_Lane_Assignment_V_9 "Validator for lane assignment";
CM_ SG_ 154 OBJ_Age_Seconds_9 "Time in seconds in which the object was recognized. ";
CM_ SG_ 154 OBJ_Age_Seconds_V_9 "Validator for object age";
CM_ SG_ 154 OBJ_Width_9 "The width of the target vehicle in the world (not to be mistaken with the width of the visible part of the vehicle).";
CM_ SG_ 154 OBJ_Width_V_9 "Validator for object width";
CM_ SG_ 154 OBJ_Width_STD_9 "Standard deviation for object width";
CM_ SG_ 154 OBJ_Width_STD_V_9 "Validator for the standard deviation of object width";
CM_ SG_ 154 OBJ_Length_9 "The length of the vehicle in the world. For crossing bicycles it gives the viewed length of the bicycle.";
CM_ SG_ 154 OBJ_Length_V_9 "Validator for object length.";
CM_ SG_ 154 OBJ_Length_STD_9 "Standard deviation for object length.";
CM_ SG_ 154 OBJ_Length_STD_V_9 "Validator for the standard deviation of object length.";
CM_ SG_ 154 OBJ_Radar_ID_9 "Radar Object ID of the Fused Object, Only relvant when OBJ_Fusion_Source is not Camera only";
CM_ SG_ 154 OBJ_Height_9 "The height of the object in the world. ";
CM_ SG_ 154 OBJ_Height_V_9 "Validator for object height.";
CM_ SG_ 154 OBJ_Height_STD_9 "Standard deviation for object height.";
CM_ SG_ 154 OBJ_Height_STD_V_9 "Validator for the standard deviation of object height.";
CM_ SG_ 154 OBJ_Abs_Long_Velocity_9 "Absolute longitudinal velocity.";
CM_ SG_ 154 OBJ_Abs_Long_Velocity_V_9 "Validator for absolute longitudinal velocity.";
CM_ SG_ 154 OBJ_Abs_Long_Velocity_STD_9 "Standard deviation of absolute longitudinal velocity.";
CM_ SG_ 154 OBJ_Abs_Long_Vel_STD_V_9 "Validator for the standard deviation of the absolute longitudinal velocity.";
CM_ SG_ 154 OBJ_Abs_Lat_Velocity_9 "The lateral ground speed of the object.";
CM_ SG_ 154 OBJ_Abs_Lat_Velocity_V_9 "Validator for the lateral ground speed of the object.";
CM_ SG_ 154 OBJ_Abs_Lat_Velocity_STD_9 "STD of the lateral ground speed of the object.";
CM_ SG_ 154 OBJ_Abs_Lat_Vel_STD_V_9 "Validator for the STD of the lateral ground speed of the object.";
CM_ SG_ 154 OBJ_Abs_Long_Acc_9 "The longitudinal ground acceleration of the object.";
CM_ SG_ 154 OBJ_Abs_Long_Acc_V_9 "Validator for the longitudinal ground acceleration of the object.";
CM_ SG_ 154 OBJ_Abs_Long_Acc_STD_9 "STD of the longitudinal ground acceleration of the object.";
CM_ SG_ 154 OBJ_Abs_Long_Acc_STD_V_9 "Validator for the STD of the longitudinal ground acceleration of the object.";
CM_ SG_ 154 OBJ_Abs_Lat_Acc_9 "The lateral ground acceleration of the object.";
CM_ SG_ 154 OBJ_Abs_Lat_Acc_V_9 "Validator for the lateral ground acceleration of the object.";
CM_ SG_ 154 OBJ_Abs_Lat_Acc_STD_9 "STD of the lateral ground acceleration of the object.";
CM_ SG_ 154 OBJ_Abs_Lat_Acc_STD_V_9 "Validator for the STD of the lateral ground acceleration of the object.";
CM_ SG_ 154 OBJ_Abs_Acceleration_9 "The absolute ground acceleration in the target's heading direction.";
CM_ SG_ 154 OBJ_Abs_Acceleration_V_9 "Validator for the absolute ground acceleration.";
CM_ SG_ 154 OBJ_Abs_Acc_STD_9 "STD of the absolute ground acceleration.";
CM_ SG_ 154 OBJ_Abs_Acc_STD_V_9 "Validator for the STD of the absolute ground acceleration.";
CM_ SG_ 154 OBJ_Inv_TTC_9 "Inverse TTC (time to collision).";
CM_ SG_ 154 OBJ_Inv_TTC_STD_9 "STD for inverse TTC .";
CM_ SG_ 154 OBJ_Inv_TTC_STD_V_9 "Validator for the STD for inverse TTC .";
CM_ SG_ 154 OBJ_Relative_Long_Acc_9 "The relative lateral ground acceleration of the object.";
CM_ SG_ 154 OBJ_Relative_Long_Acc_V_9 "Validator for the relative lateral ground acceleration of the object.";
CM_ SG_ 154 OBJ_Relative_Long_Acc_STD_9 "STD of the relative lateral ground acceleration of the object.";
CM_ SG_ 154 OBJ_Rel_Long_Acc_STD_V_9 "Validator for the STD of the relative lateral ground acceleration.";
CM_ SG_ 154 OBJ_Relative_Long_Velocity_9 "The relative longtitudinal speed between the target and ego vehicle. ";
CM_ SG_ 154 OBJ_Relative_Long_Velocity_V_9 "Validator for the relative longtitudinal speed.";
CM_ SG_ 154 OBJ_Relative_Long_Vel_STD_9 "STD of the relative longtitudinal speed.";
CM_ SG_ 154 OBJ_Rel_Long_Vel_STD_V_9 "Validator for the STD of the relative longtitudinal speed.";
CM_ SG_ 154 OBJ_Relative_Lat_Velocity_9 "The relative lateral speed between the target and ego vehicle. ";
CM_ SG_ 154 OBJ_Relative_Lat_Velocity_V_9 "Validator for the relative lateral speed. ";
CM_ SG_ 154 OBJ_Relative_Lat_Velocity_STD_9 "STD of the relative lateral speed. ";
CM_ SG_ 154 OBJ_Rel_Lat_Vel_STD_V_9 "Validator for the STD of the relative lateral speed. ";
CM_ SG_ 154 OBJ_Long_Distance_9 "The longitudinal distance to middle of the rear bumper (middle of the RL and RR corners) of the target.";
CM_ SG_ 154 OBJ_Long_Distance_V_9 "Validator of the longtitudinal distance field";
CM_ SG_ 154 OBJ_Long_Distance_STD_9 "STD of the  longtitudinal distance.";
CM_ SG_ 154 OBJ_Long_Distance_STD_V_9 "Validator for the STD of the  longtitudinal distance.";
CM_ SG_ 154 OBJ_Lat_Distance_9 "Lateral distance to the middle of the RL and RR corners.  ";
CM_ SG_ 154 OBJ_Lat_Distance_V_9 "Validator for the lateral distance of the object.";
CM_ SG_ 154 OBJ_Lat_Distance_STD_9 "STD of the lateral distance of the object.";
CM_ SG_ 154 OBJ_Lat_Distance_STD_V_9 "Validator for the STD of the lateral distance of the object.";
CM_ SG_ 154 OBJ_Absolute_Speed_9 "The absolute ground speed in the targets' heading direction.";
CM_ SG_ 154 OBJ_Absolute_Speed_V_9 "Validator for the absolute ground speed.";
CM_ SG_ 154 OBJ_Absolute_Speed_STD_9 "STD of the absolute ground speed.";
CM_ SG_ 154 OBJ_Absolute_Speed_STD_V_9 "Validator for the STD of the absolute ground speed.";
CM_ SG_ 154 OBJ_Heading_9 "The angle beetweenthe host longitudinal axis and target's heading (clockwise, e.g. PI/2 is a target crossing from left to right).";
CM_ SG_ 154 OBJ_Heading_V_9 "Validator for the object heading.";
CM_ SG_ 154 OBJ_Heading_STD_9 "STD of the object heading.";
CM_ SG_ 154 OBJ_Heading_STD_V_9 "Validator for the STD of the object heading.";
CM_ SG_ 154 OBJ_Angle_Rate_STD_9 "Standard deviation of the angular speed. (radians)";
CM_ SG_ 154 OBJ_Angle_Rate_STD_V_9 "Validator for the STD of the angular speed.";
CM_ SG_ 154 OBJ_Angle_Rate_9 "The momentary angular speed of the object. (radians)";
CM_ SG_ 154 OBJ_Angle_Rate_V_9 "Validator for the angular speed.";
CM_ SG_ 154 OBJ_Angle_Right_9 "The angle between the host longitudinal axis and the right side of the front / rear of the target (the visible one). The positive side is to the host's right.";
CM_ SG_ 154 OBJ_Angle_Right_V_9 "Validator for angleRight";
CM_ SG_ 154 OBJ_Angle_Right_STD_9 "Standard deviation of angleRight";
CM_ SG_ 154 OBJ_Angle_Right_STD_V_9 "Validator for the standard deviation of angleRight.";
CM_ SG_ 154 OBJ_Angle_Left_9 "The angle between the host longitudinal axis and the left side of the front / rear of the target (the visible one). The positive side is to the host's right.";
CM_ SG_ 154 OBJ_Angle_Left_V_9 "Validator for angleLeft.";
CM_ SG_ 154 OBJ_Angle_Left_STD_9 "Standard deviation of angleLeft.";
CM_ SG_ 154 OBJ_Angle_Left_STD_V_9 "Validator for the standard deviation of angleLeft.";
CM_ SG_ 154 OBJ_Angle_Side_9 "The angle between the host longitudinal axis and the far visible edge - the visible edge of the front / rear of the target that is not visible. Currently supported for vehicles only.";
CM_ SG_ 154 OBJ_Angle_Side_V_9 "Validator for angleSide.";
CM_ SG_ 154 OBJ_Angle_Side_STD_9 "Standard deviation of angleSide.";
CM_ SG_ 154 OBJ_Angle_Side_STD_V_9 "Validator for the STD of angleSide.";
CM_ SG_ 154 OBJ_Angle_Mid_V_9 "Validator for angleMid.";
CM_ SG_ 154 OBJ_Angle_Mid_9 "The angle between the host longitudinal axis and the middle of the front / rear of the target (the visible one). The positive side is to the host's right.";
CM_ SG_ 154 OBJ_Angle_Mid_STD_9 "Standard deviation of angleMid.";
CM_ SG_ 154 OBJ_Angle_Mid_STD_V_9 "Validator for the STD of angleMid.";
CM_ SG_ 154 OBJ_Angle_Bottom_V_9 "Validator for OBJAngle_Bottom. ";
CM_ SG_ 154 OBJ_Angle_Bottom_9 "The angle between the longitudinal axis and the Bottom of the front / rear of the target (the visible one). The positive side is to the host's bottom";
CM_ SG_ 154 OBJ_Angle_Bottom_STD_9 "STD for OBJAngle_Bottom. ";
CM_ SG_ 154 OBJ_Angle_Bottom_STD_V_9 "Validator for OBJAngle_Bottom_STD. ";
CM_ SG_ 154 OBJ_Visibility_Side_V_9 "Currently Supported for VD only";
CM_ SG_ 154 OBJ_Visibility_Side_9 "From what car  side is the object visible";
CM_ SG_ 154 OBJ_Is_In_Drivable_Area_9 "Indicates whether the target is in a driveable area.";
CM_ SG_ 154 OBJ_Is_In_Drivable_Area_V_9 "Validator for OBJ_Is_In_Drivable_Area.";
CM_ SG_ 154 OBJ_Is_VeryClose_V_9 "Validator for OBJ_Is_VeryClose. ";
CM_ SG_ 154 OBJ_Is_VeryClose_9 "Indicates whether the target is very close to the host such that it is hard to measure its distance. Currently relevant for peds only";
CM_ SG_ 154 OBJ_OverlapAngleEgoLaneR_9 "Lateral distance to the middle of the RL and RR corners.";
CM_ SG_ 154 OBJ_OverlapAngleEgoLaneR_V_9 "Validator for OBJ_OverlapAngleEgoLaneR";
CM_ SG_ 154 OBJ_OverlapAngleEgoLaneL_9 "Lateral distance to the middle of the RL and RR corners.  ";
CM_ SG_ 154 OBJ_OverlapAngleEgoLaneL_V_9 "Validator for OBJ_OverlapAngleEgoLaneL";
CM_ SG_ 154 OBJ_Is_EMERGENCY_VCL_9 "Is Object an Emergency Vehicle";
CM_ SG_ 154 OBJ_EMERGENCY_LIGHT_COLOR_9 "Emergency Color";
CM_ SG_ 154 OBJ_EMERGENCY_V_9 "Are OBJ_Is_EMERGENCY_VCL and OBJ_EMERGENCY_LIGHT_COLOR Valid";
CM_ SG_ 154 OBJ_Angle_Top_9 "From VD touching point on the ground till the roof of the car";
CM_ SG_ 154 OBJ_Angle_Top_V_9 "Validator for OBJ_Angle_Top ";
CM_ SG_ 154 OBJ_Angle_Top_STD_9 "STD for OBJ_Angle_Top";
CM_ SG_ 154 OBJ_Angle_Top_STD_V_9 "Validator for OBJ_Angle_Top_STD. ";
CM_ SG_ 154 OBJ_CRC_10 "Calculated over all element signals. From the signal after the CRC until the first signal in the next elements OBJ_CRC_N+1  not including";
CM_ SG_ 154 OBJ_ID_10 "The detected object ID. Range is 1-255, while 0 indicates that the field in unfilled.";
CM_ SG_ 154 OBJ_Existence_Probability_10 "The existence probability of the reported object";
CM_ SG_ 154 OBJ_Fusion_Source_10 "sources ids used for fusion";
CM_ SG_ 154 OBJ_Triggered_SDM_10 "Indicates whether the object has trigered the SDM (Safety Diagnostic Manager) alert.";
CM_ SG_ 154 OBJ_Motion_Category_10 "Relevant for VD only. Full description of values can be found at the ACC guide.";
CM_ SG_ 154 OBJ_Object_Age_10 "The number of frames in which the object was recognized.";
CM_ SG_ 154 OBJ_Measuring_Status_10 "Measurment status. Old vs New marks if this is the first frame in which the object is reported. Predicted vs Measured marks if the report is raw or has been predicted forward in time using the measured dynamics and ego motion.";
CM_ SG_ 154 OBJ_Object_Class_10 "Indicates the object type. Uncertain is outputted in case the probability that a vehicle is a truck is very similar to the probability that it is a car. ";
CM_ SG_ 154 OBJ_Class_Probability_10 "The probability of this type classification.";
CM_ SG_ 154 OBJ_Car_Probability_10 "The probability the object is a car";
CM_ SG_ 154 OBJ_Truck_Probability_10 "The probability the object is a Truck";
CM_ SG_ 154 OBJ_Bike_Probability_10 "The probability the object is a Bike";
CM_ SG_ 154 OBJ_Camera_Source_10 "The camera in which this object was detected (best choice).";
CM_ SG_ 154 OBJ_Motion_Status_10 "MOVING - the object is moving STATIONARY - the object was never seen moving STOPPED -  the object was moving and has stopped MOVING_SLOWLY - the object is moving very slowly";
CM_ SG_ 154 OBJ_Motion_Orientation_10 "The direction of the targets heading compared to the host. ";
CM_ SG_ 154 OBJ_Has_Cut_Lane_10 "Indicates whether the object cut the host's (right or left) lane. In case there are no lanes, indicates whether the objects is at most 1 meters away from the host.";
CM_ SG_ 154 OBJ_Has_Cut_Path_10 "Indicates whether the object is in the host's path.";
CM_ SG_ 154 OBJ_Brake_Light_10 "Indication for brake lights ";
CM_ SG_ 154 OBJ_Turn_Indicator_Right_10 "Indication for blinking right light.";
CM_ SG_ 154 OBJ_Turn_Indicator_Left_10 "Indication for blinking left light ";
CM_ SG_ 154 OBJ_Light_Indicator_Validity_10 "Validator for light indicators";
CM_ SG_ 154 OBJ_Right_Out_Of_Image_10 "Indicates whether the measurment are predicted out of the right side of the image bounderies.";
CM_ SG_ 154 OBJ_Left_Out_Of_Image_10 "Indicates whether if measurment are predicted out of  the left side of the image bounderies";
CM_ SG_ 154 OBJ_Right_Out_Of_Image_V_10 "validator";
CM_ SG_ 154 OBJ_Left_Out_Of_Image_V_10 "validator";
CM_ SG_ 154 OBJ_Top_Out_Of_Image_10 "Indicates whether if measurment are predicted out of  the top of the image bounderies";
CM_ SG_ 154 OBJ_Bottom_Out_Of_Image_10 "Indicates whether if measurment are predicted out of  the bottom of the image bounderies";
CM_ SG_ 154 OBJ_Top_Out_Of_Image_V_10 "validator";
CM_ SG_ 154 OBJ_Bottom_Out_Of_Image_V_10 "validator";
CM_ SG_ 154 OBJ_Lane_Assignment_10 "The object's lane relative to the host lane.";
CM_ SG_ 154 OBJ_Lane_Assignment_V_10 "Validator for lane assignment";
CM_ SG_ 154 OBJ_Age_Seconds_10 "Time in seconds in which the object was recognized. ";
CM_ SG_ 154 OBJ_Age_Seconds_V_10 "Validator for object age";
CM_ SG_ 154 OBJ_Width_10 "The width of the target vehicle in the world (not to be mistaken with the width of the visible part of the vehicle).";
CM_ SG_ 154 OBJ_Width_V_10 "Validator for object width";
CM_ SG_ 154 OBJ_Width_STD_10 "Standard deviation for object width";
CM_ SG_ 154 OBJ_Width_STD_V_10 "Validator for the standard deviation of object width";
CM_ SG_ 154 OBJ_Length_10 "The length of the vehicle in the world. For crossing bicycles it gives the viewed length of the bicycle.";
CM_ SG_ 154 OBJ_Length_V_10 "Validator for object length.";
CM_ SG_ 154 OBJ_Length_STD_10 "Standard deviation for object length.";
CM_ SG_ 154 OBJ_Length_STD_V_10 "Validator for the standard deviation of object length.";
CM_ SG_ 154 OBJ_Radar_ID_10 "Radar Object ID of the Fused Object, Only relvant when OBJ_Fusion_Source is not Camera only";
CM_ SG_ 154 OBJ_Height_10 "The height of the object in the world. ";
CM_ SG_ 154 OBJ_Height_V_10 "Validator for object height.";
CM_ SG_ 154 OBJ_Height_STD_10 "Standard deviation for object height.";
CM_ SG_ 154 OBJ_Height_STD_V_10 "Validator for the standard deviation of object height.";
CM_ SG_ 154 OBJ_Abs_Long_Velocity_10 "Absolute longitudinal velocity.";
CM_ SG_ 154 OBJ_Abs_Long_Velocity_V_10 "Validator for absolute longitudinal velocity.";
CM_ SG_ 154 OBJ_Abs_Long_Velocity_STD_10 "Standard deviation of absolute longitudinal velocity.";
CM_ SG_ 154 OBJ_Abs_Long_Vel_STD_V_10 "Validator for the standard deviation of the absolute longitudinal velocity.";
CM_ SG_ 154 OBJ_Abs_Lat_Velocity_10 "The lateral ground speed of the object.";
CM_ SG_ 154 OBJ_Abs_Lat_Velocity_V_10 "Validator for the lateral ground speed of the object.";
CM_ SG_ 154 OBJ_Abs_Lat_Velocity_STD_10 "STD of the lateral ground speed of the object.";
CM_ SG_ 154 OBJ_Abs_Lat_Vel_STD_V_10 "Validator for the STD of the lateral ground speed of the object.";
CM_ SG_ 154 OBJ_Abs_Long_Acc_10 "The longitudinal ground acceleration of the object.";
CM_ SG_ 154 OBJ_Abs_Long_Acc_V_10 "Validator for the longitudinal ground acceleration of the object.";
CM_ SG_ 154 OBJ_Abs_Long_Acc_STD_10 "STD of the longitudinal ground acceleration of the object.";
CM_ SG_ 154 OBJ_Abs_Long_Acc_STD_V_10 "Validator for the STD of the longitudinal ground acceleration of the object.";
CM_ SG_ 154 OBJ_Abs_Lat_Acc_10 "The lateral ground acceleration of the object.";
CM_ SG_ 154 OBJ_Abs_Lat_Acc_V_10 "Validator for the lateral ground acceleration of the object.";
CM_ SG_ 154 OBJ_Abs_Lat_Acc_STD_10 "STD of the lateral ground acceleration of the object.";
CM_ SG_ 154 OBJ_Abs_Lat_Acc_STD_V_10 "Validator for the STD of the lateral ground acceleration of the object.";
CM_ SG_ 154 OBJ_Abs_Acceleration_10 "The absolute ground acceleration in the target's heading direction.";
CM_ SG_ 154 OBJ_Abs_Acceleration_V_10 "Validator for the absolute ground acceleration.";
CM_ SG_ 154 OBJ_Abs_Acc_STD_10 "STD of the absolute ground acceleration.";
CM_ SG_ 154 OBJ_Abs_Acc_STD_V_10 "Validator for the STD of the absolute ground acceleration.";
CM_ SG_ 154 OBJ_Inv_TTC_10 "Inverse TTC (time to collision).";
CM_ SG_ 154 OBJ_Inv_TTC_STD_10 "STD for inverse TTC .";
CM_ SG_ 154 OBJ_Inv_TTC_STD_V_10 "Validator for the STD for inverse TTC .";
CM_ SG_ 154 OBJ_Relative_Long_Acc_10 "The relative lateral ground acceleration of the object.";
CM_ SG_ 154 OBJ_Relative_Long_Acc_V_10 "Validator for the relative lateral ground acceleration of the object.";
CM_ SG_ 154 OBJ_Relative_Long_Acc_STD_10 "STD of the relative lateral ground acceleration of the object.";
CM_ SG_ 154 OBJ_Rel_Long_Acc_STD_V_10 "Validator for the STD of the relative lateral ground acceleration.";
CM_ SG_ 154 OBJ_Relative_Long_Velocity_10 "The relative longtitudinal speed between the target and ego vehicle. ";
CM_ SG_ 154 OBJ_Relative_Long_Velocity_V_10 "Validator for the relative longtitudinal speed.";
CM_ SG_ 154 OBJ_Relative_Long_Vel_STD_10 "STD of the relative longtitudinal speed.";
CM_ SG_ 154 OBJ_Rel_Long_Vel_STD_V_10 "Validator for the STD of the relative longtitudinal speed.";
CM_ SG_ 154 OBJ_Relative_Lat_Velocity_10 "The relative lateral speed between the target and ego vehicle. ";
CM_ SG_ 154 OBJ_Relative_Lat_Velocity_V_10 "Validator for the relative lateral speed. ";
CM_ SG_ 154 OBJ_Relative_Lat_Velocity_STD_10 "STD of the relative lateral speed. ";
CM_ SG_ 154 OBJ_Rel_Lat_Vel_STD_V_10 "Validator for the STD of the relative lateral speed. ";
CM_ SG_ 154 OBJ_Long_Distance_10 "The longitudinal distance to middle of the rear bumper (middle of the RL and RR corners) of the target.";
CM_ SG_ 154 OBJ_Long_Distance_V_10 "Validator of the longtitudinal distance field";
CM_ SG_ 154 OBJ_Long_Distance_STD_10 "STD of the  longtitudinal distance.";
CM_ SG_ 154 OBJ_Long_Distance_STD_V_10 "Validator for the STD of the  longtitudinal distance.";
CM_ SG_ 154 OBJ_Lat_Distance_10 "Lateral distance to the middle of the RL and RR corners.  ";
CM_ SG_ 154 OBJ_Lat_Distance_V_10 "Validator for the lateral distance of the object.";
CM_ SG_ 154 OBJ_Lat_Distance_STD_10 "STD of the lateral distance of the object.";
CM_ SG_ 154 OBJ_Lat_Distance_STD_V_10 "Validator for the STD of the lateral distance of the object.";
CM_ SG_ 154 OBJ_Absolute_Speed_10 "The absolute ground speed in the targets' heading direction.";
CM_ SG_ 154 OBJ_Absolute_Speed_V_10 "Validator for the absolute ground speed.";
CM_ SG_ 154 OBJ_Absolute_Speed_STD_10 "STD of the absolute ground speed.";
CM_ SG_ 154 OBJ_Absolute_Speed_STD_V_10 "Validator for the STD of the absolute ground speed.";
CM_ SG_ 154 OBJ_Heading_10 "The angle beetweenthe host longitudinal axis and target's heading (clockwise, e.g. PI/2 is a target crossing from left to right).";
CM_ SG_ 154 OBJ_Heading_V_10 "Validator for the object heading.";
CM_ SG_ 154 OBJ_Heading_STD_10 "STD of the object heading.";
CM_ SG_ 154 OBJ_Heading_STD_V_10 "Validator for the STD of the object heading.";
CM_ SG_ 154 OBJ_Angle_Rate_STD_10 "Standard deviation of the angular speed. (radians)";
CM_ SG_ 154 OBJ_Angle_Rate_STD_V_10 "Validator for the STD of the angular speed.";
CM_ SG_ 154 OBJ_Angle_Rate_10 "The momentary angular speed of the object. (radians)";
CM_ SG_ 154 OBJ_Angle_Rate_V_10 "Validator for the angular speed.";
CM_ SG_ 154 OBJ_Angle_Right_10 "The angle between the host longitudinal axis and the right side of the front / rear of the target (the visible one). The positive side is to the host's right.";
CM_ SG_ 154 OBJ_Angle_Right_V_10 "Validator for angleRight";
CM_ SG_ 154 OBJ_Angle_Right_STD_10 "Standard deviation of angleRight";
CM_ SG_ 154 OBJ_Angle_Right_STD_V_10 "Validator for the standard deviation of angleRight.";
CM_ SG_ 154 OBJ_Angle_Left_10 "The angle between the host longitudinal axis and the left side of the front / rear of the target (the visible one). The positive side is to the host's right.";
CM_ SG_ 154 OBJ_Angle_Left_V_10 "Validator for angleLeft.";
CM_ SG_ 154 OBJ_Angle_Left_STD_10 "Standard deviation of angleLeft.";
CM_ SG_ 154 OBJ_Angle_Left_STD_V_10 "Validator for the standard deviation of angleLeft.";
CM_ SG_ 154 OBJ_Angle_Side_10 "The angle between the host longitudinal axis and the far visible edge - the visible edge of the front / rear of the target that is not visible. Currently supported for vehicles only.";
CM_ SG_ 154 OBJ_Angle_Side_V_10 "Validator for angleSide.";
CM_ SG_ 154 OBJ_Angle_Side_STD_10 "Standard deviation of angleSide.";
CM_ SG_ 154 OBJ_Angle_Side_STD_V_10 "Validator for the STD of angleSide.";
CM_ SG_ 154 OBJ_Angle_Mid_V_10 "Validator for angleMid.";
CM_ SG_ 154 OBJ_Angle_Mid_10 "The angle between the host longitudinal axis and the middle of the front / rear of the target (the visible one). The positive side is to the host's right.";
CM_ SG_ 154 OBJ_Angle_Mid_STD_10 "Standard deviation of angleMid.";
CM_ SG_ 154 OBJ_Angle_Mid_STD_V_10 "Validator for the STD of angleMid.";
CM_ SG_ 154 OBJ_Angle_Bottom_V_10 "Validator for OBJAngle_Bottom. ";
CM_ SG_ 154 OBJ_Angle_Bottom_10 "The angle between the longitudinal axis and the Bottom of the front / rear of the target (the visible one). The positive side is to the host's bottom";
CM_ SG_ 154 OBJ_Angle_Bottom_STD_10 "STD for OBJAngle_Bottom. ";
CM_ SG_ 154 OBJ_Angle_Bottom_STD_V_10 "Validator for OBJAngle_Bottom_STD. ";
CM_ SG_ 154 OBJ_Visibility_Side_V_10 "Currently Supported for VD only";
CM_ SG_ 154 OBJ_Visibility_Side_10 "From what car  side is the object visible";
CM_ SG_ 154 OBJ_Is_In_Drivable_Area_10 "Indicates whether the target is in a driveable area.";
CM_ SG_ 154 OBJ_Is_In_Drivable_Area_V_10 "Validator for OBJ_Is_In_Drivable_Area.";
CM_ SG_ 154 OBJ_Is_VeryClose_V_10 "Validator for OBJ_Is_VeryClose. ";
CM_ SG_ 154 OBJ_Is_VeryClose_10 "Indicates whether the target is very close to the host such that it is hard to measure its distance. Currently relevant for peds only";
CM_ SG_ 154 OBJ_OverlapAngleEgoLaneR_10 "Lateral distance to the middle of the RL and RR corners.";
CM_ SG_ 154 OBJ_OverlapAngleEgoLaneR_V_10 "Validator for OBJ_OverlapAngleEgoLaneR";
CM_ SG_ 154 OBJ_OverlapAngleEgoLaneL_10 "Lateral distance to the middle of the RL and RR corners.  ";
CM_ SG_ 154 OBJ_OverlapAngleEgoLaneL_V_10 "Validator for OBJ_OverlapAngleEgoLaneL";
CM_ SG_ 154 OBJ_Is_EMERGENCY_VCL_10 "Is Object an Emergency Vehicle";
CM_ SG_ 154 OBJ_EMERGENCY_LIGHT_COLOR_10 "Emergency Color";
CM_ SG_ 154 OBJ_EMERGENCY_V_10 "Are OBJ_Is_EMERGENCY_VCL and OBJ_EMERGENCY_LIGHT_COLOR Valid";
CM_ SG_ 154 OBJ_Angle_Top_10 "From VD touching point on the ground till the roof of the car";
CM_ SG_ 154 OBJ_Angle_Top_V_10 "Validator for OBJ_Angle_Top ";
CM_ SG_ 154 OBJ_Angle_Top_STD_10 "STD for OBJ_Angle_Top";
CM_ SG_ 154 OBJ_Angle_Top_STD_V_10 "Validator for OBJ_Angle_Top_STD. ";
CM_ SG_ 154 OBJ_CRC_11 "Calculated over all element signals. From the signal after the CRC until the first signal in the next elements OBJ_CRC_N+1  not including";
CM_ SG_ 154 OBJ_ID_11 "The detected object ID. Range is 1-255, while 0 indicates that the field in unfilled.";
CM_ SG_ 154 OBJ_Existence_Probability_11 "The existence probability of the reported object";
CM_ SG_ 154 OBJ_Fusion_Source_11 "sources ids used for fusion";
CM_ SG_ 154 OBJ_Triggered_SDM_11 "Indicates whether the object has trigered the SDM (Safety Diagnostic Manager) alert.";
CM_ SG_ 154 OBJ_Motion_Category_11 "Relevant for VD only. Full description of values can be found at the ACC guide.";
CM_ SG_ 154 OBJ_Object_Age_11 "The number of frames in which the object was recognized.";
CM_ SG_ 154 OBJ_Measuring_Status_11 "Measurment status. Old vs New marks if this is the first frame in which the object is reported. Predicted vs Measured marks if the report is raw or has been predicted forward in time using the measured dynamics and ego motion.";
CM_ SG_ 154 OBJ_Object_Class_11 "Indicates the object type. Uncertain is outputted in case the probability that a vehicle is a truck is very similar to the probability that it is a car. ";
CM_ SG_ 154 OBJ_Class_Probability_11 "The probability of this type classification.";
CM_ SG_ 154 OBJ_Car_Probability_11 "The probability the object is a car";
CM_ SG_ 154 OBJ_Truck_Probability_11 "The probability the object is a Truck";
CM_ SG_ 154 OBJ_Bike_Probability_11 "The probability the object is a Bike";
CM_ SG_ 154 OBJ_Camera_Source_11 "The camera in which this object was detected (best choice).";
CM_ SG_ 154 OBJ_Motion_Status_11 "MOVING - the object is moving STATIONARY - the object was never seen moving STOPPED -  the object was moving and has stopped MOVING_SLOWLY - the object is moving very slowly";
CM_ SG_ 154 OBJ_Motion_Orientation_11 "The direction of the targets heading compared to the host. ";
CM_ SG_ 154 OBJ_Has_Cut_Lane_11 "Indicates whether the object cut the host's (right or left) lane. In case there are no lanes, indicates whether the objects is at most 1 meters away from the host.";
CM_ SG_ 154 OBJ_Has_Cut_Path_11 "Indicates whether the object is in the host's path.";
CM_ SG_ 154 OBJ_Brake_Light_11 "Indication for brake lights ";
CM_ SG_ 154 OBJ_Turn_Indicator_Right_11 "Indication for blinking right light.";
CM_ SG_ 154 OBJ_Turn_Indicator_Left_11 "Indication for blinking left light ";
CM_ SG_ 154 OBJ_Light_Indicator_Validity_11 "Validator for light indicators";
CM_ SG_ 154 OBJ_Right_Out_Of_Image_11 "Indicates whether the measurment are predicted out of the right side of the image bounderies.";
CM_ SG_ 154 OBJ_Left_Out_Of_Image_11 "Indicates whether if measurment are predicted out of  the left side of the image bounderies";
CM_ SG_ 154 OBJ_Right_Out_Of_Image_V_11 "validator";
CM_ SG_ 154 OBJ_Left_Out_Of_Image_V_11 "validator";
CM_ SG_ 154 OBJ_Top_Out_Of_Image_11 "Indicates whether if measurment are predicted out of  the top of the image bounderies";
CM_ SG_ 154 OBJ_Bottom_Out_Of_Image_11 "Indicates whether if measurment are predicted out of  the bottom of the image bounderies";
CM_ SG_ 154 OBJ_Top_Out_Of_Image_V_11 "validator";
CM_ SG_ 154 OBJ_Bottom_Out_Of_Image_V_11 "validator";
CM_ SG_ 154 OBJ_Lane_Assignment_11 "The object's lane relative to the host lane.";
CM_ SG_ 154 OBJ_Lane_Assignment_V_11 "Validator for lane assignment";
CM_ SG_ 154 OBJ_Age_Seconds_11 "Time in seconds in which the object was recognized. ";
CM_ SG_ 154 OBJ_Age_Seconds_V_11 "Validator for object age";
CM_ SG_ 154 OBJ_Width_11 "The width of the target vehicle in the world (not to be mistaken with the width of the visible part of the vehicle).";
CM_ SG_ 154 OBJ_Width_V_11 "Validator for object width";
CM_ SG_ 154 OBJ_Width_STD_11 "Standard deviation for object width";
CM_ SG_ 154 OBJ_Width_STD_V_11 "Validator for the standard deviation of object width";
CM_ SG_ 154 OBJ_Length_11 "The length of the vehicle in the world. For crossing bicycles it gives the viewed length of the bicycle.";
CM_ SG_ 154 OBJ_Length_V_11 "Validator for object length.";
CM_ SG_ 154 OBJ_Length_STD_11 "Standard deviation for object length.";
CM_ SG_ 154 OBJ_Length_STD_V_11 "Validator for the standard deviation of object length.";
CM_ SG_ 154 OBJ_Radar_ID_11 "Radar Object ID of the Fused Object, Only relvant when OBJ_Fusion_Source is not Camera only";
CM_ SG_ 154 OBJ_Height_11 "The height of the object in the world. ";
CM_ SG_ 154 OBJ_Height_V_11 "Validator for object height.";
CM_ SG_ 154 OBJ_Height_STD_11 "Standard deviation for object height.";
CM_ SG_ 154 OBJ_Height_STD_V_11 "Validator for the standard deviation of object height.";
CM_ SG_ 154 OBJ_Abs_Long_Velocity_11 "Absolute longitudinal velocity.";
CM_ SG_ 154 OBJ_Abs_Long_Velocity_V_11 "Validator for absolute longitudinal velocity.";
CM_ SG_ 154 OBJ_Abs_Long_Velocity_STD_11 "Standard deviation of absolute longitudinal velocity.";
CM_ SG_ 154 OBJ_Abs_Long_Vel_STD_V_11 "Validator for the standard deviation of the absolute longitudinal velocity.";
CM_ SG_ 154 OBJ_Abs_Lat_Velocity_11 "The lateral ground speed of the object.";
CM_ SG_ 154 OBJ_Abs_Lat_Velocity_V_11 "Validator for the lateral ground speed of the object.";
CM_ SG_ 154 OBJ_Abs_Lat_Velocity_STD_11 "STD of the lateral ground speed of the object.";
CM_ SG_ 154 OBJ_Abs_Lat_Vel_STD_V_11 "Validator for the STD of the lateral ground speed of the object.";
CM_ SG_ 154 OBJ_Abs_Long_Acc_11 "The longitudinal ground acceleration of the object.";
CM_ SG_ 154 OBJ_Abs_Long_Acc_V_11 "Validator for the longitudinal ground acceleration of the object.";
CM_ SG_ 154 OBJ_Abs_Long_Acc_STD_11 "STD of the longitudinal ground acceleration of the object.";
CM_ SG_ 154 OBJ_Abs_Long_Acc_STD_V_11 "Validator for the STD of the longitudinal ground acceleration of the object.";
CM_ SG_ 154 OBJ_Abs_Lat_Acc_11 "The lateral ground acceleration of the object.";
CM_ SG_ 154 OBJ_Abs_Lat_Acc_V_11 "Validator for the lateral ground acceleration of the object.";
CM_ SG_ 154 OBJ_Abs_Lat_Acc_STD_11 "STD of the lateral ground acceleration of the object.";
CM_ SG_ 154 OBJ_Abs_Lat_Acc_STD_V_11 "Validator for the STD of the lateral ground acceleration of the object.";
CM_ SG_ 154 OBJ_Abs_Acceleration_11 "The absolute ground acceleration in the target's heading direction.";
CM_ SG_ 154 OBJ_Abs_Acceleration_V_11 "Validator for the absolute ground acceleration.";
CM_ SG_ 154 OBJ_Abs_Acc_STD_11 "STD of the absolute ground acceleration.";
CM_ SG_ 154 OBJ_Abs_Acc_STD_V_11 "Validator for the STD of the absolute ground acceleration.";
CM_ SG_ 154 OBJ_Inv_TTC_11 "Inverse TTC (time to collision).";
CM_ SG_ 154 OBJ_Inv_TTC_STD_11 "STD for inverse TTC .";
CM_ SG_ 154 OBJ_Inv_TTC_STD_V_11 "Validator for the STD for inverse TTC .";
CM_ SG_ 154 OBJ_Relative_Long_Acc_11 "The relative lateral ground acceleration of the object.";
CM_ SG_ 154 OBJ_Relative_Long_Acc_V_11 "Validator for the relative lateral ground acceleration of the object.";
CM_ SG_ 154 OBJ_Relative_Long_Acc_STD_11 "STD of the relative lateral ground acceleration of the object.";
CM_ SG_ 154 OBJ_Rel_Long_Acc_STD_V_11 "Validator for the STD of the relative lateral ground acceleration.";
CM_ SG_ 154 OBJ_Relative_Long_Velocity_11 "The relative longtitudinal speed between the target and ego vehicle. ";
CM_ SG_ 154 OBJ_Relative_Long_Velocity_V_11 "Validator for the relative longtitudinal speed.";
CM_ SG_ 154 OBJ_Relative_Long_Vel_STD_11 "STD of the relative longtitudinal speed.";
CM_ SG_ 154 OBJ_Rel_Long_Vel_STD_V_11 "Validator for the STD of the relative longtitudinal speed.";
CM_ SG_ 154 OBJ_Relative_Lat_Velocity_11 "The relative lateral speed between the target and ego vehicle. ";
CM_ SG_ 154 OBJ_Relative_Lat_Velocity_V_11 "Validator for the relative lateral speed. ";
CM_ SG_ 154 OBJ_Relative_Lat_Velocity_STD_11 "STD of the relative lateral speed. ";
CM_ SG_ 154 OBJ_Rel_Lat_Vel_STD_V_11 "Validator for the STD of the relative lateral speed. ";
CM_ SG_ 154 OBJ_Long_Distance_11 "The longitudinal distance to middle of the rear bumper (middle of the RL and RR corners) of the target.";
CM_ SG_ 154 OBJ_Long_Distance_V_11 "Validator of the longtitudinal distance field";
CM_ SG_ 154 OBJ_Long_Distance_STD_11 "STD of the  longtitudinal distance.";
CM_ SG_ 154 OBJ_Long_Distance_STD_V_11 "Validator for the STD of the  longtitudinal distance.";
BA_DEF_ SG_  "GenSigStartValue" INT 0 0;
BA_DEF_DEF_  "GenSigStartValue" 0;
BA_ "GenSigStartValue" SG_ 154 OBJ_Width_6 40;
BA_ "GenSigStartValue" SG_ 154 OBJ_Length_6 24;
BA_ "GenSigStartValue" SG_ 154 OBJ_Width_7 40;
BA_ "GenSigStartValue" SG_ 154 OBJ_Length_7 24;
BA_ "GenSigStartValue" SG_ 154 OBJ_Width_8 40;
BA_ "GenSigStartValue" SG_ 154 OBJ_Length_8 24;
BA_ "GenSigStartValue" SG_ 154 OBJ_Width_9 40;
BA_ "GenSigStartValue" SG_ 154 OBJ_Length_9 24;
BA_ "GenSigStartValue" SG_ 154 OBJ_Width_10 40;
BA_ "GenSigStartValue" SG_ 154 OBJ_Length_10 24;
BA_ "GenSigStartValue" SG_ 154 OBJ_Width_11 40;
BA_ "GenSigStartValue" SG_ 154 OBJ_Length_11 24;
VAL_ 154 OBJ_Angle_Left_STD_V_5 1 "VALID" 0 "INVALID" ;
VAL_ 154 OBJ_Angle_Side_V_5 1 "VALID" 0 "INVALID" ;
VAL_ 154 OBJ_Angle_Side_STD_V_5 1 "VALID" 0 "INVALID" ;
VAL_ 154 OBJ_Angle_Mid_V_5 1 "VALID" 0 "INVALID" ;
VAL_ 154 OBJ_Angle_Mid_STD_V_5 1 "VALID" 0 "INVALID" ;
VAL_ 154 OBJ_Angle_Bottom_V_5 1 "VALID" 0 "INVALID" ;
VAL_ 154 OBJ_Angle_Bottom_STD_V_5 1 "VALID" 0 "INVALID" ;
VAL_ 154 OBJ_Visibility_Side_V_5 1 "VALID" 0 "INVALID" ;
VAL_ 154 OBJ_Visibility_Side_5 2 "REAR" 1 "FRONT" 0 "NOT_VISIBLE" ;
VAL_ 154 OBJ_Is_In_Drivable_Area_5 1 "TRUE" 0 "FALSE" ;
VAL_ 154 OBJ_Is_In_Drivable_Area_V_5 1 "VALID" 0 "INVALID" ;
VAL_ 154 OBJ_Is_VeryClose_V_5 1 "VALID" 0 "INVALID" ;
VAL_ 154 OBJ_Is_VeryClose_5 1 "TRUE" 0 "FALSE" ;
VAL_ 154 OBJ_OverlapAngleEgoLaneR_V_5 1 "VALID" 0 "INVALID" ;
VAL_ 154 OBJ_OverlapAngleEgoLaneL_V_5 1 "VALID" 0 "INVALID" ;
VAL_ 154 OBJ_Is_EMERGENCY_VCL_5 1 "TRUE" 0 "FALSE" ;
VAL_ 154 OBJ_EMERGENCY_LIGHT_COLOR_5 3 "(1000)ORANGE" 2 "(0100)BLUE" 1 "(0010)RED" 0 "(0001)OTHER" ;
VAL_ 154 OBJ_EMERGENCY_V_5 1 "TRUE" 0 "FALSE" ;
VAL_ 154 OBJ_Angle_Top_V_5 1 "VALID" 0 "INVALID" ;
VAL_ 154 OBJ_Angle_Top_STD_V_5 1 "VALID" 0 "INVALID" ;
VAL_ 154 OBJ_Fusion_Source_6 2 "(BIT_2)RADAR2" 1 "(BIT_1)RADAR1" 0 "(BIT_0)CAMERA" ;
VAL_ 154 OBJ_Triggered_SDM_6 2 "NOT_TRIGGERED" 1 "TRIGGERED" 0 "NOT_AVAILABLE" ;
VAL_ 154 OBJ_Motion_Category_6 13 "ONCOMING" 12 "PRECEEDING" 11 "MOVING" 10 "RTAP" 9 "LTAP" 8 "CROSSING" 7 "MOVING_OUT" 6 "MOVING_IN" 5 "CLOSE_CUT_IN" 4 "PASSING_OUT" 3 "PASSING_IN" 2 "PASSING" 1 "UNDEFINED" 0 "UNFILLED" ;
VAL_ 154 OBJ_Measuring_Status_6 2 "(BIT_2)NOT_VALID_OR_VALID" 1 "(BIT_1)PREDICTED_OR_MEASURED" 0 "(BIT_0)OLD_OR_NEW" ;
VAL_ 154 OBJ_Object_Class_6 8 "UNCERTAIN_VCL" 7 "ANIMAL" 6 "GENERAL_OBJECT" 5 "PEDESTRIAN" 4 "BICYCLE" 3 "MOTORBIKE" 2 "TRUCK" 1 "CAR" 0 "UNFILLED" ;
VAL_ 154 OBJ_Camera_Source_6 11 "PARKING_RIGHT" 10 "PARKING_LEFT" 9 "PARKING_REAR" 8 "PARKING_FRONT" 7 "FRONT_CORNER_RIGHT" 6 "FRONT_CORNER_LEFT" 5 "REAR_CORNER_RIGHT" 4 "REAR_CORNER_LEFT" 3 "REAR" 2 "FRONT_FISHEYE" 1 "FRONT_NARROW" 0 "FRONT_MAIN" ;
VAL_ 154 OBJ_Motion_Status_6 5 "MOVING_SLOWLY" 4 "STOPPED" 3 "STATIONARY" 2 "MOVING" 1 "UNKNOWN" 0 "INVALID" ;
VAL_ 154 OBJ_Motion_Orientation_6 13 "INVALID" 12 "NORTH" 11 "NORTH_WEST" 9 "WEST" 7 "SOUTH_WEST" 6 "SOUTH" 5 "SOUTH_EAST" 3 "EAST" 1 "NORTH_EAST" 0 "UNKNOWN" ;
VAL_ 154 OBJ_Has_Cut_Lane_6 1 "TRUE" 0 "FALSE" ;
VAL_ 154 OBJ_Has_Cut_Path_6 1 "TRUE" 0 "FALSE" ;
VAL_ 154 OBJ_Brake_Light_6 1 "TRUE" 0 "FALSE" ;
VAL_ 154 OBJ_Turn_Indicator_Right_6 1 "TRUE" 0 "FALSE" ;
VAL_ 154 OBJ_Turn_Indicator_Left_6 1 "TRUE" 0 "FALSE" ;
VAL_ 154 OBJ_Light_Indicator_Validity_6 1 "TRUE" 0 "FALSE" ;
VAL_ 154 OBJ_Right_Out_Of_Image_6 1 "TRUE" 0 "FALSE" ;
VAL_ 154 OBJ_Left_Out_Of_Image_6 1 "TRUE" 0 "FALSE" ;
VAL_ 154 OBJ_Right_Out_Of_Image_V_6 1 "TRUE" 0 "FALSE" ;
VAL_ 154 OBJ_Left_Out_Of_Image_V_6 1 "TRUE" 0 "FALSE" ;
VAL_ 154 OBJ_Top_Out_Of_Image_6 1 "TRUE" 0 "FALSE" ;
VAL_ 154 OBJ_Bottom_Out_Of_Image_6 1 "TRUE" 0 "FALSE" ;
VAL_ 154 OBJ_Top_Out_Of_Image_V_6 1 "VALID" 0 "INVALID" ;
VAL_ 154 OBJ_Bottom_Out_Of_Image_V_6 1 "VALID" 0 "INVALID" ;
VAL_ 154 OBJ_Lane_Assignment_6 5 "RIGHT_RIGHT" 4 "RIGHT" 3 "HOST" 2 "LEFT" 1 "LEFT_LEFT" 0 "UNKNOWN" ;
VAL_ 154 OBJ_Lane_Assignment_V_6 1 "VALID" 0 "INVALID" ;
VAL_ 154 OBJ_Age_Seconds_V_6 1 "VALID" 0 "INVALID" ;
VAL_ 154 OBJ_Width_V_6 1 "VALID" 0 "INVALID" ;
VAL_ 154 OBJ_Width_STD_V_6 1 "VALID" 0 "INVALID" ;
VAL_ 154 OBJ_Length_V_6 1 "VALID" 0 "INVALID" ;
VAL_ 154 OBJ_Length_STD_V_6 1 "VALID" 0 "INVALID" ;
VAL_ 154 OBJ_Height_V_6 1 "VALID" 0 "INVALID" ;
VAL_ 154 OBJ_Height_STD_V_6 1 "VALID" 0 "INVALID" ;
VAL_ 154 OBJ_Abs_Long_Velocity_V_6 1 "VALID" 0 "INVALID" ;
VAL_ 154 OBJ_Abs_Long_Vel_STD_V_6 1 "VALID" 0 "INVALID" ;
VAL_ 154 OBJ_Abs_Lat_Velocity_V_6 1 "VALID" 0 "INVALID" ;
VAL_ 154 OBJ_Abs_Lat_Vel_STD_V_6 1 "VALID" 0 "INVALID" ;
VAL_ 154 OBJ_Abs_Long_Acc_V_6 1 "VALID" 0 "INVALID" ;
VAL_ 154 OBJ_Abs_Long_Acc_STD_V_6 1 "VALID" 0 "INVALID" ;
VAL_ 154 OBJ_Abs_Lat_Acc_V_6 1 "VALID" 0 "INVALID" ;
VAL_ 154 OBJ_Abs_Lat_Acc_STD_V_6 1 "VALID" 0 "INVALID" ;
VAL_ 154 OBJ_Abs_Acceleration_V_6 1 "VALID" 0 "INVALID" ;
VAL_ 154 OBJ_Abs_Acc_STD_V_6 1 "VALID" 0 "INVALID" ;
VAL_ 154 OBJ_Inv_TTC_V_6 1 "VALID" 0 "INVALID" ;
VAL_ 154 OBJ_Inv_TTC_STD_V_6 1 "VALID" 0 "INVALID" ;
VAL_ 154 OBJ_Relative_Long_Acc_V_6 1 "VALID" 0 "INVALID" ;
VAL_ 154 OBJ_Rel_Long_Acc_STD_V_6 1 "VALID" 0 "INVALID" ;
VAL_ 154 OBJ_Relative_Long_Velocity_V_6 1 "VALID" 0 "INVALID" ;
VAL_ 154 OBJ_Rel_Long_Vel_STD_V_6 1 "VALID" 0 "INVALID" ;
VAL_ 154 OBJ_Relative_Lat_Velocity_V_6 1 "VALID" 0 "INVALID" ;
VAL_ 154 OBJ_Rel_Lat_Vel_STD_V_6 1 "VALID" 0 "INVALID" ;
VAL_ 154 OBJ_Long_Distance_V_6 1 "VALID" 0 "INVALID" ;
VAL_ 154 OBJ_Long_Distance_STD_V_6 1 "VALID" 0 "INVALID" ;
VAL_ 154 OBJ_Lat_Distance_V_6 1 "VALID" 0 "INVALID" ;
VAL_ 154 OBJ_Lat_Distance_STD_V_6 1 "VALID" 0 "INVALID" ;
VAL_ 154 OBJ_Absolute_Speed_V_6 1 "VALID" 0 "INVALID" ;
VAL_ 154 OBJ_Absolute_Speed_STD_V_6 1 "VALID" 0 "INVALID" ;
VAL_ 154 OBJ_Heading_V_6 1 "VALID" 0 "INVALID" ;
VAL_ 154 OBJ_Heading_STD_V_6 1 "VALID" 0 "INVALID" ;
VAL_ 154 OBJ_Angle_Rate_STD_V_6 1 "VALID" 0 "INVALID" ;
VAL_ 154 OBJ_Angle_Rate_V_6 1 "VALID" 0 "INVALID" ;
VAL_ 154 OBJ_Angle_Right_V_6 1 "VALID" 0 "INVALID" ;
VAL_ 154 OBJ_Angle_Right_STD_V_6 1 "VALID" 0 "INVALID" ;
VAL_ 154 OBJ_Angle_Left_V_6 1 "VALID" 0 "INVALID" ;
VAL_ 154 OBJ_Angle_Left_STD_V_6 1 "VALID" 0 "INVALID" ;
VAL_ 154 OBJ_Angle_Side_V_6 1 "VALID" 0 "INVALID" ;
VAL_ 154 OBJ_Angle_Side_STD_V_6 1 "VALID" 0 "INVALID" ;
VAL_ 154 OBJ_Angle_Mid_V_6 1 "VALID" 0 "INVALID" ;
VAL_ 154 OBJ_Angle_Mid_STD_V_6 1 "VALID" 0 "INVALID" ;
VAL_ 154 OBJ_Angle_Bottom_V_6 1 "VALID" 0 "INVALID" ;
VAL_ 154 OBJ_Angle_Bottom_STD_V_6 1 "VALID" 0 "INVALID" ;
VAL_ 154 OBJ_Visibility_Side_V_6 1 "VALID" 0 "INVALID" ;
VAL_ 154 OBJ_Visibility_Side_6 2 "REAR" 1 "FRONT" 0 "NOT_VISIBLE" ;
VAL_ 154 OBJ_Is_In_Drivable_Area_6 1 "TRUE" 0 "FALSE" ;
VAL_ 154 OBJ_Is_In_Drivable_Area_V_6 1 "VALID" 0 "INVALID" ;
VAL_ 154 OBJ_Is_VeryClose_V_6 1 "VALID" 0 "INVALID" ;
VAL_ 154 OBJ_Is_VeryClose_6 1 "TRUE" 0 "FALSE" ;
VAL_ 154 OBJ_OverlapAngleEgoLaneR_V_6 1 "VALID" 0 "INVALID" ;
VAL_ 154 OBJ_OverlapAngleEgoLaneL_V_6 1 "VALID" 0 "INVALID" ;
VAL_ 154 OBJ_Is_EMERGENCY_VCL_6 1 "TRUE" 0 "FALSE" ;
VAL_ 154 OBJ_EMERGENCY_LIGHT_COLOR_6 3 "(1000)ORANGE" 2 "(0100)BLUE" 1 "(0010)RED" 0 "(0001)OTHER" ;
VAL_ 154 OBJ_EMERGENCY_V_6 1 "TRUE" 0 "FALSE" ;
VAL_ 154 OBJ_Angle_Top_V_6 1 "VALID" 0 "INVALID" ;
VAL_ 154 OBJ_Angle_Top_STD_V_6 1 "VALID" 0 "INVALID" ;
VAL_ 154 OBJ_Fusion_Source_7 2 "(BIT_2)RADAR2" 1 "(BIT_1)RADAR1" 0 "(BIT_0)CAMERA" ;
VAL_ 154 OBJ_Triggered_SDM_7 2 "NOT_TRIGGERED" 1 "TRIGGERED" 0 "NOT_AVAILABLE" ;
VAL_ 154 OBJ_Motion_Category_7 13 "ONCOMING" 12 "PRECEEDING" 11 "MOVING" 10 "RTAP" 9 "LTAP" 8 "CROSSING" 7 "MOVING_OUT" 6 "MOVING_IN" 5 "CLOSE_CUT_IN" 4 "PASSING_OUT" 3 "PASSING_IN" 2 "PASSING" 1 "UNDEFINED" 0 "UNFILLED" ;
VAL_ 154 OBJ_Measuring_Status_7 2 "(BIT_2)NOT_VALID_OR_VALID" 1 "(BIT_1)PREDICTED_OR_MEASURED" 0 "(BIT_0)OLD_OR_NEW" ;
VAL_ 154 OBJ_Object_Class_7 8 "UNCERTAIN_VCL" 7 "ANIMAL" 6 "GENERAL_OBJECT" 5 "PEDESTRIAN" 4 "BICYCLE" 3 "MOTORBIKE" 2 "TRUCK" 1 "CAR" 0 "UNFILLED" ;
VAL_ 154 OBJ_Camera_Source_7 11 "PARKING_RIGHT" 10 "PARKING_LEFT" 9 "PARKING_REAR" 8 "PARKING_FRONT" 7 "FRONT_CORNER_RIGHT" 6 "FRONT_CORNER_LEFT" 5 "REAR_CORNER_RIGHT" 4 "REAR_CORNER_LEFT" 3 "REAR" 2 "FRONT_FISHEYE" 1 "FRONT_NARROW" 0 "FRONT_MAIN" ;
VAL_ 154 OBJ_Motion_Status_7 5 "MOVING_SLOWLY" 4 "STOPPED" 3 "STATIONARY" 2 "MOVING" 1 "UNKNOWN" 0 "INVALID" ;
VAL_ 154 OBJ_Motion_Orientation_7 13 "INVALID" 12 "NORTH" 11 "NORTH_WEST" 9 "WEST" 7 "SOUTH_WEST" 6 "SOUTH" 5 "SOUTH_EAST" 3 "EAST" 1 "NORTH_EAST" 0 "UNKNOWN" ;
VAL_ 154 OBJ_Has_Cut_Lane_7 1 "TRUE" 0 "FALSE" ;
VAL_ 154 OBJ_Has_Cut_Path_7 1 "TRUE" 0 "FALSE" ;
VAL_ 154 OBJ_Brake_Light_7 1 "TRUE" 0 "FALSE" ;
VAL_ 154 OBJ_Turn_Indicator_Right_7 1 "TRUE" 0 "FALSE" ;
VAL_ 154 OBJ_Turn_Indicator_Left_7 1 "TRUE" 0 "FALSE" ;
VAL_ 154 OBJ_Light_Indicator_Validity_7 1 "TRUE" 0 "FALSE" ;
VAL_ 154 OBJ_Right_Out_Of_Image_7 1 "TRUE" 0 "FALSE" ;
VAL_ 154 OBJ_Left_Out_Of_Image_7 1 "TRUE" 0 "FALSE" ;
VAL_ 154 OBJ_Right_Out_Of_Image_V_7 1 "TRUE" 0 "FALSE" ;
VAL_ 154 OBJ_Left_Out_Of_Image_V_7 1 "TRUE" 0 "FALSE" ;
VAL_ 154 OBJ_Top_Out_Of_Image_7 1 "TRUE" 0 "FALSE" ;
VAL_ 154 OBJ_Bottom_Out_Of_Image_7 1 "TRUE" 0 "FALSE" ;
VAL_ 154 OBJ_Top_Out_Of_Image_V_7 1 "VALID" 0 "INVALID" ;
VAL_ 154 OBJ_Bottom_Out_Of_Image_V_7 1 "VALID" 0 "INVALID" ;
VAL_ 154 OBJ_Lane_Assignment_7 5 "RIGHT_RIGHT" 4 "RIGHT" 3 "HOST" 2 "LEFT" 1 "LEFT_LEFT" 0 "UNKNOWN" ;
VAL_ 154 OBJ_Lane_Assignment_V_7 1 "VALID" 0 "INVALID" ;
VAL_ 154 OBJ_Age_Seconds_V_7 1 "VALID" 0 "INVALID" ;
VAL_ 154 OBJ_Width_V_7 1 "VALID" 0 "INVALID" ;
VAL_ 154 OBJ_Width_STD_V_7 1 "VALID" 0 "INVALID" ;
VAL_ 154 OBJ_Length_V_7 1 "VALID" 0 "INVALID" ;
VAL_ 154 OBJ_Length_STD_V_7 1 "VALID" 0 "INVALID" ;
VAL_ 154 OBJ_Height_V_7 1 "VALID" 0 "INVALID" ;
VAL_ 154 OBJ_Height_STD_V_7 1 "VALID" 0 "INVALID" ;
VAL_ 154 OBJ_Abs_Long_Velocity_V_7 1 "VALID" 0 "INVALID" ;
VAL_ 154 OBJ_Abs_Long_Vel_STD_V_7 1 "VALID" 0 "INVALID" ;
VAL_ 154 OBJ_Abs_Lat_Velocity_V_7 1 "VALID" 0 "INVALID" ;
VAL_ 154 OBJ_Abs_Lat_Vel_STD_V_7 1 "VALID" 0 "INVALID" ;
VAL_ 154 OBJ_Abs_Long_Acc_V_7 1 "VALID" 0 "INVALID" ;
VAL_ 154 OBJ_Abs_Long_Acc_STD_V_7 1 "VALID" 0 "INVALID" ;
VAL_ 154 OBJ_Abs_Lat_Acc_V_7 1 "VALID" 0 "INVALID" ;
VAL_ 154 OBJ_Abs_Lat_Acc_STD_V_7 1 "VALID" 0 "INVALID" ;
VAL_ 154 OBJ_Abs_Acceleration_V_7 1 "VALID" 0 "INVALID" ;
VAL_ 154 OBJ_Abs_Acc_STD_V_7 1 "VALID" 0 "INVALID" ;
VAL_ 154 OBJ_Inv_TTC_V_7 1 "VALID" 0 "INVALID" ;
VAL_ 154 OBJ_Inv_TTC_STD_V_7 1 "VALID" 0 "INVALID" ;
VAL_ 154 OBJ_Relative_Long_Acc_V_7 1 "VALID" 0 "INVALID" ;
VAL_ 154 OBJ_Rel_Long_Acc_STD_V_7 1 "VALID" 0 "INVALID" ;
VAL_ 154 OBJ_Relative_Long_Velocity_V_7 1 "VALID" 0 "INVALID" ;
VAL_ 154 OBJ_Rel_Long_Vel_STD_V_7 1 "VALID" 0 "INVALID" ;
VAL_ 154 OBJ_Relative_Lat_Velocity_V_7 1 "VALID" 0 "INVALID" ;
VAL_ 154 OBJ_Rel_Lat_Vel_STD_V_7 1 "VALID" 0 "INVALID" ;
VAL_ 154 OBJ_Long_Distance_V_7 1 "VALID" 0 "INVALID" ;
VAL_ 154 OBJ_Long_Distance_STD_V_7 1 "VALID" 0 "INVALID" ;
VAL_ 154 OBJ_Lat_Distance_V_7 1 "VALID" 0 "INVALID" ;
VAL_ 154 OBJ_Lat_Distance_STD_V_7 1 "VALID" 0 "INVALID" ;
VAL_ 154 OBJ_Absolute_Speed_V_7 1 "VALID" 0 "INVALID" ;
VAL_ 154 OBJ_Absolute_Speed_STD_V_7 1 "VALID" 0 "INVALID" ;
VAL_ 154 OBJ_Heading_V_7 1 "VALID" 0 "INVALID" ;
VAL_ 154 OBJ_Heading_STD_V_7 1 "VALID" 0 "INVALID" ;
VAL_ 154 OBJ_Angle_Rate_STD_V_7 1 "VALID" 0 "INVALID" ;
VAL_ 154 OBJ_Angle_Rate_V_7 1 "VALID" 0 "INVALID" ;
VAL_ 154 OBJ_Angle_Right_V_7 1 "VALID" 0 "INVALID" ;
VAL_ 154 OBJ_Angle_Right_STD_V_7 1 "VALID" 0 "INVALID" ;
VAL_ 154 OBJ_Angle_Left_V_7 1 "VALID" 0 "INVALID" ;
VAL_ 154 OBJ_Angle_Left_STD_V_7 1 "VALID" 0 "INVALID" ;
VAL_ 154 OBJ_Angle_Side_V_7 1 "VALID" 0 "INVALID" ;
VAL_ 154 OBJ_Angle_Side_STD_V_7 1 "VALID" 0 "INVALID" ;
VAL_ 154 OBJ_Angle_Mid_V_7 1 "VALID" 0 "INVALID" ;
VAL_ 154 OBJ_Angle_Mid_STD_V_7 1 "VALID" 0 "INVALID" ;
VAL_ 154 OBJ_Angle_Bottom_V_7 1 "VALID" 0 "INVALID" ;
VAL_ 154 OBJ_Angle_Bottom_STD_V_7 1 "VALID" 0 "INVALID" ;
VAL_ 154 OBJ_Visibility_Side_V_7 1 "VALID" 0 "INVALID" ;
VAL_ 154 OBJ_Visibility_Side_7 2 "REAR" 1 "FRONT" 0 "NOT_VISIBLE" ;
VAL_ 154 OBJ_Is_In_Drivable_Area_7 1 "TRUE" 0 "FALSE" ;
VAL_ 154 OBJ_Is_In_Drivable_Area_V_7 1 "VALID" 0 "INVALID" ;
VAL_ 154 OBJ_Is_VeryClose_V_7 1 "VALID" 0 "INVALID" ;
VAL_ 154 OBJ_Is_VeryClose_7 1 "TRUE" 0 "FALSE" ;
VAL_ 154 OBJ_OverlapAngleEgoLaneR_V_7 1 "VALID" 0 "INVALID" ;
VAL_ 154 OBJ_OverlapAngleEgoLaneL_V_7 1 "VALID" 0 "INVALID" ;
VAL_ 154 OBJ_Is_EMERGENCY_VCL_7 1 "TRUE" 0 "FALSE" ;
VAL_ 154 OBJ_EMERGENCY_LIGHT_COLOR_7 3 "(1000)ORANGE" 2 "(0100)BLUE" 1 "(0010)RED" 0 "(0001)OTHER" ;
VAL_ 154 OBJ_EMERGENCY_V_7 1 "TRUE" 0 "FALSE" ;
VAL_ 154 OBJ_Angle_Top_V_7 1 "VALID" 0 "INVALID" ;
VAL_ 154 OBJ_Angle_Top_STD_V_7 1 "VALID" 0 "INVALID" ;
VAL_ 154 OBJ_Fusion_Source_8 2 "(BIT_2)RADAR2" 1 "(BIT_1)RADAR1" 0 "(BIT_0)CAMERA" ;
VAL_ 154 OBJ_Triggered_SDM_8 2 "NOT_TRIGGERED" 1 "TRIGGERED" 0 "NOT_AVAILABLE" ;
VAL_ 154 OBJ_Motion_Category_8 13 "ONCOMING" 12 "PRECEEDING" 11 "MOVING" 10 "RTAP" 9 "LTAP" 8 "CROSSING" 7 "MOVING_OUT" 6 "MOVING_IN" 5 "CLOSE_CUT_IN" 4 "PASSING_OUT" 3 "PASSING_IN" 2 "PASSING" 1 "UNDEFINED" 0 "UNFILLED" ;
VAL_ 154 OBJ_Measuring_Status_8 2 "(BIT_2)NOT_VALID_OR_VALID" 1 "(BIT_1)PREDICTED_OR_MEASURED" 0 "(BIT_0)OLD_OR_NEW" ;
VAL_ 154 OBJ_Object_Class_8 8 "UNCERTAIN_VCL" 7 "ANIMAL" 6 "GENERAL_OBJECT" 5 "PEDESTRIAN" 4 "BICYCLE" 3 "MOTORBIKE" 2 "TRUCK" 1 "CAR" 0 "UNFILLED" ;
VAL_ 154 OBJ_Camera_Source_8 11 "PARKING_RIGHT" 10 "PARKING_LEFT" 9 "PARKING_REAR" 8 "PARKING_FRONT" 7 "FRONT_CORNER_RIGHT" 6 "FRONT_CORNER_LEFT" 5 "REAR_CORNER_RIGHT" 4 "REAR_CORNER_LEFT" 3 "REAR" 2 "FRONT_FISHEYE" 1 "FRONT_NARROW" 0 "FRONT_MAIN" ;
VAL_ 154 OBJ_Motion_Status_8 5 "MOVING_SLOWLY" 4 "STOPPED" 3 "STATIONARY" 2 "MOVING" 1 "UNKNOWN" 0 "INVALID" ;
VAL_ 154 OBJ_Motion_Orientation_8 13 "INVALID" 12 "NORTH" 11 "NORTH_WEST" 9 "WEST" 7 "SOUTH_WEST" 6 "SOUTH" 5 "SOUTH_EAST" 3 "EAST" 1 "NORTH_EAST" 0 "UNKNOWN" ;
VAL_ 154 OBJ_Has_Cut_Lane_8 1 "TRUE" 0 "FALSE" ;
VAL_ 154 OBJ_Has_Cut_Path_8 1 "TRUE" 0 "FALSE" ;
VAL_ 154 OBJ_Brake_Light_8 1 "TRUE" 0 "FALSE" ;
VAL_ 154 OBJ_Turn_Indicator_Right_8 1 "TRUE" 0 "FALSE" ;
VAL_ 154 OBJ_Turn_Indicator_Left_8 1 "TRUE" 0 "FALSE" ;
VAL_ 154 OBJ_Light_Indicator_Validity_8 1 "TRUE" 0 "FALSE" ;
VAL_ 154 OBJ_Right_Out_Of_Image_8 1 "TRUE" 0 "FALSE" ;
VAL_ 154 OBJ_Left_Out_Of_Image_8 1 "TRUE" 0 "FALSE" ;
VAL_ 154 OBJ_Right_Out_Of_Image_V_8 1 "TRUE" 0 "FALSE" ;
VAL_ 154 OBJ_Left_Out_Of_Image_V_8 1 "TRUE" 0 "FALSE" ;
VAL_ 154 OBJ_Top_Out_Of_Image_8 1 "TRUE" 0 "FALSE" ;
VAL_ 154 OBJ_Bottom_Out_Of_Image_8 1 "TRUE" 0 "FALSE" ;
VAL_ 154 OBJ_Top_Out_Of_Image_V_8 1 "VALID" 0 "INVALID" ;
VAL_ 154 OBJ_Bottom_Out_Of_Image_V_8 1 "VALID" 0 "INVALID" ;
VAL_ 154 OBJ_Lane_Assignment_8 5 "RIGHT_RIGHT" 4 "RIGHT" 3 "HOST" 2 "LEFT" 1 "LEFT_LEFT" 0 "UNKNOWN" ;
VAL_ 154 OBJ_Lane_Assignment_V_8 1 "VALID" 0 "INVALID" ;
VAL_ 154 OBJ_Age_Seconds_V_8 1 "VALID" 0 "INVALID" ;
VAL_ 154 OBJ_Width_V_8 1 "VALID" 0 "INVALID" ;
VAL_ 154 OBJ_Width_STD_V_8 1 "VALID" 0 "INVALID" ;
VAL_ 154 OBJ_Length_V_8 1 "VALID" 0 "INVALID" ;
VAL_ 154 OBJ_Length_STD_V_8 1 "VALID" 0 "INVALID" ;
VAL_ 154 OBJ_Height_V_8 1 "VALID" 0 "INVALID" ;
VAL_ 154 OBJ_Height_STD_V_8 1 "VALID" 0 "INVALID" ;
VAL_ 154 OBJ_Abs_Long_Velocity_V_8 1 "VALID" 0 "INVALID" ;
VAL_ 154 OBJ_Abs_Long_Vel_STD_V_8 1 "VALID" 0 "INVALID" ;
VAL_ 154 OBJ_Abs_Lat_Velocity_V_8 1 "VALID" 0 "INVALID" ;
VAL_ 154 OBJ_Abs_Lat_Vel_STD_V_8 1 "VALID" 0 "INVALID" ;
VAL_ 154 OBJ_Abs_Long_Acc_V_8 1 "VALID" 0 "INVALID" ;
VAL_ 154 OBJ_Abs_Long_Acc_STD_V_8 1 "VALID" 0 "INVALID" ;
VAL_ 154 OBJ_Abs_Lat_Acc_V_8 1 "VALID" 0 "INVALID" ;
VAL_ 154 OBJ_Abs_Lat_Acc_STD_V_8 1 "VALID" 0 "INVALID" ;
VAL_ 154 OBJ_Abs_Acceleration_V_8 1 "VALID" 0 "INVALID" ;
VAL_ 154 OBJ_Abs_Acc_STD_V_8 1 "VALID" 0 "INVALID" ;
VAL_ 154 OBJ_Inv_TTC_V_8 1 "VALID" 0 "INVALID" ;
VAL_ 154 OBJ_Inv_TTC_STD_V_8 1 "VALID" 0 "INVALID" ;
VAL_ 154 OBJ_Relative_Long_Acc_V_8 1 "VALID" 0 "INVALID" ;
VAL_ 154 OBJ_Rel_Long_Acc_STD_V_8 1 "VALID" 0 "INVALID" ;
VAL_ 154 OBJ_Relative_Long_Velocity_V_8 1 "VALID" 0 "INVALID" ;
VAL_ 154 OBJ_Rel_Long_Vel_STD_V_8 1 "VALID" 0 "INVALID" ;
VAL_ 154 OBJ_Relative_Lat_Velocity_V_8 1 "VALID" 0 "INVALID" ;
VAL_ 154 OBJ_Rel_Lat_Vel_STD_V_8 1 "VALID" 0 "INVALID" ;
VAL_ 154 OBJ_Long_Distance_V_8 1 "VALID" 0 "INVALID" ;
VAL_ 154 OBJ_Long_Distance_STD_V_8 1 "VALID" 0 "INVALID" ;
VAL_ 154 OBJ_Lat_Distance_V_8 1 "VALID" 0 "INVALID" ;
VAL_ 154 OBJ_Lat_Distance_STD_V_8 1 "VALID" 0 "INVALID" ;
VAL_ 154 OBJ_Absolute_Speed_V_8 1 "VALID" 0 "INVALID" ;
VAL_ 154 OBJ_Absolute_Speed_STD_V_8 1 "VALID" 0 "INVALID" ;
VAL_ 154 OBJ_Heading_V_8 1 "VALID" 0 "INVALID" ;
VAL_ 154 OBJ_Heading_STD_V_8 1 "VALID" 0 "INVALID" ;
VAL_ 154 OBJ_Angle_Rate_STD_V_8 1 "VALID" 0 "INVALID" ;
VAL_ 154 OBJ_Angle_Rate_V_8 1 "VALID" 0 "INVALID" ;
VAL_ 154 OBJ_Angle_Right_V_8 1 "VALID" 0 "INVALID" ;
VAL_ 154 OBJ_Angle_Right_STD_V_8 1 "VALID" 0 "INVALID" ;
VAL_ 154 OBJ_Angle_Left_V_8 1 "VALID" 0 "INVALID" ;
VAL_ 154 OBJ_Angle_Left_STD_V_8 1 "VALID" 0 "INVALID" ;
VAL_ 154 OBJ_Angle_Side_V_8 1 "VALID" 0 "INVALID" ;
VAL_ 154 OBJ_Angle_Side_STD_V_8 1 "VALID" 0 "INVALID" ;
VAL_ 154 OBJ_Angle_Mid_V_8 1 "VALID" 0 "INVALID" ;
VAL_ 154 OBJ_Angle_Mid_STD_V_8 1 "VALID" 0 "INVALID" ;
VAL_ 154 OBJ_Angle_Bottom_V_8 1 "VALID" 0 "INVALID" ;
VAL_ 154 OBJ_Angle_Bottom_STD_V_8 1 "VALID" 0 "INVALID" ;
VAL_ 154 OBJ_Visibility_Side_V_8 1 "VALID" 0 "INVALID" ;
VAL_ 154 OBJ_Visibility_Side_8 2 "REAR" 1 "FRONT" 0 "NOT_VISIBLE" ;
VAL_ 154 OBJ_Is_In_Drivable_Area_8 1 "TRUE" 0 "FALSE" ;
VAL_ 154 OBJ_Is_In_Drivable_Area_V_8 1 "VALID" 0 "INVALID" ;
VAL_ 154 OBJ_Is_VeryClose_V_8 1 "VALID" 0 "INVALID" ;
VAL_ 154 OBJ_Is_VeryClose_8 1 "TRUE" 0 "FALSE" ;
VAL_ 154 OBJ_OverlapAngleEgoLaneR_V_8 1 "VALID" 0 "INVALID" ;
VAL_ 154 OBJ_OverlapAngleEgoLaneL_V_8 1 "VALID" 0 "INVALID" ;
VAL_ 154 OBJ_Is_EMERGENCY_VCL_8 1 "TRUE" 0 "FALSE" ;
VAL_ 154 OBJ_EMERGENCY_LIGHT_COLOR_8 3 "(1000)ORANGE" 2 "(0100)BLUE" 1 "(0010)RED" 0 "(0001)OTHER" ;
VAL_ 154 OBJ_EMERGENCY_V_8 1 "TRUE" 0 "FALSE" ;
VAL_ 154 OBJ_Angle_Top_V_8 1 "VALID" 0 "INVALID" ;
VAL_ 154 OBJ_Angle_Top_STD_V_8 1 "VALID" 0 "INVALID" ;
VAL_ 154 OBJ_Fusion_Source_9 2 "(BIT_2)RADAR2" 1 "(BIT_1)RADAR1" 0 "(BIT_0)CAMERA" ;
VAL_ 154 OBJ_Triggered_SDM_9 2 "NOT_TRIGGERED" 1 "TRIGGERED" 0 "NOT_AVAILABLE" ;
VAL_ 154 OBJ_Motion_Category_9 13 "ONCOMING" 12 "PRECEEDING" 11 "MOVING" 10 "RTAP" 9 "LTAP" 8 "CROSSING" 7 "MOVING_OUT" 6 "MOVING_IN" 5 "CLOSE_CUT_IN" 4 "PASSING_OUT" 3 "PASSING_IN" 2 "PASSING" 1 "UNDEFINED" 0 "UNFILLED" ;
VAL_ 154 OBJ_Measuring_Status_9 2 "(BIT_2)NOT_VALID_OR_VALID" 1 "(BIT_1)PREDICTED_OR_MEASURED" 0 "(BIT_0)OLD_OR_NEW" ;
VAL_ 154 OBJ_Object_Class_9 8 "UNCERTAIN_VCL" 7 "ANIMAL" 6 "GENERAL_OBJECT" 5 "PEDESTRIAN" 4 "BICYCLE" 3 "MOTORBIKE" 2 "TRUCK" 1 "CAR" 0 "UNFILLED" ;
VAL_ 154 OBJ_Camera_Source_9 11 "PARKING_RIGHT" 10 "PARKING_LEFT" 9 "PARKING_REAR" 8 "PARKING_FRONT" 7 "FRONT_CORNER_RIGHT" 6 "FRONT_CORNER_LEFT" 5 "REAR_CORNER_RIGHT" 4 "REAR_CORNER_LEFT" 3 "REAR" 2 "FRONT_FISHEYE" 1 "FRONT_NARROW" 0 "FRONT_MAIN" ;
VAL_ 154 OBJ_Motion_Status_9 5 "MOVING_SLOWLY" 4 "STOPPED" 3 "STATIONARY" 2 "MOVING" 1 "UNKNOWN" 0 "INVALID" ;
VAL_ 154 OBJ_Motion_Orientation_9 13 "INVALID" 12 "NORTH" 11 "NORTH_WEST" 9 "WEST" 7 "SOUTH_WEST" 6 "SOUTH" 5 "SOUTH_EAST" 3 "EAST" 1 "NORTH_EAST" 0 "UNKNOWN" ;
VAL_ 154 OBJ_Has_Cut_Lane_9 1 "TRUE" 0 "FALSE" ;
VAL_ 154 OBJ_Has_Cut_Path_9 1 "TRUE" 0 "FALSE" ;
VAL_ 154 OBJ_Brake_Light_9 1 "TRUE" 0 "FALSE" ;
VAL_ 154 OBJ_Turn_Indicator_Right_9 1 "TRUE" 0 "FALSE" ;
VAL_ 154 OBJ_Turn_Indicator_Left_9 1 "TRUE" 0 "FALSE" ;
VAL_ 154 OBJ_Light_Indicator_Validity_9 1 "TRUE" 0 "FALSE" ;
VAL_ 154 OBJ_Right_Out_Of_Image_9 1 "TRUE" 0 "FALSE" ;
VAL_ 154 OBJ_Left_Out_Of_Image_9 1 "TRUE" 0 "FALSE" ;
VAL_ 154 OBJ_Right_Out_Of_Image_V_9 1 "TRUE" 0 "FALSE" ;
VAL_ 154 OBJ_Left_Out_Of_Image_V_9 1 "TRUE" 0 "FALSE" ;
VAL_ 154 OBJ_Top_Out_Of_Image_9 1 "TRUE" 0 "FALSE" ;
VAL_ 154 OBJ_Bottom_Out_Of_Image_9 1 "TRUE" 0 "FALSE" ;
VAL_ 154 OBJ_Top_Out_Of_Image_V_9 1 "VALID" 0 "INVALID" ;
VAL_ 154 OBJ_Bottom_Out_Of_Image_V_9 1 "VALID" 0 "INVALID" ;
VAL_ 154 OBJ_Lane_Assignment_9 5 "RIGHT_RIGHT" 4 "RIGHT" 3 "HOST" 2 "LEFT" 1 "LEFT_LEFT" 0 "UNKNOWN" ;
VAL_ 154 OBJ_Lane_Assignment_V_9 1 "VALID" 0 "INVALID" ;
VAL_ 154 OBJ_Age_Seconds_V_9 1 "VALID" 0 "INVALID" ;
VAL_ 154 OBJ_Width_V_9 1 "VALID" 0 "INVALID" ;
VAL_ 154 OBJ_Width_STD_V_9 1 "VALID" 0 "INVALID" ;
VAL_ 154 OBJ_Length_V_9 1 "VALID" 0 "INVALID" ;
VAL_ 154 OBJ_Length_STD_V_9 1 "VALID" 0 "INVALID" ;
VAL_ 154 OBJ_Height_V_9 1 "VALID" 0 "INVALID" ;
VAL_ 154 OBJ_Height_STD_V_9 1 "VALID" 0 "INVALID" ;
VAL_ 154 OBJ_Abs_Long_Velocity_V_9 1 "VALID" 0 "INVALID" ;
VAL_ 154 OBJ_Abs_Long_Vel_STD_V_9 1 "VALID" 0 "INVALID" ;
VAL_ 154 OBJ_Abs_Lat_Velocity_V_9 1 "VALID" 0 "INVALID" ;
VAL_ 154 OBJ_Abs_Lat_Vel_STD_V_9 1 "VALID" 0 "INVALID" ;
VAL_ 154 OBJ_Abs_Long_Acc_V_9 1 "VALID" 0 "INVALID" ;
VAL_ 154 OBJ_Abs_Long_Acc_STD_V_9 1 "VALID" 0 "INVALID" ;
VAL_ 154 OBJ_Abs_Lat_Acc_V_9 1 "VALID" 0 "INVALID" ;
VAL_ 154 OBJ_Abs_Lat_Acc_STD_V_9 1 "VALID" 0 "INVALID" ;
VAL_ 154 OBJ_Abs_Acceleration_V_9 1 "VALID" 0 "INVALID" ;
VAL_ 154 OBJ_Abs_Acc_STD_V_9 1 "VALID" 0 "INVALID" ;
VAL_ 154 OBJ_Inv_TTC_V_9 1 "VALID" 0 "INVALID" ;
VAL_ 154 OBJ_Inv_TTC_STD_V_9 1 "VALID" 0 "INVALID" ;
VAL_ 154 OBJ_Relative_Long_Acc_V_9 1 "VALID" 0 "INVALID" ;
VAL_ 154 OBJ_Rel_Long_Acc_STD_V_9 1 "VALID" 0 "INVALID" ;
VAL_ 154 OBJ_Relative_Long_Velocity_V_9 1 "VALID" 0 "INVALID" ;
VAL_ 154 OBJ_Rel_Long_Vel_STD_V_9 1 "VALID" 0 "INVALID" ;
VAL_ 154 OBJ_Relative_Lat_Velocity_V_9 1 "VALID" 0 "INVALID" ;
VAL_ 154 OBJ_Rel_Lat_Vel_STD_V_9 1 "VALID" 0 "INVALID" ;
VAL_ 154 OBJ_Long_Distance_V_9 1 "VALID" 0 "INVALID" ;
VAL_ 154 OBJ_Long_Distance_STD_V_9 1 "VALID" 0 "INVALID" ;
VAL_ 154 OBJ_Lat_Distance_V_9 1 "VALID" 0 "INVALID" ;
VAL_ 154 OBJ_Lat_Distance_STD_V_9 1 "VALID" 0 "INVALID" ;
VAL_ 154 OBJ_Absolute_Speed_V_9 1 "VALID" 0 "INVALID" ;
VAL_ 154 OBJ_Absolute_Speed_STD_V_9 1 "VALID" 0 "INVALID" ;
VAL_ 154 OBJ_Heading_V_9 1 "VALID" 0 "INVALID" ;
VAL_ 154 OBJ_Heading_STD_V_9 1 "VALID" 0 "INVALID" ;
VAL_ 154 OBJ_Angle_Rate_STD_V_9 1 "VALID" 0 "INVALID" ;
VAL_ 154 OBJ_Angle_Rate_V_9 1 "VALID" 0 "INVALID" ;
VAL_ 154 OBJ_Angle_Right_V_9 1 "VALID" 0 "INVALID" ;
VAL_ 154 OBJ_Angle_Right_STD_V_9 1 "VALID" 0 "INVALID" ;
VAL_ 154 OBJ_Angle_Left_V_9 1 "VALID" 0 "INVALID" ;
VAL_ 154 OBJ_Angle_Left_STD_V_9 1 "VALID" 0 "INVALID" ;
VAL_ 154 OBJ_Angle_Side_V_9 1 "VALID" 0 "INVALID" ;
VAL_ 154 OBJ_Angle_Side_STD_V_9 1 "VALID" 0 "INVALID" ;
VAL_ 154 OBJ_Angle_Mid_V_9 1 "VALID" 0 "INVALID" ;
VAL_ 154 OBJ_Angle_Mid_STD_V_9 1 "VALID" 0 "INVALID" ;
VAL_ 154 OBJ_Angle_Bottom_V_9 1 "VALID" 0 "INVALID" ;
VAL_ 154 OBJ_Angle_Bottom_STD_V_9 1 "VALID" 0 "INVALID" ;
VAL_ 154 OBJ_Visibility_Side_V_9 1 "VALID" 0 "INVALID" ;
VAL_ 154 OBJ_Visibility_Side_9 2 "REAR" 1 "FRONT" 0 "NOT_VISIBLE" ;
VAL_ 154 OBJ_Is_In_Drivable_Area_9 1 "TRUE" 0 "FALSE" ;
VAL_ 154 OBJ_Is_In_Drivable_Area_V_9 1 "VALID" 0 "INVALID" ;
VAL_ 154 OBJ_Is_VeryClose_V_9 1 "VALID" 0 "INVALID" ;
VAL_ 154 OBJ_Is_VeryClose_9 1 "TRUE" 0 "FALSE" ;
VAL_ 154 OBJ_OverlapAngleEgoLaneR_V_9 1 "VALID" 0 "INVALID" ;
VAL_ 154 OBJ_OverlapAngleEgoLaneL_V_9 1 "VALID" 0 "INVALID" ;
VAL_ 154 OBJ_Is_EMERGENCY_VCL_9 1 "TRUE" 0 "FALSE" ;
VAL_ 154 OBJ_EMERGENCY_LIGHT_COLOR_9 3 "(1000)ORANGE" 2 "(0100)BLUE" 1 "(0010)RED" 0 "(0001)OTHER" ;
VAL_ 154 OBJ_EMERGENCY_V_9 1 "TRUE" 0 "FALSE" ;
VAL_ 154 OBJ_Angle_Top_V_9 1 "VALID" 0 "INVALID" ;
VAL_ 154 OBJ_Angle_Top_STD_V_9 1 "VALID" 0 "INVALID" ;
VAL_ 154 OBJ_Fusion_Source_10 2 "(BIT_2)RADAR2" 1 "(BIT_1)RADAR1" 0 "(BIT_0)CAMERA" ;
VAL_ 154 OBJ_Triggered_SDM_10 2 "NOT_TRIGGERED" 1 "TRIGGERED" 0 "NOT_AVAILABLE" ;
VAL_ 154 OBJ_Motion_Category_10 13 "ONCOMING" 12 "PRECEEDING" 11 "MOVING" 10 "RTAP" 9 "LTAP" 8 "CROSSING" 7 "MOVING_OUT" 6 "MOVING_IN" 5 "CLOSE_CUT_IN" 4 "PASSING_OUT" 3 "PASSING_IN" 2 "PASSING" 1 "UNDEFINED" 0 "UNFILLED" ;
VAL_ 154 OBJ_Measuring_Status_10 2 "(BIT_2)NOT_VALID_OR_VALID" 1 "(BIT_1)PREDICTED_OR_MEASURED" 0 "(BIT_0)OLD_OR_NEW" ;
VAL_ 154 OBJ_Object_Class_10 8 "UNCERTAIN_VCL" 7 "ANIMAL" 6 "GENERAL_OBJECT" 5 "PEDESTRIAN" 4 "BICYCLE" 3 "MOTORBIKE" 2 "TRUCK" 1 "CAR" 0 "UNFILLED" ;
VAL_ 154 OBJ_Camera_Source_10 11 "PARKING_RIGHT" 10 "PARKING_LEFT" 9 "PARKING_REAR" 8 "PARKING_FRONT" 7 "FRONT_CORNER_RIGHT" 6 "FRONT_CORNER_LEFT" 5 "REAR_CORNER_RIGHT" 4 "REAR_CORNER_LEFT" 3 "REAR" 2 "FRONT_FISHEYE" 1 "FRONT_NARROW" 0 "FRONT_MAIN" ;
VAL_ 154 OBJ_Motion_Status_10 5 "MOVING_SLOWLY" 4 "STOPPED" 3 "STATIONARY" 2 "MOVING" 1 "UNKNOWN" 0 "INVALID" ;
VAL_ 154 OBJ_Motion_Orientation_10 13 "INVALID" 12 "NORTH" 11 "NORTH_WEST" 9 "WEST" 7 "SOUTH_WEST" 6 "SOUTH" 5 "SOUTH_EAST" 3 "EAST" 1 "NORTH_EAST" 0 "UNKNOWN" ;
VAL_ 154 OBJ_Has_Cut_Lane_10 1 "TRUE" 0 "FALSE" ;
VAL_ 154 OBJ_Has_Cut_Path_10 1 "TRUE" 0 "FALSE" ;
VAL_ 154 OBJ_Brake_Light_10 1 "TRUE" 0 "FALSE" ;
VAL_ 154 OBJ_Turn_Indicator_Right_10 1 "TRUE" 0 "FALSE" ;
VAL_ 154 OBJ_Turn_Indicator_Left_10 1 "TRUE" 0 "FALSE" ;
VAL_ 154 OBJ_Light_Indicator_Validity_10 1 "TRUE" 0 "FALSE" ;
VAL_ 154 OBJ_Right_Out_Of_Image_10 1 "TRUE" 0 "FALSE" ;
VAL_ 154 OBJ_Left_Out_Of_Image_10 1 "TRUE" 0 "FALSE" ;
VAL_ 154 OBJ_Right_Out_Of_Image_V_10 1 "TRUE" 0 "FALSE" ;
VAL_ 154 OBJ_Left_Out_Of_Image_V_10 1 "TRUE" 0 "FALSE" ;
VAL_ 154 OBJ_Top_Out_Of_Image_10 1 "TRUE" 0 "FALSE" ;
VAL_ 154 OBJ_Bottom_Out_Of_Image_10 1 "TRUE" 0 "FALSE" ;
VAL_ 154 OBJ_Top_Out_Of_Image_V_10 1 "VALID" 0 "INVALID" ;
VAL_ 154 OBJ_Bottom_Out_Of_Image_V_10 1 "VALID" 0 "INVALID" ;
VAL_ 154 OBJ_Lane_Assignment_10 5 "RIGHT_RIGHT" 4 "RIGHT" 3 "HOST" 2 "LEFT" 1 "LEFT_LEFT" 0 "UNKNOWN" ;
VAL_ 154 OBJ_Lane_Assignment_V_10 1 "VALID" 0 "INVALID" ;
VAL_ 154 OBJ_Age_Seconds_V_10 1 "VALID" 0 "INVALID" ;
VAL_ 154 OBJ_Width_V_10 1 "VALID" 0 "INVALID" ;
VAL_ 154 OBJ_Width_STD_V_10 1 "VALID" 0 "INVALID" ;
VAL_ 154 OBJ_Length_V_10 1 "VALID" 0 "INVALID" ;
VAL_ 154 OBJ_Length_STD_V_10 1 "VALID" 0 "INVALID" ;
VAL_ 154 OBJ_Height_V_10 1 "VALID" 0 "INVALID" ;
VAL_ 154 OBJ_Height_STD_V_10 1 "VALID" 0 "INVALID" ;
VAL_ 154 OBJ_Abs_Long_Velocity_V_10 1 "VALID" 0 "INVALID" ;
VAL_ 154 OBJ_Abs_Long_Vel_STD_V_10 1 "VALID" 0 "INVALID" ;
VAL_ 154 OBJ_Abs_Lat_Velocity_V_10 1 "VALID" 0 "INVALID" ;
VAL_ 154 OBJ_Abs_Lat_Vel_STD_V_10 1 "VALID" 0 "INVALID" ;
VAL_ 154 OBJ_Abs_Long_Acc_V_10 1 "VALID" 0 "INVALID" ;
VAL_ 154 OBJ_Abs_Long_Acc_STD_V_10 1 "VALID" 0 "INVALID" ;
VAL_ 154 OBJ_Abs_Lat_Acc_V_10 1 "VALID" 0 "INVALID" ;
VAL_ 154 OBJ_Abs_Lat_Acc_STD_V_10 1 "VALID" 0 "INVALID" ;
VAL_ 154 OBJ_Abs_Acceleration_V_10 1 "VALID" 0 "INVALID" ;
VAL_ 154 OBJ_Abs_Acc_STD_V_10 1 "VALID" 0 "INVALID" ;
VAL_ 154 OBJ_Inv_TTC_V_10 1 "VALID" 0 "INVALID" ;
VAL_ 154 OBJ_Inv_TTC_STD_V_10 1 "VALID" 0 "INVALID" ;
VAL_ 154 OBJ_Relative_Long_Acc_V_10 1 "VALID" 0 "INVALID" ;
VAL_ 154 OBJ_Rel_Long_Acc_STD_V_10 1 "VALID" 0 "INVALID" ;
VAL_ 154 OBJ_Relative_Long_Velocity_V_10 1 "VALID" 0 "INVALID" ;
VAL_ 154 OBJ_Rel_Long_Vel_STD_V_10 1 "VALID" 0 "INVALID" ;
VAL_ 154 OBJ_Relative_Lat_Velocity_V_10 1 "VALID" 0 "INVALID" ;
VAL_ 154 OBJ_Rel_Lat_Vel_STD_V_10 1 "VALID" 0 "INVALID" ;
VAL_ 154 OBJ_Long_Distance_V_10 1 "VALID" 0 "INVALID" ;
VAL_ 154 OBJ_Long_Distance_STD_V_10 1 "VALID" 0 "INVALID" ;
VAL_ 154 OBJ_Lat_Distance_V_10 1 "VALID" 0 "INVALID" ;
VAL_ 154 OBJ_Lat_Distance_STD_V_10 1 "VALID" 0 "INVALID" ;
VAL_ 154 OBJ_Absolute_Speed_V_10 1 "VALID" 0 "INVALID" ;
VAL_ 154 OBJ_Absolute_Speed_STD_V_10 1 "VALID" 0 "INVALID" ;
VAL_ 154 OBJ_Heading_V_10 1 "VALID" 0 "INVALID" ;
VAL_ 154 OBJ_Heading_STD_V_10 1 "VALID" 0 "INVALID" ;
VAL_ 154 OBJ_Angle_Rate_STD_V_10 1 "VALID" 0 "INVALID" ;
VAL_ 154 OBJ_Angle_Rate_V_10 1 "VALID" 0 "INVALID" ;
VAL_ 154 OBJ_Angle_Right_V_10 1 "VALID" 0 "INVALID" ;
VAL_ 154 OBJ_Angle_Right_STD_V_10 1 "VALID" 0 "INVALID" ;
VAL_ 154 OBJ_Angle_Left_V_10 1 "VALID" 0 "INVALID" ;
VAL_ 154 OBJ_Angle_Left_STD_V_10 1 "VALID" 0 "INVALID" ;
VAL_ 154 OBJ_Angle_Side_V_10 1 "VALID" 0 "INVALID" ;
VAL_ 154 OBJ_Angle_Side_STD_V_10 1 "VALID" 0 "INVALID" ;
VAL_ 154 OBJ_Angle_Mid_V_10 1 "VALID" 0 "INVALID" ;
VAL_ 154 OBJ_Angle_Mid_STD_V_10 1 "VALID" 0 "INVALID" ;
VAL_ 154 OBJ_Angle_Bottom_V_10 1 "VALID" 0 "INVALID" ;
VAL_ 154 OBJ_Angle_Bottom_STD_V_10 1 "VALID" 0 "INVALID" ;
VAL_ 154 OBJ_Visibility_Side_V_10 1 "VALID" 0 "INVALID" ;
VAL_ 154 OBJ_Visibility_Side_10 2 "REAR" 1 "FRONT" 0 "NOT_VISIBLE" ;
VAL_ 154 OBJ_Is_In_Drivable_Area_10 1 "TRUE" 0 "FALSE" ;
VAL_ 154 OBJ_Is_In_Drivable_Area_V_10 1 "VALID" 0 "INVALID" ;
VAL_ 154 OBJ_Is_VeryClose_V_10 1 "VALID" 0 "INVALID" ;
VAL_ 154 OBJ_Is_VeryClose_10 1 "TRUE" 0 "FALSE" ;
VAL_ 154 OBJ_OverlapAngleEgoLaneR_V_10 1 "VALID" 0 "INVALID" ;
VAL_ 154 OBJ_OverlapAngleEgoLaneL_V_10 1 "VALID" 0 "INVALID" ;
VAL_ 154 OBJ_Is_EMERGENCY_VCL_10 1 "TRUE" 0 "FALSE" ;
VAL_ 154 OBJ_EMERGENCY_LIGHT_COLOR_10 3 "(1000)ORANGE" 2 "(0100)BLUE" 1 "(0010)RED" 0 "(0001)OTHER" ;
VAL_ 154 OBJ_EMERGENCY_V_10 1 "TRUE" 0 "FALSE" ;
VAL_ 154 OBJ_Angle_Top_V_10 1 "VALID" 0 "INVALID" ;
VAL_ 154 OBJ_Angle_Top_STD_V_10 1 "VALID" 0 "INVALID" ;
VAL_ 154 OBJ_Fusion_Source_11 2 "(BIT_2)RADAR2" 1 "(BIT_1)RADAR1" 0 "(BIT_0)CAMERA" ;
VAL_ 154 OBJ_Triggered_SDM_11 2 "NOT_TRIGGERED" 1 "TRIGGERED" 0 "NOT_AVAILABLE" ;
VAL_ 154 OBJ_Motion_Category_11 13 "ONCOMING" 12 "PRECEEDING" 11 "MOVING" 10 "RTAP" 9 "LTAP" 8 "CROSSING" 7 "MOVING_OUT" 6 "MOVING_IN" 5 "CLOSE_CUT_IN" 4 "PASSING_OUT" 3 "PASSING_IN" 2 "PASSING" 1 "UNDEFINED" 0 "UNFILLED" ;
VAL_ 154 OBJ_Measuring_Status_11 2 "(BIT_2)NOT_VALID_OR_VALID" 1 "(BIT_1)PREDICTED_OR_MEASURED" 0 "(BIT_0)OLD_OR_NEW" ;
VAL_ 154 OBJ_Object_Class_11 8 "UNCERTAIN_VCL" 7 "ANIMAL" 6 "GENERAL_OBJECT" 5 "PEDESTRIAN" 4 "BICYCLE" 3 "MOTORBIKE" 2 "TRUCK" 1 "CAR" 0 "UNFILLED" ;
VAL_ 154 OBJ_Camera_Source_11 11 "PARKING_RIGHT" 10 "PARKING_LEFT" 9 "PARKING_REAR" 8 "PARKING_FRONT" 7 "FRONT_CORNER_RIGHT" 6 "FRONT_CORNER_LEFT" 5 "REAR_CORNER_RIGHT" 4 "REAR_CORNER_LEFT" 3 "REAR" 2 "FRONT_FISHEYE" 1 "FRONT_NARROW" 0 "FRONT_MAIN" ;
VAL_ 154 OBJ_Motion_Status_11 5 "MOVING_SLOWLY" 4 "STOPPED" 3 "STATIONARY" 2 "MOVING" 1 "UNKNOWN" 0 "INVALID" ;
VAL_ 154 OBJ_Motion_Orientation_11 13 "INVALID" 12 "NORTH" 11 "NORTH_WEST" 9 "WEST" 7 "SOUTH_WEST" 6 "SOUTH" 5 "SOUTH_EAST" 3 "EAST" 1 "NORTH_EAST" 0 "UNKNOWN" ;
VAL_ 154 OBJ_Has_Cut_Lane_11 1 "TRUE" 0 "FALSE" ;
VAL_ 154 OBJ_Has_Cut_Path_11 1 "TRUE" 0 "FALSE" ;
VAL_ 154 OBJ_Brake_Light_11 1 "TRUE" 0 "FALSE" ;
VAL_ 154 OBJ_Turn_Indicator_Right_11 1 "TRUE" 0 "FALSE" ;
VAL_ 154 OBJ_Turn_Indicator_Left_11 1 "TRUE" 0 "FALSE" ;
VAL_ 154 OBJ_Light_Indicator_Validity_11 1 "TRUE" 0 "FALSE" ;
VAL_ 154 OBJ_Right_Out_Of_Image_11 1 "TRUE" 0 "FALSE" ;
VAL_ 154 OBJ_Left_Out_Of_Image_11 1 "TRUE" 0 "FALSE" ;
VAL_ 154 OBJ_Right_Out_Of_Image_V_11 1 "TRUE" 0 "FALSE" ;
VAL_ 154 OBJ_Left_Out_Of_Image_V_11 1 "TRUE" 0 "FALSE" ;
VAL_ 154 OBJ_Top_Out_Of_Image_11 1 "TRUE" 0 "FALSE" ;
VAL_ 154 OBJ_Bottom_Out_Of_Image_11 1 "TRUE" 0 "FALSE" ;
VAL_ 154 OBJ_Top_Out_Of_Image_V_11 1 "VALID" 0 "INVALID" ;
VAL_ 154 OBJ_Bottom_Out_Of_Image_V_11 1 "VALID" 0 "INVALID" ;
VAL_ 154 OBJ_Lane_Assignment_11 5 "RIGHT_RIGHT" 4 "RIGHT" 3 "HOST" 2 "LEFT" 1 "LEFT_LEFT" 0 "UNKNOWN" ;
VAL_ 154 OBJ_Lane_Assignment_V_11 1 "VALID" 0 "INVALID" ;
VAL_ 154 OBJ_Age_Seconds_V_11 1 "VALID" 0 "INVALID" ;
VAL_ 154 OBJ_Width_V_11 1 "VALID" 0 "INVALID" ;
VAL_ 154 OBJ_Width_STD_V_11 1 "VALID" 0 "INVALID" ;
VAL_ 154 OBJ_Length_V_11 1 "VALID" 0 "INVALID" ;
VAL_ 154 OBJ_Length_STD_V_11 1 "VALID" 0 "INVALID" ;
VAL_ 154 OBJ_Height_V_11 1 "VALID" 0 "INVALID" ;
VAL_ 154 OBJ_Height_STD_V_11 1 "VALID" 0 "INVALID" ;
VAL_ 154 OBJ_Abs_Long_Velocity_V_11 1 "VALID" 0 "INVALID" ;
VAL_ 154 OBJ_Abs_Long_Vel_STD_V_11 1 "VALID" 0 "INVALID" ;
VAL_ 154 OBJ_Abs_Lat_Velocity_V_11 1 "VALID" 0 "INVALID" ;
VAL_ 154 OBJ_Abs_Lat_Vel_STD_V_11 1 "VALID" 0 "INVALID" ;
VAL_ 154 OBJ_Abs_Long_Acc_V_11 1 "VALID" 0 "INVALID" ;
VAL_ 154 OBJ_Abs_Long_Acc_STD_V_11 1 "VALID" 0 "INVALID" ;
VAL_ 154 OBJ_Abs_Lat_Acc_V_11 1 "VALID" 0 "INVALID" ;
VAL_ 154 OBJ_Abs_Lat_Acc_STD_V_11 1 "VALID" 0 "INVALID" ;
VAL_ 154 OBJ_Abs_Acceleration_V_11 1 "VALID" 0 "INVALID" ;
VAL_ 154 OBJ_Abs_Acc_STD_V_11 1 "VALID" 0 "INVALID" ;
VAL_ 154 OBJ_Inv_TTC_V_11 1 "VALID" 0 "INVALID" ;
VAL_ 154 OBJ_Inv_TTC_STD_V_11 1 "VALID" 0 "INVALID" ;
VAL_ 154 OBJ_Relative_Long_Acc_V_11 1 "VALID" 0 "INVALID" ;
VAL_ 154 OBJ_Rel_Long_Acc_STD_V_11 1 "VALID" 0 "INVALID" ;
VAL_ 154 OBJ_Relative_Long_Velocity_V_11 1 "VALID" 0 "INVALID" ;
VAL_ 154 OBJ_Rel_Long_Vel_STD_V_11 1 "VALID" 0 "INVALID" ;
VAL_ 154 OBJ_Relative_Lat_Velocity_V_11 1 "VALID" 0 "INVALID" ;
VAL_ 154 OBJ_Rel_Lat_Vel_STD_V_11 1 "VALID" 0 "INVALID" ;
VAL_ 154 OBJ_Long_Distance_V_11 1 "VALID" 0 "INVALID" ;
VAL_ 154 OBJ_Long_Distance_STD_V_11 1 "VALID" 0 "INVALID" ;
