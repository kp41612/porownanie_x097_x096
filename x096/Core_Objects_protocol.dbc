VERSION "14"
// BundelVersion=v4.20.10_RC1
NS_ :

BS_:

BU_: EyeQ4 MCU

BO_ 154 Core_Objects_protocol: 4660 EyeQ4
 SG_ OBJ_Abs_Lat_Velocity_V_17 : 16217|1@1+ (1,0) [0|1] "bool" MCU
 SG_ Reserved_7_17 : 16218|6@1+ (1,0) [0|0] "NA" MCU
 SG_ OBJ_Abs_Lat_Velocity_STD_17 : 16224|13@1+ (0.01,0) [0|50] "m_per_s" MCU
 SG_ OBJ_Abs_Lat_Vel_STD_V_17 : 16237|1@1+ (1,0) [0|1] "bool" MCU
 SG_ OBJ_Abs_Long_Acc_17 : 16238|9@1+ (0.05,-10) [-10|10] "m_per_s2" MCU
 SG_ OBJ_Abs_Long_Acc_V_17 : 16247|1@1+ (1,0) [0|1] "bool" MCU
 SG_ Reserved_8_17 : 16248|8@1+ (1,0) [0|0] "NA" MCU
 SG_ OBJ_Abs_Long_Acc_STD_17 : 16256|10@1+ (0.01,0) [0|7.3] "m_per_s2" MCU
 SG_ OBJ_Abs_Long_Acc_STD_V_17 : 16266|1@1+ (1,0) [0|1] "bool" MCU
 SG_ OBJ_Abs_Lat_Acc_17 : 16267|9@1+ (0.05,-10) [-10|10] "m_per_s2" MCU
 SG_ OBJ_Abs_Lat_Acc_V_17 : 16276|1@1+ (1,0) [0|1] "bool" MCU
 SG_ OBJ_Abs_Lat_Acc_STD_17 : 16277|10@1+ (0.01,0) [0|7.3] "m_per_s2" MCU
 SG_ OBJ_Abs_Lat_Acc_STD_V_17 : 16287|1@1+ (1,0) [0|1] "bool" MCU
 SG_ OBJ_Abs_Acceleration_17 : 16288|9@1+ (0.05,-12.7) [-12.7|12.7] "m_per_s2" MCU
 SG_ OBJ_Abs_Acceleration_V_17 : 16297|1@1+ (1,0) [0|1] "bool" MCU
 SG_ OBJ_Abs_Acc_STD_17 : 16298|10@1+ (0.01,0) [0|7.3] "m_per_s2" MCU
 SG_ OBJ_Abs_Acc_STD_V_17 : 16308|1@1+ (1,0) [0|1] "bool" MCU
 SG_ OBJ_Inv_TTC_17 : 16309|11@1+ (0.01,-8) [-8|8] "INV(s)" MCU
 SG_ OBJ_Inv_TTC_V_17 : 16320|1@1+ (1,0) [0|1] "bool" MCU
 SG_ OBJ_Inv_TTC_STD_17 : 16321|12@1+ (0.001,0) [0|4] "INV(s)" MCU
 SG_ OBJ_Inv_TTC_STD_V_17 : 16333|1@1+ (1,0) [0|1] "bool" MCU
 SG_ OBJ_Relative_Long_Acc_17 : 16334|10@1+ (0.05,-20) [-20|20] "m_per_s2" MCU
 SG_ OBJ_Relative_Long_Acc_V_17 : 16344|1@1+ (1,0) [0|1] "bool" MCU
 SG_ Reserved_9_17 : 16345|7@1+ (1,0) [0|0] "NA" MCU
 SG_ OBJ_Relative_Long_Acc_STD_17 : 16352|10@1+ (0.01,0) [0|7.3] "m_per_s2" MCU
 SG_ OBJ_Rel_Long_Acc_STD_V_17 : 16362|1@1+ (1,0) [0|1] "bool" MCU
 SG_ OBJ_Relative_Long_Velocity_17 : 16363|13@1+ (0.05,-120) [-120|130] "m_per_s" MCU
 SG_ OBJ_Relative_Long_Velocity_V_17 : 16376|1@1+ (1,0) [0|1] "bool" MCU
 SG_ Reserved_10_17 : 16377|7@1+ (1,0) [0|0] "NA" MCU
 SG_ OBJ_Relative_Long_Vel_STD_17 : 16384|14@1+ (0.01,0) [0|130] "m_per_s" MCU
 SG_ OBJ_Rel_Long_Vel_STD_V_17 : 16398|1@1+ (1,0) [0|1] "bool" MCU
 SG_ OBJ_Relative_Lat_Velocity_17 : 16399|11@1+ (0.05,-50) [-50|50] "m_per_s" MCU
 SG_ OBJ_Relative_Lat_Velocity_V_17 : 16410|1@1+ (1,0) [0|1] "bool" MCU
 SG_ Reserved_11_17 : 16411|5@1+ (1,0) [0|0] "NA" MCU
 SG_ OBJ_Relative_Lat_Velocity_STD_17 : 16416|13@1+ (0.01,0) [0|50] "m_per_s" MCU
 SG_ OBJ_Rel_Lat_Vel_STD_V_17 : 16429|1@1+ (1,0) [0|1] "bool" MCU
 SG_ OBJ_Long_Distance_17 : 16430|14@1+ (0.05,-200) [-200|500] "m" MCU
 SG_ OBJ_Long_Distance_V_17 : 16444|1@1+ (1,0) [0|1] "bool" MCU
 SG_ Reserved_12_17 : 16445|3@1+ (1,0) [0|0] "NA" MCU
 SG_ OBJ_Long_Distance_STD_17 : 16448|15@1+ (0.01,0) [0|250] "m" MCU
 SG_ OBJ_Long_Distance_STD_V_17 : 16463|1@1+ (1,0) [0|1] "bool" MCU
 SG_ OBJ_Lat_Distance_17 : 16464|12@1+ (0.05,-100) [-100|100] "m" MCU
 SG_ OBJ_Lat_Distance_V_17 : 16476|1@1+ (1,0) [0|1] "bool" MCU
 SG_ Reserved_13_17 : 16477|3@1+ (1,0) [0|0] "NA" MCU
 SG_ OBJ_Lat_Distance_STD_17 : 16480|14@1+ (0.01,0) [0|100] "m" MCU
 SG_ OBJ_Lat_Distance_STD_V_17 : 16494|1@1+ (1,0) [0|1] "bool" MCU
 SG_ OBJ_Absolute_Speed_17 : 16495|12@1+ (0.05,-65) [-65|65] "m_per_s" MCU
 SG_ OBJ_Absolute_Speed_V_17 : 16507|1@1+ (1,0) [0|1] "bool" MCU
 SG_ Reserved_14_17 : 16508|4@1+ (1,0) [0|0] "NA" MCU
 SG_ OBJ_Absolute_Speed_STD_17 : 16512|13@1+ (0.01,0) [0|65] "m_per_s" MCU
 SG_ OBJ_Absolute_Speed_STD_V_17 : 16525|1@1+ (1,0) [0|1] "bool" MCU
 SG_ OBJ_Heading_17 : 16526|10@1+ (0.01,-3.14) [-3.14|3.14] "rad" MCU
 SG_ OBJ_Heading_V_17 : 16536|1@1+ (1,0) [0|1] "bool" MCU
 SG_ Reserved_15_17 : 16537|7@1+ (1,0) [0|0] "NA" MCU
 SG_ OBJ_Heading_STD_17 : 16544|15@1+ (0.0001,0) [0|3.14] "rad" MCU
 SG_ OBJ_Heading_STD_V_17 : 16559|1@1+ (1,0) [0|1] "bool" MCU
 SG_ OBJ_Angle_Rate_STD_17 : 16560|15@1+ (0.0001,0) [0|2.2318] "RPS" MCU
 SG_ OBJ_Angle_Rate_STD_V_17 : 16575|1@1+ (1,0) [0|1] "bool" MCU
 SG_ OBJ_Angle_Rate_17 : 16576|12@1+ (0.002,-2.234) [-2.234|2.2318] "RPS" MCU
 SG_ OBJ_Angle_Rate_V_17 : 16588|1@1+ (1,0) [0|1] "bool" MCU
 SG_ OBJ_Angle_Right_17 : 16589|14@1+ (0.0002,-1.571) [-1.571|1.571] "rad" MCU
 SG_ OBJ_Angle_Right_V_17 : 16603|1@1+ (1,0) [0|1] "bool" MCU
 SG_ Reserved_16_17 : 16604|4@1+ (1,0) [0|0] "NA" MCU
 SG_ OBJ_Angle_Right_STD_17 : 16608|14@1+ (0.0001,0) [0|1.571] "rad" MCU
 SG_ OBJ_Angle_Right_STD_V_17 : 16622|1@1+ (1,0) [0|1] "bool" MCU
 SG_ OBJ_Angle_Left_17 : 16623|14@1+ (0.0002,-1.571) [-1.571|1.571] "rad" MCU
 SG_ OBJ_Angle_Left_V_17 : 16637|1@1+ (1,0) [0|1] "bool" MCU
 SG_ Reserved_17_17 : 16638|2@1+ (1,0) [0|0] "NA" MCU
 SG_ OBJ_Angle_Left_STD_17 : 16640|14@1+ (0.0001,0) [0|1.571] "rad" MCU
 SG_ OBJ_Angle_Left_STD_V_17 : 16654|1@1+ (1,0) [0|1] "bool" MCU
 SG_ OBJ_Angle_Side_17 : 16655|14@1+ (0.0002,-1.571) [-1.571|1.571] "rad" MCU
 SG_ OBJ_Angle_Side_V_17 : 16669|1@1+ (1,0) [0|1] "bool" MCU
 SG_ Reserved_18_17 : 16670|2@1+ (1,0) [0|0] "NA" MCU
 SG_ OBJ_Angle_Side_STD_17 : 16672|14@1+ (0.0001,0) [0|1.571] "rad" MCU
 SG_ OBJ_Angle_Side_STD_V_17 : 16686|1@1+ (1,0) [0|1] "bool" MCU
 SG_ OBJ_Angle_Mid_V_17 : 16687|1@1+ (1,0) [0|1] "bool" MCU
 SG_ OBJ_Angle_Mid_17 : 16688|14@1+ (0.0002,-1.571) [-1.571|1.571] "rad" MCU
 SG_ Reserved_19_17 : 16702|2@1+ (1,0) [0|0] "NA" MCU
 SG_ OBJ_Angle_Mid_STD_17 : 16704|14@1+ (0.0001,0) [0|1.571] "rad" MCU
 SG_ OBJ_Angle_Mid_STD_V_17 : 16718|1@1+ (1,0) [0|1] "bool" MCU
 SG_ OBJ_Angle_Bottom_V_17 : 16719|1@1+ (1,0) [0|1] "bool" MCU
 SG_ OBJ_Angle_Bottom_17 : 16720|14@1+ (0.0002,-1.571) [-1.571|1.571] "rad" MCU
 SG_ Reserved_20_17 : 16734|2@1+ (1,0) [0|0] "NA" MCU
 SG_ OBJ_Angle_Bottom_STD_17 : 16736|14@1+ (0.0001,0) [0|1.571] "rad" MCU
 SG_ OBJ_Angle_Bottom_STD_V_17 : 16750|1@1+ (1,0) [0|1] "bool" MCU
 SG_ OBJ_Visibility_Side_V_17 : 16751|1@1+ (1,0) [0|1] "bool" MCU
 SG_ OBJ_Visibility_Side_17 : 16752|2@1+ (1,0) [0|2] "ENUM" MCU
 SG_ OBJ_Is_In_Drivable_Area_17 : 16754|1@1+ (1,0) [0|1] "bool" MCU
 SG_ OBJ_Is_In_Drivable_Area_V_17 : 16755|1@1+ (1,0) [0|1] "bool" MCU
 SG_ OBJ_Is_VeryClose_V_17 : 16756|1@1+ (1,0) [0|1] "bool" MCU
 SG_ OBJ_Is_VeryClose_17 : 16757|1@1+ (1,0) [0|1] "bool" MCU
 SG_ OBJ_Buffer_C4_17 : 16758|2@1+ (1,0) [0|2] "NA" MCU
 SG_ OBJ_Buffer_C5_17 : 16760|2@1+ (1,0) [0|2] "NA" MCU
 SG_ OBJ_Buffer_C6_17 : 16762|2@1+ (1,0) [0|2] "NA" MCU
 SG_ OBJ_Buffer_C7_17 : 16764|2@1+ (1,0) [0|2] "NA" MCU
 SG_ Reserved_21_17 : 16766|2@1+ (1,0) [0|0] "NA" MCU
 SG_ OBJ_OverlapAngleEgoLaneR_17 : 16768|10@1+ (0.01,-3.14) [-3.14|3.14] "rad" MCU
 SG_ OBJ_OverlapAngleEgoLaneR_V_17 : 16778|1@1+ (1,0) [0|1] "bool" MCU
 SG_ OBJ_OverlapAngleEgoLaneL_17 : 16779|10@1+ (0.01,-3.14) [-3.14|3.14] "rad" MCU
 SG_ OBJ_OverlapAngleEgoLaneL_V_17 : 16789|1@1+ (1,0) [0|1] "bool" MCU
 SG_ OBJ_Is_EMERGENCY_VCL_17 : 16790|1@1+ (1,0) [0|1] "bool" MCU
 SG_ OBJ_EMERGENCY_LIGHT_COLOR_17 : 16791|4@1+ (1,0) [0|15] "BITWIZE" MCU
 SG_ OBJ_EMERGENCY_V_17 : 16795|1@1+ (1,0) [0|1] "bool" MCU
 SG_ Reserved_22_17 : 16796|4@1+ (1,0) [0|0] "NA" MCU
 SG_ OBJ_Angle_Top_17 : 16800|14@1+ (0.0002,0) [0|3.1415] "rad" MCU
 SG_ OBJ_Angle_Top_V_17 : 16814|1@1+ (1,0) [0|1] "bool" MCU
 SG_ OBJ_Angle_Top_STD_17 : 16815|15@1+ (0.0001,0) [0|3.1415] "rad" MCU
 SG_ OBJ_Angle_Top_STD_V_17 : 16830|1@1+ (1,0) [0|1] "bool" MCU
 SG_ OBJ_Buffer_C14_17 : 16831|1@1+ (1,0) [0|1] "NA" MCU
 SG_ OBJ_Buffer_C15_17 : 16832|1@1+ (1,0) [0|1] "NA" MCU
 SG_ OBJ_Buffer_C18_17 : 16833|2@1+ (1,0) [0|2] "NA" MCU
 SG_ OBJ_Buffer_C19_17 : 16835|1@1+ (1,0) [0|1] "NA" MCU
 SG_ Reserved_23_17 : 16836|28@1+ (1,0) [0|0] "NA" MCU
 SG_ OBJ_CRC_18 : 16864|32@1+ (1,0) [0|4294967295] "NA" MCU
 SG_ OBJ_ID_18 : 16896|8@1+ (1,0) [0|255] "counter" MCU
 SG_ OBJ_Existence_Probability_18 : 16904|8@1+ (0.01,0) [0|1] "NA" MCU
 SG_ OBJ_Fusion_Source_18 : 16912|16@1+ (1,0) [0|65535] "BITWIZE" MCU
 SG_ OBJ_Triggered_SDM_18 : 16928|2@1+ (1,0) [0|2] "ENUM" MCU
 SG_ OBJ_Motion_Category_18 : 16930|4@1+ (1,0) [0|13] "ENUM" MCU
 SG_ OBJ_Buffer_C0_18 : 16934|7@1+ (0.01,0) [0|1] "NA" MCU
 SG_ OBJ_Object_Age_18 : 16941|11@1+ (1,0) [0|2047] "frames" MCU
 SG_ OBJ_Measuring_Status_18 : 16952|3@1+ (1,0) [0|7] "BITWIZE" MCU
 SG_ OBJ_Object_Class_18 : 16955|4@1+ (1,0) [0|8] "ENUM" MCU
 SG_ Reserved_4_18 : 16959|1@1+ (1,0) [0|0] "NA" MCU
 SG_ OBJ_Class_Probability_18 : 16960|7@1+ (0.01,0) [0|1] "NA" MCU
 SG_ OBJ_Car_Probability_18 : 16967|7@1+ (0.01,0) [0|1] "NA" MCU
 SG_ OBJ_Truck_Probability_18 : 16974|7@1+ (0.01,0) [0|1] "NA" MCU
 SG_ OBJ_Bike_Probability_18 : 16981|7@1+ (0.01,0) [0|1] "NA" MCU
 SG_ OBJ_Camera_Source_18 : 16988|4@1+ (1,0) [0|15] "ENUM" MCU
 SG_ OBJ_Motion_Status_18 : 16992|3@1+ (1,0) [0|5] "ENUM" MCU
 SG_ OBJ_Motion_Orientation_18 : 16995|4@1+ (1,0) [0|13] "ENUM" MCU
 SG_ OBJ_Has_Cut_Lane_18 : 16999|1@1+ (1,0) [0|1] "bool" MCU
 SG_ OBJ_Has_Cut_Path_18 : 17000|1@1+ (1,0) [0|1] "bool" MCU
 SG_ OBJ_Brake_Light_18 : 17001|1@1+ (1,0) [0|1] "bool" MCU
 SG_ OBJ_Turn_Indicator_Right_18 : 17002|1@1+ (1,0) [0|1] "bool" MCU
 SG_ OBJ_Turn_Indicator_Left_18 : 17003|1@1+ (1,0) [0|1] "bool" MCU
 SG_ OBJ_Light_Indicator_Validity_18 : 17004|1@1+ (1,0) [0|1] "bool" MCU
 SG_ OBJ_Right_Out_Of_Image_18 : 17005|1@1+ (1,0) [0|1] "bool" MCU
 SG_ OBJ_Left_Out_Of_Image_18 : 17006|1@1+ (1,0) [0|1] "bool" MCU
 SG_ OBJ_Right_Out_Of_Image_V_18 : 17007|1@1+ (1,0) [0|1] "bool" MCU
 SG_ OBJ_Left_Out_Of_Image_V_18 : 17008|1@1+ (1,0) [0|1] "bool" MCU
 SG_ OBJ_Top_Out_Of_Image_18 : 17009|1@1+ (1,0) [0|1] "bool" MCU
 SG_ OBJ_Bottom_Out_Of_Image_18 : 17010|1@1+ (1,0) [0|1] "bool" MCU
 SG_ OBJ_Top_Out_Of_Image_V_18 : 17011|1@1+ (1,0) [0|1] "bool" MCU
 SG_ OBJ_Bottom_Out_Of_Image_V_18 : 17012|1@1+ (1,0) [0|1] "bool" MCU
 SG_ OBJ_Lane_Assignment_18 : 17013|3@1+ (1,0) [0|5] "ENUM" MCU
 SG_ OBJ_Lane_Assignment_V_18 : 17016|1@1+ (1,0) [0|1] "bool" MCU
 SG_ OBJ_Age_Seconds_18 : 17017|7@1+ (1,0) [0|100] "s" MCU
 SG_ OBJ_Age_Seconds_V_18 : 17024|1@1+ (1,0) [0|1] "bool" MCU
 SG_ OBJ_Width_18 : 17025|9@1+ (0.01,0) [0.4|2.95] "m" MCU
 SG_ OBJ_Width_V_18 : 17034|1@1+ (1,0) [0|1] "bool" MCU
 SG_ OBJ_Width_STD_18 : 17035|11@1+ (0.001,0) [0|2] "m" MCU
 SG_ OBJ_Width_STD_V_18 : 17046|1@1+ (1,0) [0|1] "bool" MCU
 SG_ OBJ_Length_18 : 17047|9@1+ (0.05,0) [1.2|21] "m" MCU
 SG_ OBJ_Length_V_18 : 17056|1@1+ (1,0) [0|1] "bool" MCU
 SG_ OBJ_Length_STD_18 : 17057|10@1+ (0.01,0) [0|10] "m" MCU
 SG_ OBJ_Length_STD_V_18 : 17067|1@1+ (1,0) [0|1] "bool" MCU
 SG_ OBJ_Radar_ID_18 : 17068|8@1+ (1,0) [0|255] "counter" MCU
 SG_ OBJ_Height_18 : 17076|9@1+ (0.01,0) [0|2.95] "m" MCU
 SG_ OBJ_Height_V_18 : 17085|1@1+ (1,0) [0|1] "bool" MCU
 SG_ Reserved_5_18 : 17086|2@1+ (1,0) [0|0] "NA" MCU
 SG_ OBJ_Height_STD_18 : 17088|11@1+ (0.001,0) [0|2] "m" MCU
 SG_ OBJ_Height_STD_V_18 : 17099|1@1+ (1,0) [0|1] "bool" MCU
 SG_ OBJ_Abs_Long_Velocity_18 : 17100|12@1+ (0.05,-100) [-100|100] "m_per_s" MCU
 SG_ OBJ_Abs_Long_Velocity_V_18 : 17112|1@1+ (1,0) [0|1] "bool" MCU
 SG_ Reserved_6_18 : 17113|7@1+ (1,0) [0|0] "NA" MCU
 SG_ OBJ_Abs_Long_Velocity_STD_18 : 17120|13@1+ (0.01,0) [0|65] "m_per_s" MCU
 SG_ OBJ_Abs_Long_Vel_STD_V_18 : 17133|1@1+ (1,0) [0|1] "bool" MCU
 SG_ OBJ_Abs_Lat_Velocity_18 : 17134|11@1+ (0.05,-50) [-50|50] "m_per_s" MCU
 SG_ OBJ_Abs_Lat_Velocity_V_18 : 17145|1@1+ (1,0) [0|1] "bool" MCU
 SG_ Reserved_7_18 : 17146|6@1+ (1,0) [0|0] "NA" MCU
 SG_ OBJ_Abs_Lat_Velocity_STD_18 : 17152|13@1+ (0.01,0) [0|50] "m_per_s" MCU
 SG_ OBJ_Abs_Lat_Vel_STD_V_18 : 17165|1@1+ (1,0) [0|1] "bool" MCU
 SG_ OBJ_Abs_Long_Acc_18 : 17166|9@1+ (0.05,-10) [-10|10] "m_per_s2" MCU
 SG_ OBJ_Abs_Long_Acc_V_18 : 17175|1@1+ (1,0) [0|1] "bool" MCU
 SG_ Reserved_8_18 : 17176|8@1+ (1,0) [0|0] "NA" MCU
 SG_ OBJ_Abs_Long_Acc_STD_18 : 17184|10@1+ (0.01,0) [0|7.3] "m_per_s2" MCU
 SG_ OBJ_Abs_Long_Acc_STD_V_18 : 17194|1@1+ (1,0) [0|1] "bool" MCU
 SG_ OBJ_Abs_Lat_Acc_18 : 17195|9@1+ (0.05,-10) [-10|10] "m_per_s2" MCU
 SG_ OBJ_Abs_Lat_Acc_V_18 : 17204|1@1+ (1,0) [0|1] "bool" MCU
 SG_ OBJ_Abs_Lat_Acc_STD_18 : 17205|10@1+ (0.01,0) [0|7.3] "m_per_s2" MCU
 SG_ OBJ_Abs_Lat_Acc_STD_V_18 : 17215|1@1+ (1,0) [0|1] "bool" MCU
 SG_ OBJ_Abs_Acceleration_18 : 17216|9@1+ (0.05,-12.7) [-12.7|12.7] "m_per_s2" MCU
 SG_ OBJ_Abs_Acceleration_V_18 : 17225|1@1+ (1,0) [0|1] "bool" MCU
 SG_ OBJ_Abs_Acc_STD_18 : 17226|10@1+ (0.01,0) [0|7.3] "m_per_s2" MCU
 SG_ OBJ_Abs_Acc_STD_V_18 : 17236|1@1+ (1,0) [0|1] "bool" MCU
 SG_ OBJ_Inv_TTC_18 : 17237|11@1+ (0.01,-8) [-8|8] "INV(s)" MCU
 SG_ OBJ_Inv_TTC_V_18 : 17248|1@1+ (1,0) [0|1] "bool" MCU
 SG_ OBJ_Inv_TTC_STD_18 : 17249|12@1+ (0.001,0) [0|4] "INV(s)" MCU
 SG_ OBJ_Inv_TTC_STD_V_18 : 17261|1@1+ (1,0) [0|1] "bool" MCU
 SG_ OBJ_Relative_Long_Acc_18 : 17262|10@1+ (0.05,-20) [-20|20] "m_per_s2" MCU
 SG_ OBJ_Relative_Long_Acc_V_18 : 17272|1@1+ (1,0) [0|1] "bool" MCU
 SG_ Reserved_9_18 : 17273|7@1+ (1,0) [0|0] "NA" MCU
 SG_ OBJ_Relative_Long_Acc_STD_18 : 17280|10@1+ (0.01,0) [0|7.3] "m_per_s2" MCU
 SG_ OBJ_Rel_Long_Acc_STD_V_18 : 17290|1@1+ (1,0) [0|1] "bool" MCU
 SG_ OBJ_Relative_Long_Velocity_18 : 17291|13@1+ (0.05,-120) [-120|130] "m_per_s" MCU
 SG_ OBJ_Relative_Long_Velocity_V_18 : 17304|1@1+ (1,0) [0|1] "bool" MCU
 SG_ Reserved_10_18 : 17305|7@1+ (1,0) [0|0] "NA" MCU
 SG_ OBJ_Relative_Long_Vel_STD_18 : 17312|14@1+ (0.01,0) [0|130] "m_per_s" MCU
 SG_ OBJ_Rel_Long_Vel_STD_V_18 : 17326|1@1+ (1,0) [0|1] "bool" MCU
 SG_ OBJ_Relative_Lat_Velocity_18 : 17327|11@1+ (0.05,-50) [-50|50] "m_per_s" MCU
 SG_ OBJ_Relative_Lat_Velocity_V_18 : 17338|1@1+ (1,0) [0|1] "bool" MCU
 SG_ Reserved_11_18 : 17339|5@1+ (1,0) [0|0] "NA" MCU
 SG_ OBJ_Relative_Lat_Velocity_STD_18 : 17344|13@1+ (0.01,0) [0|50] "m_per_s" MCU
 SG_ OBJ_Rel_Lat_Vel_STD_V_18 : 17357|1@1+ (1,0) [0|1] "bool" MCU
 SG_ OBJ_Long_Distance_18 : 17358|14@1+ (0.05,-200) [-200|500] "m" MCU
 SG_ OBJ_Long_Distance_V_18 : 17372|1@1+ (1,0) [0|1] "bool" MCU
 SG_ Reserved_12_18 : 17373|3@1+ (1,0) [0|0] "NA" MCU
 SG_ OBJ_Long_Distance_STD_18 : 17376|15@1+ (0.01,0) [0|250] "m" MCU
 SG_ OBJ_Long_Distance_STD_V_18 : 17391|1@1+ (1,0) [0|1] "bool" MCU
 SG_ OBJ_Lat_Distance_18 : 17392|12@1+ (0.05,-100) [-100|100] "m" MCU
 SG_ OBJ_Lat_Distance_V_18 : 17404|1@1+ (1,0) [0|1] "bool" MCU
 SG_ Reserved_13_18 : 17405|3@1+ (1,0) [0|0] "NA" MCU
 SG_ OBJ_Lat_Distance_STD_18 : 17408|14@1+ (0.01,0) [0|100] "m" MCU
 SG_ OBJ_Lat_Distance_STD_V_18 : 17422|1@1+ (1,0) [0|1] "bool" MCU
 SG_ OBJ_Absolute_Speed_18 : 17423|12@1+ (0.05,-65) [-65|65] "m_per_s" MCU
 SG_ OBJ_Absolute_Speed_V_18 : 17435|1@1+ (1,0) [0|1] "bool" MCU
 SG_ Reserved_14_18 : 17436|4@1+ (1,0) [0|0] "NA" MCU
 SG_ OBJ_Absolute_Speed_STD_18 : 17440|13@1+ (0.01,0) [0|65] "m_per_s" MCU
 SG_ OBJ_Absolute_Speed_STD_V_18 : 17453|1@1+ (1,0) [0|1] "bool" MCU
 SG_ OBJ_Heading_18 : 17454|10@1+ (0.01,-3.14) [-3.14|3.14] "rad" MCU
 SG_ OBJ_Heading_V_18 : 17464|1@1+ (1,0) [0|1] "bool" MCU
 SG_ Reserved_15_18 : 17465|7@1+ (1,0) [0|0] "NA" MCU
 SG_ OBJ_Heading_STD_18 : 17472|15@1+ (0.0001,0) [0|3.14] "rad" MCU
 SG_ OBJ_Heading_STD_V_18 : 17487|1@1+ (1,0) [0|1] "bool" MCU
 SG_ OBJ_Angle_Rate_STD_18 : 17488|15@1+ (0.0001,0) [0|2.2318] "RPS" MCU
 SG_ OBJ_Angle_Rate_STD_V_18 : 17503|1@1+ (1,0) [0|1] "bool" MCU
 SG_ OBJ_Angle_Rate_18 : 17504|12@1+ (0.002,-2.234) [-2.234|2.2318] "RPS" MCU
 SG_ OBJ_Angle_Rate_V_18 : 17516|1@1+ (1,0) [0|1] "bool" MCU
 SG_ OBJ_Angle_Right_18 : 17517|14@1+ (0.0002,-1.571) [-1.571|1.571] "rad" MCU
 SG_ OBJ_Angle_Right_V_18 : 17531|1@1+ (1,0) [0|1] "bool" MCU
 SG_ Reserved_16_18 : 17532|4@1+ (1,0) [0|0] "NA" MCU
 SG_ OBJ_Angle_Right_STD_18 : 17536|14@1+ (0.0001,0) [0|1.571] "rad" MCU
 SG_ OBJ_Angle_Right_STD_V_18 : 17550|1@1+ (1,0) [0|1] "bool" MCU
 SG_ OBJ_Angle_Left_18 : 17551|14@1+ (0.0002,-1.571) [-1.571|1.571] "rad" MCU
 SG_ OBJ_Angle_Left_V_18 : 17565|1@1+ (1,0) [0|1] "bool" MCU
 SG_ Reserved_17_18 : 17566|2@1+ (1,0) [0|0] "NA" MCU
 SG_ OBJ_Angle_Left_STD_18 : 17568|14@1+ (0.0001,0) [0|1.571] "rad" MCU
 SG_ OBJ_Angle_Left_STD_V_18 : 17582|1@1+ (1,0) [0|1] "bool" MCU
 SG_ OBJ_Angle_Side_18 : 17583|14@1+ (0.0002,-1.571) [-1.571|1.571] "rad" MCU
 SG_ OBJ_Angle_Side_V_18 : 17597|1@1+ (1,0) [0|1] "bool" MCU
 SG_ Reserved_18_18 : 17598|2@1+ (1,0) [0|0] "NA" MCU
 SG_ OBJ_Angle_Side_STD_18 : 17600|14@1+ (0.0001,0) [0|1.571] "rad" MCU
 SG_ OBJ_Angle_Side_STD_V_18 : 17614|1@1+ (1,0) [0|1] "bool" MCU
 SG_ OBJ_Angle_Mid_V_18 : 17615|1@1+ (1,0) [0|1] "bool" MCU
 SG_ OBJ_Angle_Mid_18 : 17616|14@1+ (0.0002,-1.571) [-1.571|1.571] "rad" MCU
 SG_ Reserved_19_18 : 17630|2@1+ (1,0) [0|0] "NA" MCU
 SG_ OBJ_Angle_Mid_STD_18 : 17632|14@1+ (0.0001,0) [0|1.571] "rad" MCU
 SG_ OBJ_Angle_Mid_STD_V_18 : 17646|1@1+ (1,0) [0|1] "bool" MCU
 SG_ OBJ_Angle_Bottom_V_18 : 17647|1@1+ (1,0) [0|1] "bool" MCU
 SG_ OBJ_Angle_Bottom_18 : 17648|14@1+ (0.0002,-1.571) [-1.571|1.571] "rad" MCU
 SG_ Reserved_20_18 : 17662|2@1+ (1,0) [0|0] "NA" MCU
 SG_ OBJ_Angle_Bottom_STD_18 : 17664|14@1+ (0.0001,0) [0|1.571] "rad" MCU
 SG_ OBJ_Angle_Bottom_STD_V_18 : 17678|1@1+ (1,0) [0|1] "bool" MCU
 SG_ OBJ_Visibility_Side_V_18 : 17679|1@1+ (1,0) [0|1] "bool" MCU
 SG_ OBJ_Visibility_Side_18 : 17680|2@1+ (1,0) [0|2] "ENUM" MCU
 SG_ OBJ_Is_In_Drivable_Area_18 : 17682|1@1+ (1,0) [0|1] "bool" MCU
 SG_ OBJ_Is_In_Drivable_Area_V_18 : 17683|1@1+ (1,0) [0|1] "bool" MCU
 SG_ OBJ_Is_VeryClose_V_18 : 17684|1@1+ (1,0) [0|1] "bool" MCU
 SG_ OBJ_Is_VeryClose_18 : 17685|1@1+ (1,0) [0|1] "bool" MCU
 SG_ OBJ_Buffer_C4_18 : 17686|2@1+ (1,0) [0|2] "NA" MCU
 SG_ OBJ_Buffer_C5_18 : 17688|2@1+ (1,0) [0|2] "NA" MCU
 SG_ OBJ_Buffer_C6_18 : 17690|2@1+ (1,0) [0|2] "NA" MCU
 SG_ OBJ_Buffer_C7_18 : 17692|2@1+ (1,0) [0|2] "NA" MCU
 SG_ Reserved_21_18 : 17694|2@1+ (1,0) [0|0] "NA" MCU
 SG_ OBJ_OverlapAngleEgoLaneR_18 : 17696|10@1+ (0.01,-3.14) [-3.14|3.14] "rad" MCU
 SG_ OBJ_OverlapAngleEgoLaneR_V_18 : 17706|1@1+ (1,0) [0|1] "bool" MCU
 SG_ OBJ_OverlapAngleEgoLaneL_18 : 17707|10@1+ (0.01,-3.14) [-3.14|3.14] "rad" MCU
 SG_ OBJ_OverlapAngleEgoLaneL_V_18 : 17717|1@1+ (1,0) [0|1] "bool" MCU
 SG_ OBJ_Is_EMERGENCY_VCL_18 : 17718|1@1+ (1,0) [0|1] "bool" MCU
 SG_ OBJ_EMERGENCY_LIGHT_COLOR_18 : 17719|4@1+ (1,0) [0|15] "BITWIZE" MCU
 SG_ OBJ_EMERGENCY_V_18 : 17723|1@1+ (1,0) [0|1] "bool" MCU
 SG_ Reserved_22_18 : 17724|4@1+ (1,0) [0|0] "NA" MCU
 SG_ OBJ_Angle_Top_18 : 17728|14@1+ (0.0002,0) [0|3.1415] "rad" MCU
 SG_ OBJ_Angle_Top_V_18 : 17742|1@1+ (1,0) [0|1] "bool" MCU
 SG_ OBJ_Angle_Top_STD_18 : 17743|15@1+ (0.0001,0) [0|3.1415] "rad" MCU
 SG_ OBJ_Angle_Top_STD_V_18 : 17758|1@1+ (1,0) [0|1] "bool" MCU
 SG_ OBJ_Buffer_C14_18 : 17759|1@1+ (1,0) [0|1] "NA" MCU
 SG_ OBJ_Buffer_C15_18 : 17760|1@1+ (1,0) [0|1] "NA" MCU
 SG_ OBJ_Buffer_C18_18 : 17761|2@1+ (1,0) [0|2] "NA" MCU
 SG_ OBJ_Buffer_C19_18 : 17763|1@1+ (1,0) [0|1] "NA" MCU
 SG_ Reserved_23_18 : 17764|28@1+ (1,0) [0|0] "NA" MCU
 SG_ OBJ_CRC_19 : 17792|32@1+ (1,0) [0|4294967295] "NA" MCU
 SG_ OBJ_ID_19 : 17824|8@1+ (1,0) [0|255] "counter" MCU
 SG_ OBJ_Existence_Probability_19 : 17832|8@1+ (0.01,0) [0|1] "NA" MCU
 SG_ OBJ_Fusion_Source_19 : 17840|16@1+ (1,0) [0|65535] "BITWIZE" MCU
 SG_ OBJ_Triggered_SDM_19 : 17856|2@1+ (1,0) [0|2] "ENUM" MCU
 SG_ OBJ_Motion_Category_19 : 17858|4@1+ (1,0) [0|13] "ENUM" MCU
 SG_ OBJ_Buffer_C0_19 : 17862|7@1+ (0.01,0) [0|1] "NA" MCU
 SG_ OBJ_Object_Age_19 : 17869|11@1+ (1,0) [0|2047] "frames" MCU
 SG_ OBJ_Measuring_Status_19 : 17880|3@1+ (1,0) [0|7] "BITWIZE" MCU
 SG_ OBJ_Object_Class_19 : 17883|4@1+ (1,0) [0|8] "ENUM" MCU
 SG_ Reserved_4_19 : 17887|1@1+ (1,0) [0|0] "NA" MCU
 SG_ OBJ_Class_Probability_19 : 17888|7@1+ (0.01,0) [0|1] "NA" MCU
 SG_ OBJ_Car_Probability_19 : 17895|7@1+ (0.01,0) [0|1] "NA" MCU
 SG_ OBJ_Truck_Probability_19 : 17902|7@1+ (0.01,0) [0|1] "NA" MCU
 SG_ OBJ_Bike_Probability_19 : 17909|7@1+ (0.01,0) [0|1] "NA" MCU
 SG_ OBJ_Camera_Source_19 : 17916|4@1+ (1,0) [0|15] "ENUM" MCU
 SG_ OBJ_Motion_Status_19 : 17920|3@1+ (1,0) [0|5] "ENUM" MCU
 SG_ OBJ_Motion_Orientation_19 : 17923|4@1+ (1,0) [0|13] "ENUM" MCU
 SG_ OBJ_Has_Cut_Lane_19 : 17927|1@1+ (1,0) [0|1] "bool" MCU
 SG_ OBJ_Has_Cut_Path_19 : 17928|1@1+ (1,0) [0|1] "bool" MCU
 SG_ OBJ_Brake_Light_19 : 17929|1@1+ (1,0) [0|1] "bool" MCU
 SG_ OBJ_Turn_Indicator_Right_19 : 17930|1@1+ (1,0) [0|1] "bool" MCU
 SG_ OBJ_Turn_Indicator_Left_19 : 17931|1@1+ (1,0) [0|1] "bool" MCU
 SG_ OBJ_Light_Indicator_Validity_19 : 17932|1@1+ (1,0) [0|1] "bool" MCU
 SG_ OBJ_Right_Out_Of_Image_19 : 17933|1@1+ (1,0) [0|1] "bool" MCU
 SG_ OBJ_Left_Out_Of_Image_19 : 17934|1@1+ (1,0) [0|1] "bool" MCU
 SG_ OBJ_Right_Out_Of_Image_V_19 : 17935|1@1+ (1,0) [0|1] "bool" MCU
 SG_ OBJ_Left_Out_Of_Image_V_19 : 17936|1@1+ (1,0) [0|1] "bool" MCU
 SG_ OBJ_Top_Out_Of_Image_19 : 17937|1@1+ (1,0) [0|1] "bool" MCU
 SG_ OBJ_Bottom_Out_Of_Image_19 : 17938|1@1+ (1,0) [0|1] "bool" MCU
 SG_ OBJ_Top_Out_Of_Image_V_19 : 17939|1@1+ (1,0) [0|1] "bool" MCU
 SG_ OBJ_Bottom_Out_Of_Image_V_19 : 17940|1@1+ (1,0) [0|1] "bool" MCU
 SG_ OBJ_Lane_Assignment_19 : 17941|3@1+ (1,0) [0|5] "ENUM" MCU
 SG_ OBJ_Lane_Assignment_V_19 : 17944|1@1+ (1,0) [0|1] "bool" MCU
 SG_ OBJ_Age_Seconds_19 : 17945|7@1+ (1,0) [0|100] "s" MCU
 SG_ OBJ_Age_Seconds_V_19 : 17952|1@1+ (1,0) [0|1] "bool" MCU
 SG_ OBJ_Width_19 : 17953|9@1+ (0.01,0) [0.4|2.95] "m" MCU
 SG_ OBJ_Width_V_19 : 17962|1@1+ (1,0) [0|1] "bool" MCU
 SG_ OBJ_Width_STD_19 : 17963|11@1+ (0.001,0) [0|2] "m" MCU
 SG_ OBJ_Width_STD_V_19 : 17974|1@1+ (1,0) [0|1] "bool" MCU
 SG_ OBJ_Length_19 : 17975|9@1+ (0.05,0) [1.2|21] "m" MCU
 SG_ OBJ_Length_V_19 : 17984|1@1+ (1,0) [0|1] "bool" MCU
 SG_ OBJ_Length_STD_19 : 17985|10@1+ (0.01,0) [0|10] "m" MCU
 SG_ OBJ_Length_STD_V_19 : 17995|1@1+ (1,0) [0|1] "bool" MCU
 SG_ OBJ_Radar_ID_19 : 17996|8@1+ (1,0) [0|255] "counter" MCU
 SG_ OBJ_Height_19 : 18004|9@1+ (0.01,0) [0|2.95] "m" MCU
 SG_ OBJ_Height_V_19 : 18013|1@1+ (1,0) [0|1] "bool" MCU
 SG_ Reserved_5_19 : 18014|2@1+ (1,0) [0|0] "NA" MCU
 SG_ OBJ_Height_STD_19 : 18016|11@1+ (0.001,0) [0|2] "m" MCU
 SG_ OBJ_Height_STD_V_19 : 18027|1@1+ (1,0) [0|1] "bool" MCU
 SG_ OBJ_Abs_Long_Velocity_19 : 18028|12@1+ (0.05,-100) [-100|100] "m_per_s" MCU
 SG_ OBJ_Abs_Long_Velocity_V_19 : 18040|1@1+ (1,0) [0|1] "bool" MCU
 SG_ Reserved_6_19 : 18041|7@1+ (1,0) [0|0] "NA" MCU
 SG_ OBJ_Abs_Long_Velocity_STD_19 : 18048|13@1+ (0.01,0) [0|65] "m_per_s" MCU
 SG_ OBJ_Abs_Long_Vel_STD_V_19 : 18061|1@1+ (1,0) [0|1] "bool" MCU
 SG_ OBJ_Abs_Lat_Velocity_19 : 18062|11@1+ (0.05,-50) [-50|50] "m_per_s" MCU
 SG_ OBJ_Abs_Lat_Velocity_V_19 : 18073|1@1+ (1,0) [0|1] "bool" MCU
 SG_ Reserved_7_19 : 18074|6@1+ (1,0) [0|0] "NA" MCU
 SG_ OBJ_Abs_Lat_Velocity_STD_19 : 18080|13@1+ (0.01,0) [0|50] "m_per_s" MCU
 SG_ OBJ_Abs_Lat_Vel_STD_V_19 : 18093|1@1+ (1,0) [0|1] "bool" MCU
 SG_ OBJ_Abs_Long_Acc_19 : 18094|9@1+ (0.05,-10) [-10|10] "m_per_s2" MCU
 SG_ OBJ_Abs_Long_Acc_V_19 : 18103|1@1+ (1,0) [0|1] "bool" MCU
 SG_ Reserved_8_19 : 18104|8@1+ (1,0) [0|0] "NA" MCU
 SG_ OBJ_Abs_Long_Acc_STD_19 : 18112|10@1+ (0.01,0) [0|7.3] "m_per_s2" MCU
 SG_ OBJ_Abs_Long_Acc_STD_V_19 : 18122|1@1+ (1,0) [0|1] "bool" MCU
 SG_ OBJ_Abs_Lat_Acc_19 : 18123|9@1+ (0.05,-10) [-10|10] "m_per_s2" MCU
 SG_ OBJ_Abs_Lat_Acc_V_19 : 18132|1@1+ (1,0) [0|1] "bool" MCU
 SG_ OBJ_Abs_Lat_Acc_STD_19 : 18133|10@1+ (0.01,0) [0|7.3] "m_per_s2" MCU
 SG_ OBJ_Abs_Lat_Acc_STD_V_19 : 18143|1@1+ (1,0) [0|1] "bool" MCU
 SG_ OBJ_Abs_Acceleration_19 : 18144|9@1+ (0.05,-12.7) [-12.7|12.7] "m_per_s2" MCU
 SG_ OBJ_Abs_Acceleration_V_19 : 18153|1@1+ (1,0) [0|1] "bool" MCU
 SG_ OBJ_Abs_Acc_STD_19 : 18154|10@1+ (0.01,0) [0|7.3] "m_per_s2" MCU
 SG_ OBJ_Abs_Acc_STD_V_19 : 18164|1@1+ (1,0) [0|1] "bool" MCU
 SG_ OBJ_Inv_TTC_19 : 18165|11@1+ (0.01,-8) [-8|8] "INV(s)" MCU
 SG_ OBJ_Inv_TTC_V_19 : 18176|1@1+ (1,0) [0|1] "bool" MCU
 SG_ OBJ_Inv_TTC_STD_19 : 18177|12@1+ (0.001,0) [0|4] "INV(s)" MCU
 SG_ OBJ_Inv_TTC_STD_V_19 : 18189|1@1+ (1,0) [0|1] "bool" MCU
 SG_ OBJ_Relative_Long_Acc_19 : 18190|10@1+ (0.05,-20) [-20|20] "m_per_s2" MCU
 SG_ OBJ_Relative_Long_Acc_V_19 : 18200|1@1+ (1,0) [0|1] "bool" MCU
 SG_ Reserved_9_19 : 18201|7@1+ (1,0) [0|0] "NA" MCU
 SG_ OBJ_Relative_Long_Acc_STD_19 : 18208|10@1+ (0.01,0) [0|7.3] "m_per_s2" MCU
 SG_ OBJ_Rel_Long_Acc_STD_V_19 : 18218|1@1+ (1,0) [0|1] "bool" MCU
 SG_ OBJ_Relative_Long_Velocity_19 : 18219|13@1+ (0.05,-120) [-120|130] "m_per_s" MCU
 SG_ OBJ_Relative_Long_Velocity_V_19 : 18232|1@1+ (1,0) [0|1] "bool" MCU
 SG_ Reserved_10_19 : 18233|7@1+ (1,0) [0|0] "NA" MCU
 SG_ OBJ_Relative_Long_Vel_STD_19 : 18240|14@1+ (0.01,0) [0|130] "m_per_s" MCU
 SG_ OBJ_Rel_Long_Vel_STD_V_19 : 18254|1@1+ (1,0) [0|1] "bool" MCU
 SG_ OBJ_Relative_Lat_Velocity_19 : 18255|11@1+ (0.05,-50) [-50|50] "m_per_s" MCU
 SG_ OBJ_Relative_Lat_Velocity_V_19 : 18266|1@1+ (1,0) [0|1] "bool" MCU
 SG_ Reserved_11_19 : 18267|5@1+ (1,0) [0|0] "NA" MCU
 SG_ OBJ_Relative_Lat_Velocity_STD_19 : 18272|13@1+ (0.01,0) [0|50] "m_per_s" MCU
 SG_ OBJ_Rel_Lat_Vel_STD_V_19 : 18285|1@1+ (1,0) [0|1] "bool" MCU
 SG_ OBJ_Long_Distance_19 : 18286|14@1+ (0.05,-200) [-200|500] "m" MCU
 SG_ OBJ_Long_Distance_V_19 : 18300|1@1+ (1,0) [0|1] "bool" MCU
 SG_ Reserved_12_19 : 18301|3@1+ (1,0) [0|0] "NA" MCU
 SG_ OBJ_Long_Distance_STD_19 : 18304|15@1+ (0.01,0) [0|250] "m" MCU
 SG_ OBJ_Long_Distance_STD_V_19 : 18319|1@1+ (1,0) [0|1] "bool" MCU
 SG_ OBJ_Lat_Distance_19 : 18320|12@1+ (0.05,-100) [-100|100] "m" MCU
 SG_ OBJ_Lat_Distance_V_19 : 18332|1@1+ (1,0) [0|1] "bool" MCU
 SG_ Reserved_13_19 : 18333|3@1+ (1,0) [0|0] "NA" MCU
 SG_ OBJ_Lat_Distance_STD_19 : 18336|14@1+ (0.01,0) [0|100] "m" MCU
 SG_ OBJ_Lat_Distance_STD_V_19 : 18350|1@1+ (1,0) [0|1] "bool" MCU
 SG_ OBJ_Absolute_Speed_19 : 18351|12@1+ (0.05,-65) [-65|65] "m_per_s" MCU
 SG_ OBJ_Absolute_Speed_V_19 : 18363|1@1+ (1,0) [0|1] "bool" MCU
 SG_ Reserved_14_19 : 18364|4@1+ (1,0) [0|0] "NA" MCU
 SG_ OBJ_Absolute_Speed_STD_19 : 18368|13@1+ (0.01,0) [0|65] "m_per_s" MCU
 SG_ OBJ_Absolute_Speed_STD_V_19 : 18381|1@1+ (1,0) [0|1] "bool" MCU
 SG_ OBJ_Heading_19 : 18382|10@1+ (0.01,-3.14) [-3.14|3.14] "rad" MCU
 SG_ OBJ_Heading_V_19 : 18392|1@1+ (1,0) [0|1] "bool" MCU
 SG_ Reserved_15_19 : 18393|7@1+ (1,0) [0|0] "NA" MCU
 SG_ OBJ_Heading_STD_19 : 18400|15@1+ (0.0001,0) [0|3.14] "rad" MCU
 SG_ OBJ_Heading_STD_V_19 : 18415|1@1+ (1,0) [0|1] "bool" MCU
 SG_ OBJ_Angle_Rate_STD_19 : 18416|15@1+ (0.0001,0) [0|2.2318] "RPS" MCU
 SG_ OBJ_Angle_Rate_STD_V_19 : 18431|1@1+ (1,0) [0|1] "bool" MCU
 SG_ OBJ_Angle_Rate_19 : 18432|12@1+ (0.002,-2.234) [-2.234|2.2318] "RPS" MCU
 SG_ OBJ_Angle_Rate_V_19 : 18444|1@1+ (1,0) [0|1] "bool" MCU
 SG_ OBJ_Angle_Right_19 : 18445|14@1+ (0.0002,-1.571) [-1.571|1.571] "rad" MCU
 SG_ OBJ_Angle_Right_V_19 : 18459|1@1+ (1,0) [0|1] "bool" MCU
 SG_ Reserved_16_19 : 18460|4@1+ (1,0) [0|0] "NA" MCU
 SG_ OBJ_Angle_Right_STD_19 : 18464|14@1+ (0.0001,0) [0|1.571] "rad" MCU
 SG_ OBJ_Angle_Right_STD_V_19 : 18478|1@1+ (1,0) [0|1] "bool" MCU
 SG_ OBJ_Angle_Left_19 : 18479|14@1+ (0.0002,-1.571) [-1.571|1.571] "rad" MCU
 SG_ OBJ_Angle_Left_V_19 : 18493|1@1+ (1,0) [0|1] "bool" MCU
 SG_ Reserved_17_19 : 18494|2@1+ (1,0) [0|0] "NA" MCU
 SG_ OBJ_Angle_Left_STD_19 : 18496|14@1+ (0.0001,0) [0|1.571] "rad" MCU
 SG_ OBJ_Angle_Left_STD_V_19 : 18510|1@1+ (1,0) [0|1] "bool" MCU
 SG_ OBJ_Angle_Side_19 : 18511|14@1+ (0.0002,-1.571) [-1.571|1.571] "rad" MCU
 SG_ OBJ_Angle_Side_V_19 : 18525|1@1+ (1,0) [0|1] "bool" MCU
 SG_ Reserved_18_19 : 18526|2@1+ (1,0) [0|0] "NA" MCU
 SG_ OBJ_Angle_Side_STD_19 : 18528|14@1+ (0.0001,0) [0|1.571] "rad" MCU
 SG_ OBJ_Angle_Side_STD_V_19 : 18542|1@1+ (1,0) [0|1] "bool" MCU
 SG_ OBJ_Angle_Mid_V_19 : 18543|1@1+ (1,0) [0|1] "bool" MCU
 SG_ OBJ_Angle_Mid_19 : 18544|14@1+ (0.0002,-1.571) [-1.571|1.571] "rad" MCU
 SG_ Reserved_19_19 : 18558|2@1+ (1,0) [0|0] "NA" MCU
 SG_ OBJ_Angle_Mid_STD_19 : 18560|14@1+ (0.0001,0) [0|1.571] "rad" MCU
 SG_ OBJ_Angle_Mid_STD_V_19 : 18574|1@1+ (1,0) [0|1] "bool" MCU
 SG_ OBJ_Angle_Bottom_V_19 : 18575|1@1+ (1,0) [0|1] "bool" MCU
 SG_ OBJ_Angle_Bottom_19 : 18576|14@1+ (0.0002,-1.571) [-1.571|1.571] "rad" MCU
 SG_ Reserved_20_19 : 18590|2@1+ (1,0) [0|0] "NA" MCU
 SG_ OBJ_Angle_Bottom_STD_19 : 18592|14@1+ (0.0001,0) [0|1.571] "rad" MCU
 SG_ OBJ_Angle_Bottom_STD_V_19 : 18606|1@1+ (1,0) [0|1] "bool" MCU
 SG_ OBJ_Visibility_Side_V_19 : 18607|1@1+ (1,0) [0|1] "bool" MCU
 SG_ OBJ_Visibility_Side_19 : 18608|2@1+ (1,0) [0|2] "ENUM" MCU
 SG_ OBJ_Is_In_Drivable_Area_19 : 18610|1@1+ (1,0) [0|1] "bool" MCU
 SG_ OBJ_Is_In_Drivable_Area_V_19 : 18611|1@1+ (1,0) [0|1] "bool" MCU
 SG_ OBJ_Is_VeryClose_V_19 : 18612|1@1+ (1,0) [0|1] "bool" MCU
 SG_ OBJ_Is_VeryClose_19 : 18613|1@1+ (1,0) [0|1] "bool" MCU
 SG_ OBJ_Buffer_C4_19 : 18614|2@1+ (1,0) [0|2] "NA" MCU
 SG_ OBJ_Buffer_C5_19 : 18616|2@1+ (1,0) [0|2] "NA" MCU
 SG_ OBJ_Buffer_C6_19 : 18618|2@1+ (1,0) [0|2] "NA" MCU
 SG_ OBJ_Buffer_C7_19 : 18620|2@1+ (1,0) [0|2] "NA" MCU
 SG_ Reserved_21_19 : 18622|2@1+ (1,0) [0|0] "NA" MCU
 SG_ OBJ_OverlapAngleEgoLaneR_19 : 18624|10@1+ (0.01,-3.14) [-3.14|3.14] "rad" MCU
 SG_ OBJ_OverlapAngleEgoLaneR_V_19 : 18634|1@1+ (1,0) [0|1] "bool" MCU
 SG_ OBJ_OverlapAngleEgoLaneL_19 : 18635|10@1+ (0.01,-3.14) [-3.14|3.14] "rad" MCU
 SG_ OBJ_OverlapAngleEgoLaneL_V_19 : 18645|1@1+ (1,0) [0|1] "bool" MCU
 SG_ OBJ_Is_EMERGENCY_VCL_19 : 18646|1@1+ (1,0) [0|1] "bool" MCU
 SG_ OBJ_EMERGENCY_LIGHT_COLOR_19 : 18647|4@1+ (1,0) [0|15] "BITWIZE" MCU
 SG_ OBJ_EMERGENCY_V_19 : 18651|1@1+ (1,0) [0|1] "bool" MCU
 SG_ Reserved_22_19 : 18652|4@1+ (1,0) [0|0] "NA" MCU
 SG_ OBJ_Angle_Top_19 : 18656|14@1+ (0.0002,0) [0|3.1415] "rad" MCU
 SG_ OBJ_Angle_Top_V_19 : 18670|1@1+ (1,0) [0|1] "bool" MCU
 SG_ OBJ_Angle_Top_STD_19 : 18671|15@1+ (0.0001,0) [0|3.1415] "rad" MCU
 SG_ OBJ_Angle_Top_STD_V_19 : 18686|1@1+ (1,0) [0|1] "bool" MCU
 SG_ OBJ_Buffer_C14_19 : 18687|1@1+ (1,0) [0|1] "NA" MCU
 SG_ OBJ_Buffer_C15_19 : 18688|1@1+ (1,0) [0|1] "NA" MCU
 SG_ OBJ_Buffer_C18_19 : 18689|2@1+ (1,0) [0|2] "NA" MCU
 SG_ OBJ_Buffer_C19_19 : 18691|1@1+ (1,0) [0|1] "NA" MCU
 SG_ Reserved_23_19 : 18692|28@1+ (1,0) [0|0] "NA" MCU
 SG_ OBJ_CRC_20 : 18720|32@1+ (1,0) [0|4294967295] "NA" MCU
 SG_ OBJ_ID_20 : 18752|8@1+ (1,0) [0|255] "counter" MCU
 SG_ OBJ_Existence_Probability_20 : 18760|8@1+ (0.01,0) [0|1] "NA" MCU
 SG_ OBJ_Fusion_Source_20 : 18768|16@1+ (1,0) [0|65535] "BITWIZE" MCU
 SG_ OBJ_Triggered_SDM_20 : 18784|2@1+ (1,0) [0|2] "ENUM" MCU
 SG_ OBJ_Motion_Category_20 : 18786|4@1+ (1,0) [0|13] "ENUM" MCU
 SG_ OBJ_Buffer_C0_20 : 18790|7@1+ (0.01,0) [0|1] "NA" MCU
 SG_ OBJ_Object_Age_20 : 18797|11@1+ (1,0) [0|2047] "frames" MCU
 SG_ OBJ_Measuring_Status_20 : 18808|3@1+ (1,0) [0|7] "BITWIZE" MCU
 SG_ OBJ_Object_Class_20 : 18811|4@1+ (1,0) [0|8] "ENUM" MCU
 SG_ Reserved_4_20 : 18815|1@1+ (1,0) [0|0] "NA" MCU
 SG_ OBJ_Class_Probability_20 : 18816|7@1+ (0.01,0) [0|1] "NA" MCU
 SG_ OBJ_Car_Probability_20 : 18823|7@1+ (0.01,0) [0|1] "NA" MCU
 SG_ OBJ_Truck_Probability_20 : 18830|7@1+ (0.01,0) [0|1] "NA" MCU
 SG_ OBJ_Bike_Probability_20 : 18837|7@1+ (0.01,0) [0|1] "NA" MCU
 SG_ OBJ_Camera_Source_20 : 18844|4@1+ (1,0) [0|15] "ENUM" MCU
 SG_ OBJ_Motion_Status_20 : 18848|3@1+ (1,0) [0|5] "ENUM" MCU
 SG_ OBJ_Motion_Orientation_20 : 18851|4@1+ (1,0) [0|13] "ENUM" MCU
 SG_ OBJ_Has_Cut_Lane_20 : 18855|1@1+ (1,0) [0|1] "bool" MCU
 SG_ OBJ_Has_Cut_Path_20 : 18856|1@1+ (1,0) [0|1] "bool" MCU
 SG_ OBJ_Brake_Light_20 : 18857|1@1+ (1,0) [0|1] "bool" MCU
 SG_ OBJ_Turn_Indicator_Right_20 : 18858|1@1+ (1,0) [0|1] "bool" MCU
 SG_ OBJ_Turn_Indicator_Left_20 : 18859|1@1+ (1,0) [0|1] "bool" MCU
 SG_ OBJ_Light_Indicator_Validity_20 : 18860|1@1+ (1,0) [0|1] "bool" MCU
 SG_ OBJ_Right_Out_Of_Image_20 : 18861|1@1+ (1,0) [0|1] "bool" MCU
 SG_ OBJ_Left_Out_Of_Image_20 : 18862|1@1+ (1,0) [0|1] "bool" MCU
 SG_ OBJ_Right_Out_Of_Image_V_20 : 18863|1@1+ (1,0) [0|1] "bool" MCU
 SG_ OBJ_Left_Out_Of_Image_V_20 : 18864|1@1+ (1,0) [0|1] "bool" MCU
 SG_ OBJ_Top_Out_Of_Image_20 : 18865|1@1+ (1,0) [0|1] "bool" MCU
 SG_ OBJ_Bottom_Out_Of_Image_20 : 18866|1@1+ (1,0) [0|1] "bool" MCU
 SG_ OBJ_Top_Out_Of_Image_V_20 : 18867|1@1+ (1,0) [0|1] "bool" MCU
 SG_ OBJ_Bottom_Out_Of_Image_V_20 : 18868|1@1+ (1,0) [0|1] "bool" MCU
 SG_ OBJ_Lane_Assignment_20 : 18869|3@1+ (1,0) [0|5] "ENUM" MCU
 SG_ OBJ_Lane_Assignment_V_20 : 18872|1@1+ (1,0) [0|1] "bool" MCU
 SG_ OBJ_Age_Seconds_20 : 18873|7@1+ (1,0) [0|100] "s" MCU
 SG_ OBJ_Age_Seconds_V_20 : 18880|1@1+ (1,0) [0|1] "bool" MCU
 SG_ OBJ_Width_20 : 18881|9@1+ (0.01,0) [0.4|2.95] "m" MCU
 SG_ OBJ_Width_V_20 : 18890|1@1+ (1,0) [0|1] "bool" MCU
 SG_ OBJ_Width_STD_20 : 18891|11@1+ (0.001,0) [0|2] "m" MCU
 SG_ OBJ_Width_STD_V_20 : 18902|1@1+ (1,0) [0|1] "bool" MCU
 SG_ OBJ_Length_20 : 18903|9@1+ (0.05,0) [1.2|21] "m" MCU
 SG_ OBJ_Length_V_20 : 18912|1@1+ (1,0) [0|1] "bool" MCU
 SG_ OBJ_Length_STD_20 : 18913|10@1+ (0.01,0) [0|10] "m" MCU
 SG_ OBJ_Length_STD_V_20 : 18923|1@1+ (1,0) [0|1] "bool" MCU
 SG_ OBJ_Radar_ID_20 : 18924|8@1+ (1,0) [0|255] "counter" MCU
 SG_ OBJ_Height_20 : 18932|9@1+ (0.01,0) [0|2.95] "m" MCU
 SG_ OBJ_Height_V_20 : 18941|1@1+ (1,0) [0|1] "bool" MCU
 SG_ Reserved_5_20 : 18942|2@1+ (1,0) [0|0] "NA" MCU
 SG_ OBJ_Height_STD_20 : 18944|11@1+ (0.001,0) [0|2] "m" MCU
 SG_ OBJ_Height_STD_V_20 : 18955|1@1+ (1,0) [0|1] "bool" MCU
 SG_ OBJ_Abs_Long_Velocity_20 : 18956|12@1+ (0.05,-100) [-100|100] "m_per_s" MCU
 SG_ OBJ_Abs_Long_Velocity_V_20 : 18968|1@1+ (1,0) [0|1] "bool" MCU
 SG_ Reserved_6_20 : 18969|7@1+ (1,0) [0|0] "NA" MCU
 SG_ OBJ_Abs_Long_Velocity_STD_20 : 18976|13@1+ (0.01,0) [0|65] "m_per_s" MCU
 SG_ OBJ_Abs_Long_Vel_STD_V_20 : 18989|1@1+ (1,0) [0|1] "bool" MCU
 SG_ OBJ_Abs_Lat_Velocity_20 : 18990|11@1+ (0.05,-50) [-50|50] "m_per_s" MCU
 SG_ OBJ_Abs_Lat_Velocity_V_20 : 19001|1@1+ (1,0) [0|1] "bool" MCU
 SG_ Reserved_7_20 : 19002|6@1+ (1,0) [0|0] "NA" MCU
 SG_ OBJ_Abs_Lat_Velocity_STD_20 : 19008|13@1+ (0.01,0) [0|50] "m_per_s" MCU
 SG_ OBJ_Abs_Lat_Vel_STD_V_20 : 19021|1@1+ (1,0) [0|1] "bool" MCU
 SG_ OBJ_Abs_Long_Acc_20 : 19022|9@1+ (0.05,-10) [-10|10] "m_per_s2" MCU
 SG_ OBJ_Abs_Long_Acc_V_20 : 19031|1@1+ (1,0) [0|1] "bool" MCU
 SG_ Reserved_8_20 : 19032|8@1+ (1,0) [0|0] "NA" MCU
 SG_ OBJ_Abs_Long_Acc_STD_20 : 19040|10@1+ (0.01,0) [0|7.3] "m_per_s2" MCU
 SG_ OBJ_Abs_Long_Acc_STD_V_20 : 19050|1@1+ (1,0) [0|1] "bool" MCU
 SG_ OBJ_Abs_Lat_Acc_20 : 19051|9@1+ (0.05,-10) [-10|10] "m_per_s2" MCU
 SG_ OBJ_Abs_Lat_Acc_V_20 : 19060|1@1+ (1,0) [0|1] "bool" MCU
 SG_ OBJ_Abs_Lat_Acc_STD_20 : 19061|10@1+ (0.01,0) [0|7.3] "m_per_s2" MCU
 SG_ OBJ_Abs_Lat_Acc_STD_V_20 : 19071|1@1+ (1,0) [0|1] "bool" MCU
 SG_ OBJ_Abs_Acceleration_20 : 19072|9@1+ (0.05,-12.7) [-12.7|12.7] "m_per_s2" MCU
 SG_ OBJ_Abs_Acceleration_V_20 : 19081|1@1+ (1,0) [0|1] "bool" MCU
 SG_ OBJ_Abs_Acc_STD_20 : 19082|10@1+ (0.01,0) [0|7.3] "m_per_s2" MCU
 SG_ OBJ_Abs_Acc_STD_V_20 : 19092|1@1+ (1,0) [0|1] "bool" MCU
 SG_ OBJ_Inv_TTC_20 : 19093|11@1+ (0.01,-8) [-8|8] "INV(s)" MCU
 SG_ OBJ_Inv_TTC_V_20 : 19104|1@1+ (1,0) [0|1] "bool" MCU
 SG_ OBJ_Inv_TTC_STD_20 : 19105|12@1+ (0.001,0) [0|4] "INV(s)" MCU
 SG_ OBJ_Inv_TTC_STD_V_20 : 19117|1@1+ (1,0) [0|1] "bool" MCU
 SG_ OBJ_Relative_Long_Acc_20 : 19118|10@1+ (0.05,-20) [-20|20] "m_per_s2" MCU
 SG_ OBJ_Relative_Long_Acc_V_20 : 19128|1@1+ (1,0) [0|1] "bool" MCU
 SG_ Reserved_9_20 : 19129|7@1+ (1,0) [0|0] "NA" MCU
 SG_ OBJ_Relative_Long_Acc_STD_20 : 19136|10@1+ (0.01,0) [0|7.3] "m_per_s2" MCU
 SG_ OBJ_Rel_Long_Acc_STD_V_20 : 19146|1@1+ (1,0) [0|1] "bool" MCU
 SG_ OBJ_Relative_Long_Velocity_20 : 19147|13@1+ (0.05,-120) [-120|130] "m_per_s" MCU
 SG_ OBJ_Relative_Long_Velocity_V_20 : 19160|1@1+ (1,0) [0|1] "bool" MCU
 SG_ Reserved_10_20 : 19161|7@1+ (1,0) [0|0] "NA" MCU
 SG_ OBJ_Relative_Long_Vel_STD_20 : 19168|14@1+ (0.01,0) [0|130] "m_per_s" MCU
 SG_ OBJ_Rel_Long_Vel_STD_V_20 : 19182|1@1+ (1,0) [0|1] "bool" MCU
 SG_ OBJ_Relative_Lat_Velocity_20 : 19183|11@1+ (0.05,-50) [-50|50] "m_per_s" MCU
 SG_ OBJ_Relative_Lat_Velocity_V_20 : 19194|1@1+ (1,0) [0|1] "bool" MCU
 SG_ Reserved_11_20 : 19195|5@1+ (1,0) [0|0] "NA" MCU
 SG_ OBJ_Relative_Lat_Velocity_STD_20 : 19200|13@1+ (0.01,0) [0|50] "m_per_s" MCU
 SG_ OBJ_Rel_Lat_Vel_STD_V_20 : 19213|1@1+ (1,0) [0|1] "bool" MCU
 SG_ OBJ_Long_Distance_20 : 19214|14@1+ (0.05,-200) [-200|500] "m" MCU
 SG_ OBJ_Long_Distance_V_20 : 19228|1@1+ (1,0) [0|1] "bool" MCU
 SG_ Reserved_12_20 : 19229|3@1+ (1,0) [0|0] "NA" MCU
 SG_ OBJ_Long_Distance_STD_20 : 19232|15@1+ (0.01,0) [0|250] "m" MCU
 SG_ OBJ_Long_Distance_STD_V_20 : 19247|1@1+ (1,0) [0|1] "bool" MCU
 SG_ OBJ_Lat_Distance_20 : 19248|12@1+ (0.05,-100) [-100|100] "m" MCU
 SG_ OBJ_Lat_Distance_V_20 : 19260|1@1+ (1,0) [0|1] "bool" MCU
 SG_ Reserved_13_20 : 19261|3@1+ (1,0) [0|0] "NA" MCU
 SG_ OBJ_Lat_Distance_STD_20 : 19264|14@1+ (0.01,0) [0|100] "m" MCU
 SG_ OBJ_Lat_Distance_STD_V_20 : 19278|1@1+ (1,0) [0|1] "bool" MCU
 SG_ OBJ_Absolute_Speed_20 : 19279|12@1+ (0.05,-65) [-65|65] "m_per_s" MCU
 SG_ OBJ_Absolute_Speed_V_20 : 19291|1@1+ (1,0) [0|1] "bool" MCU
 SG_ Reserved_14_20 : 19292|4@1+ (1,0) [0|0] "NA" MCU
 SG_ OBJ_Absolute_Speed_STD_20 : 19296|13@1+ (0.01,0) [0|65] "m_per_s" MCU
 SG_ OBJ_Absolute_Speed_STD_V_20 : 19309|1@1+ (1,0) [0|1] "bool" MCU
 SG_ OBJ_Heading_20 : 19310|10@1+ (0.01,-3.14) [-3.14|3.14] "rad" MCU
 SG_ OBJ_Heading_V_20 : 19320|1@1+ (1,0) [0|1] "bool" MCU
 SG_ Reserved_15_20 : 19321|7@1+ (1,0) [0|0] "NA" MCU
 SG_ OBJ_Heading_STD_20 : 19328|15@1+ (0.0001,0) [0|3.14] "rad" MCU
 SG_ OBJ_Heading_STD_V_20 : 19343|1@1+ (1,0) [0|1] "bool" MCU
 SG_ OBJ_Angle_Rate_STD_20 : 19344|15@1+ (0.0001,0) [0|2.2318] "RPS" MCU
 SG_ OBJ_Angle_Rate_STD_V_20 : 19359|1@1+ (1,0) [0|1] "bool" MCU
 SG_ OBJ_Angle_Rate_20 : 19360|12@1+ (0.002,-2.234) [-2.234|2.2318] "RPS" MCU
 SG_ OBJ_Angle_Rate_V_20 : 19372|1@1+ (1,0) [0|1] "bool" MCU
 SG_ OBJ_Angle_Right_20 : 19373|14@1+ (0.0002,-1.571) [-1.571|1.571] "rad" MCU
 SG_ OBJ_Angle_Right_V_20 : 19387|1@1+ (1,0) [0|1] "bool" MCU
 SG_ Reserved_16_20 : 19388|4@1+ (1,0) [0|0] "NA" MCU
 SG_ OBJ_Angle_Right_STD_20 : 19392|14@1+ (0.0001,0) [0|1.571] "rad" MCU
 SG_ OBJ_Angle_Right_STD_V_20 : 19406|1@1+ (1,0) [0|1] "bool" MCU
 SG_ OBJ_Angle_Left_20 : 19407|14@1+ (0.0002,-1.571) [-1.571|1.571] "rad" MCU
 SG_ OBJ_Angle_Left_V_20 : 19421|1@1+ (1,0) [0|1] "bool" MCU
 SG_ Reserved_17_20 : 19422|2@1+ (1,0) [0|0] "NA" MCU
 SG_ OBJ_Angle_Left_STD_20 : 19424|14@1+ (0.0001,0) [0|1.571] "rad" MCU
 SG_ OBJ_Angle_Left_STD_V_20 : 19438|1@1+ (1,0) [0|1] "bool" MCU
 SG_ OBJ_Angle_Side_20 : 19439|14@1+ (0.0002,-1.571) [-1.571|1.571] "rad" MCU
 SG_ OBJ_Angle_Side_V_20 : 19453|1@1+ (1,0) [0|1] "bool" MCU
 SG_ Reserved_18_20 : 19454|2@1+ (1,0) [0|0] "NA" MCU
 SG_ OBJ_Angle_Side_STD_20 : 19456|14@1+ (0.0001,0) [0|1.571] "rad" MCU
 SG_ OBJ_Angle_Side_STD_V_20 : 19470|1@1+ (1,0) [0|1] "bool" MCU
 SG_ OBJ_Angle_Mid_V_20 : 19471|1@1+ (1,0) [0|1] "bool" MCU
 SG_ OBJ_Angle_Mid_20 : 19472|14@1+ (0.0002,-1.571) [-1.571|1.571] "rad" MCU
 SG_ Reserved_19_20 : 19486|2@1+ (1,0) [0|0] "NA" MCU
 SG_ OBJ_Angle_Mid_STD_20 : 19488|14@1+ (0.0001,0) [0|1.571] "rad" MCU
 SG_ OBJ_Angle_Mid_STD_V_20 : 19502|1@1+ (1,0) [0|1] "bool" MCU
 SG_ OBJ_Angle_Bottom_V_20 : 19503|1@1+ (1,0) [0|1] "bool" MCU
 SG_ OBJ_Angle_Bottom_20 : 19504|14@1+ (0.0002,-1.571) [-1.571|1.571] "rad" MCU
 SG_ Reserved_20_20 : 19518|2@1+ (1,0) [0|0] "NA" MCU
 SG_ OBJ_Angle_Bottom_STD_20 : 19520|14@1+ (0.0001,0) [0|1.571] "rad" MCU
 SG_ OBJ_Angle_Bottom_STD_V_20 : 19534|1@1+ (1,0) [0|1] "bool" MCU
 SG_ OBJ_Visibility_Side_V_20 : 19535|1@1+ (1,0) [0|1] "bool" MCU
 SG_ OBJ_Visibility_Side_20 : 19536|2@1+ (1,0) [0|2] "ENUM" MCU
 SG_ OBJ_Is_In_Drivable_Area_20 : 19538|1@1+ (1,0) [0|1] "bool" MCU
 SG_ OBJ_Is_In_Drivable_Area_V_20 : 19539|1@1+ (1,0) [0|1] "bool" MCU
 SG_ OBJ_Is_VeryClose_V_20 : 19540|1@1+ (1,0) [0|1] "bool" MCU
 SG_ OBJ_Is_VeryClose_20 : 19541|1@1+ (1,0) [0|1] "bool" MCU
 SG_ OBJ_Buffer_C4_20 : 19542|2@1+ (1,0) [0|2] "NA" MCU
 SG_ OBJ_Buffer_C5_20 : 19544|2@1+ (1,0) [0|2] "NA" MCU
 SG_ OBJ_Buffer_C6_20 : 19546|2@1+ (1,0) [0|2] "NA" MCU
 SG_ OBJ_Buffer_C7_20 : 19548|2@1+ (1,0) [0|2] "NA" MCU
 SG_ Reserved_21_20 : 19550|2@1+ (1,0) [0|0] "NA" MCU
 SG_ OBJ_OverlapAngleEgoLaneR_20 : 19552|10@1+ (0.01,-3.14) [-3.14|3.14] "rad" MCU
 SG_ OBJ_OverlapAngleEgoLaneR_V_20 : 19562|1@1+ (1,0) [0|1] "bool" MCU
 SG_ OBJ_OverlapAngleEgoLaneL_20 : 19563|10@1+ (0.01,-3.14) [-3.14|3.14] "rad" MCU
 SG_ OBJ_OverlapAngleEgoLaneL_V_20 : 19573|1@1+ (1,0) [0|1] "bool" MCU
 SG_ OBJ_Is_EMERGENCY_VCL_20 : 19574|1@1+ (1,0) [0|1] "bool" MCU
 SG_ OBJ_EMERGENCY_LIGHT_COLOR_20 : 19575|4@1+ (1,0) [0|15] "BITWIZE" MCU
 SG_ OBJ_EMERGENCY_V_20 : 19579|1@1+ (1,0) [0|1] "bool" MCU
 SG_ Reserved_22_20 : 19580|4@1+ (1,0) [0|0] "NA" MCU
 SG_ OBJ_Angle_Top_20 : 19584|14@1+ (0.0002,0) [0|3.1415] "rad" MCU
 SG_ OBJ_Angle_Top_V_20 : 19598|1@1+ (1,0) [0|1] "bool" MCU
 SG_ OBJ_Angle_Top_STD_20 : 19599|15@1+ (0.0001,0) [0|3.1415] "rad" MCU
 SG_ OBJ_Angle_Top_STD_V_20 : 19614|1@1+ (1,0) [0|1] "bool" MCU
 SG_ OBJ_Buffer_C14_20 : 19615|1@1+ (1,0) [0|1] "NA" MCU
 SG_ OBJ_Buffer_C15_20 : 19616|1@1+ (1,0) [0|1] "NA" MCU
 SG_ OBJ_Buffer_C18_20 : 19617|2@1+ (1,0) [0|2] "NA" MCU
 SG_ OBJ_Buffer_C19_20 : 19619|1@1+ (1,0) [0|1] "NA" MCU
 SG_ Reserved_23_20 : 19620|28@1+ (1,0) [0|0] "NA" MCU
 SG_ OBJ_CRC_21 : 19648|32@1+ (1,0) [0|4294967295] "NA" MCU
 SG_ OBJ_ID_21 : 19680|8@1+ (1,0) [0|255] "counter" MCU
 SG_ OBJ_Existence_Probability_21 : 19688|8@1+ (0.01,0) [0|1] "NA" MCU
 SG_ OBJ_Fusion_Source_21 : 19696|16@1+ (1,0) [0|65535] "BITWIZE" MCU
 SG_ OBJ_Triggered_SDM_21 : 19712|2@1+ (1,0) [0|2] "ENUM" MCU
 SG_ OBJ_Motion_Category_21 : 19714|4@1+ (1,0) [0|13] "ENUM" MCU
 SG_ OBJ_Buffer_C0_21 : 19718|7@1+ (0.01,0) [0|1] "NA" MCU
 SG_ OBJ_Object_Age_21 : 19725|11@1+ (1,0) [0|2047] "frames" MCU
 SG_ OBJ_Measuring_Status_21 : 19736|3@1+ (1,0) [0|7] "BITWIZE" MCU
 SG_ OBJ_Object_Class_21 : 19739|4@1+ (1,0) [0|8] "ENUM" MCU
 SG_ Reserved_4_21 : 19743|1@1+ (1,0) [0|0] "NA" MCU
 SG_ OBJ_Class_Probability_21 : 19744|7@1+ (0.01,0) [0|1] "NA" MCU
 SG_ OBJ_Car_Probability_21 : 19751|7@1+ (0.01,0) [0|1] "NA" MCU
 SG_ OBJ_Truck_Probability_21 : 19758|7@1+ (0.01,0) [0|1] "NA" MCU
 SG_ OBJ_Bike_Probability_21 : 19765|7@1+ (0.01,0) [0|1] "NA" MCU
 SG_ OBJ_Camera_Source_21 : 19772|4@1+ (1,0) [0|15] "ENUM" MCU
 SG_ OBJ_Motion_Status_21 : 19776|3@1+ (1,0) [0|5] "ENUM" MCU
 SG_ OBJ_Motion_Orientation_21 : 19779|4@1+ (1,0) [0|13] "ENUM" MCU
 SG_ OBJ_Has_Cut_Lane_21 : 19783|1@1+ (1,0) [0|1] "bool" MCU
 SG_ OBJ_Has_Cut_Path_21 : 19784|1@1+ (1,0) [0|1] "bool" MCU
 SG_ OBJ_Brake_Light_21 : 19785|1@1+ (1,0) [0|1] "bool" MCU
 SG_ OBJ_Turn_Indicator_Right_21 : 19786|1@1+ (1,0) [0|1] "bool" MCU
 SG_ OBJ_Turn_Indicator_Left_21 : 19787|1@1+ (1,0) [0|1] "bool" MCU
 SG_ OBJ_Light_Indicator_Validity_21 : 19788|1@1+ (1,0) [0|1] "bool" MCU
 SG_ OBJ_Right_Out_Of_Image_21 : 19789|1@1+ (1,0) [0|1] "bool" MCU
 SG_ OBJ_Left_Out_Of_Image_21 : 19790|1@1+ (1,0) [0|1] "bool" MCU
 SG_ OBJ_Right_Out_Of_Image_V_21 : 19791|1@1+ (1,0) [0|1] "bool" MCU
 SG_ OBJ_Left_Out_Of_Image_V_21 : 19792|1@1+ (1,0) [0|1] "bool" MCU
 SG_ OBJ_Top_Out_Of_Image_21 : 19793|1@1+ (1,0) [0|1] "bool" MCU
 SG_ OBJ_Bottom_Out_Of_Image_21 : 19794|1@1+ (1,0) [0|1] "bool" MCU
 SG_ OBJ_Top_Out_Of_Image_V_21 : 19795|1@1+ (1,0) [0|1] "bool" MCU
 SG_ OBJ_Bottom_Out_Of_Image_V_21 : 19796|1@1+ (1,0) [0|1] "bool" MCU
 SG_ OBJ_Lane_Assignment_21 : 19797|3@1+ (1,0) [0|5] "ENUM" MCU
 SG_ OBJ_Lane_Assignment_V_21 : 19800|1@1+ (1,0) [0|1] "bool" MCU
 SG_ OBJ_Age_Seconds_21 : 19801|7@1+ (1,0) [0|100] "s" MCU
 SG_ OBJ_Age_Seconds_V_21 : 19808|1@1+ (1,0) [0|1] "bool" MCU
 SG_ OBJ_Width_21 : 19809|9@1+ (0.01,0) [0.4|2.95] "m" MCU
 SG_ OBJ_Width_V_21 : 19818|1@1+ (1,0) [0|1] "bool" MCU
 SG_ OBJ_Width_STD_21 : 19819|11@1+ (0.001,0) [0|2] "m" MCU
 SG_ OBJ_Width_STD_V_21 : 19830|1@1+ (1,0) [0|1] "bool" MCU
 SG_ OBJ_Length_21 : 19831|9@1+ (0.05,0) [1.2|21] "m" MCU
 SG_ OBJ_Length_V_21 : 19840|1@1+ (1,0) [0|1] "bool" MCU
 SG_ OBJ_Length_STD_21 : 19841|10@1+ (0.01,0) [0|10] "m" MCU
 SG_ OBJ_Length_STD_V_21 : 19851|1@1+ (1,0) [0|1] "bool" MCU
 SG_ OBJ_Radar_ID_21 : 19852|8@1+ (1,0) [0|255] "counter" MCU
 SG_ OBJ_Height_21 : 19860|9@1+ (0.01,0) [0|2.95] "m" MCU
 SG_ OBJ_Height_V_21 : 19869|1@1+ (1,0) [0|1] "bool" MCU
 SG_ Reserved_5_21 : 19870|2@1+ (1,0) [0|0] "NA" MCU
 SG_ OBJ_Height_STD_21 : 19872|11@1+ (0.001,0) [0|2] "m" MCU
 SG_ OBJ_Height_STD_V_21 : 19883|1@1+ (1,0) [0|1] "bool" MCU
 SG_ OBJ_Abs_Long_Velocity_21 : 19884|12@1+ (0.05,-100) [-100|100] "m_per_s" MCU
 SG_ OBJ_Abs_Long_Velocity_V_21 : 19896|1@1+ (1,0) [0|1] "bool" MCU
 SG_ Reserved_6_21 : 19897|7@1+ (1,0) [0|0] "NA" MCU
 SG_ OBJ_Abs_Long_Velocity_STD_21 : 19904|13@1+ (0.01,0) [0|65] "m_per_s" MCU
 SG_ OBJ_Abs_Long_Vel_STD_V_21 : 19917|1@1+ (1,0) [0|1] "bool" MCU
 SG_ OBJ_Abs_Lat_Velocity_21 : 19918|11@1+ (0.05,-50) [-50|50] "m_per_s" MCU
 SG_ OBJ_Abs_Lat_Velocity_V_21 : 19929|1@1+ (1,0) [0|1] "bool" MCU
 SG_ Reserved_7_21 : 19930|6@1+ (1,0) [0|0] "NA" MCU
 SG_ OBJ_Abs_Lat_Velocity_STD_21 : 19936|13@1+ (0.01,0) [0|50] "m_per_s" MCU
 SG_ OBJ_Abs_Lat_Vel_STD_V_21 : 19949|1@1+ (1,0) [0|1] "bool" MCU
 SG_ OBJ_Abs_Long_Acc_21 : 19950|9@1+ (0.05,-10) [-10|10] "m_per_s2" MCU
 SG_ OBJ_Abs_Long_Acc_V_21 : 19959|1@1+ (1,0) [0|1] "bool" MCU
 SG_ Reserved_8_21 : 19960|8@1+ (1,0) [0|0] "NA" MCU
 SG_ OBJ_Abs_Long_Acc_STD_21 : 19968|10@1+ (0.01,0) [0|7.3] "m_per_s2" MCU
 SG_ OBJ_Abs_Long_Acc_STD_V_21 : 19978|1@1+ (1,0) [0|1] "bool" MCU
 SG_ OBJ_Abs_Lat_Acc_21 : 19979|9@1+ (0.05,-10) [-10|10] "m_per_s2" MCU
 SG_ OBJ_Abs_Lat_Acc_V_21 : 19988|1@1+ (1,0) [0|1] "bool" MCU
 SG_ OBJ_Abs_Lat_Acc_STD_21 : 19989|10@1+ (0.01,0) [0|7.3] "m_per_s2" MCU
 SG_ OBJ_Abs_Lat_Acc_STD_V_21 : 19999|1@1+ (1,0) [0|1] "bool" MCU
 SG_ OBJ_Abs_Acceleration_21 : 20000|9@1+ (0.05,-12.7) [-12.7|12.7] "m_per_s2" MCU
 SG_ OBJ_Abs_Acceleration_V_21 : 20009|1@1+ (1,0) [0|1] "bool" MCU
 SG_ OBJ_Abs_Acc_STD_21 : 20010|10@1+ (0.01,0) [0|7.3] "m_per_s2" MCU
 SG_ OBJ_Abs_Acc_STD_V_21 : 20020|1@1+ (1,0) [0|1] "bool" MCU
 SG_ OBJ_Inv_TTC_21 : 20021|11@1+ (0.01,-8) [-8|8] "INV(s)" MCU
 SG_ OBJ_Inv_TTC_V_21 : 20032|1@1+ (1,0) [0|1] "bool" MCU
 SG_ OBJ_Inv_TTC_STD_21 : 20033|12@1+ (0.001,0) [0|4] "INV(s)" MCU
 SG_ OBJ_Inv_TTC_STD_V_21 : 20045|1@1+ (1,0) [0|1] "bool" MCU
 SG_ OBJ_Relative_Long_Acc_21 : 20046|10@1+ (0.05,-20) [-20|20] "m_per_s2" MCU
 SG_ OBJ_Relative_Long_Acc_V_21 : 20056|1@1+ (1,0) [0|1] "bool" MCU
 SG_ Reserved_9_21 : 20057|7@1+ (1,0) [0|0] "NA" MCU
 SG_ OBJ_Relative_Long_Acc_STD_21 : 20064|10@1+ (0.01,0) [0|7.3] "m_per_s2" MCU
 SG_ OBJ_Rel_Long_Acc_STD_V_21 : 20074|1@1+ (1,0) [0|1] "bool" MCU
 SG_ OBJ_Relative_Long_Velocity_21 : 20075|13@1+ (0.05,-120) [-120|130] "m_per_s" MCU
 SG_ OBJ_Relative_Long_Velocity_V_21 : 20088|1@1+ (1,0) [0|1] "bool" MCU
 SG_ Reserved_10_21 : 20089|7@1+ (1,0) [0|0] "NA" MCU
 SG_ OBJ_Relative_Long_Vel_STD_21 : 20096|14@1+ (0.01,0) [0|130] "m_per_s" MCU
 SG_ OBJ_Rel_Long_Vel_STD_V_21 : 20110|1@1+ (1,0) [0|1] "bool" MCU
 SG_ OBJ_Relative_Lat_Velocity_21 : 20111|11@1+ (0.05,-50) [-50|50] "m_per_s" MCU
 SG_ OBJ_Relative_Lat_Velocity_V_21 : 20122|1@1+ (1,0) [0|1] "bool" MCU
 SG_ Reserved_11_21 : 20123|5@1+ (1,0) [0|0] "NA" MCU
 SG_ OBJ_Relative_Lat_Velocity_STD_21 : 20128|13@1+ (0.01,0) [0|50] "m_per_s" MCU
 SG_ OBJ_Rel_Lat_Vel_STD_V_21 : 20141|1@1+ (1,0) [0|1] "bool" MCU
 SG_ OBJ_Long_Distance_21 : 20142|14@1+ (0.05,-200) [-200|500] "m" MCU
 SG_ OBJ_Long_Distance_V_21 : 20156|1@1+ (1,0) [0|1] "bool" MCU
 SG_ Reserved_12_21 : 20157|3@1+ (1,0) [0|0] "NA" MCU
 SG_ OBJ_Long_Distance_STD_21 : 20160|15@1+ (0.01,0) [0|250] "m" MCU
 SG_ OBJ_Long_Distance_STD_V_21 : 20175|1@1+ (1,0) [0|1] "bool" MCU
 SG_ OBJ_Lat_Distance_21 : 20176|12@1+ (0.05,-100) [-100|100] "m" MCU
 SG_ OBJ_Lat_Distance_V_21 : 20188|1@1+ (1,0) [0|1] "bool" MCU
 SG_ Reserved_13_21 : 20189|3@1+ (1,0) [0|0] "NA" MCU
 SG_ OBJ_Lat_Distance_STD_21 : 20192|14@1+ (0.01,0) [0|100] "m" MCU
 SG_ OBJ_Lat_Distance_STD_V_21 : 20206|1@1+ (1,0) [0|1] "bool" MCU
 SG_ OBJ_Absolute_Speed_21 : 20207|12@1+ (0.05,-65) [-65|65] "m_per_s" MCU
 SG_ OBJ_Absolute_Speed_V_21 : 20219|1@1+ (1,0) [0|1] "bool" MCU
 SG_ Reserved_14_21 : 20220|4@1+ (1,0) [0|0] "NA" MCU
 SG_ OBJ_Absolute_Speed_STD_21 : 20224|13@1+ (0.01,0) [0|65] "m_per_s" MCU
 SG_ OBJ_Absolute_Speed_STD_V_21 : 20237|1@1+ (1,0) [0|1] "bool" MCU
 SG_ OBJ_Heading_21 : 20238|10@1+ (0.01,-3.14) [-3.14|3.14] "rad" MCU
 SG_ OBJ_Heading_V_21 : 20248|1@1+ (1,0) [0|1] "bool" MCU
 SG_ Reserved_15_21 : 20249|7@1+ (1,0) [0|0] "NA" MCU
 SG_ OBJ_Heading_STD_21 : 20256|15@1+ (0.0001,0) [0|3.14] "rad" MCU
 SG_ OBJ_Heading_STD_V_21 : 20271|1@1+ (1,0) [0|1] "bool" MCU
 SG_ OBJ_Angle_Rate_STD_21 : 20272|15@1+ (0.0001,0) [0|2.2318] "RPS" MCU
 SG_ OBJ_Angle_Rate_STD_V_21 : 20287|1@1+ (1,0) [0|1] "bool" MCU
 SG_ OBJ_Angle_Rate_21 : 20288|12@1+ (0.002,-2.234) [-2.234|2.2318] "RPS" MCU
 SG_ OBJ_Angle_Rate_V_21 : 20300|1@1+ (1,0) [0|1] "bool" MCU
 SG_ OBJ_Angle_Right_21 : 20301|14@1+ (0.0002,-1.571) [-1.571|1.571] "rad" MCU
 SG_ OBJ_Angle_Right_V_21 : 20315|1@1+ (1,0) [0|1] "bool" MCU
 SG_ Reserved_16_21 : 20316|4@1+ (1,0) [0|0] "NA" MCU
 SG_ OBJ_Angle_Right_STD_21 : 20320|14@1+ (0.0001,0) [0|1.571] "rad" MCU
 SG_ OBJ_Angle_Right_STD_V_21 : 20334|1@1+ (1,0) [0|1] "bool" MCU
 SG_ OBJ_Angle_Left_21 : 20335|14@1+ (0.0002,-1.571) [-1.571|1.571] "rad" MCU
 SG_ OBJ_Angle_Left_V_21 : 20349|1@1+ (1,0) [0|1] "bool" MCU
 SG_ Reserved_17_21 : 20350|2@1+ (1,0) [0|0] "NA" MCU
 SG_ OBJ_Angle_Left_STD_21 : 20352|14@1+ (0.0001,0) [0|1.571] "rad" MCU
 SG_ OBJ_Angle_Left_STD_V_21 : 20366|1@1+ (1,0) [0|1] "bool" MCU
 SG_ OBJ_Angle_Side_21 : 20367|14@1+ (0.0002,-1.571) [-1.571|1.571] "rad" MCU
 SG_ OBJ_Angle_Side_V_21 : 20381|1@1+ (1,0) [0|1] "bool" MCU
 SG_ Reserved_18_21 : 20382|2@1+ (1,0) [0|0] "NA" MCU
 SG_ OBJ_Angle_Side_STD_21 : 20384|14@1+ (0.0001,0) [0|1.571] "rad" MCU
 SG_ OBJ_Angle_Side_STD_V_21 : 20398|1@1+ (1,0) [0|1] "bool" MCU
 SG_ OBJ_Angle_Mid_V_21 : 20399|1@1+ (1,0) [0|1] "bool" MCU
 SG_ OBJ_Angle_Mid_21 : 20400|14@1+ (0.0002,-1.571) [-1.571|1.571] "rad" MCU
 SG_ Reserved_19_21 : 20414|2@1+ (1,0) [0|0] "NA" MCU
 SG_ OBJ_Angle_Mid_STD_21 : 20416|14@1+ (0.0001,0) [0|1.571] "rad" MCU
 SG_ OBJ_Angle_Mid_STD_V_21 : 20430|1@1+ (1,0) [0|1] "bool" MCU
 SG_ OBJ_Angle_Bottom_V_21 : 20431|1@1+ (1,0) [0|1] "bool" MCU
 SG_ OBJ_Angle_Bottom_21 : 20432|14@1+ (0.0002,-1.571) [-1.571|1.571] "rad" MCU
 SG_ Reserved_20_21 : 20446|2@1+ (1,0) [0|0] "NA" MCU
 SG_ OBJ_Angle_Bottom_STD_21 : 20448|14@1+ (0.0001,0) [0|1.571] "rad" MCU
 SG_ OBJ_Angle_Bottom_STD_V_21 : 20462|1@1+ (1,0) [0|1] "bool" MCU
 SG_ OBJ_Visibility_Side_V_21 : 20463|1@1+ (1,0) [0|1] "bool" MCU
 SG_ OBJ_Visibility_Side_21 : 20464|2@1+ (1,0) [0|2] "ENUM" MCU
 SG_ OBJ_Is_In_Drivable_Area_21 : 20466|1@1+ (1,0) [0|1] "bool" MCU
 SG_ OBJ_Is_In_Drivable_Area_V_21 : 20467|1@1+ (1,0) [0|1] "bool" MCU
 SG_ OBJ_Is_VeryClose_V_21 : 20468|1@1+ (1,0) [0|1] "bool" MCU
 SG_ OBJ_Is_VeryClose_21 : 20469|1@1+ (1,0) [0|1] "bool" MCU
 SG_ OBJ_Buffer_C4_21 : 20470|2@1+ (1,0) [0|2] "NA" MCU
 SG_ OBJ_Buffer_C5_21 : 20472|2@1+ (1,0) [0|2] "NA" MCU
 SG_ OBJ_Buffer_C6_21 : 20474|2@1+ (1,0) [0|2] "NA" MCU
 SG_ OBJ_Buffer_C7_21 : 20476|2@1+ (1,0) [0|2] "NA" MCU
 SG_ Reserved_21_21 : 20478|2@1+ (1,0) [0|0] "NA" MCU
 SG_ OBJ_OverlapAngleEgoLaneR_21 : 20480|10@1+ (0.01,-3.14) [-3.14|3.14] "rad" MCU
 SG_ OBJ_OverlapAngleEgoLaneR_V_21 : 20490|1@1+ (1,0) [0|1] "bool" MCU
 SG_ OBJ_OverlapAngleEgoLaneL_21 : 20491|10@1+ (0.01,-3.14) [-3.14|3.14] "rad" MCU
 SG_ OBJ_OverlapAngleEgoLaneL_V_21 : 20501|1@1+ (1,0) [0|1] "bool" MCU
 SG_ OBJ_Is_EMERGENCY_VCL_21 : 20502|1@1+ (1,0) [0|1] "bool" MCU
 SG_ OBJ_EMERGENCY_LIGHT_COLOR_21 : 20503|4@1+ (1,0) [0|15] "BITWIZE" MCU
 SG_ OBJ_EMERGENCY_V_21 : 20507|1@1+ (1,0) [0|1] "bool" MCU
 SG_ Reserved_22_21 : 20508|4@1+ (1,0) [0|0] "NA" MCU
 SG_ OBJ_Angle_Top_21 : 20512|14@1+ (0.0002,0) [0|3.1415] "rad" MCU
 SG_ OBJ_Angle_Top_V_21 : 20526|1@1+ (1,0) [0|1] "bool" MCU
 SG_ OBJ_Angle_Top_STD_21 : 20527|15@1+ (0.0001,0) [0|3.1415] "rad" MCU
 SG_ OBJ_Angle_Top_STD_V_21 : 20542|1@1+ (1,0) [0|1] "bool" MCU
 SG_ OBJ_Buffer_C14_21 : 20543|1@1+ (1,0) [0|1] "NA" MCU
 SG_ OBJ_Buffer_C15_21 : 20544|1@1+ (1,0) [0|1] "NA" MCU
 SG_ OBJ_Buffer_C18_21 : 20545|2@1+ (1,0) [0|2] "NA" MCU
 SG_ OBJ_Buffer_C19_21 : 20547|1@1+ (1,0) [0|1] "NA" MCU
 SG_ Reserved_23_21 : 20548|28@1+ (1,0) [0|0] "NA" MCU
 SG_ OBJ_CRC_22 : 20576|32@1+ (1,0) [0|4294967295] "NA" MCU
 SG_ OBJ_ID_22 : 20608|8@1+ (1,0) [0|255] "counter" MCU
 SG_ OBJ_Existence_Probability_22 : 20616|8@1+ (0.01,0) [0|1] "NA" MCU
 SG_ OBJ_Fusion_Source_22 : 20624|16@1+ (1,0) [0|65535] "BITWIZE" MCU
 SG_ OBJ_Triggered_SDM_22 : 20640|2@1+ (1,0) [0|2] "ENUM" MCU
 SG_ OBJ_Motion_Category_22 : 20642|4@1+ (1,0) [0|13] "ENUM" MCU
 SG_ OBJ_Buffer_C0_22 : 20646|7@1+ (0.01,0) [0|1] "NA" MCU
 SG_ OBJ_Object_Age_22 : 20653|11@1+ (1,0) [0|2047] "frames" MCU
 SG_ OBJ_Measuring_Status_22 : 20664|3@1+ (1,0) [0|7] "BITWIZE" MCU
 SG_ OBJ_Object_Class_22 : 20667|4@1+ (1,0) [0|8] "ENUM" MCU
 SG_ Reserved_4_22 : 20671|1@1+ (1,0) [0|0] "NA" MCU
 SG_ OBJ_Class_Probability_22 : 20672|7@1+ (0.01,0) [0|1] "NA" MCU
 SG_ OBJ_Car_Probability_22 : 20679|7@1+ (0.01,0) [0|1] "NA" MCU
 SG_ OBJ_Truck_Probability_22 : 20686|7@1+ (0.01,0) [0|1] "NA" MCU
 SG_ OBJ_Bike_Probability_22 : 20693|7@1+ (0.01,0) [0|1] "NA" MCU
 SG_ OBJ_Camera_Source_22 : 20700|4@1+ (1,0) [0|15] "ENUM" MCU
 SG_ OBJ_Motion_Status_22 : 20704|3@1+ (1,0) [0|5] "ENUM" MCU
 SG_ OBJ_Motion_Orientation_22 : 20707|4@1+ (1,0) [0|13] "ENUM" MCU
 SG_ OBJ_Has_Cut_Lane_22 : 20711|1@1+ (1,0) [0|1] "bool" MCU
 SG_ OBJ_Has_Cut_Path_22 : 20712|1@1+ (1,0) [0|1] "bool" MCU
 SG_ OBJ_Brake_Light_22 : 20713|1@1+ (1,0) [0|1] "bool" MCU
 SG_ OBJ_Turn_Indicator_Right_22 : 20714|1@1+ (1,0) [0|1] "bool" MCU
 SG_ OBJ_Turn_Indicator_Left_22 : 20715|1@1+ (1,0) [0|1] "bool" MCU
 SG_ OBJ_Light_Indicator_Validity_22 : 20716|1@1+ (1,0) [0|1] "bool" MCU
 SG_ OBJ_Right_Out_Of_Image_22 : 20717|1@1+ (1,0) [0|1] "bool" MCU
 SG_ OBJ_Left_Out_Of_Image_22 : 20718|1@1+ (1,0) [0|1] "bool" MCU
 SG_ OBJ_Right_Out_Of_Image_V_22 : 20719|1@1+ (1,0) [0|1] "bool" MCU
 SG_ OBJ_Left_Out_Of_Image_V_22 : 20720|1@1+ (1,0) [0|1] "bool" MCU
 SG_ OBJ_Top_Out_Of_Image_22 : 20721|1@1+ (1,0) [0|1] "bool" MCU
 SG_ OBJ_Bottom_Out_Of_Image_22 : 20722|1@1+ (1,0) [0|1] "bool" MCU
 SG_ OBJ_Top_Out_Of_Image_V_22 : 20723|1@1+ (1,0) [0|1] "bool" MCU
 SG_ OBJ_Bottom_Out_Of_Image_V_22 : 20724|1@1+ (1,0) [0|1] "bool" MCU
 SG_ OBJ_Lane_Assignment_22 : 20725|3@1+ (1,0) [0|5] "ENUM" MCU
 SG_ OBJ_Lane_Assignment_V_22 : 20728|1@1+ (1,0) [0|1] "bool" MCU
 SG_ OBJ_Age_Seconds_22 : 20729|7@1+ (1,0) [0|100] "s" MCU
 SG_ OBJ_Age_Seconds_V_22 : 20736|1@1+ (1,0) [0|1] "bool" MCU
 SG_ OBJ_Width_22 : 20737|9@1+ (0.01,0) [0.4|2.95] "m" MCU
 SG_ OBJ_Width_V_22 : 20746|1@1+ (1,0) [0|1] "bool" MCU
 SG_ OBJ_Width_STD_22 : 20747|11@1+ (0.001,0) [0|2] "m" MCU
 SG_ OBJ_Width_STD_V_22 : 20758|1@1+ (1,0) [0|1] "bool" MCU
 SG_ OBJ_Length_22 : 20759|9@1+ (0.05,0) [1.2|21] "m" MCU
 SG_ OBJ_Length_V_22 : 20768|1@1+ (1,0) [0|1] "bool" MCU
 SG_ OBJ_Length_STD_22 : 20769|10@1+ (0.01,0) [0|10] "m" MCU
 SG_ OBJ_Length_STD_V_22 : 20779|1@1+ (1,0) [0|1] "bool" MCU
 SG_ OBJ_Radar_ID_22 : 20780|8@1+ (1,0) [0|255] "counter" MCU
 SG_ OBJ_Height_22 : 20788|9@1+ (0.01,0) [0|2.95] "m" MCU
 SG_ OBJ_Height_V_22 : 20797|1@1+ (1,0) [0|1] "bool" MCU
 SG_ Reserved_5_22 : 20798|2@1+ (1,0) [0|0] "NA" MCU
 SG_ OBJ_Height_STD_22 : 20800|11@1+ (0.001,0) [0|2] "m" MCU
 SG_ OBJ_Height_STD_V_22 : 20811|1@1+ (1,0) [0|1] "bool" MCU
 SG_ OBJ_Abs_Long_Velocity_22 : 20812|12@1+ (0.05,-100) [-100|100] "m_per_s" MCU
 SG_ OBJ_Abs_Long_Velocity_V_22 : 20824|1@1+ (1,0) [0|1] "bool" MCU
 SG_ Reserved_6_22 : 20825|7@1+ (1,0) [0|0] "NA" MCU
 SG_ OBJ_Abs_Long_Velocity_STD_22 : 20832|13@1+ (0.01,0) [0|65] "m_per_s" MCU
 SG_ OBJ_Abs_Long_Vel_STD_V_22 : 20845|1@1+ (1,0) [0|1] "bool" MCU
 SG_ OBJ_Abs_Lat_Velocity_22 : 20846|11@1+ (0.05,-50) [-50|50] "m_per_s" MCU
 SG_ OBJ_Abs_Lat_Velocity_V_22 : 20857|1@1+ (1,0) [0|1] "bool" MCU
 SG_ Reserved_7_22 : 20858|6@1+ (1,0) [0|0] "NA" MCU
 SG_ OBJ_Abs_Lat_Velocity_STD_22 : 20864|13@1+ (0.01,0) [0|50] "m_per_s" MCU
 SG_ OBJ_Abs_Lat_Vel_STD_V_22 : 20877|1@1+ (1,0) [0|1] "bool" MCU
 SG_ OBJ_Abs_Long_Acc_22 : 20878|9@1+ (0.05,-10) [-10|10] "m_per_s2" MCU
 SG_ OBJ_Abs_Long_Acc_V_22 : 20887|1@1+ (1,0) [0|1] "bool" MCU
 SG_ Reserved_8_22 : 20888|8@1+ (1,0) [0|0] "NA" MCU
 SG_ OBJ_Abs_Long_Acc_STD_22 : 20896|10@1+ (0.01,0) [0|7.3] "m_per_s2" MCU
 SG_ OBJ_Abs_Long_Acc_STD_V_22 : 20906|1@1+ (1,0) [0|1] "bool" MCU
 SG_ OBJ_Abs_Lat_Acc_22 : 20907|9@1+ (0.05,-10) [-10|10] "m_per_s2" MCU
 SG_ OBJ_Abs_Lat_Acc_V_22 : 20916|1@1+ (1,0) [0|1] "bool" MCU
 SG_ OBJ_Abs_Lat_Acc_STD_22 : 20917|10@1+ (0.01,0) [0|7.3] "m_per_s2" MCU
 SG_ OBJ_Abs_Lat_Acc_STD_V_22 : 20927|1@1+ (1,0) [0|1] "bool" MCU
 SG_ OBJ_Abs_Acceleration_22 : 20928|9@1+ (0.05,-12.7) [-12.7|12.7] "m_per_s2" MCU
 SG_ OBJ_Abs_Acceleration_V_22 : 20937|1@1+ (1,0) [0|1] "bool" MCU
 SG_ OBJ_Abs_Acc_STD_22 : 20938|10@1+ (0.01,0) [0|7.3] "m_per_s2" MCU
 SG_ OBJ_Abs_Acc_STD_V_22 : 20948|1@1+ (1,0) [0|1] "bool" MCU
 SG_ OBJ_Inv_TTC_22 : 20949|11@1+ (0.01,-8) [-8|8] "INV(s)" MCU
 SG_ OBJ_Inv_TTC_V_22 : 20960|1@1+ (1,0) [0|1] "bool" MCU
 SG_ OBJ_Inv_TTC_STD_22 : 20961|12@1+ (0.001,0) [0|4] "INV(s)" MCU
 SG_ OBJ_Inv_TTC_STD_V_22 : 20973|1@1+ (1,0) [0|1] "bool" MCU
 SG_ OBJ_Relative_Long_Acc_22 : 20974|10@1+ (0.05,-20) [-20|20] "m_per_s2" MCU
 SG_ OBJ_Relative_Long_Acc_V_22 : 20984|1@1+ (1,0) [0|1] "bool" MCU
 SG_ Reserved_9_22 : 20985|7@1+ (1,0) [0|0] "NA" MCU
 SG_ OBJ_Relative_Long_Acc_STD_22 : 20992|10@1+ (0.01,0) [0|7.3] "m_per_s2" MCU
 SG_ OBJ_Rel_Long_Acc_STD_V_22 : 21002|1@1+ (1,0) [0|1] "bool" MCU
 SG_ OBJ_Relative_Long_Velocity_22 : 21003|13@1+ (0.05,-120) [-120|130] "m_per_s" MCU
 SG_ OBJ_Relative_Long_Velocity_V_22 : 21016|1@1+ (1,0) [0|1] "bool" MCU
 SG_ Reserved_10_22 : 21017|7@1+ (1,0) [0|0] "NA" MCU
 SG_ OBJ_Relative_Long_Vel_STD_22 : 21024|14@1+ (0.01,0) [0|130] "m_per_s" MCU
 SG_ OBJ_Rel_Long_Vel_STD_V_22 : 21038|1@1+ (1,0) [0|1] "bool" MCU
 SG_ OBJ_Relative_Lat_Velocity_22 : 21039|11@1+ (0.05,-50) [-50|50] "m_per_s" MCU
 SG_ OBJ_Relative_Lat_Velocity_V_22 : 21050|1@1+ (1,0) [0|1] "bool" MCU
 SG_ Reserved_11_22 : 21051|5@1+ (1,0) [0|0] "NA" MCU
 SG_ OBJ_Relative_Lat_Velocity_STD_22 : 21056|13@1+ (0.01,0) [0|50] "m_per_s" MCU
 SG_ OBJ_Rel_Lat_Vel_STD_V_22 : 21069|1@1+ (1,0) [0|1] "bool" MCU
 SG_ OBJ_Long_Distance_22 : 21070|14@1+ (0.05,-200) [-200|500] "m" MCU
 SG_ OBJ_Long_Distance_V_22 : 21084|1@1+ (1,0) [0|1] "bool" MCU
 SG_ Reserved_12_22 : 21085|3@1+ (1,0) [0|0] "NA" MCU
 SG_ OBJ_Long_Distance_STD_22 : 21088|15@1+ (0.01,0) [0|250] "m" MCU
 SG_ OBJ_Long_Distance_STD_V_22 : 21103|1@1+ (1,0) [0|1] "bool" MCU
 SG_ OBJ_Lat_Distance_22 : 21104|12@1+ (0.05,-100) [-100|100] "m" MCU
 SG_ OBJ_Lat_Distance_V_22 : 21116|1@1+ (1,0) [0|1] "bool" MCU
 SG_ Reserved_13_22 : 21117|3@1+ (1,0) [0|0] "NA" MCU
 SG_ OBJ_Lat_Distance_STD_22 : 21120|14@1+ (0.01,0) [0|100] "m" MCU
 SG_ OBJ_Lat_Distance_STD_V_22 : 21134|1@1+ (1,0) [0|1] "bool" MCU
 SG_ OBJ_Absolute_Speed_22 : 21135|12@1+ (0.05,-65) [-65|65] "m_per_s" MCU
 SG_ OBJ_Absolute_Speed_V_22 : 21147|1@1+ (1,0) [0|1] "bool" MCU
 SG_ Reserved_14_22 : 21148|4@1+ (1,0) [0|0] "NA" MCU
 SG_ OBJ_Absolute_Speed_STD_22 : 21152|13@1+ (0.01,0) [0|65] "m_per_s" MCU
 SG_ OBJ_Absolute_Speed_STD_V_22 : 21165|1@1+ (1,0) [0|1] "bool" MCU
 SG_ OBJ_Heading_22 : 21166|10@1+ (0.01,-3.14) [-3.14|3.14] "rad" MCU
 SG_ OBJ_Heading_V_22 : 21176|1@1+ (1,0) [0|1] "bool" MCU
 SG_ Reserved_15_22 : 21177|7@1+ (1,0) [0|0] "NA" MCU
 SG_ OBJ_Heading_STD_22 : 21184|15@1+ (0.0001,0) [0|3.14] "rad" MCU
 SG_ OBJ_Heading_STD_V_22 : 21199|1@1+ (1,0) [0|1] "bool" MCU
 SG_ OBJ_Angle_Rate_STD_22 : 21200|15@1+ (0.0001,0) [0|2.2318] "RPS" MCU
 SG_ OBJ_Angle_Rate_STD_V_22 : 21215|1@1+ (1,0) [0|1] "bool" MCU
 SG_ OBJ_Angle_Rate_22 : 21216|12@1+ (0.002,-2.234) [-2.234|2.2318] "RPS" MCU
 SG_ OBJ_Angle_Rate_V_22 : 21228|1@1+ (1,0) [0|1] "bool" MCU
 SG_ OBJ_Angle_Right_22 : 21229|14@1+ (0.0002,-1.571) [-1.571|1.571] "rad" MCU
 SG_ OBJ_Angle_Right_V_22 : 21243|1@1+ (1,0) [0|1] "bool" MCU
 SG_ Reserved_16_22 : 21244|4@1+ (1,0) [0|0] "NA" MCU
 SG_ OBJ_Angle_Right_STD_22 : 21248|14@1+ (0.0001,0) [0|1.571] "rad" MCU
 SG_ OBJ_Angle_Right_STD_V_22 : 21262|1@1+ (1,0) [0|1] "bool" MCU
 SG_ OBJ_Angle_Left_22 : 21263|14@1+ (0.0002,-1.571) [-1.571|1.571] "rad" MCU
 SG_ OBJ_Angle_Left_V_22 : 21277|1@1+ (1,0) [0|1] "bool" MCU
 SG_ Reserved_17_22 : 21278|2@1+ (1,0) [0|0] "NA" MCU
 SG_ OBJ_Angle_Left_STD_22 : 21280|14@1+ (0.0001,0) [0|1.571] "rad" MCU
 SG_ OBJ_Angle_Left_STD_V_22 : 21294|1@1+ (1,0) [0|1] "bool" MCU
 SG_ OBJ_Angle_Side_22 : 21295|14@1+ (0.0002,-1.571) [-1.571|1.571] "rad" MCU
 SG_ OBJ_Angle_Side_V_22 : 21309|1@1+ (1,0) [0|1] "bool" MCU
 SG_ Reserved_18_22 : 21310|2@1+ (1,0) [0|0] "NA" MCU
 SG_ OBJ_Angle_Side_STD_22 : 21312|14@1+ (0.0001,0) [0|1.571] "rad" MCU
 SG_ OBJ_Angle_Side_STD_V_22 : 21326|1@1+ (1,0) [0|1] "bool" MCU
 SG_ OBJ_Angle_Mid_V_22 : 21327|1@1+ (1,0) [0|1] "bool" MCU
 SG_ OBJ_Angle_Mid_22 : 21328|14@1+ (0.0002,-1.571) [-1.571|1.571] "rad" MCU
 SG_ Reserved_19_22 : 21342|2@1+ (1,0) [0|0] "NA" MCU
 SG_ OBJ_Angle_Mid_STD_22 : 21344|14@1+ (0.0001,0) [0|1.571] "rad" MCU
 SG_ OBJ_Angle_Mid_STD_V_22 : 21358|1@1+ (1,0) [0|1] "bool" MCU
 SG_ OBJ_Angle_Bottom_V_22 : 21359|1@1+ (1,0) [0|1] "bool" MCU
 SG_ OBJ_Angle_Bottom_22 : 21360|14@1+ (0.0002,-1.571) [-1.571|1.571] "rad" MCU
 SG_ Reserved_20_22 : 21374|2@1+ (1,0) [0|0] "NA" MCU
 SG_ OBJ_Angle_Bottom_STD_22 : 21376|14@1+ (0.0001,0) [0|1.571] "rad" MCU
 SG_ OBJ_Angle_Bottom_STD_V_22 : 21390|1@1+ (1,0) [0|1] "bool" MCU
 SG_ OBJ_Visibility_Side_V_22 : 21391|1@1+ (1,0) [0|1] "bool" MCU
 SG_ OBJ_Visibility_Side_22 : 21392|2@1+ (1,0) [0|2] "ENUM" MCU
 SG_ OBJ_Is_In_Drivable_Area_22 : 21394|1@1+ (1,0) [0|1] "bool" MCU
 SG_ OBJ_Is_In_Drivable_Area_V_22 : 21395|1@1+ (1,0) [0|1] "bool" MCU
 SG_ OBJ_Is_VeryClose_V_22 : 21396|1@1+ (1,0) [0|1] "bool" MCU
 SG_ OBJ_Is_VeryClose_22 : 21397|1@1+ (1,0) [0|1] "bool" MCU
 SG_ OBJ_Buffer_C4_22 : 21398|2@1+ (1,0) [0|2] "NA" MCU
 SG_ OBJ_Buffer_C5_22 : 21400|2@1+ (1,0) [0|2] "NA" MCU
 SG_ OBJ_Buffer_C6_22 : 21402|2@1+ (1,0) [0|2] "NA" MCU
 SG_ OBJ_Buffer_C7_22 : 21404|2@1+ (1,0) [0|2] "NA" MCU
 SG_ Reserved_21_22 : 21406|2@1+ (1,0) [0|0] "NA" MCU
 SG_ OBJ_OverlapAngleEgoLaneR_22 : 21408|10@1+ (0.01,-3.14) [-3.14|3.14] "rad" MCU
 SG_ OBJ_OverlapAngleEgoLaneR_V_22 : 21418|1@1+ (1,0) [0|1] "bool" MCU
 SG_ OBJ_OverlapAngleEgoLaneL_22 : 21419|10@1+ (0.01,-3.14) [-3.14|3.14] "rad" MCU
 SG_ OBJ_OverlapAngleEgoLaneL_V_22 : 21429|1@1+ (1,0) [0|1] "bool" MCU
 SG_ OBJ_Is_EMERGENCY_VCL_22 : 21430|1@1+ (1,0) [0|1] "bool" MCU
 SG_ OBJ_EMERGENCY_LIGHT_COLOR_22 : 21431|4@1+ (1,0) [0|15] "BITWIZE" MCU
 SG_ OBJ_EMERGENCY_V_22 : 21435|1@1+ (1,0) [0|1] "bool" MCU
 SG_ Reserved_22_22 : 21436|4@1+ (1,0) [0|0] "NA" MCU
 SG_ OBJ_Angle_Top_22 : 21440|14@1+ (0.0002,0) [0|3.1415] "rad" MCU
 SG_ OBJ_Angle_Top_V_22 : 21454|1@1+ (1,0) [0|1] "bool" MCU
 SG_ OBJ_Angle_Top_STD_22 : 21455|15@1+ (0.0001,0) [0|3.1415] "rad" MCU
 SG_ OBJ_Angle_Top_STD_V_22 : 21470|1@1+ (1,0) [0|1] "bool" MCU
 SG_ OBJ_Buffer_C14_22 : 21471|1@1+ (1,0) [0|1] "NA" MCU
 SG_ OBJ_Buffer_C15_22 : 21472|1@1+ (1,0) [0|1] "NA" MCU
 SG_ OBJ_Buffer_C18_22 : 21473|2@1+ (1,0) [0|2] "NA" MCU
 SG_ OBJ_Buffer_C19_22 : 21475|1@1+ (1,0) [0|1] "NA" MCU
 SG_ Reserved_23_22 : 21476|28@1+ (1,0) [0|0] "NA" MCU
 SG_ OBJ_CRC_23 : 21504|32@1+ (1,0) [0|4294967295] "NA" MCU
 SG_ OBJ_ID_23 : 21536|8@1+ (1,0) [0|255] "counter" MCU
 SG_ OBJ_Existence_Probability_23 : 21544|8@1+ (0.01,0) [0|1] "NA" MCU
 SG_ OBJ_Fusion_Source_23 : 21552|16@1+ (1,0) [0|65535] "BITWIZE" MCU
 SG_ OBJ_Triggered_SDM_23 : 21568|2@1+ (1,0) [0|2] "ENUM" MCU
 SG_ OBJ_Motion_Category_23 : 21570|4@1+ (1,0) [0|13] "ENUM" MCU
 SG_ OBJ_Buffer_C0_23 : 21574|7@1+ (0.01,0) [0|1] "NA" MCU
 SG_ OBJ_Object_Age_23 : 21581|11@1+ (1,0) [0|2047] "frames" MCU
 SG_ OBJ_Measuring_Status_23 : 21592|3@1+ (1,0) [0|7] "BITWIZE" MCU
 SG_ OBJ_Object_Class_23 : 21595|4@1+ (1,0) [0|8] "ENUM" MCU
 SG_ Reserved_4_23 : 21599|1@1+ (1,0) [0|0] "NA" MCU
 SG_ OBJ_Class_Probability_23 : 21600|7@1+ (0.01,0) [0|1] "NA" MCU
 SG_ OBJ_Car_Probability_23 : 21607|7@1+ (0.01,0) [0|1] "NA" MCU
 SG_ OBJ_Truck_Probability_23 : 21614|7@1+ (0.01,0) [0|1] "NA" MCU
 SG_ OBJ_Bike_Probability_23 : 21621|7@1+ (0.01,0) [0|1] "NA" MCU
 SG_ OBJ_Camera_Source_23 : 21628|4@1+ (1,0) [0|15] "ENUM" MCU
 SG_ OBJ_Motion_Status_23 : 21632|3@1+ (1,0) [0|5] "ENUM" MCU
 SG_ OBJ_Motion_Orientation_23 : 21635|4@1+ (1,0) [0|13] "ENUM" MCU

CM_ SG_ 154 OBJ_Abs_Lat_Velocity_V_17 "Validator for the lateral ground speed of the object.";
CM_ SG_ 154 OBJ_Abs_Lat_Velocity_STD_17 "STD of the lateral ground speed of the object.";
CM_ SG_ 154 OBJ_Abs_Lat_Vel_STD_V_17 "Validator for the STD of the lateral ground speed of the object.";
CM_ SG_ 154 OBJ_Abs_Long_Acc_17 "The longitudinal ground acceleration of the object.";
CM_ SG_ 154 OBJ_Abs_Long_Acc_V_17 "Validator for the longitudinal ground acceleration of the object.";
CM_ SG_ 154 OBJ_Abs_Long_Acc_STD_17 "STD of the longitudinal ground acceleration of the object.";
CM_ SG_ 154 OBJ_Abs_Long_Acc_STD_V_17 "Validator for the STD of the longitudinal ground acceleration of the object.";
CM_ SG_ 154 OBJ_Abs_Lat_Acc_17 "The lateral ground acceleration of the object.";
CM_ SG_ 154 OBJ_Abs_Lat_Acc_V_17 "Validator for the lateral ground acceleration of the object.";
CM_ SG_ 154 OBJ_Abs_Lat_Acc_STD_17 "STD of the lateral ground acceleration of the object.";
CM_ SG_ 154 OBJ_Abs_Lat_Acc_STD_V_17 "Validator for the STD of the lateral ground acceleration of the object.";
CM_ SG_ 154 OBJ_Abs_Acceleration_17 "The absolute ground acceleration in the target's heading direction.";
CM_ SG_ 154 OBJ_Abs_Acceleration_V_17 "Validator for the absolute ground acceleration.";
CM_ SG_ 154 OBJ_Abs_Acc_STD_17 "STD of the absolute ground acceleration.";
CM_ SG_ 154 OBJ_Abs_Acc_STD_V_17 "Validator for the STD of the absolute ground acceleration.";
CM_ SG_ 154 OBJ_Inv_TTC_17 "Inverse TTC (time to collision).";
CM_ SG_ 154 OBJ_Inv_TTC_STD_17 "STD for inverse TTC .";
CM_ SG_ 154 OBJ_Inv_TTC_STD_V_17 "Validator for the STD for inverse TTC .";
CM_ SG_ 154 OBJ_Relative_Long_Acc_17 "The relative lateral ground acceleration of the object.";
CM_ SG_ 154 OBJ_Relative_Long_Acc_V_17 "Validator for the relative lateral ground acceleration of the object.";
CM_ SG_ 154 OBJ_Relative_Long_Acc_STD_17 "STD of the relative lateral ground acceleration of the object.";
CM_ SG_ 154 OBJ_Rel_Long_Acc_STD_V_17 "Validator for the STD of the relative lateral ground acceleration.";
CM_ SG_ 154 OBJ_Relative_Long_Velocity_17 "The relative longtitudinal speed between the target and ego vehicle. ";
CM_ SG_ 154 OBJ_Relative_Long_Velocity_V_17 "Validator for the relative longtitudinal speed.";
CM_ SG_ 154 OBJ_Relative_Long_Vel_STD_17 "STD of the relative longtitudinal speed.";
CM_ SG_ 154 OBJ_Rel_Long_Vel_STD_V_17 "Validator for the STD of the relative longtitudinal speed.";
CM_ SG_ 154 OBJ_Relative_Lat_Velocity_17 "The relative lateral speed between the target and ego vehicle. ";
CM_ SG_ 154 OBJ_Relative_Lat_Velocity_V_17 "Validator for the relative lateral speed. ";
CM_ SG_ 154 OBJ_Relative_Lat_Velocity_STD_17 "STD of the relative lateral speed. ";
CM_ SG_ 154 OBJ_Rel_Lat_Vel_STD_V_17 "Validator for the STD of the relative lateral speed. ";
CM_ SG_ 154 OBJ_Long_Distance_17 "The longitudinal distance to middle of the rear bumper (middle of the RL and RR corners) of the target.";
CM_ SG_ 154 OBJ_Long_Distance_V_17 "Validator of the longtitudinal distance field";
CM_ SG_ 154 OBJ_Long_Distance_STD_17 "STD of the  longtitudinal distance.";
CM_ SG_ 154 OBJ_Long_Distance_STD_V_17 "Validator for the STD of the  longtitudinal distance.";
CM_ SG_ 154 OBJ_Lat_Distance_17 "Lateral distance to the middle of the RL and RR corners.  ";
CM_ SG_ 154 OBJ_Lat_Distance_V_17 "Validator for the lateral distance of the object.";
CM_ SG_ 154 OBJ_Lat_Distance_STD_17 "STD of the lateral distance of the object.";
CM_ SG_ 154 OBJ_Lat_Distance_STD_V_17 "Validator for the STD of the lateral distance of the object.";
CM_ SG_ 154 OBJ_Absolute_Speed_17 "The absolute ground speed in the targets' heading direction.";
CM_ SG_ 154 OBJ_Absolute_Speed_V_17 "Validator for the absolute ground speed.";
CM_ SG_ 154 OBJ_Absolute_Speed_STD_17 "STD of the absolute ground speed.";
CM_ SG_ 154 OBJ_Absolute_Speed_STD_V_17 "Validator for the STD of the absolute ground speed.";
CM_ SG_ 154 OBJ_Heading_17 "The angle beetweenthe host longitudinal axis and target's heading (clockwise, e.g. PI/2 is a target crossing from left to right).";
CM_ SG_ 154 OBJ_Heading_V_17 "Validator for the object heading.";
CM_ SG_ 154 OBJ_Heading_STD_17 "STD of the object heading.";
CM_ SG_ 154 OBJ_Heading_STD_V_17 "Validator for the STD of the object heading.";
CM_ SG_ 154 OBJ_Angle_Rate_STD_17 "Standard deviation of the angular speed. (radians)";
CM_ SG_ 154 OBJ_Angle_Rate_STD_V_17 "Validator for the STD of the angular speed.";
CM_ SG_ 154 OBJ_Angle_Rate_17 "The momentary angular speed of the object. (radians)";
CM_ SG_ 154 OBJ_Angle_Rate_V_17 "Validator for the angular speed.";
CM_ SG_ 154 OBJ_Angle_Right_17 "The angle between the host longitudinal axis and the right side of the front / rear of the target (the visible one). The positive side is to the host's right.";
CM_ SG_ 154 OBJ_Angle_Right_V_17 "Validator for angleRight";
CM_ SG_ 154 OBJ_Angle_Right_STD_17 "Standard deviation of angleRight";
CM_ SG_ 154 OBJ_Angle_Right_STD_V_17 "Validator for the standard deviation of angleRight.";
CM_ SG_ 154 OBJ_Angle_Left_17 "The angle between the host longitudinal axis and the left side of the front / rear of the target (the visible one). The positive side is to the host's right.";
CM_ SG_ 154 OBJ_Angle_Left_V_17 "Validator for angleLeft.";
CM_ SG_ 154 OBJ_Angle_Left_STD_17 "Standard deviation of angleLeft.";
CM_ SG_ 154 OBJ_Angle_Left_STD_V_17 "Validator for the standard deviation of angleLeft.";
CM_ SG_ 154 OBJ_Angle_Side_17 "The angle between the host longitudinal axis and the far visible edge - the visible edge of the front / rear of the target that is not visible. Currently supported for vehicles only.";
CM_ SG_ 154 OBJ_Angle_Side_V_17 "Validator for angleSide.";
CM_ SG_ 154 OBJ_Angle_Side_STD_17 "Standard deviation of angleSide.";
CM_ SG_ 154 OBJ_Angle_Side_STD_V_17 "Validator for the STD of angleSide.";
CM_ SG_ 154 OBJ_Angle_Mid_V_17 "Validator for angleMid.";
CM_ SG_ 154 OBJ_Angle_Mid_17 "The angle between the host longitudinal axis and the middle of the front / rear of the target (the visible one). The positive side is to the host's right.";
CM_ SG_ 154 OBJ_Angle_Mid_STD_17 "Standard deviation of angleMid.";
CM_ SG_ 154 OBJ_Angle_Mid_STD_V_17 "Validator for the STD of angleMid.";
CM_ SG_ 154 OBJ_Angle_Bottom_V_17 "Validator for OBJAngle_Bottom. ";
CM_ SG_ 154 OBJ_Angle_Bottom_17 "The angle between the longitudinal axis and the Bottom of the front / rear of the target (the visible one). The positive side is to the host's bottom";
CM_ SG_ 154 OBJ_Angle_Bottom_STD_17 "STD for OBJAngle_Bottom. ";
CM_ SG_ 154 OBJ_Angle_Bottom_STD_V_17 "Validator for OBJAngle_Bottom_STD. ";
CM_ SG_ 154 OBJ_Visibility_Side_V_17 "Currently Supported for VD only";
CM_ SG_ 154 OBJ_Visibility_Side_17 "From what car  side is the object visible";
CM_ SG_ 154 OBJ_Is_In_Drivable_Area_17 "Indicates whether the target is in a driveable area.";
CM_ SG_ 154 OBJ_Is_In_Drivable_Area_V_17 "Validator for OBJ_Is_In_Drivable_Area.";
CM_ SG_ 154 OBJ_Is_VeryClose_V_17 "Validator for OBJ_Is_VeryClose. ";
CM_ SG_ 154 OBJ_Is_VeryClose_17 "Indicates whether the target is very close to the host such that it is hard to measure its distance. Currently relevant for peds only";
CM_ SG_ 154 OBJ_OverlapAngleEgoLaneR_17 "Lateral distance to the middle of the RL and RR corners.";
CM_ SG_ 154 OBJ_OverlapAngleEgoLaneR_V_17 "Validator for OBJ_OverlapAngleEgoLaneR";
CM_ SG_ 154 OBJ_OverlapAngleEgoLaneL_17 "Lateral distance to the middle of the RL and RR corners.  ";
CM_ SG_ 154 OBJ_OverlapAngleEgoLaneL_V_17 "Validator for OBJ_OverlapAngleEgoLaneL";
CM_ SG_ 154 OBJ_Is_EMERGENCY_VCL_17 "Is Object an Emergency Vehicle";
CM_ SG_ 154 OBJ_EMERGENCY_LIGHT_COLOR_17 "Emergency Color";
CM_ SG_ 154 OBJ_EMERGENCY_V_17 "Are OBJ_Is_EMERGENCY_VCL and OBJ_EMERGENCY_LIGHT_COLOR Valid";
CM_ SG_ 154 OBJ_Angle_Top_17 "From VD touching point on the ground till the roof of the car";
CM_ SG_ 154 OBJ_Angle_Top_V_17 "Validator for OBJ_Angle_Top ";
CM_ SG_ 154 OBJ_Angle_Top_STD_17 "STD for OBJ_Angle_Top";
CM_ SG_ 154 OBJ_Angle_Top_STD_V_17 "Validator for OBJ_Angle_Top_STD. ";
CM_ SG_ 154 OBJ_CRC_18 "Calculated over all element signals. From the signal after the CRC until the first signal in the next elements OBJ_CRC_N+1  not including";
CM_ SG_ 154 OBJ_ID_18 "The detected object ID. Range is 1-255, while 0 indicates that the field in unfilled.";
CM_ SG_ 154 OBJ_Existence_Probability_18 "The existence probability of the reported object";
CM_ SG_ 154 OBJ_Fusion_Source_18 "sources ids used for fusion";
CM_ SG_ 154 OBJ_Triggered_SDM_18 "Indicates whether the object has trigered the SDM (Safety Diagnostic Manager) alert.";
CM_ SG_ 154 OBJ_Motion_Category_18 "Relevant for VD only. Full description of values can be found at the ACC guide.";
CM_ SG_ 154 OBJ_Object_Age_18 "The number of frames in which the object was recognized.";
CM_ SG_ 154 OBJ_Measuring_Status_18 "Measurment status. Old vs New marks if this is the first frame in which the object is reported. Predicted vs Measured marks if the report is raw or has been predicted forward in time using the measured dynamics and ego motion.";
CM_ SG_ 154 OBJ_Object_Class_18 "Indicates the object type. Uncertain is outputted in case the probability that a vehicle is a truck is very similar to the probability that it is a car. ";
CM_ SG_ 154 OBJ_Class_Probability_18 "The probability of this type classification.";
CM_ SG_ 154 OBJ_Car_Probability_18 "The probability the object is a car";
CM_ SG_ 154 OBJ_Truck_Probability_18 "The probability the object is a Truck";
CM_ SG_ 154 OBJ_Bike_Probability_18 "The probability the object is a Bike";
CM_ SG_ 154 OBJ_Camera_Source_18 "The camera in which this object was detected (best choice).";
CM_ SG_ 154 OBJ_Motion_Status_18 "MOVING - the object is moving STATIONARY - the object was never seen moving STOPPED -  the object was moving and has stopped MOVING_SLOWLY - the object is moving very slowly";
CM_ SG_ 154 OBJ_Motion_Orientation_18 "The direction of the targets heading compared to the host. ";
CM_ SG_ 154 OBJ_Has_Cut_Lane_18 "Indicates whether the object cut the host's (right or left) lane. In case there are no lanes, indicates whether the objects is at most 1 meters away from the host.";
CM_ SG_ 154 OBJ_Has_Cut_Path_18 "Indicates whether the object is in the host's path.";
CM_ SG_ 154 OBJ_Brake_Light_18 "Indication for brake lights ";
CM_ SG_ 154 OBJ_Turn_Indicator_Right_18 "Indication for blinking right light.";
CM_ SG_ 154 OBJ_Turn_Indicator_Left_18 "Indication for blinking left light ";
CM_ SG_ 154 OBJ_Light_Indicator_Validity_18 "Validator for light indicators";
CM_ SG_ 154 OBJ_Right_Out_Of_Image_18 "Indicates whether the measurment are predicted out of the right side of the image bounderies.";
CM_ SG_ 154 OBJ_Left_Out_Of_Image_18 "Indicates whether if measurment are predicted out of  the left side of the image bounderies";
CM_ SG_ 154 OBJ_Right_Out_Of_Image_V_18 "validator";
CM_ SG_ 154 OBJ_Left_Out_Of_Image_V_18 "validator";
CM_ SG_ 154 OBJ_Top_Out_Of_Image_18 "Indicates whether if measurment are predicted out of  the top of the image bounderies";
CM_ SG_ 154 OBJ_Bottom_Out_Of_Image_18 "Indicates whether if measurment are predicted out of  the bottom of the image bounderies";
CM_ SG_ 154 OBJ_Top_Out_Of_Image_V_18 "validator";
CM_ SG_ 154 OBJ_Bottom_Out_Of_Image_V_18 "validator";
CM_ SG_ 154 OBJ_Lane_Assignment_18 "The object's lane relative to the host lane.";
CM_ SG_ 154 OBJ_Lane_Assignment_V_18 "Validator for lane assignment";
CM_ SG_ 154 OBJ_Age_Seconds_18 "Time in seconds in which the object was recognized. ";
CM_ SG_ 154 OBJ_Age_Seconds_V_18 "Validator for object age";
CM_ SG_ 154 OBJ_Width_18 "The width of the target vehicle in the world (not to be mistaken with the width of the visible part of the vehicle).";
CM_ SG_ 154 OBJ_Width_V_18 "Validator for object width";
CM_ SG_ 154 OBJ_Width_STD_18 "Standard deviation for object width";
CM_ SG_ 154 OBJ_Width_STD_V_18 "Validator for the standard deviation of object width";
CM_ SG_ 154 OBJ_Length_18 "The length of the vehicle in the world. For crossing bicycles it gives the viewed length of the bicycle.";
CM_ SG_ 154 OBJ_Length_V_18 "Validator for object length.";
CM_ SG_ 154 OBJ_Length_STD_18 "Standard deviation for object length.";
CM_ SG_ 154 OBJ_Length_STD_V_18 "Validator for the standard deviation of object length.";
CM_ SG_ 154 OBJ_Radar_ID_18 "Radar Object ID of the Fused Object, Only relvant when OBJ_Fusion_Source is not Camera only";
CM_ SG_ 154 OBJ_Height_18 "The height of the object in the world. ";
CM_ SG_ 154 OBJ_Height_V_18 "Validator for object height.";
CM_ SG_ 154 OBJ_Height_STD_18 "Standard deviation for object height.";
CM_ SG_ 154 OBJ_Height_STD_V_18 "Validator for the standard deviation of object height.";
CM_ SG_ 154 OBJ_Abs_Long_Velocity_18 "Absolute longitudinal velocity.";
CM_ SG_ 154 OBJ_Abs_Long_Velocity_V_18 "Validator for absolute longitudinal velocity.";
CM_ SG_ 154 OBJ_Abs_Long_Velocity_STD_18 "Standard deviation of absolute longitudinal velocity.";
CM_ SG_ 154 OBJ_Abs_Long_Vel_STD_V_18 "Validator for the standard deviation of the absolute longitudinal velocity.";
CM_ SG_ 154 OBJ_Abs_Lat_Velocity_18 "The lateral ground speed of the object.";
CM_ SG_ 154 OBJ_Abs_Lat_Velocity_V_18 "Validator for the lateral ground speed of the object.";
CM_ SG_ 154 OBJ_Abs_Lat_Velocity_STD_18 "STD of the lateral ground speed of the object.";
CM_ SG_ 154 OBJ_Abs_Lat_Vel_STD_V_18 "Validator for the STD of the lateral ground speed of the object.";
CM_ SG_ 154 OBJ_Abs_Long_Acc_18 "The longitudinal ground acceleration of the object.";
CM_ SG_ 154 OBJ_Abs_Long_Acc_V_18 "Validator for the longitudinal ground acceleration of the object.";
CM_ SG_ 154 OBJ_Abs_Long_Acc_STD_18 "STD of the longitudinal ground acceleration of the object.";
CM_ SG_ 154 OBJ_Abs_Long_Acc_STD_V_18 "Validator for the STD of the longitudinal ground acceleration of the object.";
CM_ SG_ 154 OBJ_Abs_Lat_Acc_18 "The lateral ground acceleration of the object.";
CM_ SG_ 154 OBJ_Abs_Lat_Acc_V_18 "Validator for the lateral ground acceleration of the object.";
CM_ SG_ 154 OBJ_Abs_Lat_Acc_STD_18 "STD of the lateral ground acceleration of the object.";
CM_ SG_ 154 OBJ_Abs_Lat_Acc_STD_V_18 "Validator for the STD of the lateral ground acceleration of the object.";
CM_ SG_ 154 OBJ_Abs_Acceleration_18 "The absolute ground acceleration in the target's heading direction.";
CM_ SG_ 154 OBJ_Abs_Acceleration_V_18 "Validator for the absolute ground acceleration.";
CM_ SG_ 154 OBJ_Abs_Acc_STD_18 "STD of the absolute ground acceleration.";
CM_ SG_ 154 OBJ_Abs_Acc_STD_V_18 "Validator for the STD of the absolute ground acceleration.";
CM_ SG_ 154 OBJ_Inv_TTC_18 "Inverse TTC (time to collision).";
CM_ SG_ 154 OBJ_Inv_TTC_STD_18 "STD for inverse TTC .";
CM_ SG_ 154 OBJ_Inv_TTC_STD_V_18 "Validator for the STD for inverse TTC .";
CM_ SG_ 154 OBJ_Relative_Long_Acc_18 "The relative lateral ground acceleration of the object.";
CM_ SG_ 154 OBJ_Relative_Long_Acc_V_18 "Validator for the relative lateral ground acceleration of the object.";
CM_ SG_ 154 OBJ_Relative_Long_Acc_STD_18 "STD of the relative lateral ground acceleration of the object.";
CM_ SG_ 154 OBJ_Rel_Long_Acc_STD_V_18 "Validator for the STD of the relative lateral ground acceleration.";
CM_ SG_ 154 OBJ_Relative_Long_Velocity_18 "The relative longtitudinal speed between the target and ego vehicle. ";
CM_ SG_ 154 OBJ_Relative_Long_Velocity_V_18 "Validator for the relative longtitudinal speed.";
CM_ SG_ 154 OBJ_Relative_Long_Vel_STD_18 "STD of the relative longtitudinal speed.";
CM_ SG_ 154 OBJ_Rel_Long_Vel_STD_V_18 "Validator for the STD of the relative longtitudinal speed.";
CM_ SG_ 154 OBJ_Relative_Lat_Velocity_18 "The relative lateral speed between the target and ego vehicle. ";
CM_ SG_ 154 OBJ_Relative_Lat_Velocity_V_18 "Validator for the relative lateral speed. ";
CM_ SG_ 154 OBJ_Relative_Lat_Velocity_STD_18 "STD of the relative lateral speed. ";
CM_ SG_ 154 OBJ_Rel_Lat_Vel_STD_V_18 "Validator for the STD of the relative lateral speed. ";
CM_ SG_ 154 OBJ_Long_Distance_18 "The longitudinal distance to middle of the rear bumper (middle of the RL and RR corners) of the target.";
CM_ SG_ 154 OBJ_Long_Distance_V_18 "Validator of the longtitudinal distance field";
CM_ SG_ 154 OBJ_Long_Distance_STD_18 "STD of the  longtitudinal distance.";
CM_ SG_ 154 OBJ_Long_Distance_STD_V_18 "Validator for the STD of the  longtitudinal distance.";
CM_ SG_ 154 OBJ_Lat_Distance_18 "Lateral distance to the middle of the RL and RR corners.  ";
CM_ SG_ 154 OBJ_Lat_Distance_V_18 "Validator for the lateral distance of the object.";
CM_ SG_ 154 OBJ_Lat_Distance_STD_18 "STD of the lateral distance of the object.";
CM_ SG_ 154 OBJ_Lat_Distance_STD_V_18 "Validator for the STD of the lateral distance of the object.";
CM_ SG_ 154 OBJ_Absolute_Speed_18 "The absolute ground speed in the targets' heading direction.";
CM_ SG_ 154 OBJ_Absolute_Speed_V_18 "Validator for the absolute ground speed.";
CM_ SG_ 154 OBJ_Absolute_Speed_STD_18 "STD of the absolute ground speed.";
CM_ SG_ 154 OBJ_Absolute_Speed_STD_V_18 "Validator for the STD of the absolute ground speed.";
CM_ SG_ 154 OBJ_Heading_18 "The angle beetweenthe host longitudinal axis and target's heading (clockwise, e.g. PI/2 is a target crossing from left to right).";
CM_ SG_ 154 OBJ_Heading_V_18 "Validator for the object heading.";
CM_ SG_ 154 OBJ_Heading_STD_18 "STD of the object heading.";
CM_ SG_ 154 OBJ_Heading_STD_V_18 "Validator for the STD of the object heading.";
CM_ SG_ 154 OBJ_Angle_Rate_STD_18 "Standard deviation of the angular speed. (radians)";
CM_ SG_ 154 OBJ_Angle_Rate_STD_V_18 "Validator for the STD of the angular speed.";
CM_ SG_ 154 OBJ_Angle_Rate_18 "The momentary angular speed of the object. (radians)";
CM_ SG_ 154 OBJ_Angle_Rate_V_18 "Validator for the angular speed.";
CM_ SG_ 154 OBJ_Angle_Right_18 "The angle between the host longitudinal axis and the right side of the front / rear of the target (the visible one). The positive side is to the host's right.";
CM_ SG_ 154 OBJ_Angle_Right_V_18 "Validator for angleRight";
CM_ SG_ 154 OBJ_Angle_Right_STD_18 "Standard deviation of angleRight";
CM_ SG_ 154 OBJ_Angle_Right_STD_V_18 "Validator for the standard deviation of angleRight.";
CM_ SG_ 154 OBJ_Angle_Left_18 "The angle between the host longitudinal axis and the left side of the front / rear of the target (the visible one). The positive side is to the host's right.";
CM_ SG_ 154 OBJ_Angle_Left_V_18 "Validator for angleLeft.";
CM_ SG_ 154 OBJ_Angle_Left_STD_18 "Standard deviation of angleLeft.";
CM_ SG_ 154 OBJ_Angle_Left_STD_V_18 "Validator for the standard deviation of angleLeft.";
CM_ SG_ 154 OBJ_Angle_Side_18 "The angle between the host longitudinal axis and the far visible edge - the visible edge of the front / rear of the target that is not visible. Currently supported for vehicles only.";
CM_ SG_ 154 OBJ_Angle_Side_V_18 "Validator for angleSide.";
CM_ SG_ 154 OBJ_Angle_Side_STD_18 "Standard deviation of angleSide.";
CM_ SG_ 154 OBJ_Angle_Side_STD_V_18 "Validator for the STD of angleSide.";
CM_ SG_ 154 OBJ_Angle_Mid_V_18 "Validator for angleMid.";
CM_ SG_ 154 OBJ_Angle_Mid_18 "The angle between the host longitudinal axis and the middle of the front / rear of the target (the visible one). The positive side is to the host's right.";
CM_ SG_ 154 OBJ_Angle_Mid_STD_18 "Standard deviation of angleMid.";
CM_ SG_ 154 OBJ_Angle_Mid_STD_V_18 "Validator for the STD of angleMid.";
CM_ SG_ 154 OBJ_Angle_Bottom_V_18 "Validator for OBJAngle_Bottom. ";
CM_ SG_ 154 OBJ_Angle_Bottom_18 "The angle between the longitudinal axis and the Bottom of the front / rear of the target (the visible one). The positive side is to the host's bottom";
CM_ SG_ 154 OBJ_Angle_Bottom_STD_18 "STD for OBJAngle_Bottom. ";
CM_ SG_ 154 OBJ_Angle_Bottom_STD_V_18 "Validator for OBJAngle_Bottom_STD. ";
CM_ SG_ 154 OBJ_Visibility_Side_V_18 "Currently Supported for VD only";
CM_ SG_ 154 OBJ_Visibility_Side_18 "From what car  side is the object visible";
CM_ SG_ 154 OBJ_Is_In_Drivable_Area_18 "Indicates whether the target is in a driveable area.";
CM_ SG_ 154 OBJ_Is_In_Drivable_Area_V_18 "Validator for OBJ_Is_In_Drivable_Area.";
CM_ SG_ 154 OBJ_Is_VeryClose_V_18 "Validator for OBJ_Is_VeryClose. ";
CM_ SG_ 154 OBJ_Is_VeryClose_18 "Indicates whether the target is very close to the host such that it is hard to measure its distance. Currently relevant for peds only";
CM_ SG_ 154 OBJ_OverlapAngleEgoLaneR_18 "Lateral distance to the middle of the RL and RR corners.";
CM_ SG_ 154 OBJ_OverlapAngleEgoLaneR_V_18 "Validator for OBJ_OverlapAngleEgoLaneR";
CM_ SG_ 154 OBJ_OverlapAngleEgoLaneL_18 "Lateral distance to the middle of the RL and RR corners.  ";
CM_ SG_ 154 OBJ_OverlapAngleEgoLaneL_V_18 "Validator for OBJ_OverlapAngleEgoLaneL";
CM_ SG_ 154 OBJ_Is_EMERGENCY_VCL_18 "Is Object an Emergency Vehicle";
CM_ SG_ 154 OBJ_EMERGENCY_LIGHT_COLOR_18 "Emergency Color";
CM_ SG_ 154 OBJ_EMERGENCY_V_18 "Are OBJ_Is_EMERGENCY_VCL and OBJ_EMERGENCY_LIGHT_COLOR Valid";
CM_ SG_ 154 OBJ_Angle_Top_18 "From VD touching point on the ground till the roof of the car";
CM_ SG_ 154 OBJ_Angle_Top_V_18 "Validator for OBJ_Angle_Top ";
CM_ SG_ 154 OBJ_Angle_Top_STD_18 "STD for OBJ_Angle_Top";
CM_ SG_ 154 OBJ_Angle_Top_STD_V_18 "Validator for OBJ_Angle_Top_STD. ";
CM_ SG_ 154 OBJ_CRC_19 "Calculated over all element signals. From the signal after the CRC until the first signal in the next elements OBJ_CRC_N+1  not including";
CM_ SG_ 154 OBJ_ID_19 "The detected object ID. Range is 1-255, while 0 indicates that the field in unfilled.";
CM_ SG_ 154 OBJ_Existence_Probability_19 "The existence probability of the reported object";
CM_ SG_ 154 OBJ_Fusion_Source_19 "sources ids used for fusion";
CM_ SG_ 154 OBJ_Triggered_SDM_19 "Indicates whether the object has trigered the SDM (Safety Diagnostic Manager) alert.";
CM_ SG_ 154 OBJ_Motion_Category_19 "Relevant for VD only. Full description of values can be found at the ACC guide.";
CM_ SG_ 154 OBJ_Object_Age_19 "The number of frames in which the object was recognized.";
CM_ SG_ 154 OBJ_Measuring_Status_19 "Measurment status. Old vs New marks if this is the first frame in which the object is reported. Predicted vs Measured marks if the report is raw or has been predicted forward in time using the measured dynamics and ego motion.";
CM_ SG_ 154 OBJ_Object_Class_19 "Indicates the object type. Uncertain is outputted in case the probability that a vehicle is a truck is very similar to the probability that it is a car. ";
CM_ SG_ 154 OBJ_Class_Probability_19 "The probability of this type classification.";
CM_ SG_ 154 OBJ_Car_Probability_19 "The probability the object is a car";
CM_ SG_ 154 OBJ_Truck_Probability_19 "The probability the object is a Truck";
CM_ SG_ 154 OBJ_Bike_Probability_19 "The probability the object is a Bike";
CM_ SG_ 154 OBJ_Camera_Source_19 "The camera in which this object was detected (best choice).";
CM_ SG_ 154 OBJ_Motion_Status_19 "MOVING - the object is moving STATIONARY - the object was never seen moving STOPPED -  the object was moving and has stopped MOVING_SLOWLY - the object is moving very slowly";
CM_ SG_ 154 OBJ_Motion_Orientation_19 "The direction of the targets heading compared to the host. ";
CM_ SG_ 154 OBJ_Has_Cut_Lane_19 "Indicates whether the object cut the host's (right or left) lane. In case there are no lanes, indicates whether the objects is at most 1 meters away from the host.";
CM_ SG_ 154 OBJ_Has_Cut_Path_19 "Indicates whether the object is in the host's path.";
CM_ SG_ 154 OBJ_Brake_Light_19 "Indication for brake lights ";
CM_ SG_ 154 OBJ_Turn_Indicator_Right_19 "Indication for blinking right light.";
CM_ SG_ 154 OBJ_Turn_Indicator_Left_19 "Indication for blinking left light ";
CM_ SG_ 154 OBJ_Light_Indicator_Validity_19 "Validator for light indicators";
CM_ SG_ 154 OBJ_Right_Out_Of_Image_19 "Indicates whether the measurment are predicted out of the right side of the image bounderies.";
CM_ SG_ 154 OBJ_Left_Out_Of_Image_19 "Indicates whether if measurment are predicted out of  the left side of the image bounderies";
CM_ SG_ 154 OBJ_Right_Out_Of_Image_V_19 "validator";
CM_ SG_ 154 OBJ_Left_Out_Of_Image_V_19 "validator";
CM_ SG_ 154 OBJ_Top_Out_Of_Image_19 "Indicates whether if measurment are predicted out of  the top of the image bounderies";
CM_ SG_ 154 OBJ_Bottom_Out_Of_Image_19 "Indicates whether if measurment are predicted out of  the bottom of the image bounderies";
CM_ SG_ 154 OBJ_Top_Out_Of_Image_V_19 "validator";
CM_ SG_ 154 OBJ_Bottom_Out_Of_Image_V_19 "validator";
CM_ SG_ 154 OBJ_Lane_Assignment_19 "The object's lane relative to the host lane.";
CM_ SG_ 154 OBJ_Lane_Assignment_V_19 "Validator for lane assignment";
CM_ SG_ 154 OBJ_Age_Seconds_19 "Time in seconds in which the object was recognized. ";
CM_ SG_ 154 OBJ_Age_Seconds_V_19 "Validator for object age";
CM_ SG_ 154 OBJ_Width_19 "The width of the target vehicle in the world (not to be mistaken with the width of the visible part of the vehicle).";
CM_ SG_ 154 OBJ_Width_V_19 "Validator for object width";
CM_ SG_ 154 OBJ_Width_STD_19 "Standard deviation for object width";
CM_ SG_ 154 OBJ_Width_STD_V_19 "Validator for the standard deviation of object width";
CM_ SG_ 154 OBJ_Length_19 "The length of the vehicle in the world. For crossing bicycles it gives the viewed length of the bicycle.";
CM_ SG_ 154 OBJ_Length_V_19 "Validator for object length.";
CM_ SG_ 154 OBJ_Length_STD_19 "Standard deviation for object length.";
CM_ SG_ 154 OBJ_Length_STD_V_19 "Validator for the standard deviation of object length.";
CM_ SG_ 154 OBJ_Radar_ID_19 "Radar Object ID of the Fused Object, Only relvant when OBJ_Fusion_Source is not Camera only";
CM_ SG_ 154 OBJ_Height_19 "The height of the object in the world. ";
CM_ SG_ 154 OBJ_Height_V_19 "Validator for object height.";
CM_ SG_ 154 OBJ_Height_STD_19 "Standard deviation for object height.";
CM_ SG_ 154 OBJ_Height_STD_V_19 "Validator for the standard deviation of object height.";
CM_ SG_ 154 OBJ_Abs_Long_Velocity_19 "Absolute longitudinal velocity.";
CM_ SG_ 154 OBJ_Abs_Long_Velocity_V_19 "Validator for absolute longitudinal velocity.";
CM_ SG_ 154 OBJ_Abs_Long_Velocity_STD_19 "Standard deviation of absolute longitudinal velocity.";
CM_ SG_ 154 OBJ_Abs_Long_Vel_STD_V_19 "Validator for the standard deviation of the absolute longitudinal velocity.";
CM_ SG_ 154 OBJ_Abs_Lat_Velocity_19 "The lateral ground speed of the object.";
CM_ SG_ 154 OBJ_Abs_Lat_Velocity_V_19 "Validator for the lateral ground speed of the object.";
CM_ SG_ 154 OBJ_Abs_Lat_Velocity_STD_19 "STD of the lateral ground speed of the object.";
CM_ SG_ 154 OBJ_Abs_Lat_Vel_STD_V_19 "Validator for the STD of the lateral ground speed of the object.";
CM_ SG_ 154 OBJ_Abs_Long_Acc_19 "The longitudinal ground acceleration of the object.";
CM_ SG_ 154 OBJ_Abs_Long_Acc_V_19 "Validator for the longitudinal ground acceleration of the object.";
CM_ SG_ 154 OBJ_Abs_Long_Acc_STD_19 "STD of the longitudinal ground acceleration of the object.";
CM_ SG_ 154 OBJ_Abs_Long_Acc_STD_V_19 "Validator for the STD of the longitudinal ground acceleration of the object.";
CM_ SG_ 154 OBJ_Abs_Lat_Acc_19 "The lateral ground acceleration of the object.";
CM_ SG_ 154 OBJ_Abs_Lat_Acc_V_19 "Validator for the lateral ground acceleration of the object.";
CM_ SG_ 154 OBJ_Abs_Lat_Acc_STD_19 "STD of the lateral ground acceleration of the object.";
CM_ SG_ 154 OBJ_Abs_Lat_Acc_STD_V_19 "Validator for the STD of the lateral ground acceleration of the object.";
CM_ SG_ 154 OBJ_Abs_Acceleration_19 "The absolute ground acceleration in the target's heading direction.";
CM_ SG_ 154 OBJ_Abs_Acceleration_V_19 "Validator for the absolute ground acceleration.";
CM_ SG_ 154 OBJ_Abs_Acc_STD_19 "STD of the absolute ground acceleration.";
CM_ SG_ 154 OBJ_Abs_Acc_STD_V_19 "Validator for the STD of the absolute ground acceleration.";
CM_ SG_ 154 OBJ_Inv_TTC_19 "Inverse TTC (time to collision).";
CM_ SG_ 154 OBJ_Inv_TTC_STD_19 "STD for inverse TTC .";
CM_ SG_ 154 OBJ_Inv_TTC_STD_V_19 "Validator for the STD for inverse TTC .";
CM_ SG_ 154 OBJ_Relative_Long_Acc_19 "The relative lateral ground acceleration of the object.";
CM_ SG_ 154 OBJ_Relative_Long_Acc_V_19 "Validator for the relative lateral ground acceleration of the object.";
CM_ SG_ 154 OBJ_Relative_Long_Acc_STD_19 "STD of the relative lateral ground acceleration of the object.";
CM_ SG_ 154 OBJ_Rel_Long_Acc_STD_V_19 "Validator for the STD of the relative lateral ground acceleration.";
CM_ SG_ 154 OBJ_Relative_Long_Velocity_19 "The relative longtitudinal speed between the target and ego vehicle. ";
CM_ SG_ 154 OBJ_Relative_Long_Velocity_V_19 "Validator for the relative longtitudinal speed.";
CM_ SG_ 154 OBJ_Relative_Long_Vel_STD_19 "STD of the relative longtitudinal speed.";
CM_ SG_ 154 OBJ_Rel_Long_Vel_STD_V_19 "Validator for the STD of the relative longtitudinal speed.";
CM_ SG_ 154 OBJ_Relative_Lat_Velocity_19 "The relative lateral speed between the target and ego vehicle. ";
CM_ SG_ 154 OBJ_Relative_Lat_Velocity_V_19 "Validator for the relative lateral speed. ";
CM_ SG_ 154 OBJ_Relative_Lat_Velocity_STD_19 "STD of the relative lateral speed. ";
CM_ SG_ 154 OBJ_Rel_Lat_Vel_STD_V_19 "Validator for the STD of the relative lateral speed. ";
CM_ SG_ 154 OBJ_Long_Distance_19 "The longitudinal distance to middle of the rear bumper (middle of the RL and RR corners) of the target.";
CM_ SG_ 154 OBJ_Long_Distance_V_19 "Validator of the longtitudinal distance field";
CM_ SG_ 154 OBJ_Long_Distance_STD_19 "STD of the  longtitudinal distance.";
CM_ SG_ 154 OBJ_Long_Distance_STD_V_19 "Validator for the STD of the  longtitudinal distance.";
CM_ SG_ 154 OBJ_Lat_Distance_19 "Lateral distance to the middle of the RL and RR corners.  ";
CM_ SG_ 154 OBJ_Lat_Distance_V_19 "Validator for the lateral distance of the object.";
CM_ SG_ 154 OBJ_Lat_Distance_STD_19 "STD of the lateral distance of the object.";
CM_ SG_ 154 OBJ_Lat_Distance_STD_V_19 "Validator for the STD of the lateral distance of the object.";
CM_ SG_ 154 OBJ_Absolute_Speed_19 "The absolute ground speed in the targets' heading direction.";
CM_ SG_ 154 OBJ_Absolute_Speed_V_19 "Validator for the absolute ground speed.";
CM_ SG_ 154 OBJ_Absolute_Speed_STD_19 "STD of the absolute ground speed.";
CM_ SG_ 154 OBJ_Absolute_Speed_STD_V_19 "Validator for the STD of the absolute ground speed.";
CM_ SG_ 154 OBJ_Heading_19 "The angle beetweenthe host longitudinal axis and target's heading (clockwise, e.g. PI/2 is a target crossing from left to right).";
CM_ SG_ 154 OBJ_Heading_V_19 "Validator for the object heading.";
CM_ SG_ 154 OBJ_Heading_STD_19 "STD of the object heading.";
CM_ SG_ 154 OBJ_Heading_STD_V_19 "Validator for the STD of the object heading.";
CM_ SG_ 154 OBJ_Angle_Rate_STD_19 "Standard deviation of the angular speed. (radians)";
CM_ SG_ 154 OBJ_Angle_Rate_STD_V_19 "Validator for the STD of the angular speed.";
CM_ SG_ 154 OBJ_Angle_Rate_19 "The momentary angular speed of the object. (radians)";
CM_ SG_ 154 OBJ_Angle_Rate_V_19 "Validator for the angular speed.";
CM_ SG_ 154 OBJ_Angle_Right_19 "The angle between the host longitudinal axis and the right side of the front / rear of the target (the visible one). The positive side is to the host's right.";
CM_ SG_ 154 OBJ_Angle_Right_V_19 "Validator for angleRight";
CM_ SG_ 154 OBJ_Angle_Right_STD_19 "Standard deviation of angleRight";
CM_ SG_ 154 OBJ_Angle_Right_STD_V_19 "Validator for the standard deviation of angleRight.";
CM_ SG_ 154 OBJ_Angle_Left_19 "The angle between the host longitudinal axis and the left side of the front / rear of the target (the visible one). The positive side is to the host's right.";
CM_ SG_ 154 OBJ_Angle_Left_V_19 "Validator for angleLeft.";
CM_ SG_ 154 OBJ_Angle_Left_STD_19 "Standard deviation of angleLeft.";
CM_ SG_ 154 OBJ_Angle_Left_STD_V_19 "Validator for the standard deviation of angleLeft.";
CM_ SG_ 154 OBJ_Angle_Side_19 "The angle between the host longitudinal axis and the far visible edge - the visible edge of the front / rear of the target that is not visible. Currently supported for vehicles only.";
CM_ SG_ 154 OBJ_Angle_Side_V_19 "Validator for angleSide.";
CM_ SG_ 154 OBJ_Angle_Side_STD_19 "Standard deviation of angleSide.";
CM_ SG_ 154 OBJ_Angle_Side_STD_V_19 "Validator for the STD of angleSide.";
CM_ SG_ 154 OBJ_Angle_Mid_V_19 "Validator for angleMid.";
CM_ SG_ 154 OBJ_Angle_Mid_19 "The angle between the host longitudinal axis and the middle of the front / rear of the target (the visible one). The positive side is to the host's right.";
CM_ SG_ 154 OBJ_Angle_Mid_STD_19 "Standard deviation of angleMid.";
CM_ SG_ 154 OBJ_Angle_Mid_STD_V_19 "Validator for the STD of angleMid.";
CM_ SG_ 154 OBJ_Angle_Bottom_V_19 "Validator for OBJAngle_Bottom. ";
CM_ SG_ 154 OBJ_Angle_Bottom_19 "The angle between the longitudinal axis and the Bottom of the front / rear of the target (the visible one). The positive side is to the host's bottom";
CM_ SG_ 154 OBJ_Angle_Bottom_STD_19 "STD for OBJAngle_Bottom. ";
CM_ SG_ 154 OBJ_Angle_Bottom_STD_V_19 "Validator for OBJAngle_Bottom_STD. ";
CM_ SG_ 154 OBJ_Visibility_Side_V_19 "Currently Supported for VD only";
CM_ SG_ 154 OBJ_Visibility_Side_19 "From what car  side is the object visible";
CM_ SG_ 154 OBJ_Is_In_Drivable_Area_19 "Indicates whether the target is in a driveable area.";
CM_ SG_ 154 OBJ_Is_In_Drivable_Area_V_19 "Validator for OBJ_Is_In_Drivable_Area.";
CM_ SG_ 154 OBJ_Is_VeryClose_V_19 "Validator for OBJ_Is_VeryClose. ";
CM_ SG_ 154 OBJ_Is_VeryClose_19 "Indicates whether the target is very close to the host such that it is hard to measure its distance. Currently relevant for peds only";
CM_ SG_ 154 OBJ_OverlapAngleEgoLaneR_19 "Lateral distance to the middle of the RL and RR corners.";
CM_ SG_ 154 OBJ_OverlapAngleEgoLaneR_V_19 "Validator for OBJ_OverlapAngleEgoLaneR";
CM_ SG_ 154 OBJ_OverlapAngleEgoLaneL_19 "Lateral distance to the middle of the RL and RR corners.  ";
CM_ SG_ 154 OBJ_OverlapAngleEgoLaneL_V_19 "Validator for OBJ_OverlapAngleEgoLaneL";
CM_ SG_ 154 OBJ_Is_EMERGENCY_VCL_19 "Is Object an Emergency Vehicle";
CM_ SG_ 154 OBJ_EMERGENCY_LIGHT_COLOR_19 "Emergency Color";
CM_ SG_ 154 OBJ_EMERGENCY_V_19 "Are OBJ_Is_EMERGENCY_VCL and OBJ_EMERGENCY_LIGHT_COLOR Valid";
CM_ SG_ 154 OBJ_Angle_Top_19 "From VD touching point on the ground till the roof of the car";
CM_ SG_ 154 OBJ_Angle_Top_V_19 "Validator for OBJ_Angle_Top ";
CM_ SG_ 154 OBJ_Angle_Top_STD_19 "STD for OBJ_Angle_Top";
CM_ SG_ 154 OBJ_Angle_Top_STD_V_19 "Validator for OBJ_Angle_Top_STD. ";
CM_ SG_ 154 OBJ_CRC_20 "Calculated over all element signals. From the signal after the CRC until the first signal in the next elements OBJ_CRC_N+1  not including";
CM_ SG_ 154 OBJ_ID_20 "The detected object ID. Range is 1-255, while 0 indicates that the field in unfilled.";
CM_ SG_ 154 OBJ_Existence_Probability_20 "The existence probability of the reported object";
CM_ SG_ 154 OBJ_Fusion_Source_20 "sources ids used for fusion";
CM_ SG_ 154 OBJ_Triggered_SDM_20 "Indicates whether the object has trigered the SDM (Safety Diagnostic Manager) alert.";
CM_ SG_ 154 OBJ_Motion_Category_20 "Relevant for VD only. Full description of values can be found at the ACC guide.";
CM_ SG_ 154 OBJ_Object_Age_20 "The number of frames in which the object was recognized.";
CM_ SG_ 154 OBJ_Measuring_Status_20 "Measurment status. Old vs New marks if this is the first frame in which the object is reported. Predicted vs Measured marks if the report is raw or has been predicted forward in time using the measured dynamics and ego motion.";
CM_ SG_ 154 OBJ_Object_Class_20 "Indicates the object type. Uncertain is outputted in case the probability that a vehicle is a truck is very similar to the probability that it is a car. ";
CM_ SG_ 154 OBJ_Class_Probability_20 "The probability of this type classification.";
CM_ SG_ 154 OBJ_Car_Probability_20 "The probability the object is a car";
CM_ SG_ 154 OBJ_Truck_Probability_20 "The probability the object is a Truck";
CM_ SG_ 154 OBJ_Bike_Probability_20 "The probability the object is a Bike";
CM_ SG_ 154 OBJ_Camera_Source_20 "The camera in which this object was detected (best choice).";
CM_ SG_ 154 OBJ_Motion_Status_20 "MOVING - the object is moving STATIONARY - the object was never seen moving STOPPED -  the object was moving and has stopped MOVING_SLOWLY - the object is moving very slowly";
CM_ SG_ 154 OBJ_Motion_Orientation_20 "The direction of the targets heading compared to the host. ";
CM_ SG_ 154 OBJ_Has_Cut_Lane_20 "Indicates whether the object cut the host's (right or left) lane. In case there are no lanes, indicates whether the objects is at most 1 meters away from the host.";
CM_ SG_ 154 OBJ_Has_Cut_Path_20 "Indicates whether the object is in the host's path.";
CM_ SG_ 154 OBJ_Brake_Light_20 "Indication for brake lights ";
CM_ SG_ 154 OBJ_Turn_Indicator_Right_20 "Indication for blinking right light.";
CM_ SG_ 154 OBJ_Turn_Indicator_Left_20 "Indication for blinking left light ";
CM_ SG_ 154 OBJ_Light_Indicator_Validity_20 "Validator for light indicators";
CM_ SG_ 154 OBJ_Right_Out_Of_Image_20 "Indicates whether the measurment are predicted out of the right side of the image bounderies.";
CM_ SG_ 154 OBJ_Left_Out_Of_Image_20 "Indicates whether if measurment are predicted out of  the left side of the image bounderies";
CM_ SG_ 154 OBJ_Right_Out_Of_Image_V_20 "validator";
CM_ SG_ 154 OBJ_Left_Out_Of_Image_V_20 "validator";
CM_ SG_ 154 OBJ_Top_Out_Of_Image_20 "Indicates whether if measurment are predicted out of  the top of the image bounderies";
CM_ SG_ 154 OBJ_Bottom_Out_Of_Image_20 "Indicates whether if measurment are predicted out of  the bottom of the image bounderies";
CM_ SG_ 154 OBJ_Top_Out_Of_Image_V_20 "validator";
CM_ SG_ 154 OBJ_Bottom_Out_Of_Image_V_20 "validator";
CM_ SG_ 154 OBJ_Lane_Assignment_20 "The object's lane relative to the host lane.";
CM_ SG_ 154 OBJ_Lane_Assignment_V_20 "Validator for lane assignment";
CM_ SG_ 154 OBJ_Age_Seconds_20 "Time in seconds in which the object was recognized. ";
CM_ SG_ 154 OBJ_Age_Seconds_V_20 "Validator for object age";
CM_ SG_ 154 OBJ_Width_20 "The width of the target vehicle in the world (not to be mistaken with the width of the visible part of the vehicle).";
CM_ SG_ 154 OBJ_Width_V_20 "Validator for object width";
CM_ SG_ 154 OBJ_Width_STD_20 "Standard deviation for object width";
CM_ SG_ 154 OBJ_Width_STD_V_20 "Validator for the standard deviation of object width";
CM_ SG_ 154 OBJ_Length_20 "The length of the vehicle in the world. For crossing bicycles it gives the viewed length of the bicycle.";
CM_ SG_ 154 OBJ_Length_V_20 "Validator for object length.";
CM_ SG_ 154 OBJ_Length_STD_20 "Standard deviation for object length.";
CM_ SG_ 154 OBJ_Length_STD_V_20 "Validator for the standard deviation of object length.";
CM_ SG_ 154 OBJ_Radar_ID_20 "Radar Object ID of the Fused Object, Only relvant when OBJ_Fusion_Source is not Camera only";
CM_ SG_ 154 OBJ_Height_20 "The height of the object in the world. ";
CM_ SG_ 154 OBJ_Height_V_20 "Validator for object height.";
CM_ SG_ 154 OBJ_Height_STD_20 "Standard deviation for object height.";
CM_ SG_ 154 OBJ_Height_STD_V_20 "Validator for the standard deviation of object height.";
CM_ SG_ 154 OBJ_Abs_Long_Velocity_20 "Absolute longitudinal velocity.";
CM_ SG_ 154 OBJ_Abs_Long_Velocity_V_20 "Validator for absolute longitudinal velocity.";
CM_ SG_ 154 OBJ_Abs_Long_Velocity_STD_20 "Standard deviation of absolute longitudinal velocity.";
CM_ SG_ 154 OBJ_Abs_Long_Vel_STD_V_20 "Validator for the standard deviation of the absolute longitudinal velocity.";
CM_ SG_ 154 OBJ_Abs_Lat_Velocity_20 "The lateral ground speed of the object.";
CM_ SG_ 154 OBJ_Abs_Lat_Velocity_V_20 "Validator for the lateral ground speed of the object.";
CM_ SG_ 154 OBJ_Abs_Lat_Velocity_STD_20 "STD of the lateral ground speed of the object.";
CM_ SG_ 154 OBJ_Abs_Lat_Vel_STD_V_20 "Validator for the STD of the lateral ground speed of the object.";
CM_ SG_ 154 OBJ_Abs_Long_Acc_20 "The longitudinal ground acceleration of the object.";
CM_ SG_ 154 OBJ_Abs_Long_Acc_V_20 "Validator for the longitudinal ground acceleration of the object.";
CM_ SG_ 154 OBJ_Abs_Long_Acc_STD_20 "STD of the longitudinal ground acceleration of the object.";
CM_ SG_ 154 OBJ_Abs_Long_Acc_STD_V_20 "Validator for the STD of the longitudinal ground acceleration of the object.";
CM_ SG_ 154 OBJ_Abs_Lat_Acc_20 "The lateral ground acceleration of the object.";
CM_ SG_ 154 OBJ_Abs_Lat_Acc_V_20 "Validator for the lateral ground acceleration of the object.";
CM_ SG_ 154 OBJ_Abs_Lat_Acc_STD_20 "STD of the lateral ground acceleration of the object.";
CM_ SG_ 154 OBJ_Abs_Lat_Acc_STD_V_20 "Validator for the STD of the lateral ground acceleration of the object.";
CM_ SG_ 154 OBJ_Abs_Acceleration_20 "The absolute ground acceleration in the target's heading direction.";
CM_ SG_ 154 OBJ_Abs_Acceleration_V_20 "Validator for the absolute ground acceleration.";
CM_ SG_ 154 OBJ_Abs_Acc_STD_20 "STD of the absolute ground acceleration.";
CM_ SG_ 154 OBJ_Abs_Acc_STD_V_20 "Validator for the STD of the absolute ground acceleration.";
CM_ SG_ 154 OBJ_Inv_TTC_20 "Inverse TTC (time to collision).";
CM_ SG_ 154 OBJ_Inv_TTC_STD_20 "STD for inverse TTC .";
CM_ SG_ 154 OBJ_Inv_TTC_STD_V_20 "Validator for the STD for inverse TTC .";
CM_ SG_ 154 OBJ_Relative_Long_Acc_20 "The relative lateral ground acceleration of the object.";
CM_ SG_ 154 OBJ_Relative_Long_Acc_V_20 "Validator for the relative lateral ground acceleration of the object.";
CM_ SG_ 154 OBJ_Relative_Long_Acc_STD_20 "STD of the relative lateral ground acceleration of the object.";
CM_ SG_ 154 OBJ_Rel_Long_Acc_STD_V_20 "Validator for the STD of the relative lateral ground acceleration.";
CM_ SG_ 154 OBJ_Relative_Long_Velocity_20 "The relative longtitudinal speed between the target and ego vehicle. ";
CM_ SG_ 154 OBJ_Relative_Long_Velocity_V_20 "Validator for the relative longtitudinal speed.";
CM_ SG_ 154 OBJ_Relative_Long_Vel_STD_20 "STD of the relative longtitudinal speed.";
CM_ SG_ 154 OBJ_Rel_Long_Vel_STD_V_20 "Validator for the STD of the relative longtitudinal speed.";
CM_ SG_ 154 OBJ_Relative_Lat_Velocity_20 "The relative lateral speed between the target and ego vehicle. ";
CM_ SG_ 154 OBJ_Relative_Lat_Velocity_V_20 "Validator for the relative lateral speed. ";
CM_ SG_ 154 OBJ_Relative_Lat_Velocity_STD_20 "STD of the relative lateral speed. ";
CM_ SG_ 154 OBJ_Rel_Lat_Vel_STD_V_20 "Validator for the STD of the relative lateral speed. ";
CM_ SG_ 154 OBJ_Long_Distance_20 "The longitudinal distance to middle of the rear bumper (middle of the RL and RR corners) of the target.";
CM_ SG_ 154 OBJ_Long_Distance_V_20 "Validator of the longtitudinal distance field";
CM_ SG_ 154 OBJ_Long_Distance_STD_20 "STD of the  longtitudinal distance.";
CM_ SG_ 154 OBJ_Long_Distance_STD_V_20 "Validator for the STD of the  longtitudinal distance.";
CM_ SG_ 154 OBJ_Lat_Distance_20 "Lateral distance to the middle of the RL and RR corners.  ";
CM_ SG_ 154 OBJ_Lat_Distance_V_20 "Validator for the lateral distance of the object.";
CM_ SG_ 154 OBJ_Lat_Distance_STD_20 "STD of the lateral distance of the object.";
CM_ SG_ 154 OBJ_Lat_Distance_STD_V_20 "Validator for the STD of the lateral distance of the object.";
CM_ SG_ 154 OBJ_Absolute_Speed_20 "The absolute ground speed in the targets' heading direction.";
CM_ SG_ 154 OBJ_Absolute_Speed_V_20 "Validator for the absolute ground speed.";
CM_ SG_ 154 OBJ_Absolute_Speed_STD_20 "STD of the absolute ground speed.";
CM_ SG_ 154 OBJ_Absolute_Speed_STD_V_20 "Validator for the STD of the absolute ground speed.";
CM_ SG_ 154 OBJ_Heading_20 "The angle beetweenthe host longitudinal axis and target's heading (clockwise, e.g. PI/2 is a target crossing from left to right).";
CM_ SG_ 154 OBJ_Heading_V_20 "Validator for the object heading.";
CM_ SG_ 154 OBJ_Heading_STD_20 "STD of the object heading.";
CM_ SG_ 154 OBJ_Heading_STD_V_20 "Validator for the STD of the object heading.";
CM_ SG_ 154 OBJ_Angle_Rate_STD_20 "Standard deviation of the angular speed. (radians)";
CM_ SG_ 154 OBJ_Angle_Rate_STD_V_20 "Validator for the STD of the angular speed.";
CM_ SG_ 154 OBJ_Angle_Rate_20 "The momentary angular speed of the object. (radians)";
CM_ SG_ 154 OBJ_Angle_Rate_V_20 "Validator for the angular speed.";
CM_ SG_ 154 OBJ_Angle_Right_20 "The angle between the host longitudinal axis and the right side of the front / rear of the target (the visible one). The positive side is to the host's right.";
CM_ SG_ 154 OBJ_Angle_Right_V_20 "Validator for angleRight";
CM_ SG_ 154 OBJ_Angle_Right_STD_20 "Standard deviation of angleRight";
CM_ SG_ 154 OBJ_Angle_Right_STD_V_20 "Validator for the standard deviation of angleRight.";
CM_ SG_ 154 OBJ_Angle_Left_20 "The angle between the host longitudinal axis and the left side of the front / rear of the target (the visible one). The positive side is to the host's right.";
CM_ SG_ 154 OBJ_Angle_Left_V_20 "Validator for angleLeft.";
CM_ SG_ 154 OBJ_Angle_Left_STD_20 "Standard deviation of angleLeft.";
CM_ SG_ 154 OBJ_Angle_Left_STD_V_20 "Validator for the standard deviation of angleLeft.";
CM_ SG_ 154 OBJ_Angle_Side_20 "The angle between the host longitudinal axis and the far visible edge - the visible edge of the front / rear of the target that is not visible. Currently supported for vehicles only.";
CM_ SG_ 154 OBJ_Angle_Side_V_20 "Validator for angleSide.";
CM_ SG_ 154 OBJ_Angle_Side_STD_20 "Standard deviation of angleSide.";
CM_ SG_ 154 OBJ_Angle_Side_STD_V_20 "Validator for the STD of angleSide.";
CM_ SG_ 154 OBJ_Angle_Mid_V_20 "Validator for angleMid.";
CM_ SG_ 154 OBJ_Angle_Mid_20 "The angle between the host longitudinal axis and the middle of the front / rear of the target (the visible one). The positive side is to the host's right.";
CM_ SG_ 154 OBJ_Angle_Mid_STD_20 "Standard deviation of angleMid.";
CM_ SG_ 154 OBJ_Angle_Mid_STD_V_20 "Validator for the STD of angleMid.";
CM_ SG_ 154 OBJ_Angle_Bottom_V_20 "Validator for OBJAngle_Bottom. ";
CM_ SG_ 154 OBJ_Angle_Bottom_20 "The angle between the longitudinal axis and the Bottom of the front / rear of the target (the visible one). The positive side is to the host's bottom";
CM_ SG_ 154 OBJ_Angle_Bottom_STD_20 "STD for OBJAngle_Bottom. ";
CM_ SG_ 154 OBJ_Angle_Bottom_STD_V_20 "Validator for OBJAngle_Bottom_STD. ";
CM_ SG_ 154 OBJ_Visibility_Side_V_20 "Currently Supported for VD only";
CM_ SG_ 154 OBJ_Visibility_Side_20 "From what car  side is the object visible";
CM_ SG_ 154 OBJ_Is_In_Drivable_Area_20 "Indicates whether the target is in a driveable area.";
CM_ SG_ 154 OBJ_Is_In_Drivable_Area_V_20 "Validator for OBJ_Is_In_Drivable_Area.";
CM_ SG_ 154 OBJ_Is_VeryClose_V_20 "Validator for OBJ_Is_VeryClose. ";
CM_ SG_ 154 OBJ_Is_VeryClose_20 "Indicates whether the target is very close to the host such that it is hard to measure its distance. Currently relevant for peds only";
CM_ SG_ 154 OBJ_OverlapAngleEgoLaneR_20 "Lateral distance to the middle of the RL and RR corners.";
CM_ SG_ 154 OBJ_OverlapAngleEgoLaneR_V_20 "Validator for OBJ_OverlapAngleEgoLaneR";
CM_ SG_ 154 OBJ_OverlapAngleEgoLaneL_20 "Lateral distance to the middle of the RL and RR corners.  ";
CM_ SG_ 154 OBJ_OverlapAngleEgoLaneL_V_20 "Validator for OBJ_OverlapAngleEgoLaneL";
CM_ SG_ 154 OBJ_Is_EMERGENCY_VCL_20 "Is Object an Emergency Vehicle";
CM_ SG_ 154 OBJ_EMERGENCY_LIGHT_COLOR_20 "Emergency Color";
CM_ SG_ 154 OBJ_EMERGENCY_V_20 "Are OBJ_Is_EMERGENCY_VCL and OBJ_EMERGENCY_LIGHT_COLOR Valid";
CM_ SG_ 154 OBJ_Angle_Top_20 "From VD touching point on the ground till the roof of the car";
CM_ SG_ 154 OBJ_Angle_Top_V_20 "Validator for OBJ_Angle_Top ";
CM_ SG_ 154 OBJ_Angle_Top_STD_20 "STD for OBJ_Angle_Top";
CM_ SG_ 154 OBJ_Angle_Top_STD_V_20 "Validator for OBJ_Angle_Top_STD. ";
CM_ SG_ 154 OBJ_CRC_21 "Calculated over all element signals. From the signal after the CRC until the first signal in the next elements OBJ_CRC_N+1  not including";
CM_ SG_ 154 OBJ_ID_21 "The detected object ID. Range is 1-255, while 0 indicates that the field in unfilled.";
CM_ SG_ 154 OBJ_Existence_Probability_21 "The existence probability of the reported object";
CM_ SG_ 154 OBJ_Fusion_Source_21 "sources ids used for fusion";
CM_ SG_ 154 OBJ_Triggered_SDM_21 "Indicates whether the object has trigered the SDM (Safety Diagnostic Manager) alert.";
CM_ SG_ 154 OBJ_Motion_Category_21 "Relevant for VD only. Full description of values can be found at the ACC guide.";
CM_ SG_ 154 OBJ_Object_Age_21 "The number of frames in which the object was recognized.";
CM_ SG_ 154 OBJ_Measuring_Status_21 "Measurment status. Old vs New marks if this is the first frame in which the object is reported. Predicted vs Measured marks if the report is raw or has been predicted forward in time using the measured dynamics and ego motion.";
CM_ SG_ 154 OBJ_Object_Class_21 "Indicates the object type. Uncertain is outputted in case the probability that a vehicle is a truck is very similar to the probability that it is a car. ";
CM_ SG_ 154 OBJ_Class_Probability_21 "The probability of this type classification.";
CM_ SG_ 154 OBJ_Car_Probability_21 "The probability the object is a car";
CM_ SG_ 154 OBJ_Truck_Probability_21 "The probability the object is a Truck";
CM_ SG_ 154 OBJ_Bike_Probability_21 "The probability the object is a Bike";
CM_ SG_ 154 OBJ_Camera_Source_21 "The camera in which this object was detected (best choice).";
CM_ SG_ 154 OBJ_Motion_Status_21 "MOVING - the object is moving STATIONARY - the object was never seen moving STOPPED -  the object was moving and has stopped MOVING_SLOWLY - the object is moving very slowly";
CM_ SG_ 154 OBJ_Motion_Orientation_21 "The direction of the targets heading compared to the host. ";
CM_ SG_ 154 OBJ_Has_Cut_Lane_21 "Indicates whether the object cut the host's (right or left) lane. In case there are no lanes, indicates whether the objects is at most 1 meters away from the host.";
CM_ SG_ 154 OBJ_Has_Cut_Path_21 "Indicates whether the object is in the host's path.";
CM_ SG_ 154 OBJ_Brake_Light_21 "Indication for brake lights ";
CM_ SG_ 154 OBJ_Turn_Indicator_Right_21 "Indication for blinking right light.";
CM_ SG_ 154 OBJ_Turn_Indicator_Left_21 "Indication for blinking left light ";
CM_ SG_ 154 OBJ_Light_Indicator_Validity_21 "Validator for light indicators";
CM_ SG_ 154 OBJ_Right_Out_Of_Image_21 "Indicates whether the measurment are predicted out of the right side of the image bounderies.";
CM_ SG_ 154 OBJ_Left_Out_Of_Image_21 "Indicates whether if measurment are predicted out of  the left side of the image bounderies";
CM_ SG_ 154 OBJ_Right_Out_Of_Image_V_21 "validator";
CM_ SG_ 154 OBJ_Left_Out_Of_Image_V_21 "validator";
CM_ SG_ 154 OBJ_Top_Out_Of_Image_21 "Indicates whether if measurment are predicted out of  the top of the image bounderies";
CM_ SG_ 154 OBJ_Bottom_Out_Of_Image_21 "Indicates whether if measurment are predicted out of  the bottom of the image bounderies";
CM_ SG_ 154 OBJ_Top_Out_Of_Image_V_21 "validator";
CM_ SG_ 154 OBJ_Bottom_Out_Of_Image_V_21 "validator";
CM_ SG_ 154 OBJ_Lane_Assignment_21 "The object's lane relative to the host lane.";
CM_ SG_ 154 OBJ_Lane_Assignment_V_21 "Validator for lane assignment";
CM_ SG_ 154 OBJ_Age_Seconds_21 "Time in seconds in which the object was recognized. ";
CM_ SG_ 154 OBJ_Age_Seconds_V_21 "Validator for object age";
CM_ SG_ 154 OBJ_Width_21 "The width of the target vehicle in the world (not to be mistaken with the width of the visible part of the vehicle).";
CM_ SG_ 154 OBJ_Width_V_21 "Validator for object width";
CM_ SG_ 154 OBJ_Width_STD_21 "Standard deviation for object width";
CM_ SG_ 154 OBJ_Width_STD_V_21 "Validator for the standard deviation of object width";
CM_ SG_ 154 OBJ_Length_21 "The length of the vehicle in the world. For crossing bicycles it gives the viewed length of the bicycle.";
CM_ SG_ 154 OBJ_Length_V_21 "Validator for object length.";
CM_ SG_ 154 OBJ_Length_STD_21 "Standard deviation for object length.";
CM_ SG_ 154 OBJ_Length_STD_V_21 "Validator for the standard deviation of object length.";
CM_ SG_ 154 OBJ_Radar_ID_21 "Radar Object ID of the Fused Object, Only relvant when OBJ_Fusion_Source is not Camera only";
CM_ SG_ 154 OBJ_Height_21 "The height of the object in the world. ";
CM_ SG_ 154 OBJ_Height_V_21 "Validator for object height.";
CM_ SG_ 154 OBJ_Height_STD_21 "Standard deviation for object height.";
CM_ SG_ 154 OBJ_Height_STD_V_21 "Validator for the standard deviation of object height.";
CM_ SG_ 154 OBJ_Abs_Long_Velocity_21 "Absolute longitudinal velocity.";
CM_ SG_ 154 OBJ_Abs_Long_Velocity_V_21 "Validator for absolute longitudinal velocity.";
CM_ SG_ 154 OBJ_Abs_Long_Velocity_STD_21 "Standard deviation of absolute longitudinal velocity.";
CM_ SG_ 154 OBJ_Abs_Long_Vel_STD_V_21 "Validator for the standard deviation of the absolute longitudinal velocity.";
CM_ SG_ 154 OBJ_Abs_Lat_Velocity_21 "The lateral ground speed of the object.";
CM_ SG_ 154 OBJ_Abs_Lat_Velocity_V_21 "Validator for the lateral ground speed of the object.";
CM_ SG_ 154 OBJ_Abs_Lat_Velocity_STD_21 "STD of the lateral ground speed of the object.";
CM_ SG_ 154 OBJ_Abs_Lat_Vel_STD_V_21 "Validator for the STD of the lateral ground speed of the object.";
CM_ SG_ 154 OBJ_Abs_Long_Acc_21 "The longitudinal ground acceleration of the object.";
CM_ SG_ 154 OBJ_Abs_Long_Acc_V_21 "Validator for the longitudinal ground acceleration of the object.";
CM_ SG_ 154 OBJ_Abs_Long_Acc_STD_21 "STD of the longitudinal ground acceleration of the object.";
CM_ SG_ 154 OBJ_Abs_Long_Acc_STD_V_21 "Validator for the STD of the longitudinal ground acceleration of the object.";
CM_ SG_ 154 OBJ_Abs_Lat_Acc_21 "The lateral ground acceleration of the object.";
CM_ SG_ 154 OBJ_Abs_Lat_Acc_V_21 "Validator for the lateral ground acceleration of the object.";
CM_ SG_ 154 OBJ_Abs_Lat_Acc_STD_21 "STD of the lateral ground acceleration of the object.";
CM_ SG_ 154 OBJ_Abs_Lat_Acc_STD_V_21 "Validator for the STD of the lateral ground acceleration of the object.";
CM_ SG_ 154 OBJ_Abs_Acceleration_21 "The absolute ground acceleration in the target's heading direction.";
CM_ SG_ 154 OBJ_Abs_Acceleration_V_21 "Validator for the absolute ground acceleration.";
CM_ SG_ 154 OBJ_Abs_Acc_STD_21 "STD of the absolute ground acceleration.";
CM_ SG_ 154 OBJ_Abs_Acc_STD_V_21 "Validator for the STD of the absolute ground acceleration.";
CM_ SG_ 154 OBJ_Inv_TTC_21 "Inverse TTC (time to collision).";
CM_ SG_ 154 OBJ_Inv_TTC_STD_21 "STD for inverse TTC .";
CM_ SG_ 154 OBJ_Inv_TTC_STD_V_21 "Validator for the STD for inverse TTC .";
CM_ SG_ 154 OBJ_Relative_Long_Acc_21 "The relative lateral ground acceleration of the object.";
CM_ SG_ 154 OBJ_Relative_Long_Acc_V_21 "Validator for the relative lateral ground acceleration of the object.";
CM_ SG_ 154 OBJ_Relative_Long_Acc_STD_21 "STD of the relative lateral ground acceleration of the object.";
CM_ SG_ 154 OBJ_Rel_Long_Acc_STD_V_21 "Validator for the STD of the relative lateral ground acceleration.";
CM_ SG_ 154 OBJ_Relative_Long_Velocity_21 "The relative longtitudinal speed between the target and ego vehicle. ";
CM_ SG_ 154 OBJ_Relative_Long_Velocity_V_21 "Validator for the relative longtitudinal speed.";
CM_ SG_ 154 OBJ_Relative_Long_Vel_STD_21 "STD of the relative longtitudinal speed.";
CM_ SG_ 154 OBJ_Rel_Long_Vel_STD_V_21 "Validator for the STD of the relative longtitudinal speed.";
CM_ SG_ 154 OBJ_Relative_Lat_Velocity_21 "The relative lateral speed between the target and ego vehicle. ";
CM_ SG_ 154 OBJ_Relative_Lat_Velocity_V_21 "Validator for the relative lateral speed. ";
CM_ SG_ 154 OBJ_Relative_Lat_Velocity_STD_21 "STD of the relative lateral speed. ";
CM_ SG_ 154 OBJ_Rel_Lat_Vel_STD_V_21 "Validator for the STD of the relative lateral speed. ";
CM_ SG_ 154 OBJ_Long_Distance_21 "The longitudinal distance to middle of the rear bumper (middle of the RL and RR corners) of the target.";
CM_ SG_ 154 OBJ_Long_Distance_V_21 "Validator of the longtitudinal distance field";
CM_ SG_ 154 OBJ_Long_Distance_STD_21 "STD of the  longtitudinal distance.";
CM_ SG_ 154 OBJ_Long_Distance_STD_V_21 "Validator for the STD of the  longtitudinal distance.";
CM_ SG_ 154 OBJ_Lat_Distance_21 "Lateral distance to the middle of the RL and RR corners.  ";
CM_ SG_ 154 OBJ_Lat_Distance_V_21 "Validator for the lateral distance of the object.";
CM_ SG_ 154 OBJ_Lat_Distance_STD_21 "STD of the lateral distance of the object.";
CM_ SG_ 154 OBJ_Lat_Distance_STD_V_21 "Validator for the STD of the lateral distance of the object.";
CM_ SG_ 154 OBJ_Absolute_Speed_21 "The absolute ground speed in the targets' heading direction.";
CM_ SG_ 154 OBJ_Absolute_Speed_V_21 "Validator for the absolute ground speed.";
CM_ SG_ 154 OBJ_Absolute_Speed_STD_21 "STD of the absolute ground speed.";
CM_ SG_ 154 OBJ_Absolute_Speed_STD_V_21 "Validator for the STD of the absolute ground speed.";
CM_ SG_ 154 OBJ_Heading_21 "The angle beetweenthe host longitudinal axis and target's heading (clockwise, e.g. PI/2 is a target crossing from left to right).";
CM_ SG_ 154 OBJ_Heading_V_21 "Validator for the object heading.";
CM_ SG_ 154 OBJ_Heading_STD_21 "STD of the object heading.";
CM_ SG_ 154 OBJ_Heading_STD_V_21 "Validator for the STD of the object heading.";
CM_ SG_ 154 OBJ_Angle_Rate_STD_21 "Standard deviation of the angular speed. (radians)";
CM_ SG_ 154 OBJ_Angle_Rate_STD_V_21 "Validator for the STD of the angular speed.";
CM_ SG_ 154 OBJ_Angle_Rate_21 "The momentary angular speed of the object. (radians)";
CM_ SG_ 154 OBJ_Angle_Rate_V_21 "Validator for the angular speed.";
CM_ SG_ 154 OBJ_Angle_Right_21 "The angle between the host longitudinal axis and the right side of the front / rear of the target (the visible one). The positive side is to the host's right.";
CM_ SG_ 154 OBJ_Angle_Right_V_21 "Validator for angleRight";
CM_ SG_ 154 OBJ_Angle_Right_STD_21 "Standard deviation of angleRight";
CM_ SG_ 154 OBJ_Angle_Right_STD_V_21 "Validator for the standard deviation of angleRight.";
CM_ SG_ 154 OBJ_Angle_Left_21 "The angle between the host longitudinal axis and the left side of the front / rear of the target (the visible one). The positive side is to the host's right.";
CM_ SG_ 154 OBJ_Angle_Left_V_21 "Validator for angleLeft.";
CM_ SG_ 154 OBJ_Angle_Left_STD_21 "Standard deviation of angleLeft.";
CM_ SG_ 154 OBJ_Angle_Left_STD_V_21 "Validator for the standard deviation of angleLeft.";
CM_ SG_ 154 OBJ_Angle_Side_21 "The angle between the host longitudinal axis and the far visible edge - the visible edge of the front / rear of the target that is not visible. Currently supported for vehicles only.";
CM_ SG_ 154 OBJ_Angle_Side_V_21 "Validator for angleSide.";
CM_ SG_ 154 OBJ_Angle_Side_STD_21 "Standard deviation of angleSide.";
CM_ SG_ 154 OBJ_Angle_Side_STD_V_21 "Validator for the STD of angleSide.";
CM_ SG_ 154 OBJ_Angle_Mid_V_21 "Validator for angleMid.";
CM_ SG_ 154 OBJ_Angle_Mid_21 "The angle between the host longitudinal axis and the middle of the front / rear of the target (the visible one). The positive side is to the host's right.";
CM_ SG_ 154 OBJ_Angle_Mid_STD_21 "Standard deviation of angleMid.";
CM_ SG_ 154 OBJ_Angle_Mid_STD_V_21 "Validator for the STD of angleMid.";
CM_ SG_ 154 OBJ_Angle_Bottom_V_21 "Validator for OBJAngle_Bottom. ";
CM_ SG_ 154 OBJ_Angle_Bottom_21 "The angle between the longitudinal axis and the Bottom of the front / rear of the target (the visible one). The positive side is to the host's bottom";
CM_ SG_ 154 OBJ_Angle_Bottom_STD_21 "STD for OBJAngle_Bottom. ";
CM_ SG_ 154 OBJ_Angle_Bottom_STD_V_21 "Validator for OBJAngle_Bottom_STD. ";
CM_ SG_ 154 OBJ_Visibility_Side_V_21 "Currently Supported for VD only";
CM_ SG_ 154 OBJ_Visibility_Side_21 "From what car  side is the object visible";
CM_ SG_ 154 OBJ_Is_In_Drivable_Area_21 "Indicates whether the target is in a driveable area.";
CM_ SG_ 154 OBJ_Is_In_Drivable_Area_V_21 "Validator for OBJ_Is_In_Drivable_Area.";
CM_ SG_ 154 OBJ_Is_VeryClose_V_21 "Validator for OBJ_Is_VeryClose. ";
CM_ SG_ 154 OBJ_Is_VeryClose_21 "Indicates whether the target is very close to the host such that it is hard to measure its distance. Currently relevant for peds only";
CM_ SG_ 154 OBJ_OverlapAngleEgoLaneR_21 "Lateral distance to the middle of the RL and RR corners.";
CM_ SG_ 154 OBJ_OverlapAngleEgoLaneR_V_21 "Validator for OBJ_OverlapAngleEgoLaneR";
CM_ SG_ 154 OBJ_OverlapAngleEgoLaneL_21 "Lateral distance to the middle of the RL and RR corners.  ";
CM_ SG_ 154 OBJ_OverlapAngleEgoLaneL_V_21 "Validator for OBJ_OverlapAngleEgoLaneL";
CM_ SG_ 154 OBJ_Is_EMERGENCY_VCL_21 "Is Object an Emergency Vehicle";
CM_ SG_ 154 OBJ_EMERGENCY_LIGHT_COLOR_21 "Emergency Color";
CM_ SG_ 154 OBJ_EMERGENCY_V_21 "Are OBJ_Is_EMERGENCY_VCL and OBJ_EMERGENCY_LIGHT_COLOR Valid";
CM_ SG_ 154 OBJ_Angle_Top_21 "From VD touching point on the ground till the roof of the car";
CM_ SG_ 154 OBJ_Angle_Top_V_21 "Validator for OBJ_Angle_Top ";
CM_ SG_ 154 OBJ_Angle_Top_STD_21 "STD for OBJ_Angle_Top";
CM_ SG_ 154 OBJ_Angle_Top_STD_V_21 "Validator for OBJ_Angle_Top_STD. ";
CM_ SG_ 154 OBJ_CRC_22 "Calculated over all element signals. From the signal after the CRC until the first signal in the next elements OBJ_CRC_N+1  not including";
CM_ SG_ 154 OBJ_ID_22 "The detected object ID. Range is 1-255, while 0 indicates that the field in unfilled.";
CM_ SG_ 154 OBJ_Existence_Probability_22 "The existence probability of the reported object";
CM_ SG_ 154 OBJ_Fusion_Source_22 "sources ids used for fusion";
CM_ SG_ 154 OBJ_Triggered_SDM_22 "Indicates whether the object has trigered the SDM (Safety Diagnostic Manager) alert.";
CM_ SG_ 154 OBJ_Motion_Category_22 "Relevant for VD only. Full description of values can be found at the ACC guide.";
CM_ SG_ 154 OBJ_Object_Age_22 "The number of frames in which the object was recognized.";
CM_ SG_ 154 OBJ_Measuring_Status_22 "Measurment status. Old vs New marks if this is the first frame in which the object is reported. Predicted vs Measured marks if the report is raw or has been predicted forward in time using the measured dynamics and ego motion.";
CM_ SG_ 154 OBJ_Object_Class_22 "Indicates the object type. Uncertain is outputted in case the probability that a vehicle is a truck is very similar to the probability that it is a car. ";
CM_ SG_ 154 OBJ_Class_Probability_22 "The probability of this type classification.";
CM_ SG_ 154 OBJ_Car_Probability_22 "The probability the object is a car";
CM_ SG_ 154 OBJ_Truck_Probability_22 "The probability the object is a Truck";
CM_ SG_ 154 OBJ_Bike_Probability_22 "The probability the object is a Bike";
CM_ SG_ 154 OBJ_Camera_Source_22 "The camera in which this object was detected (best choice).";
CM_ SG_ 154 OBJ_Motion_Status_22 "MOVING - the object is moving STATIONARY - the object was never seen moving STOPPED -  the object was moving and has stopped MOVING_SLOWLY - the object is moving very slowly";
CM_ SG_ 154 OBJ_Motion_Orientation_22 "The direction of the targets heading compared to the host. ";
CM_ SG_ 154 OBJ_Has_Cut_Lane_22 "Indicates whether the object cut the host's (right or left) lane. In case there are no lanes, indicates whether the objects is at most 1 meters away from the host.";
CM_ SG_ 154 OBJ_Has_Cut_Path_22 "Indicates whether the object is in the host's path.";
CM_ SG_ 154 OBJ_Brake_Light_22 "Indication for brake lights ";
CM_ SG_ 154 OBJ_Turn_Indicator_Right_22 "Indication for blinking right light.";
CM_ SG_ 154 OBJ_Turn_Indicator_Left_22 "Indication for blinking left light ";
CM_ SG_ 154 OBJ_Light_Indicator_Validity_22 "Validator for light indicators";
CM_ SG_ 154 OBJ_Right_Out_Of_Image_22 "Indicates whether the measurment are predicted out of the right side of the image bounderies.";
CM_ SG_ 154 OBJ_Left_Out_Of_Image_22 "Indicates whether if measurment are predicted out of  the left side of the image bounderies";
CM_ SG_ 154 OBJ_Right_Out_Of_Image_V_22 "validator";
CM_ SG_ 154 OBJ_Left_Out_Of_Image_V_22 "validator";
CM_ SG_ 154 OBJ_Top_Out_Of_Image_22 "Indicates whether if measurment are predicted out of  the top of the image bounderies";
CM_ SG_ 154 OBJ_Bottom_Out_Of_Image_22 "Indicates whether if measurment are predicted out of  the bottom of the image bounderies";
CM_ SG_ 154 OBJ_Top_Out_Of_Image_V_22 "validator";
CM_ SG_ 154 OBJ_Bottom_Out_Of_Image_V_22 "validator";
CM_ SG_ 154 OBJ_Lane_Assignment_22 "The object's lane relative to the host lane.";
CM_ SG_ 154 OBJ_Lane_Assignment_V_22 "Validator for lane assignment";
CM_ SG_ 154 OBJ_Age_Seconds_22 "Time in seconds in which the object was recognized. ";
CM_ SG_ 154 OBJ_Age_Seconds_V_22 "Validator for object age";
CM_ SG_ 154 OBJ_Width_22 "The width of the target vehicle in the world (not to be mistaken with the width of the visible part of the vehicle).";
CM_ SG_ 154 OBJ_Width_V_22 "Validator for object width";
CM_ SG_ 154 OBJ_Width_STD_22 "Standard deviation for object width";
CM_ SG_ 154 OBJ_Width_STD_V_22 "Validator for the standard deviation of object width";
CM_ SG_ 154 OBJ_Length_22 "The length of the vehicle in the world. For crossing bicycles it gives the viewed length of the bicycle.";
CM_ SG_ 154 OBJ_Length_V_22 "Validator for object length.";
CM_ SG_ 154 OBJ_Length_STD_22 "Standard deviation for object length.";
CM_ SG_ 154 OBJ_Length_STD_V_22 "Validator for the standard deviation of object length.";
CM_ SG_ 154 OBJ_Radar_ID_22 "Radar Object ID of the Fused Object, Only relvant when OBJ_Fusion_Source is not Camera only";
CM_ SG_ 154 OBJ_Height_22 "The height of the object in the world. ";
CM_ SG_ 154 OBJ_Height_V_22 "Validator for object height.";
CM_ SG_ 154 OBJ_Height_STD_22 "Standard deviation for object height.";
CM_ SG_ 154 OBJ_Height_STD_V_22 "Validator for the standard deviation of object height.";
CM_ SG_ 154 OBJ_Abs_Long_Velocity_22 "Absolute longitudinal velocity.";
CM_ SG_ 154 OBJ_Abs_Long_Velocity_V_22 "Validator for absolute longitudinal velocity.";
CM_ SG_ 154 OBJ_Abs_Long_Velocity_STD_22 "Standard deviation of absolute longitudinal velocity.";
CM_ SG_ 154 OBJ_Abs_Long_Vel_STD_V_22 "Validator for the standard deviation of the absolute longitudinal velocity.";
CM_ SG_ 154 OBJ_Abs_Lat_Velocity_22 "The lateral ground speed of the object.";
CM_ SG_ 154 OBJ_Abs_Lat_Velocity_V_22 "Validator for the lateral ground speed of the object.";
CM_ SG_ 154 OBJ_Abs_Lat_Velocity_STD_22 "STD of the lateral ground speed of the object.";
CM_ SG_ 154 OBJ_Abs_Lat_Vel_STD_V_22 "Validator for the STD of the lateral ground speed of the object.";
CM_ SG_ 154 OBJ_Abs_Long_Acc_22 "The longitudinal ground acceleration of the object.";
CM_ SG_ 154 OBJ_Abs_Long_Acc_V_22 "Validator for the longitudinal ground acceleration of the object.";
CM_ SG_ 154 OBJ_Abs_Long_Acc_STD_22 "STD of the longitudinal ground acceleration of the object.";
CM_ SG_ 154 OBJ_Abs_Long_Acc_STD_V_22 "Validator for the STD of the longitudinal ground acceleration of the object.";
CM_ SG_ 154 OBJ_Abs_Lat_Acc_22 "The lateral ground acceleration of the object.";
CM_ SG_ 154 OBJ_Abs_Lat_Acc_V_22 "Validator for the lateral ground acceleration of the object.";
CM_ SG_ 154 OBJ_Abs_Lat_Acc_STD_22 "STD of the lateral ground acceleration of the object.";
CM_ SG_ 154 OBJ_Abs_Lat_Acc_STD_V_22 "Validator for the STD of the lateral ground acceleration of the object.";
CM_ SG_ 154 OBJ_Abs_Acceleration_22 "The absolute ground acceleration in the target's heading direction.";
CM_ SG_ 154 OBJ_Abs_Acceleration_V_22 "Validator for the absolute ground acceleration.";
CM_ SG_ 154 OBJ_Abs_Acc_STD_22 "STD of the absolute ground acceleration.";
CM_ SG_ 154 OBJ_Abs_Acc_STD_V_22 "Validator for the STD of the absolute ground acceleration.";
CM_ SG_ 154 OBJ_Inv_TTC_22 "Inverse TTC (time to collision).";
CM_ SG_ 154 OBJ_Inv_TTC_STD_22 "STD for inverse TTC .";
CM_ SG_ 154 OBJ_Inv_TTC_STD_V_22 "Validator for the STD for inverse TTC .";
CM_ SG_ 154 OBJ_Relative_Long_Acc_22 "The relative lateral ground acceleration of the object.";
CM_ SG_ 154 OBJ_Relative_Long_Acc_V_22 "Validator for the relative lateral ground acceleration of the object.";
CM_ SG_ 154 OBJ_Relative_Long_Acc_STD_22 "STD of the relative lateral ground acceleration of the object.";
CM_ SG_ 154 OBJ_Rel_Long_Acc_STD_V_22 "Validator for the STD of the relative lateral ground acceleration.";
CM_ SG_ 154 OBJ_Relative_Long_Velocity_22 "The relative longtitudinal speed between the target and ego vehicle. ";
CM_ SG_ 154 OBJ_Relative_Long_Velocity_V_22 "Validator for the relative longtitudinal speed.";
CM_ SG_ 154 OBJ_Relative_Long_Vel_STD_22 "STD of the relative longtitudinal speed.";
CM_ SG_ 154 OBJ_Rel_Long_Vel_STD_V_22 "Validator for the STD of the relative longtitudinal speed.";
CM_ SG_ 154 OBJ_Relative_Lat_Velocity_22 "The relative lateral speed between the target and ego vehicle. ";
CM_ SG_ 154 OBJ_Relative_Lat_Velocity_V_22 "Validator for the relative lateral speed. ";
CM_ SG_ 154 OBJ_Relative_Lat_Velocity_STD_22 "STD of the relative lateral speed. ";
CM_ SG_ 154 OBJ_Rel_Lat_Vel_STD_V_22 "Validator for the STD of the relative lateral speed. ";
CM_ SG_ 154 OBJ_Long_Distance_22 "The longitudinal distance to middle of the rear bumper (middle of the RL and RR corners) of the target.";
CM_ SG_ 154 OBJ_Long_Distance_V_22 "Validator of the longtitudinal distance field";
CM_ SG_ 154 OBJ_Long_Distance_STD_22 "STD of the  longtitudinal distance.";
CM_ SG_ 154 OBJ_Long_Distance_STD_V_22 "Validator for the STD of the  longtitudinal distance.";
CM_ SG_ 154 OBJ_Lat_Distance_22 "Lateral distance to the middle of the RL and RR corners.  ";
CM_ SG_ 154 OBJ_Lat_Distance_V_22 "Validator for the lateral distance of the object.";
CM_ SG_ 154 OBJ_Lat_Distance_STD_22 "STD of the lateral distance of the object.";
CM_ SG_ 154 OBJ_Lat_Distance_STD_V_22 "Validator for the STD of the lateral distance of the object.";
CM_ SG_ 154 OBJ_Absolute_Speed_22 "The absolute ground speed in the targets' heading direction.";
CM_ SG_ 154 OBJ_Absolute_Speed_V_22 "Validator for the absolute ground speed.";
CM_ SG_ 154 OBJ_Absolute_Speed_STD_22 "STD of the absolute ground speed.";
CM_ SG_ 154 OBJ_Absolute_Speed_STD_V_22 "Validator for the STD of the absolute ground speed.";
CM_ SG_ 154 OBJ_Heading_22 "The angle beetweenthe host longitudinal axis and target's heading (clockwise, e.g. PI/2 is a target crossing from left to right).";
CM_ SG_ 154 OBJ_Heading_V_22 "Validator for the object heading.";
CM_ SG_ 154 OBJ_Heading_STD_22 "STD of the object heading.";
CM_ SG_ 154 OBJ_Heading_STD_V_22 "Validator for the STD of the object heading.";
CM_ SG_ 154 OBJ_Angle_Rate_STD_22 "Standard deviation of the angular speed. (radians)";
CM_ SG_ 154 OBJ_Angle_Rate_STD_V_22 "Validator for the STD of the angular speed.";
CM_ SG_ 154 OBJ_Angle_Rate_22 "The momentary angular speed of the object. (radians)";
CM_ SG_ 154 OBJ_Angle_Rate_V_22 "Validator for the angular speed.";
CM_ SG_ 154 OBJ_Angle_Right_22 "The angle between the host longitudinal axis and the right side of the front / rear of the target (the visible one). The positive side is to the host's right.";
CM_ SG_ 154 OBJ_Angle_Right_V_22 "Validator for angleRight";
CM_ SG_ 154 OBJ_Angle_Right_STD_22 "Standard deviation of angleRight";
CM_ SG_ 154 OBJ_Angle_Right_STD_V_22 "Validator for the standard deviation of angleRight.";
CM_ SG_ 154 OBJ_Angle_Left_22 "The angle between the host longitudinal axis and the left side of the front / rear of the target (the visible one). The positive side is to the host's right.";
CM_ SG_ 154 OBJ_Angle_Left_V_22 "Validator for angleLeft.";
CM_ SG_ 154 OBJ_Angle_Left_STD_22 "Standard deviation of angleLeft.";
CM_ SG_ 154 OBJ_Angle_Left_STD_V_22 "Validator for the standard deviation of angleLeft.";
CM_ SG_ 154 OBJ_Angle_Side_22 "The angle between the host longitudinal axis and the far visible edge - the visible edge of the front / rear of the target that is not visible. Currently supported for vehicles only.";
CM_ SG_ 154 OBJ_Angle_Side_V_22 "Validator for angleSide.";
CM_ SG_ 154 OBJ_Angle_Side_STD_22 "Standard deviation of angleSide.";
CM_ SG_ 154 OBJ_Angle_Side_STD_V_22 "Validator for the STD of angleSide.";
CM_ SG_ 154 OBJ_Angle_Mid_V_22 "Validator for angleMid.";
CM_ SG_ 154 OBJ_Angle_Mid_22 "The angle between the host longitudinal axis and the middle of the front / rear of the target (the visible one). The positive side is to the host's right.";
CM_ SG_ 154 OBJ_Angle_Mid_STD_22 "Standard deviation of angleMid.";
CM_ SG_ 154 OBJ_Angle_Mid_STD_V_22 "Validator for the STD of angleMid.";
CM_ SG_ 154 OBJ_Angle_Bottom_V_22 "Validator for OBJAngle_Bottom. ";
CM_ SG_ 154 OBJ_Angle_Bottom_22 "The angle between the longitudinal axis and the Bottom of the front / rear of the target (the visible one). The positive side is to the host's bottom";
CM_ SG_ 154 OBJ_Angle_Bottom_STD_22 "STD for OBJAngle_Bottom. ";
CM_ SG_ 154 OBJ_Angle_Bottom_STD_V_22 "Validator for OBJAngle_Bottom_STD. ";
CM_ SG_ 154 OBJ_Visibility_Side_V_22 "Currently Supported for VD only";
CM_ SG_ 154 OBJ_Visibility_Side_22 "From what car  side is the object visible";
CM_ SG_ 154 OBJ_Is_In_Drivable_Area_22 "Indicates whether the target is in a driveable area.";
CM_ SG_ 154 OBJ_Is_In_Drivable_Area_V_22 "Validator for OBJ_Is_In_Drivable_Area.";
CM_ SG_ 154 OBJ_Is_VeryClose_V_22 "Validator for OBJ_Is_VeryClose. ";
CM_ SG_ 154 OBJ_Is_VeryClose_22 "Indicates whether the target is very close to the host such that it is hard to measure its distance. Currently relevant for peds only";
CM_ SG_ 154 OBJ_OverlapAngleEgoLaneR_22 "Lateral distance to the middle of the RL and RR corners.";
CM_ SG_ 154 OBJ_OverlapAngleEgoLaneR_V_22 "Validator for OBJ_OverlapAngleEgoLaneR";
CM_ SG_ 154 OBJ_OverlapAngleEgoLaneL_22 "Lateral distance to the middle of the RL and RR corners.  ";
CM_ SG_ 154 OBJ_OverlapAngleEgoLaneL_V_22 "Validator for OBJ_OverlapAngleEgoLaneL";
CM_ SG_ 154 OBJ_Is_EMERGENCY_VCL_22 "Is Object an Emergency Vehicle";
CM_ SG_ 154 OBJ_EMERGENCY_LIGHT_COLOR_22 "Emergency Color";
CM_ SG_ 154 OBJ_EMERGENCY_V_22 "Are OBJ_Is_EMERGENCY_VCL and OBJ_EMERGENCY_LIGHT_COLOR Valid";
CM_ SG_ 154 OBJ_Angle_Top_22 "From VD touching point on the ground till the roof of the car";
CM_ SG_ 154 OBJ_Angle_Top_V_22 "Validator for OBJ_Angle_Top ";
CM_ SG_ 154 OBJ_Angle_Top_STD_22 "STD for OBJ_Angle_Top";
CM_ SG_ 154 OBJ_Angle_Top_STD_V_22 "Validator for OBJ_Angle_Top_STD. ";
CM_ SG_ 154 OBJ_CRC_23 "Calculated over all element signals. From the signal after the CRC until the first signal in the next elements OBJ_CRC_N+1  not including";
CM_ SG_ 154 OBJ_ID_23 "The detected object ID. Range is 1-255, while 0 indicates that the field in unfilled.";
CM_ SG_ 154 OBJ_Existence_Probability_23 "The existence probability of the reported object";
CM_ SG_ 154 OBJ_Fusion_Source_23 "sources ids used for fusion";
CM_ SG_ 154 OBJ_Triggered_SDM_23 "Indicates whether the object has trigered the SDM (Safety Diagnostic Manager) alert.";
CM_ SG_ 154 OBJ_Motion_Category_23 "Relevant for VD only. Full description of values can be found at the ACC guide.";
CM_ SG_ 154 OBJ_Object_Age_23 "The number of frames in which the object was recognized.";
CM_ SG_ 154 OBJ_Measuring_Status_23 "Measurment status. Old vs New marks if this is the first frame in which the object is reported. Predicted vs Measured marks if the report is raw or has been predicted forward in time using the measured dynamics and ego motion.";
CM_ SG_ 154 OBJ_Object_Class_23 "Indicates the object type. Uncertain is outputted in case the probability that a vehicle is a truck is very similar to the probability that it is a car. ";
CM_ SG_ 154 OBJ_Class_Probability_23 "The probability of this type classification.";
CM_ SG_ 154 OBJ_Car_Probability_23 "The probability the object is a car";
CM_ SG_ 154 OBJ_Truck_Probability_23 "The probability the object is a Truck";
CM_ SG_ 154 OBJ_Bike_Probability_23 "The probability the object is a Bike";
CM_ SG_ 154 OBJ_Camera_Source_23 "The camera in which this object was detected (best choice).";
CM_ SG_ 154 OBJ_Motion_Status_23 "MOVING - the object is moving STATIONARY - the object was never seen moving STOPPED -  the object was moving and has stopped MOVING_SLOWLY - the object is moving very slowly";
CM_ SG_ 154 OBJ_Motion_Orientation_23 "The direction of the targets heading compared to the host. ";
BA_DEF_ SG_  "GenSigStartValue" INT 0 0;
BA_DEF_DEF_  "GenSigStartValue" 0;
BA_ "GenSigStartValue" SG_ 154 OBJ_Width_18 40;
BA_ "GenSigStartValue" SG_ 154 OBJ_Length_18 24;
BA_ "GenSigStartValue" SG_ 154 OBJ_Width_19 40;
BA_ "GenSigStartValue" SG_ 154 OBJ_Length_19 24;
BA_ "GenSigStartValue" SG_ 154 OBJ_Width_20 40;
BA_ "GenSigStartValue" SG_ 154 OBJ_Length_20 24;
BA_ "GenSigStartValue" SG_ 154 OBJ_Width_21 40;
BA_ "GenSigStartValue" SG_ 154 OBJ_Length_21 24;
BA_ "GenSigStartValue" SG_ 154 OBJ_Width_22 40;
BA_ "GenSigStartValue" SG_ 154 OBJ_Length_22 24;
VAL_ 154 OBJ_Abs_Lat_Velocity_V_17 1 "VALID" 0 "INVALID" ;
VAL_ 154 OBJ_Abs_Lat_Vel_STD_V_17 1 "VALID" 0 "INVALID" ;
VAL_ 154 OBJ_Abs_Long_Acc_V_17 1 "VALID" 0 "INVALID" ;
VAL_ 154 OBJ_Abs_Long_Acc_STD_V_17 1 "VALID" 0 "INVALID" ;
VAL_ 154 OBJ_Abs_Lat_Acc_V_17 1 "VALID" 0 "INVALID" ;
VAL_ 154 OBJ_Abs_Lat_Acc_STD_V_17 1 "VALID" 0 "INVALID" ;
VAL_ 154 OBJ_Abs_Acceleration_V_17 1 "VALID" 0 "INVALID" ;
VAL_ 154 OBJ_Abs_Acc_STD_V_17 1 "VALID" 0 "INVALID" ;
VAL_ 154 OBJ_Inv_TTC_V_17 1 "VALID" 0 "INVALID" ;
VAL_ 154 OBJ_Inv_TTC_STD_V_17 1 "VALID" 0 "INVALID" ;
VAL_ 154 OBJ_Relative_Long_Acc_V_17 1 "VALID" 0 "INVALID" ;
VAL_ 154 OBJ_Rel_Long_Acc_STD_V_17 1 "VALID" 0 "INVALID" ;
VAL_ 154 OBJ_Relative_Long_Velocity_V_17 1 "VALID" 0 "INVALID" ;
VAL_ 154 OBJ_Rel_Long_Vel_STD_V_17 1 "VALID" 0 "INVALID" ;
VAL_ 154 OBJ_Relative_Lat_Velocity_V_17 1 "VALID" 0 "INVALID" ;
VAL_ 154 OBJ_Rel_Lat_Vel_STD_V_17 1 "VALID" 0 "INVALID" ;
VAL_ 154 OBJ_Long_Distance_V_17 1 "VALID" 0 "INVALID" ;
VAL_ 154 OBJ_Long_Distance_STD_V_17 1 "VALID" 0 "INVALID" ;
VAL_ 154 OBJ_Lat_Distance_V_17 1 "VALID" 0 "INVALID" ;
VAL_ 154 OBJ_Lat_Distance_STD_V_17 1 "VALID" 0 "INVALID" ;
VAL_ 154 OBJ_Absolute_Speed_V_17 1 "VALID" 0 "INVALID" ;
VAL_ 154 OBJ_Absolute_Speed_STD_V_17 1 "VALID" 0 "INVALID" ;
VAL_ 154 OBJ_Heading_V_17 1 "VALID" 0 "INVALID" ;
VAL_ 154 OBJ_Heading_STD_V_17 1 "VALID" 0 "INVALID" ;
VAL_ 154 OBJ_Angle_Rate_STD_V_17 1 "VALID" 0 "INVALID" ;
VAL_ 154 OBJ_Angle_Rate_V_17 1 "VALID" 0 "INVALID" ;
VAL_ 154 OBJ_Angle_Right_V_17 1 "VALID" 0 "INVALID" ;
VAL_ 154 OBJ_Angle_Right_STD_V_17 1 "VALID" 0 "INVALID" ;
VAL_ 154 OBJ_Angle_Left_V_17 1 "VALID" 0 "INVALID" ;
VAL_ 154 OBJ_Angle_Left_STD_V_17 1 "VALID" 0 "INVALID" ;
VAL_ 154 OBJ_Angle_Side_V_17 1 "VALID" 0 "INVALID" ;
VAL_ 154 OBJ_Angle_Side_STD_V_17 1 "VALID" 0 "INVALID" ;
VAL_ 154 OBJ_Angle_Mid_V_17 1 "VALID" 0 "INVALID" ;
VAL_ 154 OBJ_Angle_Mid_STD_V_17 1 "VALID" 0 "INVALID" ;
VAL_ 154 OBJ_Angle_Bottom_V_17 1 "VALID" 0 "INVALID" ;
VAL_ 154 OBJ_Angle_Bottom_STD_V_17 1 "VALID" 0 "INVALID" ;
VAL_ 154 OBJ_Visibility_Side_V_17 1 "VALID" 0 "INVALID" ;
VAL_ 154 OBJ_Visibility_Side_17 2 "REAR" 1 "FRONT" 0 "NOT_VISIBLE" ;
VAL_ 154 OBJ_Is_In_Drivable_Area_17 1 "TRUE" 0 "FALSE" ;
VAL_ 154 OBJ_Is_In_Drivable_Area_V_17 1 "VALID" 0 "INVALID" ;
VAL_ 154 OBJ_Is_VeryClose_V_17 1 "VALID" 0 "INVALID" ;
VAL_ 154 OBJ_Is_VeryClose_17 1 "TRUE" 0 "FALSE" ;
VAL_ 154 OBJ_OverlapAngleEgoLaneR_V_17 1 "VALID" 0 "INVALID" ;
VAL_ 154 OBJ_OverlapAngleEgoLaneL_V_17 1 "VALID" 0 "INVALID" ;
VAL_ 154 OBJ_Is_EMERGENCY_VCL_17 1 "TRUE" 0 "FALSE" ;
VAL_ 154 OBJ_EMERGENCY_LIGHT_COLOR_17 3 "(1000)ORANGE" 2 "(0100)BLUE" 1 "(0010)RED" 0 "(0001)OTHER" ;
VAL_ 154 OBJ_EMERGENCY_V_17 1 "TRUE" 0 "FALSE" ;
VAL_ 154 OBJ_Angle_Top_V_17 1 "VALID" 0 "INVALID" ;
VAL_ 154 OBJ_Angle_Top_STD_V_17 1 "VALID" 0 "INVALID" ;
VAL_ 154 OBJ_Fusion_Source_18 2 "(BIT_2)RADAR2" 1 "(BIT_1)RADAR1" 0 "(BIT_0)CAMERA" ;
VAL_ 154 OBJ_Triggered_SDM_18 2 "NOT_TRIGGERED" 1 "TRIGGERED" 0 "NOT_AVAILABLE" ;
VAL_ 154 OBJ_Motion_Category_18 13 "ONCOMING" 12 "PRECEEDING" 11 "MOVING" 10 "RTAP" 9 "LTAP" 8 "CROSSING" 7 "MOVING_OUT" 6 "MOVING_IN" 5 "CLOSE_CUT_IN" 4 "PASSING_OUT" 3 "PASSING_IN" 2 "PASSING" 1 "UNDEFINED" 0 "UNFILLED" ;
VAL_ 154 OBJ_Measuring_Status_18 2 "(BIT_2)NOT_VALID_OR_VALID" 1 "(BIT_1)PREDICTED_OR_MEASURED" 0 "(BIT_0)OLD_OR_NEW" ;
VAL_ 154 OBJ_Object_Class_18 8 "UNCERTAIN_VCL" 7 "ANIMAL" 6 "GENERAL_OBJECT" 5 "PEDESTRIAN" 4 "BICYCLE" 3 "MOTORBIKE" 2 "TRUCK" 1 "CAR" 0 "UNFILLED" ;
VAL_ 154 OBJ_Camera_Source_18 11 "PARKING_RIGHT" 10 "PARKING_LEFT" 9 "PARKING_REAR" 8 "PARKING_FRONT" 7 "FRONT_CORNER_RIGHT" 6 "FRONT_CORNER_LEFT" 5 "REAR_CORNER_RIGHT" 4 "REAR_CORNER_LEFT" 3 "REAR" 2 "FRONT_FISHEYE" 1 "FRONT_NARROW" 0 "FRONT_MAIN" ;
VAL_ 154 OBJ_Motion_Status_18 5 "MOVING_SLOWLY" 4 "STOPPED" 3 "STATIONARY" 2 "MOVING" 1 "UNKNOWN" 0 "INVALID" ;
VAL_ 154 OBJ_Motion_Orientation_18 13 "INVALID" 12 "NORTH" 11 "NORTH_WEST" 9 "WEST" 7 "SOUTH_WEST" 6 "SOUTH" 5 "SOUTH_EAST" 3 "EAST" 1 "NORTH_EAST" 0 "UNKNOWN" ;
VAL_ 154 OBJ_Has_Cut_Lane_18 1 "TRUE" 0 "FALSE" ;
VAL_ 154 OBJ_Has_Cut_Path_18 1 "TRUE" 0 "FALSE" ;
VAL_ 154 OBJ_Brake_Light_18 1 "TRUE" 0 "FALSE" ;
VAL_ 154 OBJ_Turn_Indicator_Right_18 1 "TRUE" 0 "FALSE" ;
VAL_ 154 OBJ_Turn_Indicator_Left_18 1 "TRUE" 0 "FALSE" ;
VAL_ 154 OBJ_Light_Indicator_Validity_18 1 "TRUE" 0 "FALSE" ;
VAL_ 154 OBJ_Right_Out_Of_Image_18 1 "TRUE" 0 "FALSE" ;
VAL_ 154 OBJ_Left_Out_Of_Image_18 1 "TRUE" 0 "FALSE" ;
VAL_ 154 OBJ_Right_Out_Of_Image_V_18 1 "TRUE" 0 "FALSE" ;
VAL_ 154 OBJ_Left_Out_Of_Image_V_18 1 "TRUE" 0 "FALSE" ;
VAL_ 154 OBJ_Top_Out_Of_Image_18 1 "TRUE" 0 "FALSE" ;
VAL_ 154 OBJ_Bottom_Out_Of_Image_18 1 "TRUE" 0 "FALSE" ;
VAL_ 154 OBJ_Top_Out_Of_Image_V_18 1 "VALID" 0 "INVALID" ;
VAL_ 154 OBJ_Bottom_Out_Of_Image_V_18 1 "VALID" 0 "INVALID" ;
VAL_ 154 OBJ_Lane_Assignment_18 5 "RIGHT_RIGHT" 4 "RIGHT" 3 "HOST" 2 "LEFT" 1 "LEFT_LEFT" 0 "UNKNOWN" ;
VAL_ 154 OBJ_Lane_Assignment_V_18 1 "VALID" 0 "INVALID" ;
VAL_ 154 OBJ_Age_Seconds_V_18 1 "VALID" 0 "INVALID" ;
VAL_ 154 OBJ_Width_V_18 1 "VALID" 0 "INVALID" ;
VAL_ 154 OBJ_Width_STD_V_18 1 "VALID" 0 "INVALID" ;
VAL_ 154 OBJ_Length_V_18 1 "VALID" 0 "INVALID" ;
VAL_ 154 OBJ_Length_STD_V_18 1 "VALID" 0 "INVALID" ;
VAL_ 154 OBJ_Height_V_18 1 "VALID" 0 "INVALID" ;
VAL_ 154 OBJ_Height_STD_V_18 1 "VALID" 0 "INVALID" ;
VAL_ 154 OBJ_Abs_Long_Velocity_V_18 1 "VALID" 0 "INVALID" ;
VAL_ 154 OBJ_Abs_Long_Vel_STD_V_18 1 "VALID" 0 "INVALID" ;
VAL_ 154 OBJ_Abs_Lat_Velocity_V_18 1 "VALID" 0 "INVALID" ;
VAL_ 154 OBJ_Abs_Lat_Vel_STD_V_18 1 "VALID" 0 "INVALID" ;
VAL_ 154 OBJ_Abs_Long_Acc_V_18 1 "VALID" 0 "INVALID" ;
VAL_ 154 OBJ_Abs_Long_Acc_STD_V_18 1 "VALID" 0 "INVALID" ;
VAL_ 154 OBJ_Abs_Lat_Acc_V_18 1 "VALID" 0 "INVALID" ;
VAL_ 154 OBJ_Abs_Lat_Acc_STD_V_18 1 "VALID" 0 "INVALID" ;
VAL_ 154 OBJ_Abs_Acceleration_V_18 1 "VALID" 0 "INVALID" ;
VAL_ 154 OBJ_Abs_Acc_STD_V_18 1 "VALID" 0 "INVALID" ;
VAL_ 154 OBJ_Inv_TTC_V_18 1 "VALID" 0 "INVALID" ;
VAL_ 154 OBJ_Inv_TTC_STD_V_18 1 "VALID" 0 "INVALID" ;
VAL_ 154 OBJ_Relative_Long_Acc_V_18 1 "VALID" 0 "INVALID" ;
VAL_ 154 OBJ_Rel_Long_Acc_STD_V_18 1 "VALID" 0 "INVALID" ;
VAL_ 154 OBJ_Relative_Long_Velocity_V_18 1 "VALID" 0 "INVALID" ;
VAL_ 154 OBJ_Rel_Long_Vel_STD_V_18 1 "VALID" 0 "INVALID" ;
VAL_ 154 OBJ_Relative_Lat_Velocity_V_18 1 "VALID" 0 "INVALID" ;
VAL_ 154 OBJ_Rel_Lat_Vel_STD_V_18 1 "VALID" 0 "INVALID" ;
VAL_ 154 OBJ_Long_Distance_V_18 1 "VALID" 0 "INVALID" ;
VAL_ 154 OBJ_Long_Distance_STD_V_18 1 "VALID" 0 "INVALID" ;
VAL_ 154 OBJ_Lat_Distance_V_18 1 "VALID" 0 "INVALID" ;
VAL_ 154 OBJ_Lat_Distance_STD_V_18 1 "VALID" 0 "INVALID" ;
VAL_ 154 OBJ_Absolute_Speed_V_18 1 "VALID" 0 "INVALID" ;
VAL_ 154 OBJ_Absolute_Speed_STD_V_18 1 "VALID" 0 "INVALID" ;
VAL_ 154 OBJ_Heading_V_18 1 "VALID" 0 "INVALID" ;
VAL_ 154 OBJ_Heading_STD_V_18 1 "VALID" 0 "INVALID" ;
VAL_ 154 OBJ_Angle_Rate_STD_V_18 1 "VALID" 0 "INVALID" ;
VAL_ 154 OBJ_Angle_Rate_V_18 1 "VALID" 0 "INVALID" ;
VAL_ 154 OBJ_Angle_Right_V_18 1 "VALID" 0 "INVALID" ;
VAL_ 154 OBJ_Angle_Right_STD_V_18 1 "VALID" 0 "INVALID" ;
VAL_ 154 OBJ_Angle_Left_V_18 1 "VALID" 0 "INVALID" ;
VAL_ 154 OBJ_Angle_Left_STD_V_18 1 "VALID" 0 "INVALID" ;
VAL_ 154 OBJ_Angle_Side_V_18 1 "VALID" 0 "INVALID" ;
VAL_ 154 OBJ_Angle_Side_STD_V_18 1 "VALID" 0 "INVALID" ;
VAL_ 154 OBJ_Angle_Mid_V_18 1 "VALID" 0 "INVALID" ;
VAL_ 154 OBJ_Angle_Mid_STD_V_18 1 "VALID" 0 "INVALID" ;
VAL_ 154 OBJ_Angle_Bottom_V_18 1 "VALID" 0 "INVALID" ;
VAL_ 154 OBJ_Angle_Bottom_STD_V_18 1 "VALID" 0 "INVALID" ;
VAL_ 154 OBJ_Visibility_Side_V_18 1 "VALID" 0 "INVALID" ;
VAL_ 154 OBJ_Visibility_Side_18 2 "REAR" 1 "FRONT" 0 "NOT_VISIBLE" ;
VAL_ 154 OBJ_Is_In_Drivable_Area_18 1 "TRUE" 0 "FALSE" ;
VAL_ 154 OBJ_Is_In_Drivable_Area_V_18 1 "VALID" 0 "INVALID" ;
VAL_ 154 OBJ_Is_VeryClose_V_18 1 "VALID" 0 "INVALID" ;
VAL_ 154 OBJ_Is_VeryClose_18 1 "TRUE" 0 "FALSE" ;
VAL_ 154 OBJ_OverlapAngleEgoLaneR_V_18 1 "VALID" 0 "INVALID" ;
VAL_ 154 OBJ_OverlapAngleEgoLaneL_V_18 1 "VALID" 0 "INVALID" ;
VAL_ 154 OBJ_Is_EMERGENCY_VCL_18 1 "TRUE" 0 "FALSE" ;
VAL_ 154 OBJ_EMERGENCY_LIGHT_COLOR_18 3 "(1000)ORANGE" 2 "(0100)BLUE" 1 "(0010)RED" 0 "(0001)OTHER" ;
VAL_ 154 OBJ_EMERGENCY_V_18 1 "TRUE" 0 "FALSE" ;
VAL_ 154 OBJ_Angle_Top_V_18 1 "VALID" 0 "INVALID" ;
VAL_ 154 OBJ_Angle_Top_STD_V_18 1 "VALID" 0 "INVALID" ;
VAL_ 154 OBJ_Fusion_Source_19 2 "(BIT_2)RADAR2" 1 "(BIT_1)RADAR1" 0 "(BIT_0)CAMERA" ;
VAL_ 154 OBJ_Triggered_SDM_19 2 "NOT_TRIGGERED" 1 "TRIGGERED" 0 "NOT_AVAILABLE" ;
VAL_ 154 OBJ_Motion_Category_19 13 "ONCOMING" 12 "PRECEEDING" 11 "MOVING" 10 "RTAP" 9 "LTAP" 8 "CROSSING" 7 "MOVING_OUT" 6 "MOVING_IN" 5 "CLOSE_CUT_IN" 4 "PASSING_OUT" 3 "PASSING_IN" 2 "PASSING" 1 "UNDEFINED" 0 "UNFILLED" ;
VAL_ 154 OBJ_Measuring_Status_19 2 "(BIT_2)NOT_VALID_OR_VALID" 1 "(BIT_1)PREDICTED_OR_MEASURED" 0 "(BIT_0)OLD_OR_NEW" ;
VAL_ 154 OBJ_Object_Class_19 8 "UNCERTAIN_VCL" 7 "ANIMAL" 6 "GENERAL_OBJECT" 5 "PEDESTRIAN" 4 "BICYCLE" 3 "MOTORBIKE" 2 "TRUCK" 1 "CAR" 0 "UNFILLED" ;
VAL_ 154 OBJ_Camera_Source_19 11 "PARKING_RIGHT" 10 "PARKING_LEFT" 9 "PARKING_REAR" 8 "PARKING_FRONT" 7 "FRONT_CORNER_RIGHT" 6 "FRONT_CORNER_LEFT" 5 "REAR_CORNER_RIGHT" 4 "REAR_CORNER_LEFT" 3 "REAR" 2 "FRONT_FISHEYE" 1 "FRONT_NARROW" 0 "FRONT_MAIN" ;
VAL_ 154 OBJ_Motion_Status_19 5 "MOVING_SLOWLY" 4 "STOPPED" 3 "STATIONARY" 2 "MOVING" 1 "UNKNOWN" 0 "INVALID" ;
VAL_ 154 OBJ_Motion_Orientation_19 13 "INVALID" 12 "NORTH" 11 "NORTH_WEST" 9 "WEST" 7 "SOUTH_WEST" 6 "SOUTH" 5 "SOUTH_EAST" 3 "EAST" 1 "NORTH_EAST" 0 "UNKNOWN" ;
VAL_ 154 OBJ_Has_Cut_Lane_19 1 "TRUE" 0 "FALSE" ;
VAL_ 154 OBJ_Has_Cut_Path_19 1 "TRUE" 0 "FALSE" ;
VAL_ 154 OBJ_Brake_Light_19 1 "TRUE" 0 "FALSE" ;
VAL_ 154 OBJ_Turn_Indicator_Right_19 1 "TRUE" 0 "FALSE" ;
VAL_ 154 OBJ_Turn_Indicator_Left_19 1 "TRUE" 0 "FALSE" ;
VAL_ 154 OBJ_Light_Indicator_Validity_19 1 "TRUE" 0 "FALSE" ;
VAL_ 154 OBJ_Right_Out_Of_Image_19 1 "TRUE" 0 "FALSE" ;
VAL_ 154 OBJ_Left_Out_Of_Image_19 1 "TRUE" 0 "FALSE" ;
VAL_ 154 OBJ_Right_Out_Of_Image_V_19 1 "TRUE" 0 "FALSE" ;
VAL_ 154 OBJ_Left_Out_Of_Image_V_19 1 "TRUE" 0 "FALSE" ;
VAL_ 154 OBJ_Top_Out_Of_Image_19 1 "TRUE" 0 "FALSE" ;
VAL_ 154 OBJ_Bottom_Out_Of_Image_19 1 "TRUE" 0 "FALSE" ;
VAL_ 154 OBJ_Top_Out_Of_Image_V_19 1 "VALID" 0 "INVALID" ;
VAL_ 154 OBJ_Bottom_Out_Of_Image_V_19 1 "VALID" 0 "INVALID" ;
VAL_ 154 OBJ_Lane_Assignment_19 5 "RIGHT_RIGHT" 4 "RIGHT" 3 "HOST" 2 "LEFT" 1 "LEFT_LEFT" 0 "UNKNOWN" ;
VAL_ 154 OBJ_Lane_Assignment_V_19 1 "VALID" 0 "INVALID" ;
VAL_ 154 OBJ_Age_Seconds_V_19 1 "VALID" 0 "INVALID" ;
VAL_ 154 OBJ_Width_V_19 1 "VALID" 0 "INVALID" ;
VAL_ 154 OBJ_Width_STD_V_19 1 "VALID" 0 "INVALID" ;
VAL_ 154 OBJ_Length_V_19 1 "VALID" 0 "INVALID" ;
VAL_ 154 OBJ_Length_STD_V_19 1 "VALID" 0 "INVALID" ;
VAL_ 154 OBJ_Height_V_19 1 "VALID" 0 "INVALID" ;
VAL_ 154 OBJ_Height_STD_V_19 1 "VALID" 0 "INVALID" ;
VAL_ 154 OBJ_Abs_Long_Velocity_V_19 1 "VALID" 0 "INVALID" ;
VAL_ 154 OBJ_Abs_Long_Vel_STD_V_19 1 "VALID" 0 "INVALID" ;
VAL_ 154 OBJ_Abs_Lat_Velocity_V_19 1 "VALID" 0 "INVALID" ;
VAL_ 154 OBJ_Abs_Lat_Vel_STD_V_19 1 "VALID" 0 "INVALID" ;
VAL_ 154 OBJ_Abs_Long_Acc_V_19 1 "VALID" 0 "INVALID" ;
VAL_ 154 OBJ_Abs_Long_Acc_STD_V_19 1 "VALID" 0 "INVALID" ;
VAL_ 154 OBJ_Abs_Lat_Acc_V_19 1 "VALID" 0 "INVALID" ;
VAL_ 154 OBJ_Abs_Lat_Acc_STD_V_19 1 "VALID" 0 "INVALID" ;
VAL_ 154 OBJ_Abs_Acceleration_V_19 1 "VALID" 0 "INVALID" ;
VAL_ 154 OBJ_Abs_Acc_STD_V_19 1 "VALID" 0 "INVALID" ;
VAL_ 154 OBJ_Inv_TTC_V_19 1 "VALID" 0 "INVALID" ;
VAL_ 154 OBJ_Inv_TTC_STD_V_19 1 "VALID" 0 "INVALID" ;
VAL_ 154 OBJ_Relative_Long_Acc_V_19 1 "VALID" 0 "INVALID" ;
VAL_ 154 OBJ_Rel_Long_Acc_STD_V_19 1 "VALID" 0 "INVALID" ;
VAL_ 154 OBJ_Relative_Long_Velocity_V_19 1 "VALID" 0 "INVALID" ;
VAL_ 154 OBJ_Rel_Long_Vel_STD_V_19 1 "VALID" 0 "INVALID" ;
VAL_ 154 OBJ_Relative_Lat_Velocity_V_19 1 "VALID" 0 "INVALID" ;
VAL_ 154 OBJ_Rel_Lat_Vel_STD_V_19 1 "VALID" 0 "INVALID" ;
VAL_ 154 OBJ_Long_Distance_V_19 1 "VALID" 0 "INVALID" ;
VAL_ 154 OBJ_Long_Distance_STD_V_19 1 "VALID" 0 "INVALID" ;
VAL_ 154 OBJ_Lat_Distance_V_19 1 "VALID" 0 "INVALID" ;
VAL_ 154 OBJ_Lat_Distance_STD_V_19 1 "VALID" 0 "INVALID" ;
VAL_ 154 OBJ_Absolute_Speed_V_19 1 "VALID" 0 "INVALID" ;
VAL_ 154 OBJ_Absolute_Speed_STD_V_19 1 "VALID" 0 "INVALID" ;
VAL_ 154 OBJ_Heading_V_19 1 "VALID" 0 "INVALID" ;
VAL_ 154 OBJ_Heading_STD_V_19 1 "VALID" 0 "INVALID" ;
VAL_ 154 OBJ_Angle_Rate_STD_V_19 1 "VALID" 0 "INVALID" ;
VAL_ 154 OBJ_Angle_Rate_V_19 1 "VALID" 0 "INVALID" ;
VAL_ 154 OBJ_Angle_Right_V_19 1 "VALID" 0 "INVALID" ;
VAL_ 154 OBJ_Angle_Right_STD_V_19 1 "VALID" 0 "INVALID" ;
VAL_ 154 OBJ_Angle_Left_V_19 1 "VALID" 0 "INVALID" ;
VAL_ 154 OBJ_Angle_Left_STD_V_19 1 "VALID" 0 "INVALID" ;
VAL_ 154 OBJ_Angle_Side_V_19 1 "VALID" 0 "INVALID" ;
VAL_ 154 OBJ_Angle_Side_STD_V_19 1 "VALID" 0 "INVALID" ;
VAL_ 154 OBJ_Angle_Mid_V_19 1 "VALID" 0 "INVALID" ;
VAL_ 154 OBJ_Angle_Mid_STD_V_19 1 "VALID" 0 "INVALID" ;
VAL_ 154 OBJ_Angle_Bottom_V_19 1 "VALID" 0 "INVALID" ;
VAL_ 154 OBJ_Angle_Bottom_STD_V_19 1 "VALID" 0 "INVALID" ;
VAL_ 154 OBJ_Visibility_Side_V_19 1 "VALID" 0 "INVALID" ;
VAL_ 154 OBJ_Visibility_Side_19 2 "REAR" 1 "FRONT" 0 "NOT_VISIBLE" ;
VAL_ 154 OBJ_Is_In_Drivable_Area_19 1 "TRUE" 0 "FALSE" ;
VAL_ 154 OBJ_Is_In_Drivable_Area_V_19 1 "VALID" 0 "INVALID" ;
VAL_ 154 OBJ_Is_VeryClose_V_19 1 "VALID" 0 "INVALID" ;
VAL_ 154 OBJ_Is_VeryClose_19 1 "TRUE" 0 "FALSE" ;
VAL_ 154 OBJ_OverlapAngleEgoLaneR_V_19 1 "VALID" 0 "INVALID" ;
VAL_ 154 OBJ_OverlapAngleEgoLaneL_V_19 1 "VALID" 0 "INVALID" ;
VAL_ 154 OBJ_Is_EMERGENCY_VCL_19 1 "TRUE" 0 "FALSE" ;
VAL_ 154 OBJ_EMERGENCY_LIGHT_COLOR_19 3 "(1000)ORANGE" 2 "(0100)BLUE" 1 "(0010)RED" 0 "(0001)OTHER" ;
VAL_ 154 OBJ_EMERGENCY_V_19 1 "TRUE" 0 "FALSE" ;
VAL_ 154 OBJ_Angle_Top_V_19 1 "VALID" 0 "INVALID" ;
VAL_ 154 OBJ_Angle_Top_STD_V_19 1 "VALID" 0 "INVALID" ;
VAL_ 154 OBJ_Fusion_Source_20 2 "(BIT_2)RADAR2" 1 "(BIT_1)RADAR1" 0 "(BIT_0)CAMERA" ;
VAL_ 154 OBJ_Triggered_SDM_20 2 "NOT_TRIGGERED" 1 "TRIGGERED" 0 "NOT_AVAILABLE" ;
VAL_ 154 OBJ_Motion_Category_20 13 "ONCOMING" 12 "PRECEEDING" 11 "MOVING" 10 "RTAP" 9 "LTAP" 8 "CROSSING" 7 "MOVING_OUT" 6 "MOVING_IN" 5 "CLOSE_CUT_IN" 4 "PASSING_OUT" 3 "PASSING_IN" 2 "PASSING" 1 "UNDEFINED" 0 "UNFILLED" ;
VAL_ 154 OBJ_Measuring_Status_20 2 "(BIT_2)NOT_VALID_OR_VALID" 1 "(BIT_1)PREDICTED_OR_MEASURED" 0 "(BIT_0)OLD_OR_NEW" ;
VAL_ 154 OBJ_Object_Class_20 8 "UNCERTAIN_VCL" 7 "ANIMAL" 6 "GENERAL_OBJECT" 5 "PEDESTRIAN" 4 "BICYCLE" 3 "MOTORBIKE" 2 "TRUCK" 1 "CAR" 0 "UNFILLED" ;
VAL_ 154 OBJ_Camera_Source_20 11 "PARKING_RIGHT" 10 "PARKING_LEFT" 9 "PARKING_REAR" 8 "PARKING_FRONT" 7 "FRONT_CORNER_RIGHT" 6 "FRONT_CORNER_LEFT" 5 "REAR_CORNER_RIGHT" 4 "REAR_CORNER_LEFT" 3 "REAR" 2 "FRONT_FISHEYE" 1 "FRONT_NARROW" 0 "FRONT_MAIN" ;
VAL_ 154 OBJ_Motion_Status_20 5 "MOVING_SLOWLY" 4 "STOPPED" 3 "STATIONARY" 2 "MOVING" 1 "UNKNOWN" 0 "INVALID" ;
VAL_ 154 OBJ_Motion_Orientation_20 13 "INVALID" 12 "NORTH" 11 "NORTH_WEST" 9 "WEST" 7 "SOUTH_WEST" 6 "SOUTH" 5 "SOUTH_EAST" 3 "EAST" 1 "NORTH_EAST" 0 "UNKNOWN" ;
VAL_ 154 OBJ_Has_Cut_Lane_20 1 "TRUE" 0 "FALSE" ;
VAL_ 154 OBJ_Has_Cut_Path_20 1 "TRUE" 0 "FALSE" ;
VAL_ 154 OBJ_Brake_Light_20 1 "TRUE" 0 "FALSE" ;
VAL_ 154 OBJ_Turn_Indicator_Right_20 1 "TRUE" 0 "FALSE" ;
VAL_ 154 OBJ_Turn_Indicator_Left_20 1 "TRUE" 0 "FALSE" ;
VAL_ 154 OBJ_Light_Indicator_Validity_20 1 "TRUE" 0 "FALSE" ;
VAL_ 154 OBJ_Right_Out_Of_Image_20 1 "TRUE" 0 "FALSE" ;
VAL_ 154 OBJ_Left_Out_Of_Image_20 1 "TRUE" 0 "FALSE" ;
VAL_ 154 OBJ_Right_Out_Of_Image_V_20 1 "TRUE" 0 "FALSE" ;
VAL_ 154 OBJ_Left_Out_Of_Image_V_20 1 "TRUE" 0 "FALSE" ;
VAL_ 154 OBJ_Top_Out_Of_Image_20 1 "TRUE" 0 "FALSE" ;
VAL_ 154 OBJ_Bottom_Out_Of_Image_20 1 "TRUE" 0 "FALSE" ;
VAL_ 154 OBJ_Top_Out_Of_Image_V_20 1 "VALID" 0 "INVALID" ;
VAL_ 154 OBJ_Bottom_Out_Of_Image_V_20 1 "VALID" 0 "INVALID" ;
VAL_ 154 OBJ_Lane_Assignment_20 5 "RIGHT_RIGHT" 4 "RIGHT" 3 "HOST" 2 "LEFT" 1 "LEFT_LEFT" 0 "UNKNOWN" ;
VAL_ 154 OBJ_Lane_Assignment_V_20 1 "VALID" 0 "INVALID" ;
VAL_ 154 OBJ_Age_Seconds_V_20 1 "VALID" 0 "INVALID" ;
VAL_ 154 OBJ_Width_V_20 1 "VALID" 0 "INVALID" ;
VAL_ 154 OBJ_Width_STD_V_20 1 "VALID" 0 "INVALID" ;
VAL_ 154 OBJ_Length_V_20 1 "VALID" 0 "INVALID" ;
VAL_ 154 OBJ_Length_STD_V_20 1 "VALID" 0 "INVALID" ;
VAL_ 154 OBJ_Height_V_20 1 "VALID" 0 "INVALID" ;
VAL_ 154 OBJ_Height_STD_V_20 1 "VALID" 0 "INVALID" ;
VAL_ 154 OBJ_Abs_Long_Velocity_V_20 1 "VALID" 0 "INVALID" ;
VAL_ 154 OBJ_Abs_Long_Vel_STD_V_20 1 "VALID" 0 "INVALID" ;
VAL_ 154 OBJ_Abs_Lat_Velocity_V_20 1 "VALID" 0 "INVALID" ;
VAL_ 154 OBJ_Abs_Lat_Vel_STD_V_20 1 "VALID" 0 "INVALID" ;
VAL_ 154 OBJ_Abs_Long_Acc_V_20 1 "VALID" 0 "INVALID" ;
VAL_ 154 OBJ_Abs_Long_Acc_STD_V_20 1 "VALID" 0 "INVALID" ;
VAL_ 154 OBJ_Abs_Lat_Acc_V_20 1 "VALID" 0 "INVALID" ;
VAL_ 154 OBJ_Abs_Lat_Acc_STD_V_20 1 "VALID" 0 "INVALID" ;
VAL_ 154 OBJ_Abs_Acceleration_V_20 1 "VALID" 0 "INVALID" ;
VAL_ 154 OBJ_Abs_Acc_STD_V_20 1 "VALID" 0 "INVALID" ;
VAL_ 154 OBJ_Inv_TTC_V_20 1 "VALID" 0 "INVALID" ;
VAL_ 154 OBJ_Inv_TTC_STD_V_20 1 "VALID" 0 "INVALID" ;
VAL_ 154 OBJ_Relative_Long_Acc_V_20 1 "VALID" 0 "INVALID" ;
VAL_ 154 OBJ_Rel_Long_Acc_STD_V_20 1 "VALID" 0 "INVALID" ;
VAL_ 154 OBJ_Relative_Long_Velocity_V_20 1 "VALID" 0 "INVALID" ;
VAL_ 154 OBJ_Rel_Long_Vel_STD_V_20 1 "VALID" 0 "INVALID" ;
VAL_ 154 OBJ_Relative_Lat_Velocity_V_20 1 "VALID" 0 "INVALID" ;
VAL_ 154 OBJ_Rel_Lat_Vel_STD_V_20 1 "VALID" 0 "INVALID" ;
VAL_ 154 OBJ_Long_Distance_V_20 1 "VALID" 0 "INVALID" ;
VAL_ 154 OBJ_Long_Distance_STD_V_20 1 "VALID" 0 "INVALID" ;
VAL_ 154 OBJ_Lat_Distance_V_20 1 "VALID" 0 "INVALID" ;
VAL_ 154 OBJ_Lat_Distance_STD_V_20 1 "VALID" 0 "INVALID" ;
VAL_ 154 OBJ_Absolute_Speed_V_20 1 "VALID" 0 "INVALID" ;
VAL_ 154 OBJ_Absolute_Speed_STD_V_20 1 "VALID" 0 "INVALID" ;
VAL_ 154 OBJ_Heading_V_20 1 "VALID" 0 "INVALID" ;
VAL_ 154 OBJ_Heading_STD_V_20 1 "VALID" 0 "INVALID" ;
VAL_ 154 OBJ_Angle_Rate_STD_V_20 1 "VALID" 0 "INVALID" ;
VAL_ 154 OBJ_Angle_Rate_V_20 1 "VALID" 0 "INVALID" ;
VAL_ 154 OBJ_Angle_Right_V_20 1 "VALID" 0 "INVALID" ;
VAL_ 154 OBJ_Angle_Right_STD_V_20 1 "VALID" 0 "INVALID" ;
VAL_ 154 OBJ_Angle_Left_V_20 1 "VALID" 0 "INVALID" ;
VAL_ 154 OBJ_Angle_Left_STD_V_20 1 "VALID" 0 "INVALID" ;
VAL_ 154 OBJ_Angle_Side_V_20 1 "VALID" 0 "INVALID" ;
VAL_ 154 OBJ_Angle_Side_STD_V_20 1 "VALID" 0 "INVALID" ;
VAL_ 154 OBJ_Angle_Mid_V_20 1 "VALID" 0 "INVALID" ;
VAL_ 154 OBJ_Angle_Mid_STD_V_20 1 "VALID" 0 "INVALID" ;
VAL_ 154 OBJ_Angle_Bottom_V_20 1 "VALID" 0 "INVALID" ;
VAL_ 154 OBJ_Angle_Bottom_STD_V_20 1 "VALID" 0 "INVALID" ;
VAL_ 154 OBJ_Visibility_Side_V_20 1 "VALID" 0 "INVALID" ;
VAL_ 154 OBJ_Visibility_Side_20 2 "REAR" 1 "FRONT" 0 "NOT_VISIBLE" ;
VAL_ 154 OBJ_Is_In_Drivable_Area_20 1 "TRUE" 0 "FALSE" ;
VAL_ 154 OBJ_Is_In_Drivable_Area_V_20 1 "VALID" 0 "INVALID" ;
VAL_ 154 OBJ_Is_VeryClose_V_20 1 "VALID" 0 "INVALID" ;
VAL_ 154 OBJ_Is_VeryClose_20 1 "TRUE" 0 "FALSE" ;
VAL_ 154 OBJ_OverlapAngleEgoLaneR_V_20 1 "VALID" 0 "INVALID" ;
VAL_ 154 OBJ_OverlapAngleEgoLaneL_V_20 1 "VALID" 0 "INVALID" ;
VAL_ 154 OBJ_Is_EMERGENCY_VCL_20 1 "TRUE" 0 "FALSE" ;
VAL_ 154 OBJ_EMERGENCY_LIGHT_COLOR_20 3 "(1000)ORANGE" 2 "(0100)BLUE" 1 "(0010)RED" 0 "(0001)OTHER" ;
VAL_ 154 OBJ_EMERGENCY_V_20 1 "TRUE" 0 "FALSE" ;
VAL_ 154 OBJ_Angle_Top_V_20 1 "VALID" 0 "INVALID" ;
VAL_ 154 OBJ_Angle_Top_STD_V_20 1 "VALID" 0 "INVALID" ;
VAL_ 154 OBJ_Fusion_Source_21 2 "(BIT_2)RADAR2" 1 "(BIT_1)RADAR1" 0 "(BIT_0)CAMERA" ;
VAL_ 154 OBJ_Triggered_SDM_21 2 "NOT_TRIGGERED" 1 "TRIGGERED" 0 "NOT_AVAILABLE" ;
VAL_ 154 OBJ_Motion_Category_21 13 "ONCOMING" 12 "PRECEEDING" 11 "MOVING" 10 "RTAP" 9 "LTAP" 8 "CROSSING" 7 "MOVING_OUT" 6 "MOVING_IN" 5 "CLOSE_CUT_IN" 4 "PASSING_OUT" 3 "PASSING_IN" 2 "PASSING" 1 "UNDEFINED" 0 "UNFILLED" ;
VAL_ 154 OBJ_Measuring_Status_21 2 "(BIT_2)NOT_VALID_OR_VALID" 1 "(BIT_1)PREDICTED_OR_MEASURED" 0 "(BIT_0)OLD_OR_NEW" ;
VAL_ 154 OBJ_Object_Class_21 8 "UNCERTAIN_VCL" 7 "ANIMAL" 6 "GENERAL_OBJECT" 5 "PEDESTRIAN" 4 "BICYCLE" 3 "MOTORBIKE" 2 "TRUCK" 1 "CAR" 0 "UNFILLED" ;
VAL_ 154 OBJ_Camera_Source_21 11 "PARKING_RIGHT" 10 "PARKING_LEFT" 9 "PARKING_REAR" 8 "PARKING_FRONT" 7 "FRONT_CORNER_RIGHT" 6 "FRONT_CORNER_LEFT" 5 "REAR_CORNER_RIGHT" 4 "REAR_CORNER_LEFT" 3 "REAR" 2 "FRONT_FISHEYE" 1 "FRONT_NARROW" 0 "FRONT_MAIN" ;
VAL_ 154 OBJ_Motion_Status_21 5 "MOVING_SLOWLY" 4 "STOPPED" 3 "STATIONARY" 2 "MOVING" 1 "UNKNOWN" 0 "INVALID" ;
VAL_ 154 OBJ_Motion_Orientation_21 13 "INVALID" 12 "NORTH" 11 "NORTH_WEST" 9 "WEST" 7 "SOUTH_WEST" 6 "SOUTH" 5 "SOUTH_EAST" 3 "EAST" 1 "NORTH_EAST" 0 "UNKNOWN" ;
VAL_ 154 OBJ_Has_Cut_Lane_21 1 "TRUE" 0 "FALSE" ;
VAL_ 154 OBJ_Has_Cut_Path_21 1 "TRUE" 0 "FALSE" ;
VAL_ 154 OBJ_Brake_Light_21 1 "TRUE" 0 "FALSE" ;
VAL_ 154 OBJ_Turn_Indicator_Right_21 1 "TRUE" 0 "FALSE" ;
VAL_ 154 OBJ_Turn_Indicator_Left_21 1 "TRUE" 0 "FALSE" ;
VAL_ 154 OBJ_Light_Indicator_Validity_21 1 "TRUE" 0 "FALSE" ;
VAL_ 154 OBJ_Right_Out_Of_Image_21 1 "TRUE" 0 "FALSE" ;
VAL_ 154 OBJ_Left_Out_Of_Image_21 1 "TRUE" 0 "FALSE" ;
VAL_ 154 OBJ_Right_Out_Of_Image_V_21 1 "TRUE" 0 "FALSE" ;
VAL_ 154 OBJ_Left_Out_Of_Image_V_21 1 "TRUE" 0 "FALSE" ;
VAL_ 154 OBJ_Top_Out_Of_Image_21 1 "TRUE" 0 "FALSE" ;
VAL_ 154 OBJ_Bottom_Out_Of_Image_21 1 "TRUE" 0 "FALSE" ;
VAL_ 154 OBJ_Top_Out_Of_Image_V_21 1 "VALID" 0 "INVALID" ;
VAL_ 154 OBJ_Bottom_Out_Of_Image_V_21 1 "VALID" 0 "INVALID" ;
VAL_ 154 OBJ_Lane_Assignment_21 5 "RIGHT_RIGHT" 4 "RIGHT" 3 "HOST" 2 "LEFT" 1 "LEFT_LEFT" 0 "UNKNOWN" ;
VAL_ 154 OBJ_Lane_Assignment_V_21 1 "VALID" 0 "INVALID" ;
VAL_ 154 OBJ_Age_Seconds_V_21 1 "VALID" 0 "INVALID" ;
VAL_ 154 OBJ_Width_V_21 1 "VALID" 0 "INVALID" ;
VAL_ 154 OBJ_Width_STD_V_21 1 "VALID" 0 "INVALID" ;
VAL_ 154 OBJ_Length_V_21 1 "VALID" 0 "INVALID" ;
VAL_ 154 OBJ_Length_STD_V_21 1 "VALID" 0 "INVALID" ;
VAL_ 154 OBJ_Height_V_21 1 "VALID" 0 "INVALID" ;
VAL_ 154 OBJ_Height_STD_V_21 1 "VALID" 0 "INVALID" ;
VAL_ 154 OBJ_Abs_Long_Velocity_V_21 1 "VALID" 0 "INVALID" ;
VAL_ 154 OBJ_Abs_Long_Vel_STD_V_21 1 "VALID" 0 "INVALID" ;
VAL_ 154 OBJ_Abs_Lat_Velocity_V_21 1 "VALID" 0 "INVALID" ;
VAL_ 154 OBJ_Abs_Lat_Vel_STD_V_21 1 "VALID" 0 "INVALID" ;
VAL_ 154 OBJ_Abs_Long_Acc_V_21 1 "VALID" 0 "INVALID" ;
VAL_ 154 OBJ_Abs_Long_Acc_STD_V_21 1 "VALID" 0 "INVALID" ;
VAL_ 154 OBJ_Abs_Lat_Acc_V_21 1 "VALID" 0 "INVALID" ;
VAL_ 154 OBJ_Abs_Lat_Acc_STD_V_21 1 "VALID" 0 "INVALID" ;
VAL_ 154 OBJ_Abs_Acceleration_V_21 1 "VALID" 0 "INVALID" ;
VAL_ 154 OBJ_Abs_Acc_STD_V_21 1 "VALID" 0 "INVALID" ;
VAL_ 154 OBJ_Inv_TTC_V_21 1 "VALID" 0 "INVALID" ;
VAL_ 154 OBJ_Inv_TTC_STD_V_21 1 "VALID" 0 "INVALID" ;
VAL_ 154 OBJ_Relative_Long_Acc_V_21 1 "VALID" 0 "INVALID" ;
VAL_ 154 OBJ_Rel_Long_Acc_STD_V_21 1 "VALID" 0 "INVALID" ;
VAL_ 154 OBJ_Relative_Long_Velocity_V_21 1 "VALID" 0 "INVALID" ;
VAL_ 154 OBJ_Rel_Long_Vel_STD_V_21 1 "VALID" 0 "INVALID" ;
VAL_ 154 OBJ_Relative_Lat_Velocity_V_21 1 "VALID" 0 "INVALID" ;
VAL_ 154 OBJ_Rel_Lat_Vel_STD_V_21 1 "VALID" 0 "INVALID" ;
VAL_ 154 OBJ_Long_Distance_V_21 1 "VALID" 0 "INVALID" ;
VAL_ 154 OBJ_Long_Distance_STD_V_21 1 "VALID" 0 "INVALID" ;
VAL_ 154 OBJ_Lat_Distance_V_21 1 "VALID" 0 "INVALID" ;
VAL_ 154 OBJ_Lat_Distance_STD_V_21 1 "VALID" 0 "INVALID" ;
VAL_ 154 OBJ_Absolute_Speed_V_21 1 "VALID" 0 "INVALID" ;
VAL_ 154 OBJ_Absolute_Speed_STD_V_21 1 "VALID" 0 "INVALID" ;
VAL_ 154 OBJ_Heading_V_21 1 "VALID" 0 "INVALID" ;
VAL_ 154 OBJ_Heading_STD_V_21 1 "VALID" 0 "INVALID" ;
VAL_ 154 OBJ_Angle_Rate_STD_V_21 1 "VALID" 0 "INVALID" ;
VAL_ 154 OBJ_Angle_Rate_V_21 1 "VALID" 0 "INVALID" ;
VAL_ 154 OBJ_Angle_Right_V_21 1 "VALID" 0 "INVALID" ;
VAL_ 154 OBJ_Angle_Right_STD_V_21 1 "VALID" 0 "INVALID" ;
VAL_ 154 OBJ_Angle_Left_V_21 1 "VALID" 0 "INVALID" ;
VAL_ 154 OBJ_Angle_Left_STD_V_21 1 "VALID" 0 "INVALID" ;
VAL_ 154 OBJ_Angle_Side_V_21 1 "VALID" 0 "INVALID" ;
VAL_ 154 OBJ_Angle_Side_STD_V_21 1 "VALID" 0 "INVALID" ;
VAL_ 154 OBJ_Angle_Mid_V_21 1 "VALID" 0 "INVALID" ;
VAL_ 154 OBJ_Angle_Mid_STD_V_21 1 "VALID" 0 "INVALID" ;
VAL_ 154 OBJ_Angle_Bottom_V_21 1 "VALID" 0 "INVALID" ;
VAL_ 154 OBJ_Angle_Bottom_STD_V_21 1 "VALID" 0 "INVALID" ;
VAL_ 154 OBJ_Visibility_Side_V_21 1 "VALID" 0 "INVALID" ;
VAL_ 154 OBJ_Visibility_Side_21 2 "REAR" 1 "FRONT" 0 "NOT_VISIBLE" ;
VAL_ 154 OBJ_Is_In_Drivable_Area_21 1 "TRUE" 0 "FALSE" ;
VAL_ 154 OBJ_Is_In_Drivable_Area_V_21 1 "VALID" 0 "INVALID" ;
VAL_ 154 OBJ_Is_VeryClose_V_21 1 "VALID" 0 "INVALID" ;
VAL_ 154 OBJ_Is_VeryClose_21 1 "TRUE" 0 "FALSE" ;
VAL_ 154 OBJ_OverlapAngleEgoLaneR_V_21 1 "VALID" 0 "INVALID" ;
VAL_ 154 OBJ_OverlapAngleEgoLaneL_V_21 1 "VALID" 0 "INVALID" ;
VAL_ 154 OBJ_Is_EMERGENCY_VCL_21 1 "TRUE" 0 "FALSE" ;
VAL_ 154 OBJ_EMERGENCY_LIGHT_COLOR_21 3 "(1000)ORANGE" 2 "(0100)BLUE" 1 "(0010)RED" 0 "(0001)OTHER" ;
VAL_ 154 OBJ_EMERGENCY_V_21 1 "TRUE" 0 "FALSE" ;
VAL_ 154 OBJ_Angle_Top_V_21 1 "VALID" 0 "INVALID" ;
VAL_ 154 OBJ_Angle_Top_STD_V_21 1 "VALID" 0 "INVALID" ;
VAL_ 154 OBJ_Fusion_Source_22 2 "(BIT_2)RADAR2" 1 "(BIT_1)RADAR1" 0 "(BIT_0)CAMERA" ;
VAL_ 154 OBJ_Triggered_SDM_22 2 "NOT_TRIGGERED" 1 "TRIGGERED" 0 "NOT_AVAILABLE" ;
VAL_ 154 OBJ_Motion_Category_22 13 "ONCOMING" 12 "PRECEEDING" 11 "MOVING" 10 "RTAP" 9 "LTAP" 8 "CROSSING" 7 "MOVING_OUT" 6 "MOVING_IN" 5 "CLOSE_CUT_IN" 4 "PASSING_OUT" 3 "PASSING_IN" 2 "PASSING" 1 "UNDEFINED" 0 "UNFILLED" ;
VAL_ 154 OBJ_Measuring_Status_22 2 "(BIT_2)NOT_VALID_OR_VALID" 1 "(BIT_1)PREDICTED_OR_MEASURED" 0 "(BIT_0)OLD_OR_NEW" ;
VAL_ 154 OBJ_Object_Class_22 8 "UNCERTAIN_VCL" 7 "ANIMAL" 6 "GENERAL_OBJECT" 5 "PEDESTRIAN" 4 "BICYCLE" 3 "MOTORBIKE" 2 "TRUCK" 1 "CAR" 0 "UNFILLED" ;
VAL_ 154 OBJ_Camera_Source_22 11 "PARKING_RIGHT" 10 "PARKING_LEFT" 9 "PARKING_REAR" 8 "PARKING_FRONT" 7 "FRONT_CORNER_RIGHT" 6 "FRONT_CORNER_LEFT" 5 "REAR_CORNER_RIGHT" 4 "REAR_CORNER_LEFT" 3 "REAR" 2 "FRONT_FISHEYE" 1 "FRONT_NARROW" 0 "FRONT_MAIN" ;
VAL_ 154 OBJ_Motion_Status_22 5 "MOVING_SLOWLY" 4 "STOPPED" 3 "STATIONARY" 2 "MOVING" 1 "UNKNOWN" 0 "INVALID" ;
VAL_ 154 OBJ_Motion_Orientation_22 13 "INVALID" 12 "NORTH" 11 "NORTH_WEST" 9 "WEST" 7 "SOUTH_WEST" 6 "SOUTH" 5 "SOUTH_EAST" 3 "EAST" 1 "NORTH_EAST" 0 "UNKNOWN" ;
VAL_ 154 OBJ_Has_Cut_Lane_22 1 "TRUE" 0 "FALSE" ;
VAL_ 154 OBJ_Has_Cut_Path_22 1 "TRUE" 0 "FALSE" ;
VAL_ 154 OBJ_Brake_Light_22 1 "TRUE" 0 "FALSE" ;
VAL_ 154 OBJ_Turn_Indicator_Right_22 1 "TRUE" 0 "FALSE" ;
VAL_ 154 OBJ_Turn_Indicator_Left_22 1 "TRUE" 0 "FALSE" ;
VAL_ 154 OBJ_Light_Indicator_Validity_22 1 "TRUE" 0 "FALSE" ;
VAL_ 154 OBJ_Right_Out_Of_Image_22 1 "TRUE" 0 "FALSE" ;
VAL_ 154 OBJ_Left_Out_Of_Image_22 1 "TRUE" 0 "FALSE" ;
VAL_ 154 OBJ_Right_Out_Of_Image_V_22 1 "TRUE" 0 "FALSE" ;
VAL_ 154 OBJ_Left_Out_Of_Image_V_22 1 "TRUE" 0 "FALSE" ;
VAL_ 154 OBJ_Top_Out_Of_Image_22 1 "TRUE" 0 "FALSE" ;
VAL_ 154 OBJ_Bottom_Out_Of_Image_22 1 "TRUE" 0 "FALSE" ;
VAL_ 154 OBJ_Top_Out_Of_Image_V_22 1 "VALID" 0 "INVALID" ;
VAL_ 154 OBJ_Bottom_Out_Of_Image_V_22 1 "VALID" 0 "INVALID" ;
VAL_ 154 OBJ_Lane_Assignment_22 5 "RIGHT_RIGHT" 4 "RIGHT" 3 "HOST" 2 "LEFT" 1 "LEFT_LEFT" 0 "UNKNOWN" ;
VAL_ 154 OBJ_Lane_Assignment_V_22 1 "VALID" 0 "INVALID" ;
VAL_ 154 OBJ_Age_Seconds_V_22 1 "VALID" 0 "INVALID" ;
VAL_ 154 OBJ_Width_V_22 1 "VALID" 0 "INVALID" ;
VAL_ 154 OBJ_Width_STD_V_22 1 "VALID" 0 "INVALID" ;
VAL_ 154 OBJ_Length_V_22 1 "VALID" 0 "INVALID" ;
VAL_ 154 OBJ_Length_STD_V_22 1 "VALID" 0 "INVALID" ;
VAL_ 154 OBJ_Height_V_22 1 "VALID" 0 "INVALID" ;
VAL_ 154 OBJ_Height_STD_V_22 1 "VALID" 0 "INVALID" ;
VAL_ 154 OBJ_Abs_Long_Velocity_V_22 1 "VALID" 0 "INVALID" ;
VAL_ 154 OBJ_Abs_Long_Vel_STD_V_22 1 "VALID" 0 "INVALID" ;
VAL_ 154 OBJ_Abs_Lat_Velocity_V_22 1 "VALID" 0 "INVALID" ;
VAL_ 154 OBJ_Abs_Lat_Vel_STD_V_22 1 "VALID" 0 "INVALID" ;
VAL_ 154 OBJ_Abs_Long_Acc_V_22 1 "VALID" 0 "INVALID" ;
VAL_ 154 OBJ_Abs_Long_Acc_STD_V_22 1 "VALID" 0 "INVALID" ;
VAL_ 154 OBJ_Abs_Lat_Acc_V_22 1 "VALID" 0 "INVALID" ;
VAL_ 154 OBJ_Abs_Lat_Acc_STD_V_22 1 "VALID" 0 "INVALID" ;
VAL_ 154 OBJ_Abs_Acceleration_V_22 1 "VALID" 0 "INVALID" ;
VAL_ 154 OBJ_Abs_Acc_STD_V_22 1 "VALID" 0 "INVALID" ;
VAL_ 154 OBJ_Inv_TTC_V_22 1 "VALID" 0 "INVALID" ;
VAL_ 154 OBJ_Inv_TTC_STD_V_22 1 "VALID" 0 "INVALID" ;
VAL_ 154 OBJ_Relative_Long_Acc_V_22 1 "VALID" 0 "INVALID" ;
VAL_ 154 OBJ_Rel_Long_Acc_STD_V_22 1 "VALID" 0 "INVALID" ;
VAL_ 154 OBJ_Relative_Long_Velocity_V_22 1 "VALID" 0 "INVALID" ;
VAL_ 154 OBJ_Rel_Long_Vel_STD_V_22 1 "VALID" 0 "INVALID" ;
VAL_ 154 OBJ_Relative_Lat_Velocity_V_22 1 "VALID" 0 "INVALID" ;
VAL_ 154 OBJ_Rel_Lat_Vel_STD_V_22 1 "VALID" 0 "INVALID" ;
VAL_ 154 OBJ_Long_Distance_V_22 1 "VALID" 0 "INVALID" ;
VAL_ 154 OBJ_Long_Distance_STD_V_22 1 "VALID" 0 "INVALID" ;
VAL_ 154 OBJ_Lat_Distance_V_22 1 "VALID" 0 "INVALID" ;
VAL_ 154 OBJ_Lat_Distance_STD_V_22 1 "VALID" 0 "INVALID" ;
VAL_ 154 OBJ_Absolute_Speed_V_22 1 "VALID" 0 "INVALID" ;
VAL_ 154 OBJ_Absolute_Speed_STD_V_22 1 "VALID" 0 "INVALID" ;
VAL_ 154 OBJ_Heading_V_22 1 "VALID" 0 "INVALID" ;
VAL_ 154 OBJ_Heading_STD_V_22 1 "VALID" 0 "INVALID" ;
VAL_ 154 OBJ_Angle_Rate_STD_V_22 1 "VALID" 0 "INVALID" ;
VAL_ 154 OBJ_Angle_Rate_V_22 1 "VALID" 0 "INVALID" ;
VAL_ 154 OBJ_Angle_Right_V_22 1 "VALID" 0 "INVALID" ;
VAL_ 154 OBJ_Angle_Right_STD_V_22 1 "VALID" 0 "INVALID" ;
VAL_ 154 OBJ_Angle_Left_V_22 1 "VALID" 0 "INVALID" ;
VAL_ 154 OBJ_Angle_Left_STD_V_22 1 "VALID" 0 "INVALID" ;
VAL_ 154 OBJ_Angle_Side_V_22 1 "VALID" 0 "INVALID" ;
VAL_ 154 OBJ_Angle_Side_STD_V_22 1 "VALID" 0 "INVALID" ;
VAL_ 154 OBJ_Angle_Mid_V_22 1 "VALID" 0 "INVALID" ;
VAL_ 154 OBJ_Angle_Mid_STD_V_22 1 "VALID" 0 "INVALID" ;
VAL_ 154 OBJ_Angle_Bottom_V_22 1 "VALID" 0 "INVALID" ;
VAL_ 154 OBJ_Angle_Bottom_STD_V_22 1 "VALID" 0 "INVALID" ;
VAL_ 154 OBJ_Visibility_Side_V_22 1 "VALID" 0 "INVALID" ;
VAL_ 154 OBJ_Visibility_Side_22 2 "REAR" 1 "FRONT" 0 "NOT_VISIBLE" ;
VAL_ 154 OBJ_Is_In_Drivable_Area_22 1 "TRUE" 0 "FALSE" ;
VAL_ 154 OBJ_Is_In_Drivable_Area_V_22 1 "VALID" 0 "INVALID" ;
VAL_ 154 OBJ_Is_VeryClose_V_22 1 "VALID" 0 "INVALID" ;
VAL_ 154 OBJ_Is_VeryClose_22 1 "TRUE" 0 "FALSE" ;
VAL_ 154 OBJ_OverlapAngleEgoLaneR_V_22 1 "VALID" 0 "INVALID" ;
VAL_ 154 OBJ_OverlapAngleEgoLaneL_V_22 1 "VALID" 0 "INVALID" ;
VAL_ 154 OBJ_Is_EMERGENCY_VCL_22 1 "TRUE" 0 "FALSE" ;
VAL_ 154 OBJ_EMERGENCY_LIGHT_COLOR_22 3 "(1000)ORANGE" 2 "(0100)BLUE" 1 "(0010)RED" 0 "(0001)OTHER" ;
VAL_ 154 OBJ_EMERGENCY_V_22 1 "TRUE" 0 "FALSE" ;
VAL_ 154 OBJ_Angle_Top_V_22 1 "VALID" 0 "INVALID" ;
VAL_ 154 OBJ_Angle_Top_STD_V_22 1 "VALID" 0 "INVALID" ;
VAL_ 154 OBJ_Fusion_Source_23 2 "(BIT_2)RADAR2" 1 "(BIT_1)RADAR1" 0 "(BIT_0)CAMERA" ;
VAL_ 154 OBJ_Triggered_SDM_23 2 "NOT_TRIGGERED" 1 "TRIGGERED" 0 "NOT_AVAILABLE" ;
VAL_ 154 OBJ_Motion_Category_23 13 "ONCOMING" 12 "PRECEEDING" 11 "MOVING" 10 "RTAP" 9 "LTAP" 8 "CROSSING" 7 "MOVING_OUT" 6 "MOVING_IN" 5 "CLOSE_CUT_IN" 4 "PASSING_OUT" 3 "PASSING_IN" 2 "PASSING" 1 "UNDEFINED" 0 "UNFILLED" ;
VAL_ 154 OBJ_Measuring_Status_23 2 "(BIT_2)NOT_VALID_OR_VALID" 1 "(BIT_1)PREDICTED_OR_MEASURED" 0 "(BIT_0)OLD_OR_NEW" ;
VAL_ 154 OBJ_Object_Class_23 8 "UNCERTAIN_VCL" 7 "ANIMAL" 6 "GENERAL_OBJECT" 5 "PEDESTRIAN" 4 "BICYCLE" 3 "MOTORBIKE" 2 "TRUCK" 1 "CAR" 0 "UNFILLED" ;
VAL_ 154 OBJ_Camera_Source_23 11 "PARKING_RIGHT" 10 "PARKING_LEFT" 9 "PARKING_REAR" 8 "PARKING_FRONT" 7 "FRONT_CORNER_RIGHT" 6 "FRONT_CORNER_LEFT" 5 "REAR_CORNER_RIGHT" 4 "REAR_CORNER_LEFT" 3 "REAR" 2 "FRONT_FISHEYE" 1 "FRONT_NARROW" 0 "FRONT_MAIN" ;
VAL_ 154 OBJ_Motion_Status_23 5 "MOVING_SLOWLY" 4 "STOPPED" 3 "STATIONARY" 2 "MOVING" 1 "UNKNOWN" 0 "INVALID" ;
VAL_ 154 OBJ_Motion_Orientation_23 13 "INVALID" 12 "NORTH" 11 "NORTH_WEST" 9 "WEST" 7 "SOUTH_WEST" 6 "SOUTH" 5 "SOUTH_EAST" 3 "EAST" 1 "NORTH_EAST" 0 "UNKNOWN" ;
