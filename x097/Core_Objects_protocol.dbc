VERSION "15"
// BundelVersion=v4.21.5_CF1
NS_ :

BS_:

BU_: EyeQ4 MCU

BO_ 154 Core_Objects_protocol: 4820 EyeQ4
 SG_ OBJ_Rel_Long_Acc_STD_V_11 : 11157|1@1+ (1,0) [0|1] "bool" MCU
 SG_ Reserved_13_11 : 11158|10@1+ (1,0) [0|0] "NA" MCU
 SG_ OBJ_Relative_Long_Velocity_11 : 11168|13@1+ (0.05,-120) [-120|130] "m_per_s" MCU
 SG_ OBJ_Relative_Long_Velocity_V_11 : 11181|1@1+ (1,0) [0|1] "bool" MCU
 SG_ OBJ_Relative_Long_Vel_STD_11 : 11182|14@1+ (0.01,0) [0|130] "m_per_s" MCU
 SG_ OBJ_Rel_Long_Vel_STD_V_11 : 11196|1@1+ (1,0) [0|1] "bool" MCU
 SG_ Reserved_14_11 : 11197|3@1+ (1,0) [0|0] "NA" MCU
 SG_ OBJ_Relative_Lat_Velocity_11 : 11200|11@1+ (0.05,-50) [-50|50] "m_per_s" MCU
 SG_ OBJ_Relative_Lat_Velocity_V_11 : 11211|1@1+ (1,0) [0|1] "bool" MCU
 SG_ OBJ_Relative_Lat_Velocity_STD_11 : 11212|13@1+ (0.01,0) [0|50] "m_per_s" MCU
 SG_ OBJ_Rel_Lat_Vel_STD_V_11 : 11225|1@1+ (1,0) [0|1] "bool" MCU
 SG_ Reserved_15_11 : 11226|6@1+ (1,0) [0|0] "NA" MCU
 SG_ OBJ_Long_Distance_11 : 11232|14@1+ (0.05,-200) [-200|500] "m" MCU
 SG_ OBJ_Long_Distance_V_11 : 11246|1@1+ (1,0) [0|1] "bool" MCU
 SG_ OBJ_Long_Distance_STD_11 : 11247|15@1+ (0.01,0) [0|250] "m" MCU
 SG_ OBJ_Long_Distance_STD_V_11 : 11262|1@1+ (1,0) [0|1] "bool" MCU
 SG_ Reserved_16_11 : 11263|1@1+ (1,0) [0|0] "NA" MCU
 SG_ OBJ_Lat_Distance_11 : 11264|12@1+ (0.05,-100) [-100|100] "m" MCU
 SG_ OBJ_Lat_Distance_V_11 : 11276|1@1+ (1,0) [0|1] "bool" MCU
 SG_ OBJ_Lat_Distance_STD_11 : 11277|14@1+ (0.01,0) [0|100] "m" MCU
 SG_ OBJ_Lat_Distance_STD_V_11 : 11291|1@1+ (1,0) [0|1] "bool" MCU
 SG_ Reserved_17_11 : 11292|4@1+ (1,0) [0|0] "NA" MCU
 SG_ OBJ_Absolute_Speed_11 : 11296|12@1+ (0.05,-65) [-65|65] "m_per_s" MCU
 SG_ OBJ_Absolute_Speed_V_11 : 11308|1@1+ (1,0) [0|1] "bool" MCU
 SG_ OBJ_Absolute_Speed_STD_11 : 11309|13@1+ (0.01,0) [0|65] "m_per_s" MCU
 SG_ OBJ_Absolute_Speed_STD_V_11 : 11322|1@1+ (1,0) [0|1] "bool" MCU
 SG_ Reserved_18_11 : 11323|5@1+ (1,0) [0|0] "NA" MCU
 SG_ OBJ_Heading_11 : 11328|10@1+ (0.01,-3.14) [-3.14|3.14] "rad" MCU
 SG_ OBJ_Heading_V_11 : 11338|1@1+ (1,0) [0|1] "bool" MCU
 SG_ OBJ_Heading_STD_11 : 11339|15@1+ (0.0001,0) [0|3.14] "rad" MCU
 SG_ OBJ_Heading_STD_V_11 : 11354|1@1+ (1,0) [0|1] "bool" MCU
 SG_ Reserved_19_11 : 11355|5@1+ (1,0) [0|0] "NA" MCU
 SG_ OBJ_Angle_Rate_STD_11 : 11360|15@1+ (0.0001,0) [0|2.2318] "RPS" MCU
 SG_ OBJ_Angle_Rate_STD_V_11 : 11375|1@1+ (1,0) [0|1] "bool" MCU
 SG_ OBJ_Angle_Rate_11 : 11376|12@1+ (0.002,-2.234) [-2.234|2.2318] "RPS" MCU
 SG_ OBJ_Angle_Rate_V_11 : 11388|1@1+ (1,0) [0|1] "bool" MCU
 SG_ Reserved_20_11 : 11389|3@1+ (1,0) [0|0] "NA" MCU
 SG_ OBJ_Angle_Right_11 : 11392|14@1+ (0.0002,-1.571) [-1.571|1.571] "rad" MCU
 SG_ OBJ_Angle_Right_V_11 : 11406|1@1+ (1,0) [0|1] "bool" MCU
 SG_ OBJ_Angle_Right_STD_11 : 11407|14@1+ (0.0001,0) [0|1.571] "rad" MCU
 SG_ OBJ_Angle_Right_STD_V_11 : 11421|1@1+ (1,0) [0|1] "bool" MCU
 SG_ Reserved_21_11 : 11422|2@1+ (1,0) [0|0] "NA" MCU
 SG_ OBJ_Angle_Left_11 : 11424|14@1+ (0.0002,-1.571) [-1.571|1.571] "rad" MCU
 SG_ OBJ_Angle_Left_V_11 : 11438|1@1+ (1,0) [0|1] "bool" MCU
 SG_ OBJ_Angle_Left_STD_11 : 11439|14@1+ (0.0001,0) [0|1.571] "rad" MCU
 SG_ OBJ_Angle_Left_STD_V_11 : 11453|1@1+ (1,0) [0|1] "bool" MCU
 SG_ Reserved_22_11 : 11454|2@1+ (1,0) [0|0] "NA" MCU
 SG_ OBJ_Angle_Side_11 : 11456|14@1+ (0.0002,-1.571) [-1.571|1.571] "rad" MCU
 SG_ OBJ_Angle_Side_V_11 : 11470|1@1+ (1,0) [0|1] "bool" MCU
 SG_ OBJ_Angle_Side_STD_11 : 11471|14@1+ (0.0001,0) [0|1.571] "rad" MCU
 SG_ OBJ_Angle_Side_STD_V_11 : 11485|1@1+ (1,0) [0|1] "bool" MCU
 SG_ OBJ_Angle_Mid_V_11 : 11486|1@1+ (1,0) [0|1] "bool" MCU
 SG_ Reserved_23_11 : 11487|1@1+ (1,0) [0|0] "NA" MCU
 SG_ OBJ_Angle_Mid_11 : 11488|14@1+ (0.0002,-1.571) [-1.571|1.571] "rad" MCU
 SG_ OBJ_Angle_Mid_STD_11 : 11502|14@1+ (0.0001,0) [0|1.571] "rad" MCU
 SG_ OBJ_Angle_Mid_STD_V_11 : 11516|1@1+ (1,0) [0|1] "bool" MCU
 SG_ OBJ_Angle_Bottom_V_11 : 11517|1@1+ (1,0) [0|1] "bool" MCU
 SG_ Reserved_24_11 : 11518|2@1+ (1,0) [0|0] "NA" MCU
 SG_ OBJ_Angle_Bottom_11 : 11520|14@1+ (0.0002,-1.571) [-1.571|1.571] "rad" MCU
 SG_ OBJ_Angle_Bottom_STD_11 : 11534|14@1+ (0.0001,0) [0|1.571] "rad" MCU
 SG_ OBJ_Angle_Bottom_STD_V_11 : 11548|1@1+ (1,0) [0|1] "bool" MCU
 SG_ OBJ_Visibility_Side_V_11 : 11549|1@1+ (1,0) [0|1] "bool" MCU
 SG_ OBJ_Visibility_Side_11 : 11550|2@1+ (1,0) [0|2] "ENUM" MCU
 SG_ OBJ_Is_In_Drivable_Area_11 : 11552|1@1+ (1,0) [0|1] "bool" MCU
 SG_ OBJ_Is_In_Drivable_Area_V_11 : 11553|1@1+ (1,0) [0|1] "bool" MCU
 SG_ OBJ_Is_VeryClose_V_11 : 11554|1@1+ (1,0) [0|1] "bool" MCU
 SG_ OBJ_Is_VeryClose_11 : 11555|1@1+ (1,0) [0|1] "bool" MCU
 SG_ OBJ_Buffer_C4_11 : 11556|2@1+ (1,0) [0|2] "NA" MCU
 SG_ OBJ_Buffer_C5_11 : 11558|2@1+ (1,0) [0|2] "NA" MCU
 SG_ OBJ_Buffer_C6_11 : 11560|2@1+ (1,0) [0|2] "NA" MCU
 SG_ OBJ_Buffer_C7_11 : 11562|2@1+ (1,0) [0|2] "NA" MCU
 SG_ OBJ_OverlapAngleEgoLaneR_11 : 11564|10@1+ (0.01,-3.14) [-3.14|3.14] "rad" MCU
 SG_ OBJ_OverlapAngleEgoLaneR_V_11 : 11574|1@1+ (1,0) [0|1] "bool" MCU
 SG_ Reserved_25_11 : 11575|9@1+ (1,0) [0|0] "NA" MCU
 SG_ OBJ_OverlapAngleEgoLaneL_11 : 11584|10@1+ (0.01,-3.14) [-3.14|3.14] "rad" MCU
 SG_ OBJ_OverlapAngleEgoLaneL_V_11 : 11594|1@1+ (1,0) [0|1] "bool" MCU
 SG_ OBJ_Is_EMERGENCY_VCL_11 : 11595|1@1+ (1,0) [0|1] "bool" MCU
 SG_ OBJ_EMERGENCY_LIGHT_COLOR_11 : 11596|4@1+ (1,0) [0|15] "BITWIZE" MCU
 SG_ OBJ_EMERGENCY_V_11 : 11600|1@1+ (1,0) [0|1] "bool" MCU
 SG_ OBJ_Angle_Top_11 : 11601|14@1+ (0.0002,0) [0|3.1415] "rad" MCU
 SG_ OBJ_Angle_Top_V_11 : 11615|1@1+ (1,0) [0|1] "bool" MCU
 SG_ OBJ_Angle_Top_STD_11 : 11616|15@1+ (0.0001,0) [0|3.1415] "rad" MCU
 SG_ OBJ_Angle_Top_STD_V_11 : 11631|1@1+ (1,0) [0|1] "bool" MCU
 SG_ OBJ_Open_Door_Left_11 : 11632|1@1+ (1,0) [0|1] "bool" MCU
 SG_ OBJ_Open_Door_Right_11 : 11633|1@1+ (1,0) [0|1] "bool" MCU
 SG_ OBJ_Visible_Left_or_Right_11 : 11634|2@1+ (1,0) [0|2] "ENUM" MCU
 SG_ OBJ_Visible_Left_or_Right_V_11 : 11636|1@1+ (1,0) [0|1] "bool" MCU
 SG_ OBJ_2W_Is_Motorbike_Probability_11 : 11637|8@1+ (0.01,0) [0|1] "NA" MCU
 SG_ Reserved_26_11 : 11645|3@1+ (1,0) [0|0] "NA" MCU
 SG_ OBJ_2W_Is_Bicycle_Probability_11 : 11648|8@1+ (0.01,0) [0|1] "NA" MCU
 SG_ Reserved_27_11 : 11656|24@1+ (1,0) [0|0] "NA" MCU
 SG_ OBJ_CRC_12 : 11680|32@1+ (1,0) [0|4294967295] "NA" MCU
 SG_ OBJ_ID_12 : 11712|8@1+ (1,0) [0|255] "counter" MCU
 SG_ OBJ_Existence_Probability_12 : 11720|8@1+ (0.01,0) [0|1] "NA" MCU
 SG_ OBJ_Fusion_Source_12 : 11728|16@1+ (1,0) [0|65535] "BITWIZE" MCU
 SG_ OBJ_Triggered_SDM_12 : 11744|2@1+ (1,0) [0|2] "ENUM" MCU
 SG_ OBJ_Motion_Category_12 : 11746|4@1+ (1,0) [0|13] "ENUM" MCU
 SG_ OBJ_Moving_IN_Probability_12 : 11750|7@1+ (0.01,0) [0|1] "NA" MCU
 SG_ OBJ_Object_Age_12 : 11757|11@1+ (1,0) [0|2047] "frames" MCU
 SG_ OBJ_Measuring_Status_12 : 11768|3@1+ (1,0) [0|7] "BITWIZE" MCU
 SG_ OBJ_Object_Class_12 : 11771|4@1+ (1,0) [0|9] "ENUM" MCU
 SG_ Reserved_4_12 : 11775|1@1+ (1,0) [0|0] "NA" MCU
 SG_ OBJ_Class_Probability_12 : 11776|7@1+ (0.01,0) [0|1] "NA" MCU
 SG_ OBJ_Car_Probability_12 : 11783|7@1+ (0.01,0) [0|1] "NA" MCU
 SG_ OBJ_Truck_Probability_12 : 11790|7@1+ (0.01,0) [0|1] "NA" MCU
 SG_ OBJ_Bike_Probability_12 : 11797|7@1+ (0.01,0) [0|1] "NA" MCU
 SG_ OBJ_Camera_Source_12 : 11804|4@1+ (1,0) [0|15] "ENUM" MCU
 SG_ OBJ_Motion_Status_12 : 11808|3@1+ (1,0) [0|5] "ENUM" MCU
 SG_ OBJ_Motion_Orientation_12 : 11811|4@1+ (1,0) [0|13] "ENUM" MCU
 SG_ OBJ_Has_Cut_Lane_12 : 11815|1@1+ (1,0) [0|1] "bool" MCU
 SG_ OBJ_Has_Cut_Path_12 : 11816|1@1+ (1,0) [0|1] "bool" MCU
 SG_ OBJ_Brake_Light_Validity_12 : 11817|1@1+ (1,0) [0|1] "bool" MCU
 SG_ OBJ_Brake_Light_12 : 11818|1@1+ (1,0) [0|1] "bool" MCU
 SG_ OBJ_Turn_Indicator_Right_12 : 11819|1@1+ (1,0) [0|1] "bool" MCU
 SG_ OBJ_Turn_Indicator_Left_12 : 11820|1@1+ (1,0) [0|1] "bool" MCU
 SG_ OBJ_Turn_Indicator_Validity_12 : 11821|1@1+ (1,0) [0|1] "bool" MCU
 SG_ OBJ_Right_Out_Of_Image_12 : 11822|1@1+ (1,0) [0|1] "bool" MCU
 SG_ OBJ_Left_Out_Of_Image_12 : 11823|1@1+ (1,0) [0|1] "bool" MCU
 SG_ OBJ_Right_Out_Of_Image_V_12 : 11824|1@1+ (1,0) [0|1] "bool" MCU
 SG_ OBJ_Left_Out_Of_Image_V_12 : 11825|1@1+ (1,0) [0|1] "bool" MCU
 SG_ OBJ_Top_Out_Of_Image_12 : 11826|1@1+ (1,0) [0|1] "bool" MCU
 SG_ OBJ_Bottom_Out_Of_Image_12 : 11827|1@1+ (1,0) [0|1] "bool" MCU
 SG_ OBJ_Top_Out_Of_Image_V_12 : 11828|1@1+ (1,0) [0|1] "bool" MCU
 SG_ OBJ_Bottom_Out_Of_Image_V_12 : 11829|1@1+ (1,0) [0|1] "bool" MCU
 SG_ OBJ_Lane_Assignment_12 : 11830|3@1+ (1,0) [0|5] "ENUM" MCU
 SG_ OBJ_Lane_Assignment_V_12 : 11833|1@1+ (1,0) [0|1] "bool" MCU
 SG_ Reserved_5_12 : 11834|6@1+ (1,0) [0|0] "NA" MCU
 SG_ OBJ_Age_Seconds_12 : 11840|7@1+ (1,0) [0|100] "s" MCU
 SG_ OBJ_Age_Seconds_V_12 : 11847|1@1+ (1,0) [0|1] "bool" MCU
 SG_ OBJ_Width_12 : 11848|9@1+ (0.01,0) [0.4|2.95] "m" MCU
 SG_ OBJ_Width_V_12 : 11857|1@1+ (1,0) [0|1] "bool" MCU
 SG_ OBJ_Width_STD_12 : 11858|11@1+ (0.001,0) [0|2] "m" MCU
 SG_ OBJ_Width_STD_V_12 : 11869|1@1+ (1,0) [0|1] "bool" MCU
 SG_ Reserved_6_12 : 11870|2@1+ (1,0) [0|0] "NA" MCU
 SG_ OBJ_Length_12 : 11872|9@1+ (0.05,0) [0.6|21] "m" MCU
 SG_ OBJ_Length_V_12 : 11881|1@1+ (1,0) [0|1] "bool" MCU
 SG_ OBJ_Length_STD_12 : 11882|10@1+ (0.01,0) [0|10] "m" MCU
 SG_ OBJ_Length_STD_V_12 : 11892|1@1+ (1,0) [0|1] "bool" MCU
 SG_ OBJ_Radar_ID_12 : 11893|8@1+ (1,0) [0|255] "counter" MCU
 SG_ Reserved_7_12 : 11901|3@1+ (1,0) [0|0] "NA" MCU
 SG_ OBJ_Height_12 : 11904|9@1+ (0.01,0) [0|2.95] "m" MCU
 SG_ OBJ_Height_V_12 : 11913|1@1+ (1,0) [0|1] "bool" MCU
 SG_ OBJ_Height_STD_12 : 11914|11@1+ (0.001,0) [0|2] "m" MCU
 SG_ OBJ_Height_STD_V_12 : 11925|1@1+ (1,0) [0|1] "bool" MCU
 SG_ Reserved_8_12 : 11926|10@1+ (1,0) [0|0] "NA" MCU
 SG_ OBJ_Abs_Long_Velocity_12 : 11936|12@1+ (0.05,-100) [-100|100] "m_per_s" MCU
 SG_ OBJ_Abs_Long_Velocity_V_12 : 11948|1@1+ (1,0) [0|1] "bool" MCU
 SG_ OBJ_Abs_Long_Velocity_STD_12 : 11949|13@1+ (0.01,0) [0|65] "m_per_s" MCU
 SG_ OBJ_Abs_Long_Vel_STD_V_12 : 11962|1@1+ (1,0) [0|1] "bool" MCU
 SG_ Reserved_9_12 : 11963|5@1+ (1,0) [0|0] "NA" MCU
 SG_ OBJ_Abs_Lat_Velocity_12 : 11968|11@1+ (0.05,-50) [-50|50] "m_per_s" MCU
 SG_ OBJ_Abs_Lat_Velocity_V_12 : 11979|1@1+ (1,0) [0|1] "bool" MCU
 SG_ OBJ_Abs_Lat_Velocity_STD_12 : 11980|13@1+ (0.01,0) [0|50] "m_per_s" MCU
 SG_ OBJ_Abs_Lat_Vel_STD_V_12 : 11993|1@1+ (1,0) [0|1] "bool" MCU
 SG_ Reserved_10_12 : 11994|6@1+ (1,0) [0|0] "NA" MCU
 SG_ OBJ_Abs_Long_Acc_12 : 12000|9@1+ (0.05,-10) [-10|10] "m_per_s2" MCU
 SG_ OBJ_Abs_Long_Acc_V_12 : 12009|1@1+ (1,0) [0|1] "bool" MCU
 SG_ OBJ_Abs_Long_Acc_STD_12 : 12010|10@1+ (0.01,0) [0|7.3] "m_per_s2" MCU
 SG_ OBJ_Abs_Long_Acc_STD_V_12 : 12020|1@1+ (1,0) [0|1] "bool" MCU
 SG_ OBJ_Abs_Lat_Acc_12 : 12021|9@1+ (0.05,-10) [-10|10] "m_per_s2" MCU
 SG_ OBJ_Abs_Lat_Acc_V_12 : 12030|1@1+ (1,0) [0|1] "bool" MCU
 SG_ Reserved_11_12 : 12031|1@1+ (1,0) [0|0] "NA" MCU
 SG_ OBJ_Abs_Lat_Acc_STD_12 : 12032|10@1+ (0.01,0) [0|7.3] "m_per_s2" MCU
 SG_ OBJ_Abs_Lat_Acc_STD_V_12 : 12042|1@1+ (1,0) [0|1] "bool" MCU
 SG_ OBJ_Abs_Acceleration_12 : 12043|9@1+ (0.05,-12.7) [-12.7|12.7] "m_per_s2" MCU
 SG_ OBJ_Abs_Acceleration_V_12 : 12052|1@1+ (1,0) [0|1] "bool" MCU
 SG_ OBJ_Abs_Acc_STD_12 : 12053|10@1+ (0.01,0) [0|7.3] "m_per_s2" MCU
 SG_ OBJ_Abs_Acc_STD_V_12 : 12063|1@1+ (1,0) [0|1] "bool" MCU
 SG_ OBJ_Inv_TTC_12 : 12064|11@1+ (0.01,-8) [-8|8] "INV(s)" MCU
 SG_ OBJ_Inv_TTC_V_12 : 12075|1@1+ (1,0) [0|1] "bool" MCU
 SG_ OBJ_Inv_TTC_STD_12 : 12076|12@1+ (0.001,0) [0|4] "INV(s)" MCU
 SG_ OBJ_Inv_TTC_STD_V_12 : 12088|1@1+ (1,0) [0|1] "bool" MCU
 SG_ Reserved_12_12 : 12089|7@1+ (1,0) [0|0] "NA" MCU
 SG_ OBJ_Relative_Long_Acc_12 : 12096|10@1+ (0.05,-20) [-20|20] "m_per_s2" MCU
 SG_ OBJ_Relative_Long_Acc_V_12 : 12106|1@1+ (1,0) [0|1] "bool" MCU
 SG_ OBJ_Relative_Long_Acc_STD_12 : 12107|10@1+ (0.01,0) [0|7.3] "m_per_s2" MCU
 SG_ OBJ_Rel_Long_Acc_STD_V_12 : 12117|1@1+ (1,0) [0|1] "bool" MCU
 SG_ Reserved_13_12 : 12118|10@1+ (1,0) [0|0] "NA" MCU
 SG_ OBJ_Relative_Long_Velocity_12 : 12128|13@1+ (0.05,-120) [-120|130] "m_per_s" MCU
 SG_ OBJ_Relative_Long_Velocity_V_12 : 12141|1@1+ (1,0) [0|1] "bool" MCU
 SG_ OBJ_Relative_Long_Vel_STD_12 : 12142|14@1+ (0.01,0) [0|130] "m_per_s" MCU
 SG_ OBJ_Rel_Long_Vel_STD_V_12 : 12156|1@1+ (1,0) [0|1] "bool" MCU
 SG_ Reserved_14_12 : 12157|3@1+ (1,0) [0|0] "NA" MCU
 SG_ OBJ_Relative_Lat_Velocity_12 : 12160|11@1+ (0.05,-50) [-50|50] "m_per_s" MCU
 SG_ OBJ_Relative_Lat_Velocity_V_12 : 12171|1@1+ (1,0) [0|1] "bool" MCU
 SG_ OBJ_Relative_Lat_Velocity_STD_12 : 12172|13@1+ (0.01,0) [0|50] "m_per_s" MCU
 SG_ OBJ_Rel_Lat_Vel_STD_V_12 : 12185|1@1+ (1,0) [0|1] "bool" MCU
 SG_ Reserved_15_12 : 12186|6@1+ (1,0) [0|0] "NA" MCU
 SG_ OBJ_Long_Distance_12 : 12192|14@1+ (0.05,-200) [-200|500] "m" MCU
 SG_ OBJ_Long_Distance_V_12 : 12206|1@1+ (1,0) [0|1] "bool" MCU
 SG_ OBJ_Long_Distance_STD_12 : 12207|15@1+ (0.01,0) [0|250] "m" MCU
 SG_ OBJ_Long_Distance_STD_V_12 : 12222|1@1+ (1,0) [0|1] "bool" MCU
 SG_ Reserved_16_12 : 12223|1@1+ (1,0) [0|0] "NA" MCU
 SG_ OBJ_Lat_Distance_12 : 12224|12@1+ (0.05,-100) [-100|100] "m" MCU
 SG_ OBJ_Lat_Distance_V_12 : 12236|1@1+ (1,0) [0|1] "bool" MCU
 SG_ OBJ_Lat_Distance_STD_12 : 12237|14@1+ (0.01,0) [0|100] "m" MCU
 SG_ OBJ_Lat_Distance_STD_V_12 : 12251|1@1+ (1,0) [0|1] "bool" MCU
 SG_ Reserved_17_12 : 12252|4@1+ (1,0) [0|0] "NA" MCU
 SG_ OBJ_Absolute_Speed_12 : 12256|12@1+ (0.05,-65) [-65|65] "m_per_s" MCU
 SG_ OBJ_Absolute_Speed_V_12 : 12268|1@1+ (1,0) [0|1] "bool" MCU
 SG_ OBJ_Absolute_Speed_STD_12 : 12269|13@1+ (0.01,0) [0|65] "m_per_s" MCU
 SG_ OBJ_Absolute_Speed_STD_V_12 : 12282|1@1+ (1,0) [0|1] "bool" MCU
 SG_ Reserved_18_12 : 12283|5@1+ (1,0) [0|0] "NA" MCU
 SG_ OBJ_Heading_12 : 12288|10@1+ (0.01,-3.14) [-3.14|3.14] "rad" MCU
 SG_ OBJ_Heading_V_12 : 12298|1@1+ (1,0) [0|1] "bool" MCU
 SG_ OBJ_Heading_STD_12 : 12299|15@1+ (0.0001,0) [0|3.14] "rad" MCU
 SG_ OBJ_Heading_STD_V_12 : 12314|1@1+ (1,0) [0|1] "bool" MCU
 SG_ Reserved_19_12 : 12315|5@1+ (1,0) [0|0] "NA" MCU
 SG_ OBJ_Angle_Rate_STD_12 : 12320|15@1+ (0.0001,0) [0|2.2318] "RPS" MCU
 SG_ OBJ_Angle_Rate_STD_V_12 : 12335|1@1+ (1,0) [0|1] "bool" MCU
 SG_ OBJ_Angle_Rate_12 : 12336|12@1+ (0.002,-2.234) [-2.234|2.2318] "RPS" MCU
 SG_ OBJ_Angle_Rate_V_12 : 12348|1@1+ (1,0) [0|1] "bool" MCU
 SG_ Reserved_20_12 : 12349|3@1+ (1,0) [0|0] "NA" MCU
 SG_ OBJ_Angle_Right_12 : 12352|14@1+ (0.0002,-1.571) [-1.571|1.571] "rad" MCU
 SG_ OBJ_Angle_Right_V_12 : 12366|1@1+ (1,0) [0|1] "bool" MCU
 SG_ OBJ_Angle_Right_STD_12 : 12367|14@1+ (0.0001,0) [0|1.571] "rad" MCU
 SG_ OBJ_Angle_Right_STD_V_12 : 12381|1@1+ (1,0) [0|1] "bool" MCU
 SG_ Reserved_21_12 : 12382|2@1+ (1,0) [0|0] "NA" MCU
 SG_ OBJ_Angle_Left_12 : 12384|14@1+ (0.0002,-1.571) [-1.571|1.571] "rad" MCU
 SG_ OBJ_Angle_Left_V_12 : 12398|1@1+ (1,0) [0|1] "bool" MCU
 SG_ OBJ_Angle_Left_STD_12 : 12399|14@1+ (0.0001,0) [0|1.571] "rad" MCU
 SG_ OBJ_Angle_Left_STD_V_12 : 12413|1@1+ (1,0) [0|1] "bool" MCU
 SG_ Reserved_22_12 : 12414|2@1+ (1,0) [0|0] "NA" MCU
 SG_ OBJ_Angle_Side_12 : 12416|14@1+ (0.0002,-1.571) [-1.571|1.571] "rad" MCU
 SG_ OBJ_Angle_Side_V_12 : 12430|1@1+ (1,0) [0|1] "bool" MCU
 SG_ OBJ_Angle_Side_STD_12 : 12431|14@1+ (0.0001,0) [0|1.571] "rad" MCU
 SG_ OBJ_Angle_Side_STD_V_12 : 12445|1@1+ (1,0) [0|1] "bool" MCU
 SG_ OBJ_Angle_Mid_V_12 : 12446|1@1+ (1,0) [0|1] "bool" MCU
 SG_ Reserved_23_12 : 12447|1@1+ (1,0) [0|0] "NA" MCU
 SG_ OBJ_Angle_Mid_12 : 12448|14@1+ (0.0002,-1.571) [-1.571|1.571] "rad" MCU
 SG_ OBJ_Angle_Mid_STD_12 : 12462|14@1+ (0.0001,0) [0|1.571] "rad" MCU
 SG_ OBJ_Angle_Mid_STD_V_12 : 12476|1@1+ (1,0) [0|1] "bool" MCU
 SG_ OBJ_Angle_Bottom_V_12 : 12477|1@1+ (1,0) [0|1] "bool" MCU
 SG_ Reserved_24_12 : 12478|2@1+ (1,0) [0|0] "NA" MCU
 SG_ OBJ_Angle_Bottom_12 : 12480|14@1+ (0.0002,-1.571) [-1.571|1.571] "rad" MCU
 SG_ OBJ_Angle_Bottom_STD_12 : 12494|14@1+ (0.0001,0) [0|1.571] "rad" MCU
 SG_ OBJ_Angle_Bottom_STD_V_12 : 12508|1@1+ (1,0) [0|1] "bool" MCU
 SG_ OBJ_Visibility_Side_V_12 : 12509|1@1+ (1,0) [0|1] "bool" MCU
 SG_ OBJ_Visibility_Side_12 : 12510|2@1+ (1,0) [0|2] "ENUM" MCU
 SG_ OBJ_Is_In_Drivable_Area_12 : 12512|1@1+ (1,0) [0|1] "bool" MCU
 SG_ OBJ_Is_In_Drivable_Area_V_12 : 12513|1@1+ (1,0) [0|1] "bool" MCU
 SG_ OBJ_Is_VeryClose_V_12 : 12514|1@1+ (1,0) [0|1] "bool" MCU
 SG_ OBJ_Is_VeryClose_12 : 12515|1@1+ (1,0) [0|1] "bool" MCU
 SG_ OBJ_Buffer_C4_12 : 12516|2@1+ (1,0) [0|2] "NA" MCU
 SG_ OBJ_Buffer_C5_12 : 12518|2@1+ (1,0) [0|2] "NA" MCU
 SG_ OBJ_Buffer_C6_12 : 12520|2@1+ (1,0) [0|2] "NA" MCU
 SG_ OBJ_Buffer_C7_12 : 12522|2@1+ (1,0) [0|2] "NA" MCU
 SG_ OBJ_OverlapAngleEgoLaneR_12 : 12524|10@1+ (0.01,-3.14) [-3.14|3.14] "rad" MCU
 SG_ OBJ_OverlapAngleEgoLaneR_V_12 : 12534|1@1+ (1,0) [0|1] "bool" MCU
 SG_ Reserved_25_12 : 12535|9@1+ (1,0) [0|0] "NA" MCU
 SG_ OBJ_OverlapAngleEgoLaneL_12 : 12544|10@1+ (0.01,-3.14) [-3.14|3.14] "rad" MCU
 SG_ OBJ_OverlapAngleEgoLaneL_V_12 : 12554|1@1+ (1,0) [0|1] "bool" MCU
 SG_ OBJ_Is_EMERGENCY_VCL_12 : 12555|1@1+ (1,0) [0|1] "bool" MCU
 SG_ OBJ_EMERGENCY_LIGHT_COLOR_12 : 12556|4@1+ (1,0) [0|15] "BITWIZE" MCU
 SG_ OBJ_EMERGENCY_V_12 : 12560|1@1+ (1,0) [0|1] "bool" MCU
 SG_ OBJ_Angle_Top_12 : 12561|14@1+ (0.0002,0) [0|3.1415] "rad" MCU
 SG_ OBJ_Angle_Top_V_12 : 12575|1@1+ (1,0) [0|1] "bool" MCU
 SG_ OBJ_Angle_Top_STD_12 : 12576|15@1+ (0.0001,0) [0|3.1415] "rad" MCU
 SG_ OBJ_Angle_Top_STD_V_12 : 12591|1@1+ (1,0) [0|1] "bool" MCU
 SG_ OBJ_Open_Door_Left_12 : 12592|1@1+ (1,0) [0|1] "bool" MCU
 SG_ OBJ_Open_Door_Right_12 : 12593|1@1+ (1,0) [0|1] "bool" MCU
 SG_ OBJ_Visible_Left_or_Right_12 : 12594|2@1+ (1,0) [0|2] "ENUM" MCU
 SG_ OBJ_Visible_Left_or_Right_V_12 : 12596|1@1+ (1,0) [0|1] "bool" MCU
 SG_ OBJ_2W_Is_Motorbike_Probability_12 : 12597|8@1+ (0.01,0) [0|1] "NA" MCU
 SG_ Reserved_26_12 : 12605|3@1+ (1,0) [0|0] "NA" MCU
 SG_ OBJ_2W_Is_Bicycle_Probability_12 : 12608|8@1+ (0.01,0) [0|1] "NA" MCU
 SG_ Reserved_27_12 : 12616|24@1+ (1,0) [0|0] "NA" MCU
 SG_ OBJ_CRC_13 : 12640|32@1+ (1,0) [0|4294967295] "NA" MCU
 SG_ OBJ_ID_13 : 12672|8@1+ (1,0) [0|255] "counter" MCU
 SG_ OBJ_Existence_Probability_13 : 12680|8@1+ (0.01,0) [0|1] "NA" MCU
 SG_ OBJ_Fusion_Source_13 : 12688|16@1+ (1,0) [0|65535] "BITWIZE" MCU
 SG_ OBJ_Triggered_SDM_13 : 12704|2@1+ (1,0) [0|2] "ENUM" MCU
 SG_ OBJ_Motion_Category_13 : 12706|4@1+ (1,0) [0|13] "ENUM" MCU
 SG_ OBJ_Moving_IN_Probability_13 : 12710|7@1+ (0.01,0) [0|1] "NA" MCU
 SG_ OBJ_Object_Age_13 : 12717|11@1+ (1,0) [0|2047] "frames" MCU
 SG_ OBJ_Measuring_Status_13 : 12728|3@1+ (1,0) [0|7] "BITWIZE" MCU
 SG_ OBJ_Object_Class_13 : 12731|4@1+ (1,0) [0|9] "ENUM" MCU
 SG_ Reserved_4_13 : 12735|1@1+ (1,0) [0|0] "NA" MCU
 SG_ OBJ_Class_Probability_13 : 12736|7@1+ (0.01,0) [0|1] "NA" MCU
 SG_ OBJ_Car_Probability_13 : 12743|7@1+ (0.01,0) [0|1] "NA" MCU
 SG_ OBJ_Truck_Probability_13 : 12750|7@1+ (0.01,0) [0|1] "NA" MCU
 SG_ OBJ_Bike_Probability_13 : 12757|7@1+ (0.01,0) [0|1] "NA" MCU
 SG_ OBJ_Camera_Source_13 : 12764|4@1+ (1,0) [0|15] "ENUM" MCU
 SG_ OBJ_Motion_Status_13 : 12768|3@1+ (1,0) [0|5] "ENUM" MCU
 SG_ OBJ_Motion_Orientation_13 : 12771|4@1+ (1,0) [0|13] "ENUM" MCU
 SG_ OBJ_Has_Cut_Lane_13 : 12775|1@1+ (1,0) [0|1] "bool" MCU
 SG_ OBJ_Has_Cut_Path_13 : 12776|1@1+ (1,0) [0|1] "bool" MCU
 SG_ OBJ_Brake_Light_Validity_13 : 12777|1@1+ (1,0) [0|1] "bool" MCU
 SG_ OBJ_Brake_Light_13 : 12778|1@1+ (1,0) [0|1] "bool" MCU
 SG_ OBJ_Turn_Indicator_Right_13 : 12779|1@1+ (1,0) [0|1] "bool" MCU
 SG_ OBJ_Turn_Indicator_Left_13 : 12780|1@1+ (1,0) [0|1] "bool" MCU
 SG_ OBJ_Turn_Indicator_Validity_13 : 12781|1@1+ (1,0) [0|1] "bool" MCU
 SG_ OBJ_Right_Out_Of_Image_13 : 12782|1@1+ (1,0) [0|1] "bool" MCU
 SG_ OBJ_Left_Out_Of_Image_13 : 12783|1@1+ (1,0) [0|1] "bool" MCU
 SG_ OBJ_Right_Out_Of_Image_V_13 : 12784|1@1+ (1,0) [0|1] "bool" MCU
 SG_ OBJ_Left_Out_Of_Image_V_13 : 12785|1@1+ (1,0) [0|1] "bool" MCU
 SG_ OBJ_Top_Out_Of_Image_13 : 12786|1@1+ (1,0) [0|1] "bool" MCU
 SG_ OBJ_Bottom_Out_Of_Image_13 : 12787|1@1+ (1,0) [0|1] "bool" MCU
 SG_ OBJ_Top_Out_Of_Image_V_13 : 12788|1@1+ (1,0) [0|1] "bool" MCU
 SG_ OBJ_Bottom_Out_Of_Image_V_13 : 12789|1@1+ (1,0) [0|1] "bool" MCU
 SG_ OBJ_Lane_Assignment_13 : 12790|3@1+ (1,0) [0|5] "ENUM" MCU
 SG_ OBJ_Lane_Assignment_V_13 : 12793|1@1+ (1,0) [0|1] "bool" MCU
 SG_ Reserved_5_13 : 12794|6@1+ (1,0) [0|0] "NA" MCU
 SG_ OBJ_Age_Seconds_13 : 12800|7@1+ (1,0) [0|100] "s" MCU
 SG_ OBJ_Age_Seconds_V_13 : 12807|1@1+ (1,0) [0|1] "bool" MCU
 SG_ OBJ_Width_13 : 12808|9@1+ (0.01,0) [0.4|2.95] "m" MCU
 SG_ OBJ_Width_V_13 : 12817|1@1+ (1,0) [0|1] "bool" MCU
 SG_ OBJ_Width_STD_13 : 12818|11@1+ (0.001,0) [0|2] "m" MCU
 SG_ OBJ_Width_STD_V_13 : 12829|1@1+ (1,0) [0|1] "bool" MCU
 SG_ Reserved_6_13 : 12830|2@1+ (1,0) [0|0] "NA" MCU
 SG_ OBJ_Length_13 : 12832|9@1+ (0.05,0) [0.6|21] "m" MCU
 SG_ OBJ_Length_V_13 : 12841|1@1+ (1,0) [0|1] "bool" MCU
 SG_ OBJ_Length_STD_13 : 12842|10@1+ (0.01,0) [0|10] "m" MCU
 SG_ OBJ_Length_STD_V_13 : 12852|1@1+ (1,0) [0|1] "bool" MCU
 SG_ OBJ_Radar_ID_13 : 12853|8@1+ (1,0) [0|255] "counter" MCU
 SG_ Reserved_7_13 : 12861|3@1+ (1,0) [0|0] "NA" MCU
 SG_ OBJ_Height_13 : 12864|9@1+ (0.01,0) [0|2.95] "m" MCU
 SG_ OBJ_Height_V_13 : 12873|1@1+ (1,0) [0|1] "bool" MCU
 SG_ OBJ_Height_STD_13 : 12874|11@1+ (0.001,0) [0|2] "m" MCU
 SG_ OBJ_Height_STD_V_13 : 12885|1@1+ (1,0) [0|1] "bool" MCU
 SG_ Reserved_8_13 : 12886|10@1+ (1,0) [0|0] "NA" MCU
 SG_ OBJ_Abs_Long_Velocity_13 : 12896|12@1+ (0.05,-100) [-100|100] "m_per_s" MCU
 SG_ OBJ_Abs_Long_Velocity_V_13 : 12908|1@1+ (1,0) [0|1] "bool" MCU
 SG_ OBJ_Abs_Long_Velocity_STD_13 : 12909|13@1+ (0.01,0) [0|65] "m_per_s" MCU
 SG_ OBJ_Abs_Long_Vel_STD_V_13 : 12922|1@1+ (1,0) [0|1] "bool" MCU
 SG_ Reserved_9_13 : 12923|5@1+ (1,0) [0|0] "NA" MCU
 SG_ OBJ_Abs_Lat_Velocity_13 : 12928|11@1+ (0.05,-50) [-50|50] "m_per_s" MCU
 SG_ OBJ_Abs_Lat_Velocity_V_13 : 12939|1@1+ (1,0) [0|1] "bool" MCU
 SG_ OBJ_Abs_Lat_Velocity_STD_13 : 12940|13@1+ (0.01,0) [0|50] "m_per_s" MCU
 SG_ OBJ_Abs_Lat_Vel_STD_V_13 : 12953|1@1+ (1,0) [0|1] "bool" MCU
 SG_ Reserved_10_13 : 12954|6@1+ (1,0) [0|0] "NA" MCU
 SG_ OBJ_Abs_Long_Acc_13 : 12960|9@1+ (0.05,-10) [-10|10] "m_per_s2" MCU
 SG_ OBJ_Abs_Long_Acc_V_13 : 12969|1@1+ (1,0) [0|1] "bool" MCU
 SG_ OBJ_Abs_Long_Acc_STD_13 : 12970|10@1+ (0.01,0) [0|7.3] "m_per_s2" MCU
 SG_ OBJ_Abs_Long_Acc_STD_V_13 : 12980|1@1+ (1,0) [0|1] "bool" MCU
 SG_ OBJ_Abs_Lat_Acc_13 : 12981|9@1+ (0.05,-10) [-10|10] "m_per_s2" MCU
 SG_ OBJ_Abs_Lat_Acc_V_13 : 12990|1@1+ (1,0) [0|1] "bool" MCU
 SG_ Reserved_11_13 : 12991|1@1+ (1,0) [0|0] "NA" MCU
 SG_ OBJ_Abs_Lat_Acc_STD_13 : 12992|10@1+ (0.01,0) [0|7.3] "m_per_s2" MCU
 SG_ OBJ_Abs_Lat_Acc_STD_V_13 : 13002|1@1+ (1,0) [0|1] "bool" MCU
 SG_ OBJ_Abs_Acceleration_13 : 13003|9@1+ (0.05,-12.7) [-12.7|12.7] "m_per_s2" MCU
 SG_ OBJ_Abs_Acceleration_V_13 : 13012|1@1+ (1,0) [0|1] "bool" MCU
 SG_ OBJ_Abs_Acc_STD_13 : 13013|10@1+ (0.01,0) [0|7.3] "m_per_s2" MCU
 SG_ OBJ_Abs_Acc_STD_V_13 : 13023|1@1+ (1,0) [0|1] "bool" MCU
 SG_ OBJ_Inv_TTC_13 : 13024|11@1+ (0.01,-8) [-8|8] "INV(s)" MCU
 SG_ OBJ_Inv_TTC_V_13 : 13035|1@1+ (1,0) [0|1] "bool" MCU
 SG_ OBJ_Inv_TTC_STD_13 : 13036|12@1+ (0.001,0) [0|4] "INV(s)" MCU
 SG_ OBJ_Inv_TTC_STD_V_13 : 13048|1@1+ (1,0) [0|1] "bool" MCU
 SG_ Reserved_12_13 : 13049|7@1+ (1,0) [0|0] "NA" MCU
 SG_ OBJ_Relative_Long_Acc_13 : 13056|10@1+ (0.05,-20) [-20|20] "m_per_s2" MCU
 SG_ OBJ_Relative_Long_Acc_V_13 : 13066|1@1+ (1,0) [0|1] "bool" MCU
 SG_ OBJ_Relative_Long_Acc_STD_13 : 13067|10@1+ (0.01,0) [0|7.3] "m_per_s2" MCU
 SG_ OBJ_Rel_Long_Acc_STD_V_13 : 13077|1@1+ (1,0) [0|1] "bool" MCU
 SG_ Reserved_13_13 : 13078|10@1+ (1,0) [0|0] "NA" MCU
 SG_ OBJ_Relative_Long_Velocity_13 : 13088|13@1+ (0.05,-120) [-120|130] "m_per_s" MCU
 SG_ OBJ_Relative_Long_Velocity_V_13 : 13101|1@1+ (1,0) [0|1] "bool" MCU
 SG_ OBJ_Relative_Long_Vel_STD_13 : 13102|14@1+ (0.01,0) [0|130] "m_per_s" MCU
 SG_ OBJ_Rel_Long_Vel_STD_V_13 : 13116|1@1+ (1,0) [0|1] "bool" MCU
 SG_ Reserved_14_13 : 13117|3@1+ (1,0) [0|0] "NA" MCU
 SG_ OBJ_Relative_Lat_Velocity_13 : 13120|11@1+ (0.05,-50) [-50|50] "m_per_s" MCU
 SG_ OBJ_Relative_Lat_Velocity_V_13 : 13131|1@1+ (1,0) [0|1] "bool" MCU
 SG_ OBJ_Relative_Lat_Velocity_STD_13 : 13132|13@1+ (0.01,0) [0|50] "m_per_s" MCU
 SG_ OBJ_Rel_Lat_Vel_STD_V_13 : 13145|1@1+ (1,0) [0|1] "bool" MCU
 SG_ Reserved_15_13 : 13146|6@1+ (1,0) [0|0] "NA" MCU
 SG_ OBJ_Long_Distance_13 : 13152|14@1+ (0.05,-200) [-200|500] "m" MCU
 SG_ OBJ_Long_Distance_V_13 : 13166|1@1+ (1,0) [0|1] "bool" MCU
 SG_ OBJ_Long_Distance_STD_13 : 13167|15@1+ (0.01,0) [0|250] "m" MCU
 SG_ OBJ_Long_Distance_STD_V_13 : 13182|1@1+ (1,0) [0|1] "bool" MCU
 SG_ Reserved_16_13 : 13183|1@1+ (1,0) [0|0] "NA" MCU
 SG_ OBJ_Lat_Distance_13 : 13184|12@1+ (0.05,-100) [-100|100] "m" MCU
 SG_ OBJ_Lat_Distance_V_13 : 13196|1@1+ (1,0) [0|1] "bool" MCU
 SG_ OBJ_Lat_Distance_STD_13 : 13197|14@1+ (0.01,0) [0|100] "m" MCU
 SG_ OBJ_Lat_Distance_STD_V_13 : 13211|1@1+ (1,0) [0|1] "bool" MCU
 SG_ Reserved_17_13 : 13212|4@1+ (1,0) [0|0] "NA" MCU
 SG_ OBJ_Absolute_Speed_13 : 13216|12@1+ (0.05,-65) [-65|65] "m_per_s" MCU
 SG_ OBJ_Absolute_Speed_V_13 : 13228|1@1+ (1,0) [0|1] "bool" MCU
 SG_ OBJ_Absolute_Speed_STD_13 : 13229|13@1+ (0.01,0) [0|65] "m_per_s" MCU
 SG_ OBJ_Absolute_Speed_STD_V_13 : 13242|1@1+ (1,0) [0|1] "bool" MCU
 SG_ Reserved_18_13 : 13243|5@1+ (1,0) [0|0] "NA" MCU
 SG_ OBJ_Heading_13 : 13248|10@1+ (0.01,-3.14) [-3.14|3.14] "rad" MCU
 SG_ OBJ_Heading_V_13 : 13258|1@1+ (1,0) [0|1] "bool" MCU
 SG_ OBJ_Heading_STD_13 : 13259|15@1+ (0.0001,0) [0|3.14] "rad" MCU
 SG_ OBJ_Heading_STD_V_13 : 13274|1@1+ (1,0) [0|1] "bool" MCU
 SG_ Reserved_19_13 : 13275|5@1+ (1,0) [0|0] "NA" MCU
 SG_ OBJ_Angle_Rate_STD_13 : 13280|15@1+ (0.0001,0) [0|2.2318] "RPS" MCU
 SG_ OBJ_Angle_Rate_STD_V_13 : 13295|1@1+ (1,0) [0|1] "bool" MCU
 SG_ OBJ_Angle_Rate_13 : 13296|12@1+ (0.002,-2.234) [-2.234|2.2318] "RPS" MCU
 SG_ OBJ_Angle_Rate_V_13 : 13308|1@1+ (1,0) [0|1] "bool" MCU
 SG_ Reserved_20_13 : 13309|3@1+ (1,0) [0|0] "NA" MCU
 SG_ OBJ_Angle_Right_13 : 13312|14@1+ (0.0002,-1.571) [-1.571|1.571] "rad" MCU
 SG_ OBJ_Angle_Right_V_13 : 13326|1@1+ (1,0) [0|1] "bool" MCU
 SG_ OBJ_Angle_Right_STD_13 : 13327|14@1+ (0.0001,0) [0|1.571] "rad" MCU
 SG_ OBJ_Angle_Right_STD_V_13 : 13341|1@1+ (1,0) [0|1] "bool" MCU
 SG_ Reserved_21_13 : 13342|2@1+ (1,0) [0|0] "NA" MCU
 SG_ OBJ_Angle_Left_13 : 13344|14@1+ (0.0002,-1.571) [-1.571|1.571] "rad" MCU
 SG_ OBJ_Angle_Left_V_13 : 13358|1@1+ (1,0) [0|1] "bool" MCU
 SG_ OBJ_Angle_Left_STD_13 : 13359|14@1+ (0.0001,0) [0|1.571] "rad" MCU
 SG_ OBJ_Angle_Left_STD_V_13 : 13373|1@1+ (1,0) [0|1] "bool" MCU
 SG_ Reserved_22_13 : 13374|2@1+ (1,0) [0|0] "NA" MCU
 SG_ OBJ_Angle_Side_13 : 13376|14@1+ (0.0002,-1.571) [-1.571|1.571] "rad" MCU
 SG_ OBJ_Angle_Side_V_13 : 13390|1@1+ (1,0) [0|1] "bool" MCU
 SG_ OBJ_Angle_Side_STD_13 : 13391|14@1+ (0.0001,0) [0|1.571] "rad" MCU
 SG_ OBJ_Angle_Side_STD_V_13 : 13405|1@1+ (1,0) [0|1] "bool" MCU
 SG_ OBJ_Angle_Mid_V_13 : 13406|1@1+ (1,0) [0|1] "bool" MCU
 SG_ Reserved_23_13 : 13407|1@1+ (1,0) [0|0] "NA" MCU
 SG_ OBJ_Angle_Mid_13 : 13408|14@1+ (0.0002,-1.571) [-1.571|1.571] "rad" MCU
 SG_ OBJ_Angle_Mid_STD_13 : 13422|14@1+ (0.0001,0) [0|1.571] "rad" MCU
 SG_ OBJ_Angle_Mid_STD_V_13 : 13436|1@1+ (1,0) [0|1] "bool" MCU
 SG_ OBJ_Angle_Bottom_V_13 : 13437|1@1+ (1,0) [0|1] "bool" MCU
 SG_ Reserved_24_13 : 13438|2@1+ (1,0) [0|0] "NA" MCU
 SG_ OBJ_Angle_Bottom_13 : 13440|14@1+ (0.0002,-1.571) [-1.571|1.571] "rad" MCU
 SG_ OBJ_Angle_Bottom_STD_13 : 13454|14@1+ (0.0001,0) [0|1.571] "rad" MCU
 SG_ OBJ_Angle_Bottom_STD_V_13 : 13468|1@1+ (1,0) [0|1] "bool" MCU
 SG_ OBJ_Visibility_Side_V_13 : 13469|1@1+ (1,0) [0|1] "bool" MCU
 SG_ OBJ_Visibility_Side_13 : 13470|2@1+ (1,0) [0|2] "ENUM" MCU
 SG_ OBJ_Is_In_Drivable_Area_13 : 13472|1@1+ (1,0) [0|1] "bool" MCU
 SG_ OBJ_Is_In_Drivable_Area_V_13 : 13473|1@1+ (1,0) [0|1] "bool" MCU
 SG_ OBJ_Is_VeryClose_V_13 : 13474|1@1+ (1,0) [0|1] "bool" MCU
 SG_ OBJ_Is_VeryClose_13 : 13475|1@1+ (1,0) [0|1] "bool" MCU
 SG_ OBJ_Buffer_C4_13 : 13476|2@1+ (1,0) [0|2] "NA" MCU
 SG_ OBJ_Buffer_C5_13 : 13478|2@1+ (1,0) [0|2] "NA" MCU
 SG_ OBJ_Buffer_C6_13 : 13480|2@1+ (1,0) [0|2] "NA" MCU
 SG_ OBJ_Buffer_C7_13 : 13482|2@1+ (1,0) [0|2] "NA" MCU
 SG_ OBJ_OverlapAngleEgoLaneR_13 : 13484|10@1+ (0.01,-3.14) [-3.14|3.14] "rad" MCU
 SG_ OBJ_OverlapAngleEgoLaneR_V_13 : 13494|1@1+ (1,0) [0|1] "bool" MCU
 SG_ Reserved_25_13 : 13495|9@1+ (1,0) [0|0] "NA" MCU
 SG_ OBJ_OverlapAngleEgoLaneL_13 : 13504|10@1+ (0.01,-3.14) [-3.14|3.14] "rad" MCU
 SG_ OBJ_OverlapAngleEgoLaneL_V_13 : 13514|1@1+ (1,0) [0|1] "bool" MCU
 SG_ OBJ_Is_EMERGENCY_VCL_13 : 13515|1@1+ (1,0) [0|1] "bool" MCU
 SG_ OBJ_EMERGENCY_LIGHT_COLOR_13 : 13516|4@1+ (1,0) [0|15] "BITWIZE" MCU
 SG_ OBJ_EMERGENCY_V_13 : 13520|1@1+ (1,0) [0|1] "bool" MCU
 SG_ OBJ_Angle_Top_13 : 13521|14@1+ (0.0002,0) [0|3.1415] "rad" MCU
 SG_ OBJ_Angle_Top_V_13 : 13535|1@1+ (1,0) [0|1] "bool" MCU
 SG_ OBJ_Angle_Top_STD_13 : 13536|15@1+ (0.0001,0) [0|3.1415] "rad" MCU
 SG_ OBJ_Angle_Top_STD_V_13 : 13551|1@1+ (1,0) [0|1] "bool" MCU
 SG_ OBJ_Open_Door_Left_13 : 13552|1@1+ (1,0) [0|1] "bool" MCU
 SG_ OBJ_Open_Door_Right_13 : 13553|1@1+ (1,0) [0|1] "bool" MCU
 SG_ OBJ_Visible_Left_or_Right_13 : 13554|2@1+ (1,0) [0|2] "ENUM" MCU
 SG_ OBJ_Visible_Left_or_Right_V_13 : 13556|1@1+ (1,0) [0|1] "bool" MCU
 SG_ OBJ_2W_Is_Motorbike_Probability_13 : 13557|8@1+ (0.01,0) [0|1] "NA" MCU
 SG_ Reserved_26_13 : 13565|3@1+ (1,0) [0|0] "NA" MCU
 SG_ OBJ_2W_Is_Bicycle_Probability_13 : 13568|8@1+ (0.01,0) [0|1] "NA" MCU
 SG_ Reserved_27_13 : 13576|24@1+ (1,0) [0|0] "NA" MCU
 SG_ OBJ_CRC_14 : 13600|32@1+ (1,0) [0|4294967295] "NA" MCU
 SG_ OBJ_ID_14 : 13632|8@1+ (1,0) [0|255] "counter" MCU
 SG_ OBJ_Existence_Probability_14 : 13640|8@1+ (0.01,0) [0|1] "NA" MCU
 SG_ OBJ_Fusion_Source_14 : 13648|16@1+ (1,0) [0|65535] "BITWIZE" MCU
 SG_ OBJ_Triggered_SDM_14 : 13664|2@1+ (1,0) [0|2] "ENUM" MCU
 SG_ OBJ_Motion_Category_14 : 13666|4@1+ (1,0) [0|13] "ENUM" MCU
 SG_ OBJ_Moving_IN_Probability_14 : 13670|7@1+ (0.01,0) [0|1] "NA" MCU
 SG_ OBJ_Object_Age_14 : 13677|11@1+ (1,0) [0|2047] "frames" MCU
 SG_ OBJ_Measuring_Status_14 : 13688|3@1+ (1,0) [0|7] "BITWIZE" MCU
 SG_ OBJ_Object_Class_14 : 13691|4@1+ (1,0) [0|9] "ENUM" MCU
 SG_ Reserved_4_14 : 13695|1@1+ (1,0) [0|0] "NA" MCU
 SG_ OBJ_Class_Probability_14 : 13696|7@1+ (0.01,0) [0|1] "NA" MCU
 SG_ OBJ_Car_Probability_14 : 13703|7@1+ (0.01,0) [0|1] "NA" MCU
 SG_ OBJ_Truck_Probability_14 : 13710|7@1+ (0.01,0) [0|1] "NA" MCU
 SG_ OBJ_Bike_Probability_14 : 13717|7@1+ (0.01,0) [0|1] "NA" MCU
 SG_ OBJ_Camera_Source_14 : 13724|4@1+ (1,0) [0|15] "ENUM" MCU
 SG_ OBJ_Motion_Status_14 : 13728|3@1+ (1,0) [0|5] "ENUM" MCU
 SG_ OBJ_Motion_Orientation_14 : 13731|4@1+ (1,0) [0|13] "ENUM" MCU
 SG_ OBJ_Has_Cut_Lane_14 : 13735|1@1+ (1,0) [0|1] "bool" MCU
 SG_ OBJ_Has_Cut_Path_14 : 13736|1@1+ (1,0) [0|1] "bool" MCU
 SG_ OBJ_Brake_Light_Validity_14 : 13737|1@1+ (1,0) [0|1] "bool" MCU
 SG_ OBJ_Brake_Light_14 : 13738|1@1+ (1,0) [0|1] "bool" MCU
 SG_ OBJ_Turn_Indicator_Right_14 : 13739|1@1+ (1,0) [0|1] "bool" MCU
 SG_ OBJ_Turn_Indicator_Left_14 : 13740|1@1+ (1,0) [0|1] "bool" MCU
 SG_ OBJ_Turn_Indicator_Validity_14 : 13741|1@1+ (1,0) [0|1] "bool" MCU
 SG_ OBJ_Right_Out_Of_Image_14 : 13742|1@1+ (1,0) [0|1] "bool" MCU
 SG_ OBJ_Left_Out_Of_Image_14 : 13743|1@1+ (1,0) [0|1] "bool" MCU
 SG_ OBJ_Right_Out_Of_Image_V_14 : 13744|1@1+ (1,0) [0|1] "bool" MCU
 SG_ OBJ_Left_Out_Of_Image_V_14 : 13745|1@1+ (1,0) [0|1] "bool" MCU
 SG_ OBJ_Top_Out_Of_Image_14 : 13746|1@1+ (1,0) [0|1] "bool" MCU
 SG_ OBJ_Bottom_Out_Of_Image_14 : 13747|1@1+ (1,0) [0|1] "bool" MCU
 SG_ OBJ_Top_Out_Of_Image_V_14 : 13748|1@1+ (1,0) [0|1] "bool" MCU
 SG_ OBJ_Bottom_Out_Of_Image_V_14 : 13749|1@1+ (1,0) [0|1] "bool" MCU
 SG_ OBJ_Lane_Assignment_14 : 13750|3@1+ (1,0) [0|5] "ENUM" MCU
 SG_ OBJ_Lane_Assignment_V_14 : 13753|1@1+ (1,0) [0|1] "bool" MCU
 SG_ Reserved_5_14 : 13754|6@1+ (1,0) [0|0] "NA" MCU
 SG_ OBJ_Age_Seconds_14 : 13760|7@1+ (1,0) [0|100] "s" MCU
 SG_ OBJ_Age_Seconds_V_14 : 13767|1@1+ (1,0) [0|1] "bool" MCU
 SG_ OBJ_Width_14 : 13768|9@1+ (0.01,0) [0.4|2.95] "m" MCU
 SG_ OBJ_Width_V_14 : 13777|1@1+ (1,0) [0|1] "bool" MCU
 SG_ OBJ_Width_STD_14 : 13778|11@1+ (0.001,0) [0|2] "m" MCU
 SG_ OBJ_Width_STD_V_14 : 13789|1@1+ (1,0) [0|1] "bool" MCU
 SG_ Reserved_6_14 : 13790|2@1+ (1,0) [0|0] "NA" MCU
 SG_ OBJ_Length_14 : 13792|9@1+ (0.05,0) [0.6|21] "m" MCU
 SG_ OBJ_Length_V_14 : 13801|1@1+ (1,0) [0|1] "bool" MCU
 SG_ OBJ_Length_STD_14 : 13802|10@1+ (0.01,0) [0|10] "m" MCU
 SG_ OBJ_Length_STD_V_14 : 13812|1@1+ (1,0) [0|1] "bool" MCU
 SG_ OBJ_Radar_ID_14 : 13813|8@1+ (1,0) [0|255] "counter" MCU
 SG_ Reserved_7_14 : 13821|3@1+ (1,0) [0|0] "NA" MCU
 SG_ OBJ_Height_14 : 13824|9@1+ (0.01,0) [0|2.95] "m" MCU
 SG_ OBJ_Height_V_14 : 13833|1@1+ (1,0) [0|1] "bool" MCU
 SG_ OBJ_Height_STD_14 : 13834|11@1+ (0.001,0) [0|2] "m" MCU
 SG_ OBJ_Height_STD_V_14 : 13845|1@1+ (1,0) [0|1] "bool" MCU
 SG_ Reserved_8_14 : 13846|10@1+ (1,0) [0|0] "NA" MCU
 SG_ OBJ_Abs_Long_Velocity_14 : 13856|12@1+ (0.05,-100) [-100|100] "m_per_s" MCU
 SG_ OBJ_Abs_Long_Velocity_V_14 : 13868|1@1+ (1,0) [0|1] "bool" MCU
 SG_ OBJ_Abs_Long_Velocity_STD_14 : 13869|13@1+ (0.01,0) [0|65] "m_per_s" MCU
 SG_ OBJ_Abs_Long_Vel_STD_V_14 : 13882|1@1+ (1,0) [0|1] "bool" MCU
 SG_ Reserved_9_14 : 13883|5@1+ (1,0) [0|0] "NA" MCU
 SG_ OBJ_Abs_Lat_Velocity_14 : 13888|11@1+ (0.05,-50) [-50|50] "m_per_s" MCU
 SG_ OBJ_Abs_Lat_Velocity_V_14 : 13899|1@1+ (1,0) [0|1] "bool" MCU
 SG_ OBJ_Abs_Lat_Velocity_STD_14 : 13900|13@1+ (0.01,0) [0|50] "m_per_s" MCU
 SG_ OBJ_Abs_Lat_Vel_STD_V_14 : 13913|1@1+ (1,0) [0|1] "bool" MCU
 SG_ Reserved_10_14 : 13914|6@1+ (1,0) [0|0] "NA" MCU
 SG_ OBJ_Abs_Long_Acc_14 : 13920|9@1+ (0.05,-10) [-10|10] "m_per_s2" MCU
 SG_ OBJ_Abs_Long_Acc_V_14 : 13929|1@1+ (1,0) [0|1] "bool" MCU
 SG_ OBJ_Abs_Long_Acc_STD_14 : 13930|10@1+ (0.01,0) [0|7.3] "m_per_s2" MCU
 SG_ OBJ_Abs_Long_Acc_STD_V_14 : 13940|1@1+ (1,0) [0|1] "bool" MCU
 SG_ OBJ_Abs_Lat_Acc_14 : 13941|9@1+ (0.05,-10) [-10|10] "m_per_s2" MCU
 SG_ OBJ_Abs_Lat_Acc_V_14 : 13950|1@1+ (1,0) [0|1] "bool" MCU
 SG_ Reserved_11_14 : 13951|1@1+ (1,0) [0|0] "NA" MCU
 SG_ OBJ_Abs_Lat_Acc_STD_14 : 13952|10@1+ (0.01,0) [0|7.3] "m_per_s2" MCU
 SG_ OBJ_Abs_Lat_Acc_STD_V_14 : 13962|1@1+ (1,0) [0|1] "bool" MCU
 SG_ OBJ_Abs_Acceleration_14 : 13963|9@1+ (0.05,-12.7) [-12.7|12.7] "m_per_s2" MCU
 SG_ OBJ_Abs_Acceleration_V_14 : 13972|1@1+ (1,0) [0|1] "bool" MCU
 SG_ OBJ_Abs_Acc_STD_14 : 13973|10@1+ (0.01,0) [0|7.3] "m_per_s2" MCU
 SG_ OBJ_Abs_Acc_STD_V_14 : 13983|1@1+ (1,0) [0|1] "bool" MCU
 SG_ OBJ_Inv_TTC_14 : 13984|11@1+ (0.01,-8) [-8|8] "INV(s)" MCU
 SG_ OBJ_Inv_TTC_V_14 : 13995|1@1+ (1,0) [0|1] "bool" MCU
 SG_ OBJ_Inv_TTC_STD_14 : 13996|12@1+ (0.001,0) [0|4] "INV(s)" MCU
 SG_ OBJ_Inv_TTC_STD_V_14 : 14008|1@1+ (1,0) [0|1] "bool" MCU
 SG_ Reserved_12_14 : 14009|7@1+ (1,0) [0|0] "NA" MCU
 SG_ OBJ_Relative_Long_Acc_14 : 14016|10@1+ (0.05,-20) [-20|20] "m_per_s2" MCU
 SG_ OBJ_Relative_Long_Acc_V_14 : 14026|1@1+ (1,0) [0|1] "bool" MCU
 SG_ OBJ_Relative_Long_Acc_STD_14 : 14027|10@1+ (0.01,0) [0|7.3] "m_per_s2" MCU
 SG_ OBJ_Rel_Long_Acc_STD_V_14 : 14037|1@1+ (1,0) [0|1] "bool" MCU
 SG_ Reserved_13_14 : 14038|10@1+ (1,0) [0|0] "NA" MCU
 SG_ OBJ_Relative_Long_Velocity_14 : 14048|13@1+ (0.05,-120) [-120|130] "m_per_s" MCU
 SG_ OBJ_Relative_Long_Velocity_V_14 : 14061|1@1+ (1,0) [0|1] "bool" MCU
 SG_ OBJ_Relative_Long_Vel_STD_14 : 14062|14@1+ (0.01,0) [0|130] "m_per_s" MCU
 SG_ OBJ_Rel_Long_Vel_STD_V_14 : 14076|1@1+ (1,0) [0|1] "bool" MCU
 SG_ Reserved_14_14 : 14077|3@1+ (1,0) [0|0] "NA" MCU
 SG_ OBJ_Relative_Lat_Velocity_14 : 14080|11@1+ (0.05,-50) [-50|50] "m_per_s" MCU
 SG_ OBJ_Relative_Lat_Velocity_V_14 : 14091|1@1+ (1,0) [0|1] "bool" MCU
 SG_ OBJ_Relative_Lat_Velocity_STD_14 : 14092|13@1+ (0.01,0) [0|50] "m_per_s" MCU
 SG_ OBJ_Rel_Lat_Vel_STD_V_14 : 14105|1@1+ (1,0) [0|1] "bool" MCU
 SG_ Reserved_15_14 : 14106|6@1+ (1,0) [0|0] "NA" MCU
 SG_ OBJ_Long_Distance_14 : 14112|14@1+ (0.05,-200) [-200|500] "m" MCU
 SG_ OBJ_Long_Distance_V_14 : 14126|1@1+ (1,0) [0|1] "bool" MCU
 SG_ OBJ_Long_Distance_STD_14 : 14127|15@1+ (0.01,0) [0|250] "m" MCU
 SG_ OBJ_Long_Distance_STD_V_14 : 14142|1@1+ (1,0) [0|1] "bool" MCU
 SG_ Reserved_16_14 : 14143|1@1+ (1,0) [0|0] "NA" MCU
 SG_ OBJ_Lat_Distance_14 : 14144|12@1+ (0.05,-100) [-100|100] "m" MCU
 SG_ OBJ_Lat_Distance_V_14 : 14156|1@1+ (1,0) [0|1] "bool" MCU
 SG_ OBJ_Lat_Distance_STD_14 : 14157|14@1+ (0.01,0) [0|100] "m" MCU
 SG_ OBJ_Lat_Distance_STD_V_14 : 14171|1@1+ (1,0) [0|1] "bool" MCU
 SG_ Reserved_17_14 : 14172|4@1+ (1,0) [0|0] "NA" MCU
 SG_ OBJ_Absolute_Speed_14 : 14176|12@1+ (0.05,-65) [-65|65] "m_per_s" MCU
 SG_ OBJ_Absolute_Speed_V_14 : 14188|1@1+ (1,0) [0|1] "bool" MCU
 SG_ OBJ_Absolute_Speed_STD_14 : 14189|13@1+ (0.01,0) [0|65] "m_per_s" MCU
 SG_ OBJ_Absolute_Speed_STD_V_14 : 14202|1@1+ (1,0) [0|1] "bool" MCU
 SG_ Reserved_18_14 : 14203|5@1+ (1,0) [0|0] "NA" MCU
 SG_ OBJ_Heading_14 : 14208|10@1+ (0.01,-3.14) [-3.14|3.14] "rad" MCU
 SG_ OBJ_Heading_V_14 : 14218|1@1+ (1,0) [0|1] "bool" MCU
 SG_ OBJ_Heading_STD_14 : 14219|15@1+ (0.0001,0) [0|3.14] "rad" MCU
 SG_ OBJ_Heading_STD_V_14 : 14234|1@1+ (1,0) [0|1] "bool" MCU
 SG_ Reserved_19_14 : 14235|5@1+ (1,0) [0|0] "NA" MCU
 SG_ OBJ_Angle_Rate_STD_14 : 14240|15@1+ (0.0001,0) [0|2.2318] "RPS" MCU
 SG_ OBJ_Angle_Rate_STD_V_14 : 14255|1@1+ (1,0) [0|1] "bool" MCU
 SG_ OBJ_Angle_Rate_14 : 14256|12@1+ (0.002,-2.234) [-2.234|2.2318] "RPS" MCU
 SG_ OBJ_Angle_Rate_V_14 : 14268|1@1+ (1,0) [0|1] "bool" MCU
 SG_ Reserved_20_14 : 14269|3@1+ (1,0) [0|0] "NA" MCU
 SG_ OBJ_Angle_Right_14 : 14272|14@1+ (0.0002,-1.571) [-1.571|1.571] "rad" MCU
 SG_ OBJ_Angle_Right_V_14 : 14286|1@1+ (1,0) [0|1] "bool" MCU
 SG_ OBJ_Angle_Right_STD_14 : 14287|14@1+ (0.0001,0) [0|1.571] "rad" MCU
 SG_ OBJ_Angle_Right_STD_V_14 : 14301|1@1+ (1,0) [0|1] "bool" MCU
 SG_ Reserved_21_14 : 14302|2@1+ (1,0) [0|0] "NA" MCU
 SG_ OBJ_Angle_Left_14 : 14304|14@1+ (0.0002,-1.571) [-1.571|1.571] "rad" MCU
 SG_ OBJ_Angle_Left_V_14 : 14318|1@1+ (1,0) [0|1] "bool" MCU
 SG_ OBJ_Angle_Left_STD_14 : 14319|14@1+ (0.0001,0) [0|1.571] "rad" MCU
 SG_ OBJ_Angle_Left_STD_V_14 : 14333|1@1+ (1,0) [0|1] "bool" MCU
 SG_ Reserved_22_14 : 14334|2@1+ (1,0) [0|0] "NA" MCU
 SG_ OBJ_Angle_Side_14 : 14336|14@1+ (0.0002,-1.571) [-1.571|1.571] "rad" MCU
 SG_ OBJ_Angle_Side_V_14 : 14350|1@1+ (1,0) [0|1] "bool" MCU
 SG_ OBJ_Angle_Side_STD_14 : 14351|14@1+ (0.0001,0) [0|1.571] "rad" MCU
 SG_ OBJ_Angle_Side_STD_V_14 : 14365|1@1+ (1,0) [0|1] "bool" MCU
 SG_ OBJ_Angle_Mid_V_14 : 14366|1@1+ (1,0) [0|1] "bool" MCU
 SG_ Reserved_23_14 : 14367|1@1+ (1,0) [0|0] "NA" MCU
 SG_ OBJ_Angle_Mid_14 : 14368|14@1+ (0.0002,-1.571) [-1.571|1.571] "rad" MCU
 SG_ OBJ_Angle_Mid_STD_14 : 14382|14@1+ (0.0001,0) [0|1.571] "rad" MCU
 SG_ OBJ_Angle_Mid_STD_V_14 : 14396|1@1+ (1,0) [0|1] "bool" MCU
 SG_ OBJ_Angle_Bottom_V_14 : 14397|1@1+ (1,0) [0|1] "bool" MCU
 SG_ Reserved_24_14 : 14398|2@1+ (1,0) [0|0] "NA" MCU
 SG_ OBJ_Angle_Bottom_14 : 14400|14@1+ (0.0002,-1.571) [-1.571|1.571] "rad" MCU
 SG_ OBJ_Angle_Bottom_STD_14 : 14414|14@1+ (0.0001,0) [0|1.571] "rad" MCU
 SG_ OBJ_Angle_Bottom_STD_V_14 : 14428|1@1+ (1,0) [0|1] "bool" MCU
 SG_ OBJ_Visibility_Side_V_14 : 14429|1@1+ (1,0) [0|1] "bool" MCU
 SG_ OBJ_Visibility_Side_14 : 14430|2@1+ (1,0) [0|2] "ENUM" MCU
 SG_ OBJ_Is_In_Drivable_Area_14 : 14432|1@1+ (1,0) [0|1] "bool" MCU
 SG_ OBJ_Is_In_Drivable_Area_V_14 : 14433|1@1+ (1,0) [0|1] "bool" MCU
 SG_ OBJ_Is_VeryClose_V_14 : 14434|1@1+ (1,0) [0|1] "bool" MCU
 SG_ OBJ_Is_VeryClose_14 : 14435|1@1+ (1,0) [0|1] "bool" MCU
 SG_ OBJ_Buffer_C4_14 : 14436|2@1+ (1,0) [0|2] "NA" MCU
 SG_ OBJ_Buffer_C5_14 : 14438|2@1+ (1,0) [0|2] "NA" MCU
 SG_ OBJ_Buffer_C6_14 : 14440|2@1+ (1,0) [0|2] "NA" MCU
 SG_ OBJ_Buffer_C7_14 : 14442|2@1+ (1,0) [0|2] "NA" MCU
 SG_ OBJ_OverlapAngleEgoLaneR_14 : 14444|10@1+ (0.01,-3.14) [-3.14|3.14] "rad" MCU
 SG_ OBJ_OverlapAngleEgoLaneR_V_14 : 14454|1@1+ (1,0) [0|1] "bool" MCU
 SG_ Reserved_25_14 : 14455|9@1+ (1,0) [0|0] "NA" MCU
 SG_ OBJ_OverlapAngleEgoLaneL_14 : 14464|10@1+ (0.01,-3.14) [-3.14|3.14] "rad" MCU
 SG_ OBJ_OverlapAngleEgoLaneL_V_14 : 14474|1@1+ (1,0) [0|1] "bool" MCU
 SG_ OBJ_Is_EMERGENCY_VCL_14 : 14475|1@1+ (1,0) [0|1] "bool" MCU
 SG_ OBJ_EMERGENCY_LIGHT_COLOR_14 : 14476|4@1+ (1,0) [0|15] "BITWIZE" MCU
 SG_ OBJ_EMERGENCY_V_14 : 14480|1@1+ (1,0) [0|1] "bool" MCU
 SG_ OBJ_Angle_Top_14 : 14481|14@1+ (0.0002,0) [0|3.1415] "rad" MCU
 SG_ OBJ_Angle_Top_V_14 : 14495|1@1+ (1,0) [0|1] "bool" MCU
 SG_ OBJ_Angle_Top_STD_14 : 14496|15@1+ (0.0001,0) [0|3.1415] "rad" MCU
 SG_ OBJ_Angle_Top_STD_V_14 : 14511|1@1+ (1,0) [0|1] "bool" MCU
 SG_ OBJ_Open_Door_Left_14 : 14512|1@1+ (1,0) [0|1] "bool" MCU
 SG_ OBJ_Open_Door_Right_14 : 14513|1@1+ (1,0) [0|1] "bool" MCU
 SG_ OBJ_Visible_Left_or_Right_14 : 14514|2@1+ (1,0) [0|2] "ENUM" MCU
 SG_ OBJ_Visible_Left_or_Right_V_14 : 14516|1@1+ (1,0) [0|1] "bool" MCU
 SG_ OBJ_2W_Is_Motorbike_Probability_14 : 14517|8@1+ (0.01,0) [0|1] "NA" MCU
 SG_ Reserved_26_14 : 14525|3@1+ (1,0) [0|0] "NA" MCU
 SG_ OBJ_2W_Is_Bicycle_Probability_14 : 14528|8@1+ (0.01,0) [0|1] "NA" MCU
 SG_ Reserved_27_14 : 14536|24@1+ (1,0) [0|0] "NA" MCU
 SG_ OBJ_CRC_15 : 14560|32@1+ (1,0) [0|4294967295] "NA" MCU
 SG_ OBJ_ID_15 : 14592|8@1+ (1,0) [0|255] "counter" MCU
 SG_ OBJ_Existence_Probability_15 : 14600|8@1+ (0.01,0) [0|1] "NA" MCU
 SG_ OBJ_Fusion_Source_15 : 14608|16@1+ (1,0) [0|65535] "BITWIZE" MCU
 SG_ OBJ_Triggered_SDM_15 : 14624|2@1+ (1,0) [0|2] "ENUM" MCU
 SG_ OBJ_Motion_Category_15 : 14626|4@1+ (1,0) [0|13] "ENUM" MCU
 SG_ OBJ_Moving_IN_Probability_15 : 14630|7@1+ (0.01,0) [0|1] "NA" MCU
 SG_ OBJ_Object_Age_15 : 14637|11@1+ (1,0) [0|2047] "frames" MCU
 SG_ OBJ_Measuring_Status_15 : 14648|3@1+ (1,0) [0|7] "BITWIZE" MCU
 SG_ OBJ_Object_Class_15 : 14651|4@1+ (1,0) [0|9] "ENUM" MCU
 SG_ Reserved_4_15 : 14655|1@1+ (1,0) [0|0] "NA" MCU
 SG_ OBJ_Class_Probability_15 : 14656|7@1+ (0.01,0) [0|1] "NA" MCU
 SG_ OBJ_Car_Probability_15 : 14663|7@1+ (0.01,0) [0|1] "NA" MCU
 SG_ OBJ_Truck_Probability_15 : 14670|7@1+ (0.01,0) [0|1] "NA" MCU
 SG_ OBJ_Bike_Probability_15 : 14677|7@1+ (0.01,0) [0|1] "NA" MCU
 SG_ OBJ_Camera_Source_15 : 14684|4@1+ (1,0) [0|15] "ENUM" MCU
 SG_ OBJ_Motion_Status_15 : 14688|3@1+ (1,0) [0|5] "ENUM" MCU
 SG_ OBJ_Motion_Orientation_15 : 14691|4@1+ (1,0) [0|13] "ENUM" MCU
 SG_ OBJ_Has_Cut_Lane_15 : 14695|1@1+ (1,0) [0|1] "bool" MCU
 SG_ OBJ_Has_Cut_Path_15 : 14696|1@1+ (1,0) [0|1] "bool" MCU
 SG_ OBJ_Brake_Light_Validity_15 : 14697|1@1+ (1,0) [0|1] "bool" MCU
 SG_ OBJ_Brake_Light_15 : 14698|1@1+ (1,0) [0|1] "bool" MCU
 SG_ OBJ_Turn_Indicator_Right_15 : 14699|1@1+ (1,0) [0|1] "bool" MCU
 SG_ OBJ_Turn_Indicator_Left_15 : 14700|1@1+ (1,0) [0|1] "bool" MCU
 SG_ OBJ_Turn_Indicator_Validity_15 : 14701|1@1+ (1,0) [0|1] "bool" MCU
 SG_ OBJ_Right_Out_Of_Image_15 : 14702|1@1+ (1,0) [0|1] "bool" MCU
 SG_ OBJ_Left_Out_Of_Image_15 : 14703|1@1+ (1,0) [0|1] "bool" MCU
 SG_ OBJ_Right_Out_Of_Image_V_15 : 14704|1@1+ (1,0) [0|1] "bool" MCU
 SG_ OBJ_Left_Out_Of_Image_V_15 : 14705|1@1+ (1,0) [0|1] "bool" MCU
 SG_ OBJ_Top_Out_Of_Image_15 : 14706|1@1+ (1,0) [0|1] "bool" MCU
 SG_ OBJ_Bottom_Out_Of_Image_15 : 14707|1@1+ (1,0) [0|1] "bool" MCU
 SG_ OBJ_Top_Out_Of_Image_V_15 : 14708|1@1+ (1,0) [0|1] "bool" MCU
 SG_ OBJ_Bottom_Out_Of_Image_V_15 : 14709|1@1+ (1,0) [0|1] "bool" MCU
 SG_ OBJ_Lane_Assignment_15 : 14710|3@1+ (1,0) [0|5] "ENUM" MCU
 SG_ OBJ_Lane_Assignment_V_15 : 14713|1@1+ (1,0) [0|1] "bool" MCU
 SG_ Reserved_5_15 : 14714|6@1+ (1,0) [0|0] "NA" MCU
 SG_ OBJ_Age_Seconds_15 : 14720|7@1+ (1,0) [0|100] "s" MCU
 SG_ OBJ_Age_Seconds_V_15 : 14727|1@1+ (1,0) [0|1] "bool" MCU
 SG_ OBJ_Width_15 : 14728|9@1+ (0.01,0) [0.4|2.95] "m" MCU
 SG_ OBJ_Width_V_15 : 14737|1@1+ (1,0) [0|1] "bool" MCU
 SG_ OBJ_Width_STD_15 : 14738|11@1+ (0.001,0) [0|2] "m" MCU
 SG_ OBJ_Width_STD_V_15 : 14749|1@1+ (1,0) [0|1] "bool" MCU
 SG_ Reserved_6_15 : 14750|2@1+ (1,0) [0|0] "NA" MCU
 SG_ OBJ_Length_15 : 14752|9@1+ (0.05,0) [0.6|21] "m" MCU
 SG_ OBJ_Length_V_15 : 14761|1@1+ (1,0) [0|1] "bool" MCU
 SG_ OBJ_Length_STD_15 : 14762|10@1+ (0.01,0) [0|10] "m" MCU
 SG_ OBJ_Length_STD_V_15 : 14772|1@1+ (1,0) [0|1] "bool" MCU
 SG_ OBJ_Radar_ID_15 : 14773|8@1+ (1,0) [0|255] "counter" MCU
 SG_ Reserved_7_15 : 14781|3@1+ (1,0) [0|0] "NA" MCU
 SG_ OBJ_Height_15 : 14784|9@1+ (0.01,0) [0|2.95] "m" MCU
 SG_ OBJ_Height_V_15 : 14793|1@1+ (1,0) [0|1] "bool" MCU
 SG_ OBJ_Height_STD_15 : 14794|11@1+ (0.001,0) [0|2] "m" MCU
 SG_ OBJ_Height_STD_V_15 : 14805|1@1+ (1,0) [0|1] "bool" MCU
 SG_ Reserved_8_15 : 14806|10@1+ (1,0) [0|0] "NA" MCU
 SG_ OBJ_Abs_Long_Velocity_15 : 14816|12@1+ (0.05,-100) [-100|100] "m_per_s" MCU
 SG_ OBJ_Abs_Long_Velocity_V_15 : 14828|1@1+ (1,0) [0|1] "bool" MCU
 SG_ OBJ_Abs_Long_Velocity_STD_15 : 14829|13@1+ (0.01,0) [0|65] "m_per_s" MCU
 SG_ OBJ_Abs_Long_Vel_STD_V_15 : 14842|1@1+ (1,0) [0|1] "bool" MCU
 SG_ Reserved_9_15 : 14843|5@1+ (1,0) [0|0] "NA" MCU
 SG_ OBJ_Abs_Lat_Velocity_15 : 14848|11@1+ (0.05,-50) [-50|50] "m_per_s" MCU
 SG_ OBJ_Abs_Lat_Velocity_V_15 : 14859|1@1+ (1,0) [0|1] "bool" MCU
 SG_ OBJ_Abs_Lat_Velocity_STD_15 : 14860|13@1+ (0.01,0) [0|50] "m_per_s" MCU
 SG_ OBJ_Abs_Lat_Vel_STD_V_15 : 14873|1@1+ (1,0) [0|1] "bool" MCU
 SG_ Reserved_10_15 : 14874|6@1+ (1,0) [0|0] "NA" MCU
 SG_ OBJ_Abs_Long_Acc_15 : 14880|9@1+ (0.05,-10) [-10|10] "m_per_s2" MCU
 SG_ OBJ_Abs_Long_Acc_V_15 : 14889|1@1+ (1,0) [0|1] "bool" MCU
 SG_ OBJ_Abs_Long_Acc_STD_15 : 14890|10@1+ (0.01,0) [0|7.3] "m_per_s2" MCU
 SG_ OBJ_Abs_Long_Acc_STD_V_15 : 14900|1@1+ (1,0) [0|1] "bool" MCU
 SG_ OBJ_Abs_Lat_Acc_15 : 14901|9@1+ (0.05,-10) [-10|10] "m_per_s2" MCU
 SG_ OBJ_Abs_Lat_Acc_V_15 : 14910|1@1+ (1,0) [0|1] "bool" MCU
 SG_ Reserved_11_15 : 14911|1@1+ (1,0) [0|0] "NA" MCU
 SG_ OBJ_Abs_Lat_Acc_STD_15 : 14912|10@1+ (0.01,0) [0|7.3] "m_per_s2" MCU
 SG_ OBJ_Abs_Lat_Acc_STD_V_15 : 14922|1@1+ (1,0) [0|1] "bool" MCU
 SG_ OBJ_Abs_Acceleration_15 : 14923|9@1+ (0.05,-12.7) [-12.7|12.7] "m_per_s2" MCU
 SG_ OBJ_Abs_Acceleration_V_15 : 14932|1@1+ (1,0) [0|1] "bool" MCU
 SG_ OBJ_Abs_Acc_STD_15 : 14933|10@1+ (0.01,0) [0|7.3] "m_per_s2" MCU
 SG_ OBJ_Abs_Acc_STD_V_15 : 14943|1@1+ (1,0) [0|1] "bool" MCU
 SG_ OBJ_Inv_TTC_15 : 14944|11@1+ (0.01,-8) [-8|8] "INV(s)" MCU
 SG_ OBJ_Inv_TTC_V_15 : 14955|1@1+ (1,0) [0|1] "bool" MCU
 SG_ OBJ_Inv_TTC_STD_15 : 14956|12@1+ (0.001,0) [0|4] "INV(s)" MCU
 SG_ OBJ_Inv_TTC_STD_V_15 : 14968|1@1+ (1,0) [0|1] "bool" MCU
 SG_ Reserved_12_15 : 14969|7@1+ (1,0) [0|0] "NA" MCU
 SG_ OBJ_Relative_Long_Acc_15 : 14976|10@1+ (0.05,-20) [-20|20] "m_per_s2" MCU
 SG_ OBJ_Relative_Long_Acc_V_15 : 14986|1@1+ (1,0) [0|1] "bool" MCU
 SG_ OBJ_Relative_Long_Acc_STD_15 : 14987|10@1+ (0.01,0) [0|7.3] "m_per_s2" MCU
 SG_ OBJ_Rel_Long_Acc_STD_V_15 : 14997|1@1+ (1,0) [0|1] "bool" MCU
 SG_ Reserved_13_15 : 14998|10@1+ (1,0) [0|0] "NA" MCU
 SG_ OBJ_Relative_Long_Velocity_15 : 15008|13@1+ (0.05,-120) [-120|130] "m_per_s" MCU
 SG_ OBJ_Relative_Long_Velocity_V_15 : 15021|1@1+ (1,0) [0|1] "bool" MCU
 SG_ OBJ_Relative_Long_Vel_STD_15 : 15022|14@1+ (0.01,0) [0|130] "m_per_s" MCU
 SG_ OBJ_Rel_Long_Vel_STD_V_15 : 15036|1@1+ (1,0) [0|1] "bool" MCU
 SG_ Reserved_14_15 : 15037|3@1+ (1,0) [0|0] "NA" MCU
 SG_ OBJ_Relative_Lat_Velocity_15 : 15040|11@1+ (0.05,-50) [-50|50] "m_per_s" MCU
 SG_ OBJ_Relative_Lat_Velocity_V_15 : 15051|1@1+ (1,0) [0|1] "bool" MCU
 SG_ OBJ_Relative_Lat_Velocity_STD_15 : 15052|13@1+ (0.01,0) [0|50] "m_per_s" MCU
 SG_ OBJ_Rel_Lat_Vel_STD_V_15 : 15065|1@1+ (1,0) [0|1] "bool" MCU
 SG_ Reserved_15_15 : 15066|6@1+ (1,0) [0|0] "NA" MCU
 SG_ OBJ_Long_Distance_15 : 15072|14@1+ (0.05,-200) [-200|500] "m" MCU
 SG_ OBJ_Long_Distance_V_15 : 15086|1@1+ (1,0) [0|1] "bool" MCU
 SG_ OBJ_Long_Distance_STD_15 : 15087|15@1+ (0.01,0) [0|250] "m" MCU
 SG_ OBJ_Long_Distance_STD_V_15 : 15102|1@1+ (1,0) [0|1] "bool" MCU
 SG_ Reserved_16_15 : 15103|1@1+ (1,0) [0|0] "NA" MCU
 SG_ OBJ_Lat_Distance_15 : 15104|12@1+ (0.05,-100) [-100|100] "m" MCU
 SG_ OBJ_Lat_Distance_V_15 : 15116|1@1+ (1,0) [0|1] "bool" MCU
 SG_ OBJ_Lat_Distance_STD_15 : 15117|14@1+ (0.01,0) [0|100] "m" MCU
 SG_ OBJ_Lat_Distance_STD_V_15 : 15131|1@1+ (1,0) [0|1] "bool" MCU
 SG_ Reserved_17_15 : 15132|4@1+ (1,0) [0|0] "NA" MCU
 SG_ OBJ_Absolute_Speed_15 : 15136|12@1+ (0.05,-65) [-65|65] "m_per_s" MCU
 SG_ OBJ_Absolute_Speed_V_15 : 15148|1@1+ (1,0) [0|1] "bool" MCU
 SG_ OBJ_Absolute_Speed_STD_15 : 15149|13@1+ (0.01,0) [0|65] "m_per_s" MCU
 SG_ OBJ_Absolute_Speed_STD_V_15 : 15162|1@1+ (1,0) [0|1] "bool" MCU
 SG_ Reserved_18_15 : 15163|5@1+ (1,0) [0|0] "NA" MCU
 SG_ OBJ_Heading_15 : 15168|10@1+ (0.01,-3.14) [-3.14|3.14] "rad" MCU
 SG_ OBJ_Heading_V_15 : 15178|1@1+ (1,0) [0|1] "bool" MCU
 SG_ OBJ_Heading_STD_15 : 15179|15@1+ (0.0001,0) [0|3.14] "rad" MCU
 SG_ OBJ_Heading_STD_V_15 : 15194|1@1+ (1,0) [0|1] "bool" MCU
 SG_ Reserved_19_15 : 15195|5@1+ (1,0) [0|0] "NA" MCU
 SG_ OBJ_Angle_Rate_STD_15 : 15200|15@1+ (0.0001,0) [0|2.2318] "RPS" MCU
 SG_ OBJ_Angle_Rate_STD_V_15 : 15215|1@1+ (1,0) [0|1] "bool" MCU
 SG_ OBJ_Angle_Rate_15 : 15216|12@1+ (0.002,-2.234) [-2.234|2.2318] "RPS" MCU
 SG_ OBJ_Angle_Rate_V_15 : 15228|1@1+ (1,0) [0|1] "bool" MCU
 SG_ Reserved_20_15 : 15229|3@1+ (1,0) [0|0] "NA" MCU
 SG_ OBJ_Angle_Right_15 : 15232|14@1+ (0.0002,-1.571) [-1.571|1.571] "rad" MCU
 SG_ OBJ_Angle_Right_V_15 : 15246|1@1+ (1,0) [0|1] "bool" MCU
 SG_ OBJ_Angle_Right_STD_15 : 15247|14@1+ (0.0001,0) [0|1.571] "rad" MCU
 SG_ OBJ_Angle_Right_STD_V_15 : 15261|1@1+ (1,0) [0|1] "bool" MCU
 SG_ Reserved_21_15 : 15262|2@1+ (1,0) [0|0] "NA" MCU
 SG_ OBJ_Angle_Left_15 : 15264|14@1+ (0.0002,-1.571) [-1.571|1.571] "rad" MCU
 SG_ OBJ_Angle_Left_V_15 : 15278|1@1+ (1,0) [0|1] "bool" MCU
 SG_ OBJ_Angle_Left_STD_15 : 15279|14@1+ (0.0001,0) [0|1.571] "rad" MCU
 SG_ OBJ_Angle_Left_STD_V_15 : 15293|1@1+ (1,0) [0|1] "bool" MCU
 SG_ Reserved_22_15 : 15294|2@1+ (1,0) [0|0] "NA" MCU
 SG_ OBJ_Angle_Side_15 : 15296|14@1+ (0.0002,-1.571) [-1.571|1.571] "rad" MCU
 SG_ OBJ_Angle_Side_V_15 : 15310|1@1+ (1,0) [0|1] "bool" MCU
 SG_ OBJ_Angle_Side_STD_15 : 15311|14@1+ (0.0001,0) [0|1.571] "rad" MCU
 SG_ OBJ_Angle_Side_STD_V_15 : 15325|1@1+ (1,0) [0|1] "bool" MCU
 SG_ OBJ_Angle_Mid_V_15 : 15326|1@1+ (1,0) [0|1] "bool" MCU
 SG_ Reserved_23_15 : 15327|1@1+ (1,0) [0|0] "NA" MCU
 SG_ OBJ_Angle_Mid_15 : 15328|14@1+ (0.0002,-1.571) [-1.571|1.571] "rad" MCU
 SG_ OBJ_Angle_Mid_STD_15 : 15342|14@1+ (0.0001,0) [0|1.571] "rad" MCU
 SG_ OBJ_Angle_Mid_STD_V_15 : 15356|1@1+ (1,0) [0|1] "bool" MCU
 SG_ OBJ_Angle_Bottom_V_15 : 15357|1@1+ (1,0) [0|1] "bool" MCU
 SG_ Reserved_24_15 : 15358|2@1+ (1,0) [0|0] "NA" MCU
 SG_ OBJ_Angle_Bottom_15 : 15360|14@1+ (0.0002,-1.571) [-1.571|1.571] "rad" MCU
 SG_ OBJ_Angle_Bottom_STD_15 : 15374|14@1+ (0.0001,0) [0|1.571] "rad" MCU
 SG_ OBJ_Angle_Bottom_STD_V_15 : 15388|1@1+ (1,0) [0|1] "bool" MCU
 SG_ OBJ_Visibility_Side_V_15 : 15389|1@1+ (1,0) [0|1] "bool" MCU
 SG_ OBJ_Visibility_Side_15 : 15390|2@1+ (1,0) [0|2] "ENUM" MCU
 SG_ OBJ_Is_In_Drivable_Area_15 : 15392|1@1+ (1,0) [0|1] "bool" MCU
 SG_ OBJ_Is_In_Drivable_Area_V_15 : 15393|1@1+ (1,0) [0|1] "bool" MCU
 SG_ OBJ_Is_VeryClose_V_15 : 15394|1@1+ (1,0) [0|1] "bool" MCU
 SG_ OBJ_Is_VeryClose_15 : 15395|1@1+ (1,0) [0|1] "bool" MCU
 SG_ OBJ_Buffer_C4_15 : 15396|2@1+ (1,0) [0|2] "NA" MCU
 SG_ OBJ_Buffer_C5_15 : 15398|2@1+ (1,0) [0|2] "NA" MCU
 SG_ OBJ_Buffer_C6_15 : 15400|2@1+ (1,0) [0|2] "NA" MCU
 SG_ OBJ_Buffer_C7_15 : 15402|2@1+ (1,0) [0|2] "NA" MCU
 SG_ OBJ_OverlapAngleEgoLaneR_15 : 15404|10@1+ (0.01,-3.14) [-3.14|3.14] "rad" MCU
 SG_ OBJ_OverlapAngleEgoLaneR_V_15 : 15414|1@1+ (1,0) [0|1] "bool" MCU
 SG_ Reserved_25_15 : 15415|9@1+ (1,0) [0|0] "NA" MCU
 SG_ OBJ_OverlapAngleEgoLaneL_15 : 15424|10@1+ (0.01,-3.14) [-3.14|3.14] "rad" MCU
 SG_ OBJ_OverlapAngleEgoLaneL_V_15 : 15434|1@1+ (1,0) [0|1] "bool" MCU
 SG_ OBJ_Is_EMERGENCY_VCL_15 : 15435|1@1+ (1,0) [0|1] "bool" MCU
 SG_ OBJ_EMERGENCY_LIGHT_COLOR_15 : 15436|4@1+ (1,0) [0|15] "BITWIZE" MCU
 SG_ OBJ_EMERGENCY_V_15 : 15440|1@1+ (1,0) [0|1] "bool" MCU
 SG_ OBJ_Angle_Top_15 : 15441|14@1+ (0.0002,0) [0|3.1415] "rad" MCU
 SG_ OBJ_Angle_Top_V_15 : 15455|1@1+ (1,0) [0|1] "bool" MCU
 SG_ OBJ_Angle_Top_STD_15 : 15456|15@1+ (0.0001,0) [0|3.1415] "rad" MCU
 SG_ OBJ_Angle_Top_STD_V_15 : 15471|1@1+ (1,0) [0|1] "bool" MCU
 SG_ OBJ_Open_Door_Left_15 : 15472|1@1+ (1,0) [0|1] "bool" MCU
 SG_ OBJ_Open_Door_Right_15 : 15473|1@1+ (1,0) [0|1] "bool" MCU
 SG_ OBJ_Visible_Left_or_Right_15 : 15474|2@1+ (1,0) [0|2] "ENUM" MCU
 SG_ OBJ_Visible_Left_or_Right_V_15 : 15476|1@1+ (1,0) [0|1] "bool" MCU
 SG_ OBJ_2W_Is_Motorbike_Probability_15 : 15477|8@1+ (0.01,0) [0|1] "NA" MCU
 SG_ Reserved_26_15 : 15485|3@1+ (1,0) [0|0] "NA" MCU
 SG_ OBJ_2W_Is_Bicycle_Probability_15 : 15488|8@1+ (0.01,0) [0|1] "NA" MCU
 SG_ Reserved_27_15 : 15496|24@1+ (1,0) [0|0] "NA" MCU
 SG_ OBJ_CRC_16 : 15520|32@1+ (1,0) [0|4294967295] "NA" MCU
 SG_ OBJ_ID_16 : 15552|8@1+ (1,0) [0|255] "counter" MCU
 SG_ OBJ_Existence_Probability_16 : 15560|8@1+ (0.01,0) [0|1] "NA" MCU
 SG_ OBJ_Fusion_Source_16 : 15568|16@1+ (1,0) [0|65535] "BITWIZE" MCU
 SG_ OBJ_Triggered_SDM_16 : 15584|2@1+ (1,0) [0|2] "ENUM" MCU
 SG_ OBJ_Motion_Category_16 : 15586|4@1+ (1,0) [0|13] "ENUM" MCU
 SG_ OBJ_Moving_IN_Probability_16 : 15590|7@1+ (0.01,0) [0|1] "NA" MCU
 SG_ OBJ_Object_Age_16 : 15597|11@1+ (1,0) [0|2047] "frames" MCU
 SG_ OBJ_Measuring_Status_16 : 15608|3@1+ (1,0) [0|7] "BITWIZE" MCU
 SG_ OBJ_Object_Class_16 : 15611|4@1+ (1,0) [0|9] "ENUM" MCU
 SG_ Reserved_4_16 : 15615|1@1+ (1,0) [0|0] "NA" MCU
 SG_ OBJ_Class_Probability_16 : 15616|7@1+ (0.01,0) [0|1] "NA" MCU
 SG_ OBJ_Car_Probability_16 : 15623|7@1+ (0.01,0) [0|1] "NA" MCU
 SG_ OBJ_Truck_Probability_16 : 15630|7@1+ (0.01,0) [0|1] "NA" MCU
 SG_ OBJ_Bike_Probability_16 : 15637|7@1+ (0.01,0) [0|1] "NA" MCU
 SG_ OBJ_Camera_Source_16 : 15644|4@1+ (1,0) [0|15] "ENUM" MCU
 SG_ OBJ_Motion_Status_16 : 15648|3@1+ (1,0) [0|5] "ENUM" MCU
 SG_ OBJ_Motion_Orientation_16 : 15651|4@1+ (1,0) [0|13] "ENUM" MCU
 SG_ OBJ_Has_Cut_Lane_16 : 15655|1@1+ (1,0) [0|1] "bool" MCU
 SG_ OBJ_Has_Cut_Path_16 : 15656|1@1+ (1,0) [0|1] "bool" MCU
 SG_ OBJ_Brake_Light_Validity_16 : 15657|1@1+ (1,0) [0|1] "bool" MCU
 SG_ OBJ_Brake_Light_16 : 15658|1@1+ (1,0) [0|1] "bool" MCU
 SG_ OBJ_Turn_Indicator_Right_16 : 15659|1@1+ (1,0) [0|1] "bool" MCU
 SG_ OBJ_Turn_Indicator_Left_16 : 15660|1@1+ (1,0) [0|1] "bool" MCU
 SG_ OBJ_Turn_Indicator_Validity_16 : 15661|1@1+ (1,0) [0|1] "bool" MCU
 SG_ OBJ_Right_Out_Of_Image_16 : 15662|1@1+ (1,0) [0|1] "bool" MCU
 SG_ OBJ_Left_Out_Of_Image_16 : 15663|1@1+ (1,0) [0|1] "bool" MCU
 SG_ OBJ_Right_Out_Of_Image_V_16 : 15664|1@1+ (1,0) [0|1] "bool" MCU
 SG_ OBJ_Left_Out_Of_Image_V_16 : 15665|1@1+ (1,0) [0|1] "bool" MCU
 SG_ OBJ_Top_Out_Of_Image_16 : 15666|1@1+ (1,0) [0|1] "bool" MCU
 SG_ OBJ_Bottom_Out_Of_Image_16 : 15667|1@1+ (1,0) [0|1] "bool" MCU
 SG_ OBJ_Top_Out_Of_Image_V_16 : 15668|1@1+ (1,0) [0|1] "bool" MCU
 SG_ OBJ_Bottom_Out_Of_Image_V_16 : 15669|1@1+ (1,0) [0|1] "bool" MCU
 SG_ OBJ_Lane_Assignment_16 : 15670|3@1+ (1,0) [0|5] "ENUM" MCU
 SG_ OBJ_Lane_Assignment_V_16 : 15673|1@1+ (1,0) [0|1] "bool" MCU
 SG_ Reserved_5_16 : 15674|6@1+ (1,0) [0|0] "NA" MCU
 SG_ OBJ_Age_Seconds_16 : 15680|7@1+ (1,0) [0|100] "s" MCU
 SG_ OBJ_Age_Seconds_V_16 : 15687|1@1+ (1,0) [0|1] "bool" MCU
 SG_ OBJ_Width_16 : 15688|9@1+ (0.01,0) [0.4|2.95] "m" MCU
 SG_ OBJ_Width_V_16 : 15697|1@1+ (1,0) [0|1] "bool" MCU
 SG_ OBJ_Width_STD_16 : 15698|11@1+ (0.001,0) [0|2] "m" MCU
 SG_ OBJ_Width_STD_V_16 : 15709|1@1+ (1,0) [0|1] "bool" MCU
 SG_ Reserved_6_16 : 15710|2@1+ (1,0) [0|0] "NA" MCU
 SG_ OBJ_Length_16 : 15712|9@1+ (0.05,0) [0.6|21] "m" MCU
 SG_ OBJ_Length_V_16 : 15721|1@1+ (1,0) [0|1] "bool" MCU
 SG_ OBJ_Length_STD_16 : 15722|10@1+ (0.01,0) [0|10] "m" MCU
 SG_ OBJ_Length_STD_V_16 : 15732|1@1+ (1,0) [0|1] "bool" MCU
 SG_ OBJ_Radar_ID_16 : 15733|8@1+ (1,0) [0|255] "counter" MCU
 SG_ Reserved_7_16 : 15741|3@1+ (1,0) [0|0] "NA" MCU
 SG_ OBJ_Height_16 : 15744|9@1+ (0.01,0) [0|2.95] "m" MCU
 SG_ OBJ_Height_V_16 : 15753|1@1+ (1,0) [0|1] "bool" MCU
 SG_ OBJ_Height_STD_16 : 15754|11@1+ (0.001,0) [0|2] "m" MCU
 SG_ OBJ_Height_STD_V_16 : 15765|1@1+ (1,0) [0|1] "bool" MCU
 SG_ Reserved_8_16 : 15766|10@1+ (1,0) [0|0] "NA" MCU
 SG_ OBJ_Abs_Long_Velocity_16 : 15776|12@1+ (0.05,-100) [-100|100] "m_per_s" MCU
 SG_ OBJ_Abs_Long_Velocity_V_16 : 15788|1@1+ (1,0) [0|1] "bool" MCU
 SG_ OBJ_Abs_Long_Velocity_STD_16 : 15789|13@1+ (0.01,0) [0|65] "m_per_s" MCU
 SG_ OBJ_Abs_Long_Vel_STD_V_16 : 15802|1@1+ (1,0) [0|1] "bool" MCU
 SG_ Reserved_9_16 : 15803|5@1+ (1,0) [0|0] "NA" MCU
 SG_ OBJ_Abs_Lat_Velocity_16 : 15808|11@1+ (0.05,-50) [-50|50] "m_per_s" MCU
 SG_ OBJ_Abs_Lat_Velocity_V_16 : 15819|1@1+ (1,0) [0|1] "bool" MCU
 SG_ OBJ_Abs_Lat_Velocity_STD_16 : 15820|13@1+ (0.01,0) [0|50] "m_per_s" MCU
 SG_ OBJ_Abs_Lat_Vel_STD_V_16 : 15833|1@1+ (1,0) [0|1] "bool" MCU
 SG_ Reserved_10_16 : 15834|6@1+ (1,0) [0|0] "NA" MCU
 SG_ OBJ_Abs_Long_Acc_16 : 15840|9@1+ (0.05,-10) [-10|10] "m_per_s2" MCU
 SG_ OBJ_Abs_Long_Acc_V_16 : 15849|1@1+ (1,0) [0|1] "bool" MCU
 SG_ OBJ_Abs_Long_Acc_STD_16 : 15850|10@1+ (0.01,0) [0|7.3] "m_per_s2" MCU
 SG_ OBJ_Abs_Long_Acc_STD_V_16 : 15860|1@1+ (1,0) [0|1] "bool" MCU
 SG_ OBJ_Abs_Lat_Acc_16 : 15861|9@1+ (0.05,-10) [-10|10] "m_per_s2" MCU
 SG_ OBJ_Abs_Lat_Acc_V_16 : 15870|1@1+ (1,0) [0|1] "bool" MCU
 SG_ Reserved_11_16 : 15871|1@1+ (1,0) [0|0] "NA" MCU
 SG_ OBJ_Abs_Lat_Acc_STD_16 : 15872|10@1+ (0.01,0) [0|7.3] "m_per_s2" MCU
 SG_ OBJ_Abs_Lat_Acc_STD_V_16 : 15882|1@1+ (1,0) [0|1] "bool" MCU
 SG_ OBJ_Abs_Acceleration_16 : 15883|9@1+ (0.05,-12.7) [-12.7|12.7] "m_per_s2" MCU
 SG_ OBJ_Abs_Acceleration_V_16 : 15892|1@1+ (1,0) [0|1] "bool" MCU
 SG_ OBJ_Abs_Acc_STD_16 : 15893|10@1+ (0.01,0) [0|7.3] "m_per_s2" MCU
 SG_ OBJ_Abs_Acc_STD_V_16 : 15903|1@1+ (1,0) [0|1] "bool" MCU
 SG_ OBJ_Inv_TTC_16 : 15904|11@1+ (0.01,-8) [-8|8] "INV(s)" MCU
 SG_ OBJ_Inv_TTC_V_16 : 15915|1@1+ (1,0) [0|1] "bool" MCU
 SG_ OBJ_Inv_TTC_STD_16 : 15916|12@1+ (0.001,0) [0|4] "INV(s)" MCU
 SG_ OBJ_Inv_TTC_STD_V_16 : 15928|1@1+ (1,0) [0|1] "bool" MCU
 SG_ Reserved_12_16 : 15929|7@1+ (1,0) [0|0] "NA" MCU
 SG_ OBJ_Relative_Long_Acc_16 : 15936|10@1+ (0.05,-20) [-20|20] "m_per_s2" MCU
 SG_ OBJ_Relative_Long_Acc_V_16 : 15946|1@1+ (1,0) [0|1] "bool" MCU
 SG_ OBJ_Relative_Long_Acc_STD_16 : 15947|10@1+ (0.01,0) [0|7.3] "m_per_s2" MCU
 SG_ OBJ_Rel_Long_Acc_STD_V_16 : 15957|1@1+ (1,0) [0|1] "bool" MCU
 SG_ Reserved_13_16 : 15958|10@1+ (1,0) [0|0] "NA" MCU
 SG_ OBJ_Relative_Long_Velocity_16 : 15968|13@1+ (0.05,-120) [-120|130] "m_per_s" MCU
 SG_ OBJ_Relative_Long_Velocity_V_16 : 15981|1@1+ (1,0) [0|1] "bool" MCU
 SG_ OBJ_Relative_Long_Vel_STD_16 : 15982|14@1+ (0.01,0) [0|130] "m_per_s" MCU
 SG_ OBJ_Rel_Long_Vel_STD_V_16 : 15996|1@1+ (1,0) [0|1] "bool" MCU
 SG_ Reserved_14_16 : 15997|3@1+ (1,0) [0|0] "NA" MCU
 SG_ OBJ_Relative_Lat_Velocity_16 : 16000|11@1+ (0.05,-50) [-50|50] "m_per_s" MCU
 SG_ OBJ_Relative_Lat_Velocity_V_16 : 16011|1@1+ (1,0) [0|1] "bool" MCU
 SG_ OBJ_Relative_Lat_Velocity_STD_16 : 16012|13@1+ (0.01,0) [0|50] "m_per_s" MCU
 SG_ OBJ_Rel_Lat_Vel_STD_V_16 : 16025|1@1+ (1,0) [0|1] "bool" MCU
 SG_ Reserved_15_16 : 16026|6@1+ (1,0) [0|0] "NA" MCU
 SG_ OBJ_Long_Distance_16 : 16032|14@1+ (0.05,-200) [-200|500] "m" MCU
 SG_ OBJ_Long_Distance_V_16 : 16046|1@1+ (1,0) [0|1] "bool" MCU
 SG_ OBJ_Long_Distance_STD_16 : 16047|15@1+ (0.01,0) [0|250] "m" MCU
 SG_ OBJ_Long_Distance_STD_V_16 : 16062|1@1+ (1,0) [0|1] "bool" MCU
 SG_ Reserved_16_16 : 16063|1@1+ (1,0) [0|0] "NA" MCU
 SG_ OBJ_Lat_Distance_16 : 16064|12@1+ (0.05,-100) [-100|100] "m" MCU
 SG_ OBJ_Lat_Distance_V_16 : 16076|1@1+ (1,0) [0|1] "bool" MCU
 SG_ OBJ_Lat_Distance_STD_16 : 16077|14@1+ (0.01,0) [0|100] "m" MCU
 SG_ OBJ_Lat_Distance_STD_V_16 : 16091|1@1+ (1,0) [0|1] "bool" MCU
 SG_ Reserved_17_16 : 16092|4@1+ (1,0) [0|0] "NA" MCU
 SG_ OBJ_Absolute_Speed_16 : 16096|12@1+ (0.05,-65) [-65|65] "m_per_s" MCU
 SG_ OBJ_Absolute_Speed_V_16 : 16108|1@1+ (1,0) [0|1] "bool" MCU
 SG_ OBJ_Absolute_Speed_STD_16 : 16109|13@1+ (0.01,0) [0|65] "m_per_s" MCU
 SG_ OBJ_Absolute_Speed_STD_V_16 : 16122|1@1+ (1,0) [0|1] "bool" MCU
 SG_ Reserved_18_16 : 16123|5@1+ (1,0) [0|0] "NA" MCU
 SG_ OBJ_Heading_16 : 16128|10@1+ (0.01,-3.14) [-3.14|3.14] "rad" MCU
 SG_ OBJ_Heading_V_16 : 16138|1@1+ (1,0) [0|1] "bool" MCU
 SG_ OBJ_Heading_STD_16 : 16139|15@1+ (0.0001,0) [0|3.14] "rad" MCU
 SG_ OBJ_Heading_STD_V_16 : 16154|1@1+ (1,0) [0|1] "bool" MCU
 SG_ Reserved_19_16 : 16155|5@1+ (1,0) [0|0] "NA" MCU
 SG_ OBJ_Angle_Rate_STD_16 : 16160|15@1+ (0.0001,0) [0|2.2318] "RPS" MCU
 SG_ OBJ_Angle_Rate_STD_V_16 : 16175|1@1+ (1,0) [0|1] "bool" MCU
 SG_ OBJ_Angle_Rate_16 : 16176|12@1+ (0.002,-2.234) [-2.234|2.2318] "RPS" MCU
 SG_ OBJ_Angle_Rate_V_16 : 16188|1@1+ (1,0) [0|1] "bool" MCU
 SG_ Reserved_20_16 : 16189|3@1+ (1,0) [0|0] "NA" MCU
 SG_ OBJ_Angle_Right_16 : 16192|14@1+ (0.0002,-1.571) [-1.571|1.571] "rad" MCU
 SG_ OBJ_Angle_Right_V_16 : 16206|1@1+ (1,0) [0|1] "bool" MCU
 SG_ OBJ_Angle_Right_STD_16 : 16207|14@1+ (0.0001,0) [0|1.571] "rad" MCU
 SG_ OBJ_Angle_Right_STD_V_16 : 16221|1@1+ (1,0) [0|1] "bool" MCU
 SG_ Reserved_21_16 : 16222|2@1+ (1,0) [0|0] "NA" MCU
 SG_ OBJ_Angle_Left_16 : 16224|14@1+ (0.0002,-1.571) [-1.571|1.571] "rad" MCU
 SG_ OBJ_Angle_Left_V_16 : 16238|1@1+ (1,0) [0|1] "bool" MCU
 SG_ OBJ_Angle_Left_STD_16 : 16239|14@1+ (0.0001,0) [0|1.571] "rad" MCU
 SG_ OBJ_Angle_Left_STD_V_16 : 16253|1@1+ (1,0) [0|1] "bool" MCU
 SG_ Reserved_22_16 : 16254|2@1+ (1,0) [0|0] "NA" MCU
 SG_ OBJ_Angle_Side_16 : 16256|14@1+ (0.0002,-1.571) [-1.571|1.571] "rad" MCU
 SG_ OBJ_Angle_Side_V_16 : 16270|1@1+ (1,0) [0|1] "bool" MCU
 SG_ OBJ_Angle_Side_STD_16 : 16271|14@1+ (0.0001,0) [0|1.571] "rad" MCU
 SG_ OBJ_Angle_Side_STD_V_16 : 16285|1@1+ (1,0) [0|1] "bool" MCU
 SG_ OBJ_Angle_Mid_V_16 : 16286|1@1+ (1,0) [0|1] "bool" MCU
 SG_ Reserved_23_16 : 16287|1@1+ (1,0) [0|0] "NA" MCU
 SG_ OBJ_Angle_Mid_16 : 16288|14@1+ (0.0002,-1.571) [-1.571|1.571] "rad" MCU
 SG_ OBJ_Angle_Mid_STD_16 : 16302|14@1+ (0.0001,0) [0|1.571] "rad" MCU
 SG_ OBJ_Angle_Mid_STD_V_16 : 16316|1@1+ (1,0) [0|1] "bool" MCU
 SG_ OBJ_Angle_Bottom_V_16 : 16317|1@1+ (1,0) [0|1] "bool" MCU
 SG_ Reserved_24_16 : 16318|2@1+ (1,0) [0|0] "NA" MCU
 SG_ OBJ_Angle_Bottom_16 : 16320|14@1+ (0.0002,-1.571) [-1.571|1.571] "rad" MCU
 SG_ OBJ_Angle_Bottom_STD_16 : 16334|14@1+ (0.0001,0) [0|1.571] "rad" MCU
 SG_ OBJ_Angle_Bottom_STD_V_16 : 16348|1@1+ (1,0) [0|1] "bool" MCU
 SG_ OBJ_Visibility_Side_V_16 : 16349|1@1+ (1,0) [0|1] "bool" MCU
 SG_ OBJ_Visibility_Side_16 : 16350|2@1+ (1,0) [0|2] "ENUM" MCU
 SG_ OBJ_Is_In_Drivable_Area_16 : 16352|1@1+ (1,0) [0|1] "bool" MCU
 SG_ OBJ_Is_In_Drivable_Area_V_16 : 16353|1@1+ (1,0) [0|1] "bool" MCU
 SG_ OBJ_Is_VeryClose_V_16 : 16354|1@1+ (1,0) [0|1] "bool" MCU
 SG_ OBJ_Is_VeryClose_16 : 16355|1@1+ (1,0) [0|1] "bool" MCU
 SG_ OBJ_Buffer_C4_16 : 16356|2@1+ (1,0) [0|2] "NA" MCU
 SG_ OBJ_Buffer_C5_16 : 16358|2@1+ (1,0) [0|2] "NA" MCU
 SG_ OBJ_Buffer_C6_16 : 16360|2@1+ (1,0) [0|2] "NA" MCU
 SG_ OBJ_Buffer_C7_16 : 16362|2@1+ (1,0) [0|2] "NA" MCU
 SG_ OBJ_OverlapAngleEgoLaneR_16 : 16364|10@1+ (0.01,-3.14) [-3.14|3.14] "rad" MCU
 SG_ OBJ_OverlapAngleEgoLaneR_V_16 : 16374|1@1+ (1,0) [0|1] "bool" MCU
 SG_ Reserved_25_16 : 16375|9@1+ (1,0) [0|0] "NA" MCU
 SG_ OBJ_OverlapAngleEgoLaneL_16 : 16384|10@1+ (0.01,-3.14) [-3.14|3.14] "rad" MCU
 SG_ OBJ_OverlapAngleEgoLaneL_V_16 : 16394|1@1+ (1,0) [0|1] "bool" MCU
 SG_ OBJ_Is_EMERGENCY_VCL_16 : 16395|1@1+ (1,0) [0|1] "bool" MCU
 SG_ OBJ_EMERGENCY_LIGHT_COLOR_16 : 16396|4@1+ (1,0) [0|15] "BITWIZE" MCU
 SG_ OBJ_EMERGENCY_V_16 : 16400|1@1+ (1,0) [0|1] "bool" MCU
 SG_ OBJ_Angle_Top_16 : 16401|14@1+ (0.0002,0) [0|3.1415] "rad" MCU
 SG_ OBJ_Angle_Top_V_16 : 16415|1@1+ (1,0) [0|1] "bool" MCU
 SG_ OBJ_Angle_Top_STD_16 : 16416|15@1+ (0.0001,0) [0|3.1415] "rad" MCU
 SG_ OBJ_Angle_Top_STD_V_16 : 16431|1@1+ (1,0) [0|1] "bool" MCU
 SG_ OBJ_Open_Door_Left_16 : 16432|1@1+ (1,0) [0|1] "bool" MCU
 SG_ OBJ_Open_Door_Right_16 : 16433|1@1+ (1,0) [0|1] "bool" MCU
 SG_ OBJ_Visible_Left_or_Right_16 : 16434|2@1+ (1,0) [0|2] "ENUM" MCU
 SG_ OBJ_Visible_Left_or_Right_V_16 : 16436|1@1+ (1,0) [0|1] "bool" MCU
 SG_ OBJ_2W_Is_Motorbike_Probability_16 : 16437|8@1+ (0.01,0) [0|1] "NA" MCU
 SG_ Reserved_26_16 : 16445|3@1+ (1,0) [0|0] "NA" MCU
 SG_ OBJ_2W_Is_Bicycle_Probability_16 : 16448|8@1+ (0.01,0) [0|1] "NA" MCU
 SG_ Reserved_27_16 : 16456|24@1+ (1,0) [0|0] "NA" MCU
 SG_ OBJ_CRC_17 : 16480|32@1+ (1,0) [0|4294967295] "NA" MCU
 SG_ OBJ_ID_17 : 16512|8@1+ (1,0) [0|255] "counter" MCU
 SG_ OBJ_Existence_Probability_17 : 16520|8@1+ (0.01,0) [0|1] "NA" MCU
 SG_ OBJ_Fusion_Source_17 : 16528|16@1+ (1,0) [0|65535] "BITWIZE" MCU
 SG_ OBJ_Triggered_SDM_17 : 16544|2@1+ (1,0) [0|2] "ENUM" MCU
 SG_ OBJ_Motion_Category_17 : 16546|4@1+ (1,0) [0|13] "ENUM" MCU
 SG_ OBJ_Moving_IN_Probability_17 : 16550|7@1+ (0.01,0) [0|1] "NA" MCU
 SG_ OBJ_Object_Age_17 : 16557|11@1+ (1,0) [0|2047] "frames" MCU
 SG_ OBJ_Measuring_Status_17 : 16568|3@1+ (1,0) [0|7] "BITWIZE" MCU
 SG_ OBJ_Object_Class_17 : 16571|4@1+ (1,0) [0|9] "ENUM" MCU
 SG_ Reserved_4_17 : 16575|1@1+ (1,0) [0|0] "NA" MCU
 SG_ OBJ_Class_Probability_17 : 16576|7@1+ (0.01,0) [0|1] "NA" MCU
 SG_ OBJ_Car_Probability_17 : 16583|7@1+ (0.01,0) [0|1] "NA" MCU
 SG_ OBJ_Truck_Probability_17 : 16590|7@1+ (0.01,0) [0|1] "NA" MCU
 SG_ OBJ_Bike_Probability_17 : 16597|7@1+ (0.01,0) [0|1] "NA" MCU
 SG_ OBJ_Camera_Source_17 : 16604|4@1+ (1,0) [0|15] "ENUM" MCU
 SG_ OBJ_Motion_Status_17 : 16608|3@1+ (1,0) [0|5] "ENUM" MCU
 SG_ OBJ_Motion_Orientation_17 : 16611|4@1+ (1,0) [0|13] "ENUM" MCU
 SG_ OBJ_Has_Cut_Lane_17 : 16615|1@1+ (1,0) [0|1] "bool" MCU
 SG_ OBJ_Has_Cut_Path_17 : 16616|1@1+ (1,0) [0|1] "bool" MCU
 SG_ OBJ_Brake_Light_Validity_17 : 16617|1@1+ (1,0) [0|1] "bool" MCU
 SG_ OBJ_Brake_Light_17 : 16618|1@1+ (1,0) [0|1] "bool" MCU
 SG_ OBJ_Turn_Indicator_Right_17 : 16619|1@1+ (1,0) [0|1] "bool" MCU
 SG_ OBJ_Turn_Indicator_Left_17 : 16620|1@1+ (1,0) [0|1] "bool" MCU
 SG_ OBJ_Turn_Indicator_Validity_17 : 16621|1@1+ (1,0) [0|1] "bool" MCU
 SG_ OBJ_Right_Out_Of_Image_17 : 16622|1@1+ (1,0) [0|1] "bool" MCU
 SG_ OBJ_Left_Out_Of_Image_17 : 16623|1@1+ (1,0) [0|1] "bool" MCU
 SG_ OBJ_Right_Out_Of_Image_V_17 : 16624|1@1+ (1,0) [0|1] "bool" MCU
 SG_ OBJ_Left_Out_Of_Image_V_17 : 16625|1@1+ (1,0) [0|1] "bool" MCU
 SG_ OBJ_Top_Out_Of_Image_17 : 16626|1@1+ (1,0) [0|1] "bool" MCU

CM_ SG_ 154 OBJ_Rel_Long_Acc_STD_V_11 "Validator for the STD of the relative longitudinal ground acceleration.";
CM_ SG_ 154 OBJ_Relative_Long_Velocity_11 "The relative longtitudinal speed between the target and ego vehicle. ";
CM_ SG_ 154 OBJ_Relative_Long_Velocity_V_11 "Validator for the relative longtitudinal speed.";
CM_ SG_ 154 OBJ_Relative_Long_Vel_STD_11 "STD of the relative longtitudinal speed.";
CM_ SG_ 154 OBJ_Rel_Long_Vel_STD_V_11 "Validator for the STD of the relative longtitudinal speed.";
CM_ SG_ 154 OBJ_Relative_Lat_Velocity_11 "The relative lateral speed between the target and ego vehicle. ";
CM_ SG_ 154 OBJ_Relative_Lat_Velocity_V_11 "Validator for the relative lateral speed. ";
CM_ SG_ 154 OBJ_Relative_Lat_Velocity_STD_11 "STD of the relative lateral speed. ";
CM_ SG_ 154 OBJ_Rel_Lat_Vel_STD_V_11 "Validator for the STD of the relative lateral speed. ";
CM_ SG_ 154 OBJ_Long_Distance_11 "The longitudinal distance to middle of the rear bumper (middle of the RL and RR corners) of the target.";
CM_ SG_ 154 OBJ_Long_Distance_V_11 "Validator of the longtitudinal distance field";
CM_ SG_ 154 OBJ_Long_Distance_STD_11 "STD of the  longtitudinal distance.";
CM_ SG_ 154 OBJ_Long_Distance_STD_V_11 "Validator for the STD of the  longtitudinal distance.";
CM_ SG_ 154 OBJ_Lat_Distance_11 "Lateral distance to the middle of the RL and RR corners.  ";
CM_ SG_ 154 OBJ_Lat_Distance_V_11 "Validator for the lateral distance of the object.";
CM_ SG_ 154 OBJ_Lat_Distance_STD_11 "STD of the lateral distance of the object.";
CM_ SG_ 154 OBJ_Lat_Distance_STD_V_11 "Validator for the STD of the lateral distance of the object.";
CM_ SG_ 154 OBJ_Absolute_Speed_11 "The absolute ground speed in the targets' heading direction.";
CM_ SG_ 154 OBJ_Absolute_Speed_V_11 "Validator for the absolute ground speed.";
CM_ SG_ 154 OBJ_Absolute_Speed_STD_11 "STD of the absolute ground speed.";
CM_ SG_ 154 OBJ_Absolute_Speed_STD_V_11 "Validator for the STD of the absolute ground speed.";
CM_ SG_ 154 OBJ_Heading_11 "The angle beetweenthe host longitudinal axis and target's heading (clockwise, e.g. PI/2 is a target crossing from left to right).";
CM_ SG_ 154 OBJ_Heading_V_11 "Validator for the object heading.";
CM_ SG_ 154 OBJ_Heading_STD_11 "STD of the object heading.";
CM_ SG_ 154 OBJ_Heading_STD_V_11 "Validator for the STD of the object heading.";
CM_ SG_ 154 OBJ_Angle_Rate_STD_11 "Standard deviation of the angular speed. (radians)";
CM_ SG_ 154 OBJ_Angle_Rate_STD_V_11 "Validator for the STD of the angular speed.";
CM_ SG_ 154 OBJ_Angle_Rate_11 "The momentary angular speed of the object (radians). The positive side is to the host's right.";
CM_ SG_ 154 OBJ_Angle_Rate_V_11 "Validator for the angular speed.";
CM_ SG_ 154 OBJ_Angle_Right_11 "The angle between the host longitudinal axis and the right side of the front / rear of the target (the visible one). The positive side is to the host's right.";
CM_ SG_ 154 OBJ_Angle_Right_V_11 "Validator for angleRight";
CM_ SG_ 154 OBJ_Angle_Right_STD_11 "Standard deviation of angleRight";
CM_ SG_ 154 OBJ_Angle_Right_STD_V_11 "Validator for the standard deviation of angleRight.";
CM_ SG_ 154 OBJ_Angle_Left_11 "The angle between the host longitudinal axis and the left side of the front / rear of the target (the visible one). The positive side is to the host's right.";
CM_ SG_ 154 OBJ_Angle_Left_V_11 "Validator for angleLeft.";
CM_ SG_ 154 OBJ_Angle_Left_STD_11 "Standard deviation of angleLeft.";
CM_ SG_ 154 OBJ_Angle_Left_STD_V_11 "Validator for the standard deviation of angleLeft.";
CM_ SG_ 154 OBJ_Angle_Side_11 "The angle between the host longitudinal axis and the far visible edge - the visible edge of the front / rear of the target that is not visible. Currently supported for vehicles only.";
CM_ SG_ 154 OBJ_Angle_Side_V_11 "Validator for angleSide.";
CM_ SG_ 154 OBJ_Angle_Side_STD_11 "Standard deviation of angleSide.";
CM_ SG_ 154 OBJ_Angle_Side_STD_V_11 "Validator for the STD of angleSide.";
CM_ SG_ 154 OBJ_Angle_Mid_V_11 "Validator for angleMid.";
CM_ SG_ 154 OBJ_Angle_Mid_11 "The angle between the host longitudinal axis and the middle of the front / rear of the target (the visible one). The positive side is to the host's right.";
CM_ SG_ 154 OBJ_Angle_Mid_STD_11 "Standard deviation of angleMid.";
CM_ SG_ 154 OBJ_Angle_Mid_STD_V_11 "Validator for the STD of angleMid.";
CM_ SG_ 154 OBJ_Angle_Bottom_V_11 "Validator for OBJAngle_Bottom. ";
CM_ SG_ 154 OBJ_Angle_Bottom_11 "The angle between the longitudinal axis and the Bottom of the front / rear of the target (the visible one). The positive side is to the host's bottom";
CM_ SG_ 154 OBJ_Angle_Bottom_STD_11 "STD for OBJAngle_Bottom. ";
CM_ SG_ 154 OBJ_Angle_Bottom_STD_V_11 "Validator for OBJAngle_Bottom_STD. ";
CM_ SG_ 154 OBJ_Visibility_Side_V_11 "Currently Supported for VD only";
CM_ SG_ 154 OBJ_Visibility_Side_11 "From what car  side is the object visible";
CM_ SG_ 154 OBJ_Is_In_Drivable_Area_11 "Indicates whether the target is in a driveable area.";
CM_ SG_ 154 OBJ_Is_In_Drivable_Area_V_11 "Validator for OBJ_Is_In_Drivable_Area.";
CM_ SG_ 154 OBJ_Is_VeryClose_V_11 "Validator for OBJ_Is_VeryClose. ";
CM_ SG_ 154 OBJ_Is_VeryClose_11 "Indicates whether the target is very close to the host such that it is hard to measure its distance. Currently relevant for peds only";
CM_ SG_ 154 OBJ_OverlapAngleEgoLaneR_11 "Lateral distance to the middle of the RL and RR corners.";
CM_ SG_ 154 OBJ_OverlapAngleEgoLaneR_V_11 "Validator for OBJ_OverlapAngleEgoLaneR";
CM_ SG_ 154 OBJ_OverlapAngleEgoLaneL_11 "Lateral distance to the middle of the RL and RR corners.  ";
CM_ SG_ 154 OBJ_OverlapAngleEgoLaneL_V_11 "Validator for OBJ_OverlapAngleEgoLaneL";
CM_ SG_ 154 OBJ_Is_EMERGENCY_VCL_11 "Is Object an Emergency Vehicle";
CM_ SG_ 154 OBJ_EMERGENCY_LIGHT_COLOR_11 "Emergency Color";
CM_ SG_ 154 OBJ_EMERGENCY_V_11 "Are OBJ_Is_EMERGENCY_VCL and OBJ_EMERGENCY_LIGHT_COLOR Valid";
CM_ SG_ 154 OBJ_Angle_Top_11 "From VD touching point on the ground till the roof of the car";
CM_ SG_ 154 OBJ_Angle_Top_V_11 "Validator for OBJ_Angle_Top ";
CM_ SG_ 154 OBJ_Angle_Top_STD_11 "STD for OBJ_Angle_Top";
CM_ SG_ 154 OBJ_Angle_Top_STD_V_11 "Validator for OBJ_Angle_Top_STD. ";
CM_ SG_ 154 OBJ_Open_Door_Left_11 "Indicator if left door is open";
CM_ SG_ 154 OBJ_Open_Door_Right_11 "Indicator if right door is open";
CM_ SG_ 154 OBJ_Visible_Left_or_Right_11 "This signal describes the visible Left or Right side of the Target vehicle.";
CM_ SG_ 154 OBJ_Visible_Left_or_Right_V_11 "OBJ_Visible_Left_or_Right";
CM_ SG_ 154 OBJ_2W_Is_Motorbike_Probability_11 "The probability of the Two-wheeler reported object being a Motorbike";
CM_ SG_ 154 OBJ_2W_Is_Bicycle_Probability_11 "The probability of the Two-wheeler reported object being a Bicycle";
CM_ SG_ 154 OBJ_CRC_12 "Calculated over all element signals. From the signal after the CRC until the first signal in the next elements OBJ_CRC_N+1  not including";
CM_ SG_ 154 OBJ_ID_12 "The detected object ID. Range is 1-255, while 0 indicates that the field in unfilled.";
CM_ SG_ 154 OBJ_Existence_Probability_12 "The existence probability of the reported object";
CM_ SG_ 154 OBJ_Fusion_Source_12 "sources ids used for fusion";
CM_ SG_ 154 OBJ_Triggered_SDM_12 "Indicates whether the object has trigered the SDM (Safety Diagnostic Manager) alert.";
CM_ SG_ 154 OBJ_Motion_Category_12 "Relevant for VD only. Full description of values can be found at the ACC guide.";
CM_ SG_ 154 OBJ_Moving_IN_Probability_12 "The probability the object is eventually move into ego lane. (In case that the OBJ_Motion_Category signal is set to  MOVING_IN ";
CM_ SG_ 154 OBJ_Object_Age_12 "The number of frames in which the object was recognized.";
CM_ SG_ 154 OBJ_Measuring_Status_12 "Measurment status. Old vs New marks if this is the first frame in which the object is reported. Predicted vs Measured marks if the report is raw or has been predicted forward in time using the measured dynamics and ego motion.";
CM_ SG_ 154 OBJ_Object_Class_12 "Indicates the object type. Uncertain is outputted in case the probability that a vehicle is a truck is very similar to the probability that it is a car.";
CM_ SG_ 154 OBJ_Class_Probability_12 "The probability of this type classification.";
CM_ SG_ 154 OBJ_Car_Probability_12 "The probability the object is a car";
CM_ SG_ 154 OBJ_Truck_Probability_12 "The probability the object is a Truck";
CM_ SG_ 154 OBJ_Bike_Probability_12 "The probability the object is a Bike";
CM_ SG_ 154 OBJ_Camera_Source_12 "The camera in which this object was detected (best choice).";
CM_ SG_ 154 OBJ_Motion_Status_12 "MOVING - the object is moving STATIONARY - the object was never seen moving STOPPED -  the object was moving and has stopped MOVING_SLOWLY - the object is moving very slowly";
CM_ SG_ 154 OBJ_Motion_Orientation_12 "The direction of the targets heading compared to the host. ";
CM_ SG_ 154 OBJ_Has_Cut_Lane_12 "Indicates whether the object cut the host's (right or left) lane. In case there are no lanes, indicates whether the objects is at most 1 meters away from the host.";
CM_ SG_ 154 OBJ_Has_Cut_Path_12 "Indicates whether the object is in the host's path.";
CM_ SG_ 154 OBJ_Brake_Light_Validity_12 "Validator for braking light indicator";
CM_ SG_ 154 OBJ_Brake_Light_12 "Indication for brake lights ";
CM_ SG_ 154 OBJ_Turn_Indicator_Right_12 "Indication for blinking right light.";
CM_ SG_ 154 OBJ_Turn_Indicator_Left_12 "Indication for blinking left light ";
CM_ SG_ 154 OBJ_Turn_Indicator_Validity_12 "Validator for light indicators";
CM_ SG_ 154 OBJ_Right_Out_Of_Image_12 "Indicates whether the measurment are predicted out of the right side of the image bounderies.";
CM_ SG_ 154 OBJ_Left_Out_Of_Image_12 "Indicates whether if measurment are predicted out of  the left side of the image bounderies";
CM_ SG_ 154 OBJ_Right_Out_Of_Image_V_12 "validator";
CM_ SG_ 154 OBJ_Left_Out_Of_Image_V_12 "validator";
CM_ SG_ 154 OBJ_Top_Out_Of_Image_12 "Indicates whether if measurment are predicted out of  the top of the image bounderies";
CM_ SG_ 154 OBJ_Bottom_Out_Of_Image_12 "Indicates whether if measurment are predicted out of  the bottom of the image bounderies";
CM_ SG_ 154 OBJ_Top_Out_Of_Image_V_12 "validator";
CM_ SG_ 154 OBJ_Bottom_Out_Of_Image_V_12 "validator";
CM_ SG_ 154 OBJ_Lane_Assignment_12 "The object's lane relative to the host lane.";
CM_ SG_ 154 OBJ_Lane_Assignment_V_12 "Validator for lane assignment";
CM_ SG_ 154 OBJ_Age_Seconds_12 "Time in seconds in which the object was recognized. ";
CM_ SG_ 154 OBJ_Age_Seconds_V_12 "Validator for object age";
CM_ SG_ 154 OBJ_Width_12 "The width of the target vehicle in the world (not to be mistaken with the width of the visible part of the vehicle).";
CM_ SG_ 154 OBJ_Width_V_12 "Validator for object width";
CM_ SG_ 154 OBJ_Width_STD_12 "Standard deviation for object width";
CM_ SG_ 154 OBJ_Width_STD_V_12 "Validator for the standard deviation of object width";
CM_ SG_ 154 OBJ_Length_12 "The length of the vehicle in the world. For crossing bicycles it gives the viewed length of the bicycle.";
CM_ SG_ 154 OBJ_Length_V_12 "Validator for object length.";
CM_ SG_ 154 OBJ_Length_STD_12 "Standard deviation for object length.";
CM_ SG_ 154 OBJ_Length_STD_V_12 "Validator for the standard deviation of object length.";
CM_ SG_ 154 OBJ_Radar_ID_12 "Radar Object ID of the Fused Object, Only relvant when OBJ_Fusion_Source is not Camera only";
CM_ SG_ 154 OBJ_Height_12 "The height of the object in the world. ";
CM_ SG_ 154 OBJ_Height_V_12 "Validator for object height.";
CM_ SG_ 154 OBJ_Height_STD_12 "Standard deviation for object height.";
CM_ SG_ 154 OBJ_Height_STD_V_12 "Validator for the standard deviation of object height.";
CM_ SG_ 154 OBJ_Abs_Long_Velocity_12 "Absolute longitudinal velocity.";
CM_ SG_ 154 OBJ_Abs_Long_Velocity_V_12 "Validator for absolute longitudinal velocity.";
CM_ SG_ 154 OBJ_Abs_Long_Velocity_STD_12 "Standard deviation of absolute longitudinal velocity.";
CM_ SG_ 154 OBJ_Abs_Long_Vel_STD_V_12 "Validator for the standard deviation of the absolute longitudinal velocity.";
CM_ SG_ 154 OBJ_Abs_Lat_Velocity_12 "The lateral ground speed of the object.";
CM_ SG_ 154 OBJ_Abs_Lat_Velocity_V_12 "Validator for the lateral ground speed of the object.";
CM_ SG_ 154 OBJ_Abs_Lat_Velocity_STD_12 "STD of the lateral ground speed of the object.";
CM_ SG_ 154 OBJ_Abs_Lat_Vel_STD_V_12 "Validator for the STD of the lateral ground speed of the object.";
CM_ SG_ 154 OBJ_Abs_Long_Acc_12 "The longitudinal ground acceleration of the object.";
CM_ SG_ 154 OBJ_Abs_Long_Acc_V_12 "Validator for the longitudinal ground acceleration of the object.";
CM_ SG_ 154 OBJ_Abs_Long_Acc_STD_12 "STD of the longitudinal ground acceleration of the object.";
CM_ SG_ 154 OBJ_Abs_Long_Acc_STD_V_12 "Validator for the STD of the longitudinal ground acceleration of the object.";
CM_ SG_ 154 OBJ_Abs_Lat_Acc_12 "The lateral ground acceleration of the object.";
CM_ SG_ 154 OBJ_Abs_Lat_Acc_V_12 "Validator for the lateral ground acceleration of the object.";
CM_ SG_ 154 OBJ_Abs_Lat_Acc_STD_12 "STD of the lateral ground acceleration of the object.";
CM_ SG_ 154 OBJ_Abs_Lat_Acc_STD_V_12 "Validator for the STD of the lateral ground acceleration of the object.";
CM_ SG_ 154 OBJ_Abs_Acceleration_12 "The absolute ground acceleration in the target's heading direction.";
CM_ SG_ 154 OBJ_Abs_Acceleration_V_12 "Validator for the absolute ground acceleration.";
CM_ SG_ 154 OBJ_Abs_Acc_STD_12 "STD of the absolute ground acceleration.";
CM_ SG_ 154 OBJ_Abs_Acc_STD_V_12 "Validator for the STD of the absolute ground acceleration.";
CM_ SG_ 154 OBJ_Inv_TTC_12 "Inverse TTC (time to collision).";
CM_ SG_ 154 OBJ_Inv_TTC_STD_12 "STD for inverse TTC .";
CM_ SG_ 154 OBJ_Inv_TTC_STD_V_12 "Validator for the STD for inverse TTC .";
CM_ SG_ 154 OBJ_Relative_Long_Acc_12 "The relative longitudinal ground acceleration of the object.";
CM_ SG_ 154 OBJ_Relative_Long_Acc_V_12 "Validator for the relative longitudinal ground acceleration of the object.";
CM_ SG_ 154 OBJ_Relative_Long_Acc_STD_12 "STD of the relative longitudinal ground acceleration of the object.";
CM_ SG_ 154 OBJ_Rel_Long_Acc_STD_V_12 "Validator for the STD of the relative longitudinal ground acceleration.";
CM_ SG_ 154 OBJ_Relative_Long_Velocity_12 "The relative longtitudinal speed between the target and ego vehicle. ";
CM_ SG_ 154 OBJ_Relative_Long_Velocity_V_12 "Validator for the relative longtitudinal speed.";
CM_ SG_ 154 OBJ_Relative_Long_Vel_STD_12 "STD of the relative longtitudinal speed.";
CM_ SG_ 154 OBJ_Rel_Long_Vel_STD_V_12 "Validator for the STD of the relative longtitudinal speed.";
CM_ SG_ 154 OBJ_Relative_Lat_Velocity_12 "The relative lateral speed between the target and ego vehicle. ";
CM_ SG_ 154 OBJ_Relative_Lat_Velocity_V_12 "Validator for the relative lateral speed. ";
CM_ SG_ 154 OBJ_Relative_Lat_Velocity_STD_12 "STD of the relative lateral speed. ";
CM_ SG_ 154 OBJ_Rel_Lat_Vel_STD_V_12 "Validator for the STD of the relative lateral speed. ";
CM_ SG_ 154 OBJ_Long_Distance_12 "The longitudinal distance to middle of the rear bumper (middle of the RL and RR corners) of the target.";
CM_ SG_ 154 OBJ_Long_Distance_V_12 "Validator of the longtitudinal distance field";
CM_ SG_ 154 OBJ_Long_Distance_STD_12 "STD of the  longtitudinal distance.";
CM_ SG_ 154 OBJ_Long_Distance_STD_V_12 "Validator for the STD of the  longtitudinal distance.";
CM_ SG_ 154 OBJ_Lat_Distance_12 "Lateral distance to the middle of the RL and RR corners.  ";
CM_ SG_ 154 OBJ_Lat_Distance_V_12 "Validator for the lateral distance of the object.";
CM_ SG_ 154 OBJ_Lat_Distance_STD_12 "STD of the lateral distance of the object.";
CM_ SG_ 154 OBJ_Lat_Distance_STD_V_12 "Validator for the STD of the lateral distance of the object.";
CM_ SG_ 154 OBJ_Absolute_Speed_12 "The absolute ground speed in the targets' heading direction.";
CM_ SG_ 154 OBJ_Absolute_Speed_V_12 "Validator for the absolute ground speed.";
CM_ SG_ 154 OBJ_Absolute_Speed_STD_12 "STD of the absolute ground speed.";
CM_ SG_ 154 OBJ_Absolute_Speed_STD_V_12 "Validator for the STD of the absolute ground speed.";
CM_ SG_ 154 OBJ_Heading_12 "The angle beetweenthe host longitudinal axis and target's heading (clockwise, e.g. PI/2 is a target crossing from left to right).";
CM_ SG_ 154 OBJ_Heading_V_12 "Validator for the object heading.";
CM_ SG_ 154 OBJ_Heading_STD_12 "STD of the object heading.";
CM_ SG_ 154 OBJ_Heading_STD_V_12 "Validator for the STD of the object heading.";
CM_ SG_ 154 OBJ_Angle_Rate_STD_12 "Standard deviation of the angular speed. (radians)";
CM_ SG_ 154 OBJ_Angle_Rate_STD_V_12 "Validator for the STD of the angular speed.";
CM_ SG_ 154 OBJ_Angle_Rate_12 "The momentary angular speed of the object (radians). The positive side is to the host's right.";
CM_ SG_ 154 OBJ_Angle_Rate_V_12 "Validator for the angular speed.";
CM_ SG_ 154 OBJ_Angle_Right_12 "The angle between the host longitudinal axis and the right side of the front / rear of the target (the visible one). The positive side is to the host's right.";
CM_ SG_ 154 OBJ_Angle_Right_V_12 "Validator for angleRight";
CM_ SG_ 154 OBJ_Angle_Right_STD_12 "Standard deviation of angleRight";
CM_ SG_ 154 OBJ_Angle_Right_STD_V_12 "Validator for the standard deviation of angleRight.";
CM_ SG_ 154 OBJ_Angle_Left_12 "The angle between the host longitudinal axis and the left side of the front / rear of the target (the visible one). The positive side is to the host's right.";
CM_ SG_ 154 OBJ_Angle_Left_V_12 "Validator for angleLeft.";
CM_ SG_ 154 OBJ_Angle_Left_STD_12 "Standard deviation of angleLeft.";
CM_ SG_ 154 OBJ_Angle_Left_STD_V_12 "Validator for the standard deviation of angleLeft.";
CM_ SG_ 154 OBJ_Angle_Side_12 "The angle between the host longitudinal axis and the far visible edge - the visible edge of the front / rear of the target that is not visible. Currently supported for vehicles only.";
CM_ SG_ 154 OBJ_Angle_Side_V_12 "Validator for angleSide.";
CM_ SG_ 154 OBJ_Angle_Side_STD_12 "Standard deviation of angleSide.";
CM_ SG_ 154 OBJ_Angle_Side_STD_V_12 "Validator for the STD of angleSide.";
CM_ SG_ 154 OBJ_Angle_Mid_V_12 "Validator for angleMid.";
CM_ SG_ 154 OBJ_Angle_Mid_12 "The angle between the host longitudinal axis and the middle of the front / rear of the target (the visible one). The positive side is to the host's right.";
CM_ SG_ 154 OBJ_Angle_Mid_STD_12 "Standard deviation of angleMid.";
CM_ SG_ 154 OBJ_Angle_Mid_STD_V_12 "Validator for the STD of angleMid.";
CM_ SG_ 154 OBJ_Angle_Bottom_V_12 "Validator for OBJAngle_Bottom. ";
CM_ SG_ 154 OBJ_Angle_Bottom_12 "The angle between the longitudinal axis and the Bottom of the front / rear of the target (the visible one). The positive side is to the host's bottom";
CM_ SG_ 154 OBJ_Angle_Bottom_STD_12 "STD for OBJAngle_Bottom. ";
CM_ SG_ 154 OBJ_Angle_Bottom_STD_V_12 "Validator for OBJAngle_Bottom_STD. ";
CM_ SG_ 154 OBJ_Visibility_Side_V_12 "Currently Supported for VD only";
CM_ SG_ 154 OBJ_Visibility_Side_12 "From what car  side is the object visible";
CM_ SG_ 154 OBJ_Is_In_Drivable_Area_12 "Indicates whether the target is in a driveable area.";
CM_ SG_ 154 OBJ_Is_In_Drivable_Area_V_12 "Validator for OBJ_Is_In_Drivable_Area.";
CM_ SG_ 154 OBJ_Is_VeryClose_V_12 "Validator for OBJ_Is_VeryClose. ";
CM_ SG_ 154 OBJ_Is_VeryClose_12 "Indicates whether the target is very close to the host such that it is hard to measure its distance. Currently relevant for peds only";
CM_ SG_ 154 OBJ_OverlapAngleEgoLaneR_12 "Lateral distance to the middle of the RL and RR corners.";
CM_ SG_ 154 OBJ_OverlapAngleEgoLaneR_V_12 "Validator for OBJ_OverlapAngleEgoLaneR";
CM_ SG_ 154 OBJ_OverlapAngleEgoLaneL_12 "Lateral distance to the middle of the RL and RR corners.  ";
CM_ SG_ 154 OBJ_OverlapAngleEgoLaneL_V_12 "Validator for OBJ_OverlapAngleEgoLaneL";
CM_ SG_ 154 OBJ_Is_EMERGENCY_VCL_12 "Is Object an Emergency Vehicle";
CM_ SG_ 154 OBJ_EMERGENCY_LIGHT_COLOR_12 "Emergency Color";
CM_ SG_ 154 OBJ_EMERGENCY_V_12 "Are OBJ_Is_EMERGENCY_VCL and OBJ_EMERGENCY_LIGHT_COLOR Valid";
CM_ SG_ 154 OBJ_Angle_Top_12 "From VD touching point on the ground till the roof of the car";
CM_ SG_ 154 OBJ_Angle_Top_V_12 "Validator for OBJ_Angle_Top ";
CM_ SG_ 154 OBJ_Angle_Top_STD_12 "STD for OBJ_Angle_Top";
CM_ SG_ 154 OBJ_Angle_Top_STD_V_12 "Validator for OBJ_Angle_Top_STD. ";
CM_ SG_ 154 OBJ_Open_Door_Left_12 "Indicator if left door is open";
CM_ SG_ 154 OBJ_Open_Door_Right_12 "Indicator if right door is open";
CM_ SG_ 154 OBJ_Visible_Left_or_Right_12 "This signal describes the visible Left or Right side of the Target vehicle.";
CM_ SG_ 154 OBJ_Visible_Left_or_Right_V_12 "OBJ_Visible_Left_or_Right";
CM_ SG_ 154 OBJ_2W_Is_Motorbike_Probability_12 "The probability of the Two-wheeler reported object being a Motorbike";
CM_ SG_ 154 OBJ_2W_Is_Bicycle_Probability_12 "The probability of the Two-wheeler reported object being a Bicycle";
CM_ SG_ 154 OBJ_CRC_13 "Calculated over all element signals. From the signal after the CRC until the first signal in the next elements OBJ_CRC_N+1  not including";
CM_ SG_ 154 OBJ_ID_13 "The detected object ID. Range is 1-255, while 0 indicates that the field in unfilled.";
CM_ SG_ 154 OBJ_Existence_Probability_13 "The existence probability of the reported object";
CM_ SG_ 154 OBJ_Fusion_Source_13 "sources ids used for fusion";
CM_ SG_ 154 OBJ_Triggered_SDM_13 "Indicates whether the object has trigered the SDM (Safety Diagnostic Manager) alert.";
CM_ SG_ 154 OBJ_Motion_Category_13 "Relevant for VD only. Full description of values can be found at the ACC guide.";
CM_ SG_ 154 OBJ_Moving_IN_Probability_13 "The probability the object is eventually move into ego lane. (In case that the OBJ_Motion_Category signal is set to  MOVING_IN ";
CM_ SG_ 154 OBJ_Object_Age_13 "The number of frames in which the object was recognized.";
CM_ SG_ 154 OBJ_Measuring_Status_13 "Measurment status. Old vs New marks if this is the first frame in which the object is reported. Predicted vs Measured marks if the report is raw or has been predicted forward in time using the measured dynamics and ego motion.";
CM_ SG_ 154 OBJ_Object_Class_13 "Indicates the object type. Uncertain is outputted in case the probability that a vehicle is a truck is very similar to the probability that it is a car.";
CM_ SG_ 154 OBJ_Class_Probability_13 "The probability of this type classification.";
CM_ SG_ 154 OBJ_Car_Probability_13 "The probability the object is a car";
CM_ SG_ 154 OBJ_Truck_Probability_13 "The probability the object is a Truck";
CM_ SG_ 154 OBJ_Bike_Probability_13 "The probability the object is a Bike";
CM_ SG_ 154 OBJ_Camera_Source_13 "The camera in which this object was detected (best choice).";
CM_ SG_ 154 OBJ_Motion_Status_13 "MOVING - the object is moving STATIONARY - the object was never seen moving STOPPED -  the object was moving and has stopped MOVING_SLOWLY - the object is moving very slowly";
CM_ SG_ 154 OBJ_Motion_Orientation_13 "The direction of the targets heading compared to the host. ";
CM_ SG_ 154 OBJ_Has_Cut_Lane_13 "Indicates whether the object cut the host's (right or left) lane. In case there are no lanes, indicates whether the objects is at most 1 meters away from the host.";
CM_ SG_ 154 OBJ_Has_Cut_Path_13 "Indicates whether the object is in the host's path.";
CM_ SG_ 154 OBJ_Brake_Light_Validity_13 "Validator for braking light indicator";
CM_ SG_ 154 OBJ_Brake_Light_13 "Indication for brake lights ";
CM_ SG_ 154 OBJ_Turn_Indicator_Right_13 "Indication for blinking right light.";
CM_ SG_ 154 OBJ_Turn_Indicator_Left_13 "Indication for blinking left light ";
CM_ SG_ 154 OBJ_Turn_Indicator_Validity_13 "Validator for light indicators";
CM_ SG_ 154 OBJ_Right_Out_Of_Image_13 "Indicates whether the measurment are predicted out of the right side of the image bounderies.";
CM_ SG_ 154 OBJ_Left_Out_Of_Image_13 "Indicates whether if measurment are predicted out of  the left side of the image bounderies";
CM_ SG_ 154 OBJ_Right_Out_Of_Image_V_13 "validator";
CM_ SG_ 154 OBJ_Left_Out_Of_Image_V_13 "validator";
CM_ SG_ 154 OBJ_Top_Out_Of_Image_13 "Indicates whether if measurment are predicted out of  the top of the image bounderies";
CM_ SG_ 154 OBJ_Bottom_Out_Of_Image_13 "Indicates whether if measurment are predicted out of  the bottom of the image bounderies";
CM_ SG_ 154 OBJ_Top_Out_Of_Image_V_13 "validator";
CM_ SG_ 154 OBJ_Bottom_Out_Of_Image_V_13 "validator";
CM_ SG_ 154 OBJ_Lane_Assignment_13 "The object's lane relative to the host lane.";
CM_ SG_ 154 OBJ_Lane_Assignment_V_13 "Validator for lane assignment";
CM_ SG_ 154 OBJ_Age_Seconds_13 "Time in seconds in which the object was recognized. ";
CM_ SG_ 154 OBJ_Age_Seconds_V_13 "Validator for object age";
CM_ SG_ 154 OBJ_Width_13 "The width of the target vehicle in the world (not to be mistaken with the width of the visible part of the vehicle).";
CM_ SG_ 154 OBJ_Width_V_13 "Validator for object width";
CM_ SG_ 154 OBJ_Width_STD_13 "Standard deviation for object width";
CM_ SG_ 154 OBJ_Width_STD_V_13 "Validator for the standard deviation of object width";
CM_ SG_ 154 OBJ_Length_13 "The length of the vehicle in the world. For crossing bicycles it gives the viewed length of the bicycle.";
CM_ SG_ 154 OBJ_Length_V_13 "Validator for object length.";
CM_ SG_ 154 OBJ_Length_STD_13 "Standard deviation for object length.";
CM_ SG_ 154 OBJ_Length_STD_V_13 "Validator for the standard deviation of object length.";
CM_ SG_ 154 OBJ_Radar_ID_13 "Radar Object ID of the Fused Object, Only relvant when OBJ_Fusion_Source is not Camera only";
CM_ SG_ 154 OBJ_Height_13 "The height of the object in the world. ";
CM_ SG_ 154 OBJ_Height_V_13 "Validator for object height.";
CM_ SG_ 154 OBJ_Height_STD_13 "Standard deviation for object height.";
CM_ SG_ 154 OBJ_Height_STD_V_13 "Validator for the standard deviation of object height.";
CM_ SG_ 154 OBJ_Abs_Long_Velocity_13 "Absolute longitudinal velocity.";
CM_ SG_ 154 OBJ_Abs_Long_Velocity_V_13 "Validator for absolute longitudinal velocity.";
CM_ SG_ 154 OBJ_Abs_Long_Velocity_STD_13 "Standard deviation of absolute longitudinal velocity.";
CM_ SG_ 154 OBJ_Abs_Long_Vel_STD_V_13 "Validator for the standard deviation of the absolute longitudinal velocity.";
CM_ SG_ 154 OBJ_Abs_Lat_Velocity_13 "The lateral ground speed of the object.";
CM_ SG_ 154 OBJ_Abs_Lat_Velocity_V_13 "Validator for the lateral ground speed of the object.";
CM_ SG_ 154 OBJ_Abs_Lat_Velocity_STD_13 "STD of the lateral ground speed of the object.";
CM_ SG_ 154 OBJ_Abs_Lat_Vel_STD_V_13 "Validator for the STD of the lateral ground speed of the object.";
CM_ SG_ 154 OBJ_Abs_Long_Acc_13 "The longitudinal ground acceleration of the object.";
CM_ SG_ 154 OBJ_Abs_Long_Acc_V_13 "Validator for the longitudinal ground acceleration of the object.";
CM_ SG_ 154 OBJ_Abs_Long_Acc_STD_13 "STD of the longitudinal ground acceleration of the object.";
CM_ SG_ 154 OBJ_Abs_Long_Acc_STD_V_13 "Validator for the STD of the longitudinal ground acceleration of the object.";
CM_ SG_ 154 OBJ_Abs_Lat_Acc_13 "The lateral ground acceleration of the object.";
CM_ SG_ 154 OBJ_Abs_Lat_Acc_V_13 "Validator for the lateral ground acceleration of the object.";
CM_ SG_ 154 OBJ_Abs_Lat_Acc_STD_13 "STD of the lateral ground acceleration of the object.";
CM_ SG_ 154 OBJ_Abs_Lat_Acc_STD_V_13 "Validator for the STD of the lateral ground acceleration of the object.";
CM_ SG_ 154 OBJ_Abs_Acceleration_13 "The absolute ground acceleration in the target's heading direction.";
CM_ SG_ 154 OBJ_Abs_Acceleration_V_13 "Validator for the absolute ground acceleration.";
CM_ SG_ 154 OBJ_Abs_Acc_STD_13 "STD of the absolute ground acceleration.";
CM_ SG_ 154 OBJ_Abs_Acc_STD_V_13 "Validator for the STD of the absolute ground acceleration.";
CM_ SG_ 154 OBJ_Inv_TTC_13 "Inverse TTC (time to collision).";
CM_ SG_ 154 OBJ_Inv_TTC_STD_13 "STD for inverse TTC .";
CM_ SG_ 154 OBJ_Inv_TTC_STD_V_13 "Validator for the STD for inverse TTC .";
CM_ SG_ 154 OBJ_Relative_Long_Acc_13 "The relative longitudinal ground acceleration of the object.";
CM_ SG_ 154 OBJ_Relative_Long_Acc_V_13 "Validator for the relative longitudinal ground acceleration of the object.";
CM_ SG_ 154 OBJ_Relative_Long_Acc_STD_13 "STD of the relative longitudinal ground acceleration of the object.";
CM_ SG_ 154 OBJ_Rel_Long_Acc_STD_V_13 "Validator for the STD of the relative longitudinal ground acceleration.";
CM_ SG_ 154 OBJ_Relative_Long_Velocity_13 "The relative longtitudinal speed between the target and ego vehicle. ";
CM_ SG_ 154 OBJ_Relative_Long_Velocity_V_13 "Validator for the relative longtitudinal speed.";
CM_ SG_ 154 OBJ_Relative_Long_Vel_STD_13 "STD of the relative longtitudinal speed.";
CM_ SG_ 154 OBJ_Rel_Long_Vel_STD_V_13 "Validator for the STD of the relative longtitudinal speed.";
CM_ SG_ 154 OBJ_Relative_Lat_Velocity_13 "The relative lateral speed between the target and ego vehicle. ";
CM_ SG_ 154 OBJ_Relative_Lat_Velocity_V_13 "Validator for the relative lateral speed. ";
CM_ SG_ 154 OBJ_Relative_Lat_Velocity_STD_13 "STD of the relative lateral speed. ";
CM_ SG_ 154 OBJ_Rel_Lat_Vel_STD_V_13 "Validator for the STD of the relative lateral speed. ";
CM_ SG_ 154 OBJ_Long_Distance_13 "The longitudinal distance to middle of the rear bumper (middle of the RL and RR corners) of the target.";
CM_ SG_ 154 OBJ_Long_Distance_V_13 "Validator of the longtitudinal distance field";
CM_ SG_ 154 OBJ_Long_Distance_STD_13 "STD of the  longtitudinal distance.";
CM_ SG_ 154 OBJ_Long_Distance_STD_V_13 "Validator for the STD of the  longtitudinal distance.";
CM_ SG_ 154 OBJ_Lat_Distance_13 "Lateral distance to the middle of the RL and RR corners.  ";
CM_ SG_ 154 OBJ_Lat_Distance_V_13 "Validator for the lateral distance of the object.";
CM_ SG_ 154 OBJ_Lat_Distance_STD_13 "STD of the lateral distance of the object.";
CM_ SG_ 154 OBJ_Lat_Distance_STD_V_13 "Validator for the STD of the lateral distance of the object.";
CM_ SG_ 154 OBJ_Absolute_Speed_13 "The absolute ground speed in the targets' heading direction.";
CM_ SG_ 154 OBJ_Absolute_Speed_V_13 "Validator for the absolute ground speed.";
CM_ SG_ 154 OBJ_Absolute_Speed_STD_13 "STD of the absolute ground speed.";
CM_ SG_ 154 OBJ_Absolute_Speed_STD_V_13 "Validator for the STD of the absolute ground speed.";
CM_ SG_ 154 OBJ_Heading_13 "The angle beetweenthe host longitudinal axis and target's heading (clockwise, e.g. PI/2 is a target crossing from left to right).";
CM_ SG_ 154 OBJ_Heading_V_13 "Validator for the object heading.";
CM_ SG_ 154 OBJ_Heading_STD_13 "STD of the object heading.";
CM_ SG_ 154 OBJ_Heading_STD_V_13 "Validator for the STD of the object heading.";
CM_ SG_ 154 OBJ_Angle_Rate_STD_13 "Standard deviation of the angular speed. (radians)";
CM_ SG_ 154 OBJ_Angle_Rate_STD_V_13 "Validator for the STD of the angular speed.";
CM_ SG_ 154 OBJ_Angle_Rate_13 "The momentary angular speed of the object (radians). The positive side is to the host's right.";
CM_ SG_ 154 OBJ_Angle_Rate_V_13 "Validator for the angular speed.";
CM_ SG_ 154 OBJ_Angle_Right_13 "The angle between the host longitudinal axis and the right side of the front / rear of the target (the visible one). The positive side is to the host's right.";
CM_ SG_ 154 OBJ_Angle_Right_V_13 "Validator for angleRight";
CM_ SG_ 154 OBJ_Angle_Right_STD_13 "Standard deviation of angleRight";
CM_ SG_ 154 OBJ_Angle_Right_STD_V_13 "Validator for the standard deviation of angleRight.";
CM_ SG_ 154 OBJ_Angle_Left_13 "The angle between the host longitudinal axis and the left side of the front / rear of the target (the visible one). The positive side is to the host's right.";
CM_ SG_ 154 OBJ_Angle_Left_V_13 "Validator for angleLeft.";
CM_ SG_ 154 OBJ_Angle_Left_STD_13 "Standard deviation of angleLeft.";
CM_ SG_ 154 OBJ_Angle_Left_STD_V_13 "Validator for the standard deviation of angleLeft.";
CM_ SG_ 154 OBJ_Angle_Side_13 "The angle between the host longitudinal axis and the far visible edge - the visible edge of the front / rear of the target that is not visible. Currently supported for vehicles only.";
CM_ SG_ 154 OBJ_Angle_Side_V_13 "Validator for angleSide.";
CM_ SG_ 154 OBJ_Angle_Side_STD_13 "Standard deviation of angleSide.";
CM_ SG_ 154 OBJ_Angle_Side_STD_V_13 "Validator for the STD of angleSide.";
CM_ SG_ 154 OBJ_Angle_Mid_V_13 "Validator for angleMid.";
CM_ SG_ 154 OBJ_Angle_Mid_13 "The angle between the host longitudinal axis and the middle of the front / rear of the target (the visible one). The positive side is to the host's right.";
CM_ SG_ 154 OBJ_Angle_Mid_STD_13 "Standard deviation of angleMid.";
CM_ SG_ 154 OBJ_Angle_Mid_STD_V_13 "Validator for the STD of angleMid.";
CM_ SG_ 154 OBJ_Angle_Bottom_V_13 "Validator for OBJAngle_Bottom. ";
CM_ SG_ 154 OBJ_Angle_Bottom_13 "The angle between the longitudinal axis and the Bottom of the front / rear of the target (the visible one). The positive side is to the host's bottom";
CM_ SG_ 154 OBJ_Angle_Bottom_STD_13 "STD for OBJAngle_Bottom. ";
CM_ SG_ 154 OBJ_Angle_Bottom_STD_V_13 "Validator for OBJAngle_Bottom_STD. ";
CM_ SG_ 154 OBJ_Visibility_Side_V_13 "Currently Supported for VD only";
CM_ SG_ 154 OBJ_Visibility_Side_13 "From what car  side is the object visible";
CM_ SG_ 154 OBJ_Is_In_Drivable_Area_13 "Indicates whether the target is in a driveable area.";
CM_ SG_ 154 OBJ_Is_In_Drivable_Area_V_13 "Validator for OBJ_Is_In_Drivable_Area.";
CM_ SG_ 154 OBJ_Is_VeryClose_V_13 "Validator for OBJ_Is_VeryClose. ";
CM_ SG_ 154 OBJ_Is_VeryClose_13 "Indicates whether the target is very close to the host such that it is hard to measure its distance. Currently relevant for peds only";
CM_ SG_ 154 OBJ_OverlapAngleEgoLaneR_13 "Lateral distance to the middle of the RL and RR corners.";
CM_ SG_ 154 OBJ_OverlapAngleEgoLaneR_V_13 "Validator for OBJ_OverlapAngleEgoLaneR";
CM_ SG_ 154 OBJ_OverlapAngleEgoLaneL_13 "Lateral distance to the middle of the RL and RR corners.  ";
CM_ SG_ 154 OBJ_OverlapAngleEgoLaneL_V_13 "Validator for OBJ_OverlapAngleEgoLaneL";
CM_ SG_ 154 OBJ_Is_EMERGENCY_VCL_13 "Is Object an Emergency Vehicle";
CM_ SG_ 154 OBJ_EMERGENCY_LIGHT_COLOR_13 "Emergency Color";
CM_ SG_ 154 OBJ_EMERGENCY_V_13 "Are OBJ_Is_EMERGENCY_VCL and OBJ_EMERGENCY_LIGHT_COLOR Valid";
CM_ SG_ 154 OBJ_Angle_Top_13 "From VD touching point on the ground till the roof of the car";
CM_ SG_ 154 OBJ_Angle_Top_V_13 "Validator for OBJ_Angle_Top ";
CM_ SG_ 154 OBJ_Angle_Top_STD_13 "STD for OBJ_Angle_Top";
CM_ SG_ 154 OBJ_Angle_Top_STD_V_13 "Validator for OBJ_Angle_Top_STD. ";
CM_ SG_ 154 OBJ_Open_Door_Left_13 "Indicator if left door is open";
CM_ SG_ 154 OBJ_Open_Door_Right_13 "Indicator if right door is open";
CM_ SG_ 154 OBJ_Visible_Left_or_Right_13 "This signal describes the visible Left or Right side of the Target vehicle.";
CM_ SG_ 154 OBJ_Visible_Left_or_Right_V_13 "OBJ_Visible_Left_or_Right";
CM_ SG_ 154 OBJ_2W_Is_Motorbike_Probability_13 "The probability of the Two-wheeler reported object being a Motorbike";
CM_ SG_ 154 OBJ_2W_Is_Bicycle_Probability_13 "The probability of the Two-wheeler reported object being a Bicycle";
CM_ SG_ 154 OBJ_CRC_14 "Calculated over all element signals. From the signal after the CRC until the first signal in the next elements OBJ_CRC_N+1  not including";
CM_ SG_ 154 OBJ_ID_14 "The detected object ID. Range is 1-255, while 0 indicates that the field in unfilled.";
CM_ SG_ 154 OBJ_Existence_Probability_14 "The existence probability of the reported object";
CM_ SG_ 154 OBJ_Fusion_Source_14 "sources ids used for fusion";
CM_ SG_ 154 OBJ_Triggered_SDM_14 "Indicates whether the object has trigered the SDM (Safety Diagnostic Manager) alert.";
CM_ SG_ 154 OBJ_Motion_Category_14 "Relevant for VD only. Full description of values can be found at the ACC guide.";
CM_ SG_ 154 OBJ_Moving_IN_Probability_14 "The probability the object is eventually move into ego lane. (In case that the OBJ_Motion_Category signal is set to  MOVING_IN ";
CM_ SG_ 154 OBJ_Object_Age_14 "The number of frames in which the object was recognized.";
CM_ SG_ 154 OBJ_Measuring_Status_14 "Measurment status. Old vs New marks if this is the first frame in which the object is reported. Predicted vs Measured marks if the report is raw or has been predicted forward in time using the measured dynamics and ego motion.";
CM_ SG_ 154 OBJ_Object_Class_14 "Indicates the object type. Uncertain is outputted in case the probability that a vehicle is a truck is very similar to the probability that it is a car.";
CM_ SG_ 154 OBJ_Class_Probability_14 "The probability of this type classification.";
CM_ SG_ 154 OBJ_Car_Probability_14 "The probability the object is a car";
CM_ SG_ 154 OBJ_Truck_Probability_14 "The probability the object is a Truck";
CM_ SG_ 154 OBJ_Bike_Probability_14 "The probability the object is a Bike";
CM_ SG_ 154 OBJ_Camera_Source_14 "The camera in which this object was detected (best choice).";
CM_ SG_ 154 OBJ_Motion_Status_14 "MOVING - the object is moving STATIONARY - the object was never seen moving STOPPED -  the object was moving and has stopped MOVING_SLOWLY - the object is moving very slowly";
CM_ SG_ 154 OBJ_Motion_Orientation_14 "The direction of the targets heading compared to the host. ";
CM_ SG_ 154 OBJ_Has_Cut_Lane_14 "Indicates whether the object cut the host's (right or left) lane. In case there are no lanes, indicates whether the objects is at most 1 meters away from the host.";
CM_ SG_ 154 OBJ_Has_Cut_Path_14 "Indicates whether the object is in the host's path.";
CM_ SG_ 154 OBJ_Brake_Light_Validity_14 "Validator for braking light indicator";
CM_ SG_ 154 OBJ_Brake_Light_14 "Indication for brake lights ";
CM_ SG_ 154 OBJ_Turn_Indicator_Right_14 "Indication for blinking right light.";
CM_ SG_ 154 OBJ_Turn_Indicator_Left_14 "Indication for blinking left light ";
CM_ SG_ 154 OBJ_Turn_Indicator_Validity_14 "Validator for light indicators";
CM_ SG_ 154 OBJ_Right_Out_Of_Image_14 "Indicates whether the measurment are predicted out of the right side of the image bounderies.";
CM_ SG_ 154 OBJ_Left_Out_Of_Image_14 "Indicates whether if measurment are predicted out of  the left side of the image bounderies";
CM_ SG_ 154 OBJ_Right_Out_Of_Image_V_14 "validator";
CM_ SG_ 154 OBJ_Left_Out_Of_Image_V_14 "validator";
CM_ SG_ 154 OBJ_Top_Out_Of_Image_14 "Indicates whether if measurment are predicted out of  the top of the image bounderies";
CM_ SG_ 154 OBJ_Bottom_Out_Of_Image_14 "Indicates whether if measurment are predicted out of  the bottom of the image bounderies";
CM_ SG_ 154 OBJ_Top_Out_Of_Image_V_14 "validator";
CM_ SG_ 154 OBJ_Bottom_Out_Of_Image_V_14 "validator";
CM_ SG_ 154 OBJ_Lane_Assignment_14 "The object's lane relative to the host lane.";
CM_ SG_ 154 OBJ_Lane_Assignment_V_14 "Validator for lane assignment";
CM_ SG_ 154 OBJ_Age_Seconds_14 "Time in seconds in which the object was recognized. ";
CM_ SG_ 154 OBJ_Age_Seconds_V_14 "Validator for object age";
CM_ SG_ 154 OBJ_Width_14 "The width of the target vehicle in the world (not to be mistaken with the width of the visible part of the vehicle).";
CM_ SG_ 154 OBJ_Width_V_14 "Validator for object width";
CM_ SG_ 154 OBJ_Width_STD_14 "Standard deviation for object width";
CM_ SG_ 154 OBJ_Width_STD_V_14 "Validator for the standard deviation of object width";
CM_ SG_ 154 OBJ_Length_14 "The length of the vehicle in the world. For crossing bicycles it gives the viewed length of the bicycle.";
CM_ SG_ 154 OBJ_Length_V_14 "Validator for object length.";
CM_ SG_ 154 OBJ_Length_STD_14 "Standard deviation for object length.";
CM_ SG_ 154 OBJ_Length_STD_V_14 "Validator for the standard deviation of object length.";
CM_ SG_ 154 OBJ_Radar_ID_14 "Radar Object ID of the Fused Object, Only relvant when OBJ_Fusion_Source is not Camera only";
CM_ SG_ 154 OBJ_Height_14 "The height of the object in the world. ";
CM_ SG_ 154 OBJ_Height_V_14 "Validator for object height.";
CM_ SG_ 154 OBJ_Height_STD_14 "Standard deviation for object height.";
CM_ SG_ 154 OBJ_Height_STD_V_14 "Validator for the standard deviation of object height.";
CM_ SG_ 154 OBJ_Abs_Long_Velocity_14 "Absolute longitudinal velocity.";
CM_ SG_ 154 OBJ_Abs_Long_Velocity_V_14 "Validator for absolute longitudinal velocity.";
CM_ SG_ 154 OBJ_Abs_Long_Velocity_STD_14 "Standard deviation of absolute longitudinal velocity.";
CM_ SG_ 154 OBJ_Abs_Long_Vel_STD_V_14 "Validator for the standard deviation of the absolute longitudinal velocity.";
CM_ SG_ 154 OBJ_Abs_Lat_Velocity_14 "The lateral ground speed of the object.";
CM_ SG_ 154 OBJ_Abs_Lat_Velocity_V_14 "Validator for the lateral ground speed of the object.";
CM_ SG_ 154 OBJ_Abs_Lat_Velocity_STD_14 "STD of the lateral ground speed of the object.";
CM_ SG_ 154 OBJ_Abs_Lat_Vel_STD_V_14 "Validator for the STD of the lateral ground speed of the object.";
CM_ SG_ 154 OBJ_Abs_Long_Acc_14 "The longitudinal ground acceleration of the object.";
CM_ SG_ 154 OBJ_Abs_Long_Acc_V_14 "Validator for the longitudinal ground acceleration of the object.";
CM_ SG_ 154 OBJ_Abs_Long_Acc_STD_14 "STD of the longitudinal ground acceleration of the object.";
CM_ SG_ 154 OBJ_Abs_Long_Acc_STD_V_14 "Validator for the STD of the longitudinal ground acceleration of the object.";
CM_ SG_ 154 OBJ_Abs_Lat_Acc_14 "The lateral ground acceleration of the object.";
CM_ SG_ 154 OBJ_Abs_Lat_Acc_V_14 "Validator for the lateral ground acceleration of the object.";
CM_ SG_ 154 OBJ_Abs_Lat_Acc_STD_14 "STD of the lateral ground acceleration of the object.";
CM_ SG_ 154 OBJ_Abs_Lat_Acc_STD_V_14 "Validator for the STD of the lateral ground acceleration of the object.";
CM_ SG_ 154 OBJ_Abs_Acceleration_14 "The absolute ground acceleration in the target's heading direction.";
CM_ SG_ 154 OBJ_Abs_Acceleration_V_14 "Validator for the absolute ground acceleration.";
CM_ SG_ 154 OBJ_Abs_Acc_STD_14 "STD of the absolute ground acceleration.";
CM_ SG_ 154 OBJ_Abs_Acc_STD_V_14 "Validator for the STD of the absolute ground acceleration.";
CM_ SG_ 154 OBJ_Inv_TTC_14 "Inverse TTC (time to collision).";
CM_ SG_ 154 OBJ_Inv_TTC_STD_14 "STD for inverse TTC .";
CM_ SG_ 154 OBJ_Inv_TTC_STD_V_14 "Validator for the STD for inverse TTC .";
CM_ SG_ 154 OBJ_Relative_Long_Acc_14 "The relative longitudinal ground acceleration of the object.";
CM_ SG_ 154 OBJ_Relative_Long_Acc_V_14 "Validator for the relative longitudinal ground acceleration of the object.";
CM_ SG_ 154 OBJ_Relative_Long_Acc_STD_14 "STD of the relative longitudinal ground acceleration of the object.";
CM_ SG_ 154 OBJ_Rel_Long_Acc_STD_V_14 "Validator for the STD of the relative longitudinal ground acceleration.";
CM_ SG_ 154 OBJ_Relative_Long_Velocity_14 "The relative longtitudinal speed between the target and ego vehicle. ";
CM_ SG_ 154 OBJ_Relative_Long_Velocity_V_14 "Validator for the relative longtitudinal speed.";
CM_ SG_ 154 OBJ_Relative_Long_Vel_STD_14 "STD of the relative longtitudinal speed.";
CM_ SG_ 154 OBJ_Rel_Long_Vel_STD_V_14 "Validator for the STD of the relative longtitudinal speed.";
CM_ SG_ 154 OBJ_Relative_Lat_Velocity_14 "The relative lateral speed between the target and ego vehicle. ";
CM_ SG_ 154 OBJ_Relative_Lat_Velocity_V_14 "Validator for the relative lateral speed. ";
CM_ SG_ 154 OBJ_Relative_Lat_Velocity_STD_14 "STD of the relative lateral speed. ";
CM_ SG_ 154 OBJ_Rel_Lat_Vel_STD_V_14 "Validator for the STD of the relative lateral speed. ";
CM_ SG_ 154 OBJ_Long_Distance_14 "The longitudinal distance to middle of the rear bumper (middle of the RL and RR corners) of the target.";
CM_ SG_ 154 OBJ_Long_Distance_V_14 "Validator of the longtitudinal distance field";
CM_ SG_ 154 OBJ_Long_Distance_STD_14 "STD of the  longtitudinal distance.";
CM_ SG_ 154 OBJ_Long_Distance_STD_V_14 "Validator for the STD of the  longtitudinal distance.";
CM_ SG_ 154 OBJ_Lat_Distance_14 "Lateral distance to the middle of the RL and RR corners.  ";
CM_ SG_ 154 OBJ_Lat_Distance_V_14 "Validator for the lateral distance of the object.";
CM_ SG_ 154 OBJ_Lat_Distance_STD_14 "STD of the lateral distance of the object.";
CM_ SG_ 154 OBJ_Lat_Distance_STD_V_14 "Validator for the STD of the lateral distance of the object.";
CM_ SG_ 154 OBJ_Absolute_Speed_14 "The absolute ground speed in the targets' heading direction.";
CM_ SG_ 154 OBJ_Absolute_Speed_V_14 "Validator for the absolute ground speed.";
CM_ SG_ 154 OBJ_Absolute_Speed_STD_14 "STD of the absolute ground speed.";
CM_ SG_ 154 OBJ_Absolute_Speed_STD_V_14 "Validator for the STD of the absolute ground speed.";
CM_ SG_ 154 OBJ_Heading_14 "The angle beetweenthe host longitudinal axis and target's heading (clockwise, e.g. PI/2 is a target crossing from left to right).";
CM_ SG_ 154 OBJ_Heading_V_14 "Validator for the object heading.";
CM_ SG_ 154 OBJ_Heading_STD_14 "STD of the object heading.";
CM_ SG_ 154 OBJ_Heading_STD_V_14 "Validator for the STD of the object heading.";
CM_ SG_ 154 OBJ_Angle_Rate_STD_14 "Standard deviation of the angular speed. (radians)";
CM_ SG_ 154 OBJ_Angle_Rate_STD_V_14 "Validator for the STD of the angular speed.";
CM_ SG_ 154 OBJ_Angle_Rate_14 "The momentary angular speed of the object (radians). The positive side is to the host's right.";
CM_ SG_ 154 OBJ_Angle_Rate_V_14 "Validator for the angular speed.";
CM_ SG_ 154 OBJ_Angle_Right_14 "The angle between the host longitudinal axis and the right side of the front / rear of the target (the visible one). The positive side is to the host's right.";
CM_ SG_ 154 OBJ_Angle_Right_V_14 "Validator for angleRight";
CM_ SG_ 154 OBJ_Angle_Right_STD_14 "Standard deviation of angleRight";
CM_ SG_ 154 OBJ_Angle_Right_STD_V_14 "Validator for the standard deviation of angleRight.";
CM_ SG_ 154 OBJ_Angle_Left_14 "The angle between the host longitudinal axis and the left side of the front / rear of the target (the visible one). The positive side is to the host's right.";
CM_ SG_ 154 OBJ_Angle_Left_V_14 "Validator for angleLeft.";
CM_ SG_ 154 OBJ_Angle_Left_STD_14 "Standard deviation of angleLeft.";
CM_ SG_ 154 OBJ_Angle_Left_STD_V_14 "Validator for the standard deviation of angleLeft.";
CM_ SG_ 154 OBJ_Angle_Side_14 "The angle between the host longitudinal axis and the far visible edge - the visible edge of the front / rear of the target that is not visible. Currently supported for vehicles only.";
CM_ SG_ 154 OBJ_Angle_Side_V_14 "Validator for angleSide.";
CM_ SG_ 154 OBJ_Angle_Side_STD_14 "Standard deviation of angleSide.";
CM_ SG_ 154 OBJ_Angle_Side_STD_V_14 "Validator for the STD of angleSide.";
CM_ SG_ 154 OBJ_Angle_Mid_V_14 "Validator for angleMid.";
CM_ SG_ 154 OBJ_Angle_Mid_14 "The angle between the host longitudinal axis and the middle of the front / rear of the target (the visible one). The positive side is to the host's right.";
CM_ SG_ 154 OBJ_Angle_Mid_STD_14 "Standard deviation of angleMid.";
CM_ SG_ 154 OBJ_Angle_Mid_STD_V_14 "Validator for the STD of angleMid.";
CM_ SG_ 154 OBJ_Angle_Bottom_V_14 "Validator for OBJAngle_Bottom. ";
CM_ SG_ 154 OBJ_Angle_Bottom_14 "The angle between the longitudinal axis and the Bottom of the front / rear of the target (the visible one). The positive side is to the host's bottom";
CM_ SG_ 154 OBJ_Angle_Bottom_STD_14 "STD for OBJAngle_Bottom. ";
CM_ SG_ 154 OBJ_Angle_Bottom_STD_V_14 "Validator for OBJAngle_Bottom_STD. ";
CM_ SG_ 154 OBJ_Visibility_Side_V_14 "Currently Supported for VD only";
CM_ SG_ 154 OBJ_Visibility_Side_14 "From what car  side is the object visible";
CM_ SG_ 154 OBJ_Is_In_Drivable_Area_14 "Indicates whether the target is in a driveable area.";
CM_ SG_ 154 OBJ_Is_In_Drivable_Area_V_14 "Validator for OBJ_Is_In_Drivable_Area.";
CM_ SG_ 154 OBJ_Is_VeryClose_V_14 "Validator for OBJ_Is_VeryClose. ";
CM_ SG_ 154 OBJ_Is_VeryClose_14 "Indicates whether the target is very close to the host such that it is hard to measure its distance. Currently relevant for peds only";
CM_ SG_ 154 OBJ_OverlapAngleEgoLaneR_14 "Lateral distance to the middle of the RL and RR corners.";
CM_ SG_ 154 OBJ_OverlapAngleEgoLaneR_V_14 "Validator for OBJ_OverlapAngleEgoLaneR";
CM_ SG_ 154 OBJ_OverlapAngleEgoLaneL_14 "Lateral distance to the middle of the RL and RR corners.  ";
CM_ SG_ 154 OBJ_OverlapAngleEgoLaneL_V_14 "Validator for OBJ_OverlapAngleEgoLaneL";
CM_ SG_ 154 OBJ_Is_EMERGENCY_VCL_14 "Is Object an Emergency Vehicle";
CM_ SG_ 154 OBJ_EMERGENCY_LIGHT_COLOR_14 "Emergency Color";
CM_ SG_ 154 OBJ_EMERGENCY_V_14 "Are OBJ_Is_EMERGENCY_VCL and OBJ_EMERGENCY_LIGHT_COLOR Valid";
CM_ SG_ 154 OBJ_Angle_Top_14 "From VD touching point on the ground till the roof of the car";
CM_ SG_ 154 OBJ_Angle_Top_V_14 "Validator for OBJ_Angle_Top ";
CM_ SG_ 154 OBJ_Angle_Top_STD_14 "STD for OBJ_Angle_Top";
CM_ SG_ 154 OBJ_Angle_Top_STD_V_14 "Validator for OBJ_Angle_Top_STD. ";
CM_ SG_ 154 OBJ_Open_Door_Left_14 "Indicator if left door is open";
CM_ SG_ 154 OBJ_Open_Door_Right_14 "Indicator if right door is open";
CM_ SG_ 154 OBJ_Visible_Left_or_Right_14 "This signal describes the visible Left or Right side of the Target vehicle.";
CM_ SG_ 154 OBJ_Visible_Left_or_Right_V_14 "OBJ_Visible_Left_or_Right";
CM_ SG_ 154 OBJ_2W_Is_Motorbike_Probability_14 "The probability of the Two-wheeler reported object being a Motorbike";
CM_ SG_ 154 OBJ_2W_Is_Bicycle_Probability_14 "The probability of the Two-wheeler reported object being a Bicycle";
CM_ SG_ 154 OBJ_CRC_15 "Calculated over all element signals. From the signal after the CRC until the first signal in the next elements OBJ_CRC_N+1  not including";
CM_ SG_ 154 OBJ_ID_15 "The detected object ID. Range is 1-255, while 0 indicates that the field in unfilled.";
CM_ SG_ 154 OBJ_Existence_Probability_15 "The existence probability of the reported object";
CM_ SG_ 154 OBJ_Fusion_Source_15 "sources ids used for fusion";
CM_ SG_ 154 OBJ_Triggered_SDM_15 "Indicates whether the object has trigered the SDM (Safety Diagnostic Manager) alert.";
CM_ SG_ 154 OBJ_Motion_Category_15 "Relevant for VD only. Full description of values can be found at the ACC guide.";
CM_ SG_ 154 OBJ_Moving_IN_Probability_15 "The probability the object is eventually move into ego lane. (In case that the OBJ_Motion_Category signal is set to  MOVING_IN ";
CM_ SG_ 154 OBJ_Object_Age_15 "The number of frames in which the object was recognized.";
CM_ SG_ 154 OBJ_Measuring_Status_15 "Measurment status. Old vs New marks if this is the first frame in which the object is reported. Predicted vs Measured marks if the report is raw or has been predicted forward in time using the measured dynamics and ego motion.";
CM_ SG_ 154 OBJ_Object_Class_15 "Indicates the object type. Uncertain is outputted in case the probability that a vehicle is a truck is very similar to the probability that it is a car.";
CM_ SG_ 154 OBJ_Class_Probability_15 "The probability of this type classification.";
CM_ SG_ 154 OBJ_Car_Probability_15 "The probability the object is a car";
CM_ SG_ 154 OBJ_Truck_Probability_15 "The probability the object is a Truck";
CM_ SG_ 154 OBJ_Bike_Probability_15 "The probability the object is a Bike";
CM_ SG_ 154 OBJ_Camera_Source_15 "The camera in which this object was detected (best choice).";
CM_ SG_ 154 OBJ_Motion_Status_15 "MOVING - the object is moving STATIONARY - the object was never seen moving STOPPED -  the object was moving and has stopped MOVING_SLOWLY - the object is moving very slowly";
CM_ SG_ 154 OBJ_Motion_Orientation_15 "The direction of the targets heading compared to the host. ";
CM_ SG_ 154 OBJ_Has_Cut_Lane_15 "Indicates whether the object cut the host's (right or left) lane. In case there are no lanes, indicates whether the objects is at most 1 meters away from the host.";
CM_ SG_ 154 OBJ_Has_Cut_Path_15 "Indicates whether the object is in the host's path.";
CM_ SG_ 154 OBJ_Brake_Light_Validity_15 "Validator for braking light indicator";
CM_ SG_ 154 OBJ_Brake_Light_15 "Indication for brake lights ";
CM_ SG_ 154 OBJ_Turn_Indicator_Right_15 "Indication for blinking right light.";
CM_ SG_ 154 OBJ_Turn_Indicator_Left_15 "Indication for blinking left light ";
CM_ SG_ 154 OBJ_Turn_Indicator_Validity_15 "Validator for light indicators";
CM_ SG_ 154 OBJ_Right_Out_Of_Image_15 "Indicates whether the measurment are predicted out of the right side of the image bounderies.";
CM_ SG_ 154 OBJ_Left_Out_Of_Image_15 "Indicates whether if measurment are predicted out of  the left side of the image bounderies";
CM_ SG_ 154 OBJ_Right_Out_Of_Image_V_15 "validator";
CM_ SG_ 154 OBJ_Left_Out_Of_Image_V_15 "validator";
CM_ SG_ 154 OBJ_Top_Out_Of_Image_15 "Indicates whether if measurment are predicted out of  the top of the image bounderies";
CM_ SG_ 154 OBJ_Bottom_Out_Of_Image_15 "Indicates whether if measurment are predicted out of  the bottom of the image bounderies";
CM_ SG_ 154 OBJ_Top_Out_Of_Image_V_15 "validator";
CM_ SG_ 154 OBJ_Bottom_Out_Of_Image_V_15 "validator";
CM_ SG_ 154 OBJ_Lane_Assignment_15 "The object's lane relative to the host lane.";
CM_ SG_ 154 OBJ_Lane_Assignment_V_15 "Validator for lane assignment";
CM_ SG_ 154 OBJ_Age_Seconds_15 "Time in seconds in which the object was recognized. ";
CM_ SG_ 154 OBJ_Age_Seconds_V_15 "Validator for object age";
CM_ SG_ 154 OBJ_Width_15 "The width of the target vehicle in the world (not to be mistaken with the width of the visible part of the vehicle).";
CM_ SG_ 154 OBJ_Width_V_15 "Validator for object width";
CM_ SG_ 154 OBJ_Width_STD_15 "Standard deviation for object width";
CM_ SG_ 154 OBJ_Width_STD_V_15 "Validator for the standard deviation of object width";
CM_ SG_ 154 OBJ_Length_15 "The length of the vehicle in the world. For crossing bicycles it gives the viewed length of the bicycle.";
CM_ SG_ 154 OBJ_Length_V_15 "Validator for object length.";
CM_ SG_ 154 OBJ_Length_STD_15 "Standard deviation for object length.";
CM_ SG_ 154 OBJ_Length_STD_V_15 "Validator for the standard deviation of object length.";
CM_ SG_ 154 OBJ_Radar_ID_15 "Radar Object ID of the Fused Object, Only relvant when OBJ_Fusion_Source is not Camera only";
CM_ SG_ 154 OBJ_Height_15 "The height of the object in the world. ";
CM_ SG_ 154 OBJ_Height_V_15 "Validator for object height.";
CM_ SG_ 154 OBJ_Height_STD_15 "Standard deviation for object height.";
CM_ SG_ 154 OBJ_Height_STD_V_15 "Validator for the standard deviation of object height.";
CM_ SG_ 154 OBJ_Abs_Long_Velocity_15 "Absolute longitudinal velocity.";
CM_ SG_ 154 OBJ_Abs_Long_Velocity_V_15 "Validator for absolute longitudinal velocity.";
CM_ SG_ 154 OBJ_Abs_Long_Velocity_STD_15 "Standard deviation of absolute longitudinal velocity.";
CM_ SG_ 154 OBJ_Abs_Long_Vel_STD_V_15 "Validator for the standard deviation of the absolute longitudinal velocity.";
CM_ SG_ 154 OBJ_Abs_Lat_Velocity_15 "The lateral ground speed of the object.";
CM_ SG_ 154 OBJ_Abs_Lat_Velocity_V_15 "Validator for the lateral ground speed of the object.";
CM_ SG_ 154 OBJ_Abs_Lat_Velocity_STD_15 "STD of the lateral ground speed of the object.";
CM_ SG_ 154 OBJ_Abs_Lat_Vel_STD_V_15 "Validator for the STD of the lateral ground speed of the object.";
CM_ SG_ 154 OBJ_Abs_Long_Acc_15 "The longitudinal ground acceleration of the object.";
CM_ SG_ 154 OBJ_Abs_Long_Acc_V_15 "Validator for the longitudinal ground acceleration of the object.";
CM_ SG_ 154 OBJ_Abs_Long_Acc_STD_15 "STD of the longitudinal ground acceleration of the object.";
CM_ SG_ 154 OBJ_Abs_Long_Acc_STD_V_15 "Validator for the STD of the longitudinal ground acceleration of the object.";
CM_ SG_ 154 OBJ_Abs_Lat_Acc_15 "The lateral ground acceleration of the object.";
CM_ SG_ 154 OBJ_Abs_Lat_Acc_V_15 "Validator for the lateral ground acceleration of the object.";
CM_ SG_ 154 OBJ_Abs_Lat_Acc_STD_15 "STD of the lateral ground acceleration of the object.";
CM_ SG_ 154 OBJ_Abs_Lat_Acc_STD_V_15 "Validator for the STD of the lateral ground acceleration of the object.";
CM_ SG_ 154 OBJ_Abs_Acceleration_15 "The absolute ground acceleration in the target's heading direction.";
CM_ SG_ 154 OBJ_Abs_Acceleration_V_15 "Validator for the absolute ground acceleration.";
CM_ SG_ 154 OBJ_Abs_Acc_STD_15 "STD of the absolute ground acceleration.";
CM_ SG_ 154 OBJ_Abs_Acc_STD_V_15 "Validator for the STD of the absolute ground acceleration.";
CM_ SG_ 154 OBJ_Inv_TTC_15 "Inverse TTC (time to collision).";
CM_ SG_ 154 OBJ_Inv_TTC_STD_15 "STD for inverse TTC .";
CM_ SG_ 154 OBJ_Inv_TTC_STD_V_15 "Validator for the STD for inverse TTC .";
CM_ SG_ 154 OBJ_Relative_Long_Acc_15 "The relative longitudinal ground acceleration of the object.";
CM_ SG_ 154 OBJ_Relative_Long_Acc_V_15 "Validator for the relative longitudinal ground acceleration of the object.";
CM_ SG_ 154 OBJ_Relative_Long_Acc_STD_15 "STD of the relative longitudinal ground acceleration of the object.";
CM_ SG_ 154 OBJ_Rel_Long_Acc_STD_V_15 "Validator for the STD of the relative longitudinal ground acceleration.";
CM_ SG_ 154 OBJ_Relative_Long_Velocity_15 "The relative longtitudinal speed between the target and ego vehicle. ";
CM_ SG_ 154 OBJ_Relative_Long_Velocity_V_15 "Validator for the relative longtitudinal speed.";
CM_ SG_ 154 OBJ_Relative_Long_Vel_STD_15 "STD of the relative longtitudinal speed.";
CM_ SG_ 154 OBJ_Rel_Long_Vel_STD_V_15 "Validator for the STD of the relative longtitudinal speed.";
CM_ SG_ 154 OBJ_Relative_Lat_Velocity_15 "The relative lateral speed between the target and ego vehicle. ";
CM_ SG_ 154 OBJ_Relative_Lat_Velocity_V_15 "Validator for the relative lateral speed. ";
CM_ SG_ 154 OBJ_Relative_Lat_Velocity_STD_15 "STD of the relative lateral speed. ";
CM_ SG_ 154 OBJ_Rel_Lat_Vel_STD_V_15 "Validator for the STD of the relative lateral speed. ";
CM_ SG_ 154 OBJ_Long_Distance_15 "The longitudinal distance to middle of the rear bumper (middle of the RL and RR corners) of the target.";
CM_ SG_ 154 OBJ_Long_Distance_V_15 "Validator of the longtitudinal distance field";
CM_ SG_ 154 OBJ_Long_Distance_STD_15 "STD of the  longtitudinal distance.";
CM_ SG_ 154 OBJ_Long_Distance_STD_V_15 "Validator for the STD of the  longtitudinal distance.";
CM_ SG_ 154 OBJ_Lat_Distance_15 "Lateral distance to the middle of the RL and RR corners.  ";
CM_ SG_ 154 OBJ_Lat_Distance_V_15 "Validator for the lateral distance of the object.";
CM_ SG_ 154 OBJ_Lat_Distance_STD_15 "STD of the lateral distance of the object.";
CM_ SG_ 154 OBJ_Lat_Distance_STD_V_15 "Validator for the STD of the lateral distance of the object.";
CM_ SG_ 154 OBJ_Absolute_Speed_15 "The absolute ground speed in the targets' heading direction.";
CM_ SG_ 154 OBJ_Absolute_Speed_V_15 "Validator for the absolute ground speed.";
CM_ SG_ 154 OBJ_Absolute_Speed_STD_15 "STD of the absolute ground speed.";
CM_ SG_ 154 OBJ_Absolute_Speed_STD_V_15 "Validator for the STD of the absolute ground speed.";
CM_ SG_ 154 OBJ_Heading_15 "The angle beetweenthe host longitudinal axis and target's heading (clockwise, e.g. PI/2 is a target crossing from left to right).";
CM_ SG_ 154 OBJ_Heading_V_15 "Validator for the object heading.";
CM_ SG_ 154 OBJ_Heading_STD_15 "STD of the object heading.";
CM_ SG_ 154 OBJ_Heading_STD_V_15 "Validator for the STD of the object heading.";
CM_ SG_ 154 OBJ_Angle_Rate_STD_15 "Standard deviation of the angular speed. (radians)";
CM_ SG_ 154 OBJ_Angle_Rate_STD_V_15 "Validator for the STD of the angular speed.";
CM_ SG_ 154 OBJ_Angle_Rate_15 "The momentary angular speed of the object (radians). The positive side is to the host's right.";
CM_ SG_ 154 OBJ_Angle_Rate_V_15 "Validator for the angular speed.";
CM_ SG_ 154 OBJ_Angle_Right_15 "The angle between the host longitudinal axis and the right side of the front / rear of the target (the visible one). The positive side is to the host's right.";
CM_ SG_ 154 OBJ_Angle_Right_V_15 "Validator for angleRight";
CM_ SG_ 154 OBJ_Angle_Right_STD_15 "Standard deviation of angleRight";
CM_ SG_ 154 OBJ_Angle_Right_STD_V_15 "Validator for the standard deviation of angleRight.";
CM_ SG_ 154 OBJ_Angle_Left_15 "The angle between the host longitudinal axis and the left side of the front / rear of the target (the visible one). The positive side is to the host's right.";
CM_ SG_ 154 OBJ_Angle_Left_V_15 "Validator for angleLeft.";
CM_ SG_ 154 OBJ_Angle_Left_STD_15 "Standard deviation of angleLeft.";
CM_ SG_ 154 OBJ_Angle_Left_STD_V_15 "Validator for the standard deviation of angleLeft.";
CM_ SG_ 154 OBJ_Angle_Side_15 "The angle between the host longitudinal axis and the far visible edge - the visible edge of the front / rear of the target that is not visible. Currently supported for vehicles only.";
CM_ SG_ 154 OBJ_Angle_Side_V_15 "Validator for angleSide.";
CM_ SG_ 154 OBJ_Angle_Side_STD_15 "Standard deviation of angleSide.";
CM_ SG_ 154 OBJ_Angle_Side_STD_V_15 "Validator for the STD of angleSide.";
CM_ SG_ 154 OBJ_Angle_Mid_V_15 "Validator for angleMid.";
CM_ SG_ 154 OBJ_Angle_Mid_15 "The angle between the host longitudinal axis and the middle of the front / rear of the target (the visible one). The positive side is to the host's right.";
CM_ SG_ 154 OBJ_Angle_Mid_STD_15 "Standard deviation of angleMid.";
CM_ SG_ 154 OBJ_Angle_Mid_STD_V_15 "Validator for the STD of angleMid.";
CM_ SG_ 154 OBJ_Angle_Bottom_V_15 "Validator for OBJAngle_Bottom. ";
CM_ SG_ 154 OBJ_Angle_Bottom_15 "The angle between the longitudinal axis and the Bottom of the front / rear of the target (the visible one). The positive side is to the host's bottom";
CM_ SG_ 154 OBJ_Angle_Bottom_STD_15 "STD for OBJAngle_Bottom. ";
CM_ SG_ 154 OBJ_Angle_Bottom_STD_V_15 "Validator for OBJAngle_Bottom_STD. ";
CM_ SG_ 154 OBJ_Visibility_Side_V_15 "Currently Supported for VD only";
CM_ SG_ 154 OBJ_Visibility_Side_15 "From what car  side is the object visible";
CM_ SG_ 154 OBJ_Is_In_Drivable_Area_15 "Indicates whether the target is in a driveable area.";
CM_ SG_ 154 OBJ_Is_In_Drivable_Area_V_15 "Validator for OBJ_Is_In_Drivable_Area.";
CM_ SG_ 154 OBJ_Is_VeryClose_V_15 "Validator for OBJ_Is_VeryClose. ";
CM_ SG_ 154 OBJ_Is_VeryClose_15 "Indicates whether the target is very close to the host such that it is hard to measure its distance. Currently relevant for peds only";
CM_ SG_ 154 OBJ_OverlapAngleEgoLaneR_15 "Lateral distance to the middle of the RL and RR corners.";
CM_ SG_ 154 OBJ_OverlapAngleEgoLaneR_V_15 "Validator for OBJ_OverlapAngleEgoLaneR";
CM_ SG_ 154 OBJ_OverlapAngleEgoLaneL_15 "Lateral distance to the middle of the RL and RR corners.  ";
CM_ SG_ 154 OBJ_OverlapAngleEgoLaneL_V_15 "Validator for OBJ_OverlapAngleEgoLaneL";
CM_ SG_ 154 OBJ_Is_EMERGENCY_VCL_15 "Is Object an Emergency Vehicle";
CM_ SG_ 154 OBJ_EMERGENCY_LIGHT_COLOR_15 "Emergency Color";
CM_ SG_ 154 OBJ_EMERGENCY_V_15 "Are OBJ_Is_EMERGENCY_VCL and OBJ_EMERGENCY_LIGHT_COLOR Valid";
CM_ SG_ 154 OBJ_Angle_Top_15 "From VD touching point on the ground till the roof of the car";
CM_ SG_ 154 OBJ_Angle_Top_V_15 "Validator for OBJ_Angle_Top ";
CM_ SG_ 154 OBJ_Angle_Top_STD_15 "STD for OBJ_Angle_Top";
CM_ SG_ 154 OBJ_Angle_Top_STD_V_15 "Validator for OBJ_Angle_Top_STD. ";
CM_ SG_ 154 OBJ_Open_Door_Left_15 "Indicator if left door is open";
CM_ SG_ 154 OBJ_Open_Door_Right_15 "Indicator if right door is open";
CM_ SG_ 154 OBJ_Visible_Left_or_Right_15 "This signal describes the visible Left or Right side of the Target vehicle.";
CM_ SG_ 154 OBJ_Visible_Left_or_Right_V_15 "OBJ_Visible_Left_or_Right";
CM_ SG_ 154 OBJ_2W_Is_Motorbike_Probability_15 "The probability of the Two-wheeler reported object being a Motorbike";
CM_ SG_ 154 OBJ_2W_Is_Bicycle_Probability_15 "The probability of the Two-wheeler reported object being a Bicycle";
CM_ SG_ 154 OBJ_CRC_16 "Calculated over all element signals. From the signal after the CRC until the first signal in the next elements OBJ_CRC_N+1  not including";
CM_ SG_ 154 OBJ_ID_16 "The detected object ID. Range is 1-255, while 0 indicates that the field in unfilled.";
CM_ SG_ 154 OBJ_Existence_Probability_16 "The existence probability of the reported object";
CM_ SG_ 154 OBJ_Fusion_Source_16 "sources ids used for fusion";
CM_ SG_ 154 OBJ_Triggered_SDM_16 "Indicates whether the object has trigered the SDM (Safety Diagnostic Manager) alert.";
CM_ SG_ 154 OBJ_Motion_Category_16 "Relevant for VD only. Full description of values can be found at the ACC guide.";
CM_ SG_ 154 OBJ_Moving_IN_Probability_16 "The probability the object is eventually move into ego lane. (In case that the OBJ_Motion_Category signal is set to  MOVING_IN ";
CM_ SG_ 154 OBJ_Object_Age_16 "The number of frames in which the object was recognized.";
CM_ SG_ 154 OBJ_Measuring_Status_16 "Measurment status. Old vs New marks if this is the first frame in which the object is reported. Predicted vs Measured marks if the report is raw or has been predicted forward in time using the measured dynamics and ego motion.";
CM_ SG_ 154 OBJ_Object_Class_16 "Indicates the object type. Uncertain is outputted in case the probability that a vehicle is a truck is very similar to the probability that it is a car.";
CM_ SG_ 154 OBJ_Class_Probability_16 "The probability of this type classification.";
CM_ SG_ 154 OBJ_Car_Probability_16 "The probability the object is a car";
CM_ SG_ 154 OBJ_Truck_Probability_16 "The probability the object is a Truck";
CM_ SG_ 154 OBJ_Bike_Probability_16 "The probability the object is a Bike";
CM_ SG_ 154 OBJ_Camera_Source_16 "The camera in which this object was detected (best choice).";
CM_ SG_ 154 OBJ_Motion_Status_16 "MOVING - the object is moving STATIONARY - the object was never seen moving STOPPED -  the object was moving and has stopped MOVING_SLOWLY - the object is moving very slowly";
CM_ SG_ 154 OBJ_Motion_Orientation_16 "The direction of the targets heading compared to the host. ";
CM_ SG_ 154 OBJ_Has_Cut_Lane_16 "Indicates whether the object cut the host's (right or left) lane. In case there are no lanes, indicates whether the objects is at most 1 meters away from the host.";
CM_ SG_ 154 OBJ_Has_Cut_Path_16 "Indicates whether the object is in the host's path.";
CM_ SG_ 154 OBJ_Brake_Light_Validity_16 "Validator for braking light indicator";
CM_ SG_ 154 OBJ_Brake_Light_16 "Indication for brake lights ";
CM_ SG_ 154 OBJ_Turn_Indicator_Right_16 "Indication for blinking right light.";
CM_ SG_ 154 OBJ_Turn_Indicator_Left_16 "Indication for blinking left light ";
CM_ SG_ 154 OBJ_Turn_Indicator_Validity_16 "Validator for light indicators";
CM_ SG_ 154 OBJ_Right_Out_Of_Image_16 "Indicates whether the measurment are predicted out of the right side of the image bounderies.";
CM_ SG_ 154 OBJ_Left_Out_Of_Image_16 "Indicates whether if measurment are predicted out of  the left side of the image bounderies";
CM_ SG_ 154 OBJ_Right_Out_Of_Image_V_16 "validator";
CM_ SG_ 154 OBJ_Left_Out_Of_Image_V_16 "validator";
CM_ SG_ 154 OBJ_Top_Out_Of_Image_16 "Indicates whether if measurment are predicted out of  the top of the image bounderies";
CM_ SG_ 154 OBJ_Bottom_Out_Of_Image_16 "Indicates whether if measurment are predicted out of  the bottom of the image bounderies";
CM_ SG_ 154 OBJ_Top_Out_Of_Image_V_16 "validator";
CM_ SG_ 154 OBJ_Bottom_Out_Of_Image_V_16 "validator";
CM_ SG_ 154 OBJ_Lane_Assignment_16 "The object's lane relative to the host lane.";
CM_ SG_ 154 OBJ_Lane_Assignment_V_16 "Validator for lane assignment";
CM_ SG_ 154 OBJ_Age_Seconds_16 "Time in seconds in which the object was recognized. ";
CM_ SG_ 154 OBJ_Age_Seconds_V_16 "Validator for object age";
CM_ SG_ 154 OBJ_Width_16 "The width of the target vehicle in the world (not to be mistaken with the width of the visible part of the vehicle).";
CM_ SG_ 154 OBJ_Width_V_16 "Validator for object width";
CM_ SG_ 154 OBJ_Width_STD_16 "Standard deviation for object width";
CM_ SG_ 154 OBJ_Width_STD_V_16 "Validator for the standard deviation of object width";
CM_ SG_ 154 OBJ_Length_16 "The length of the vehicle in the world. For crossing bicycles it gives the viewed length of the bicycle.";
CM_ SG_ 154 OBJ_Length_V_16 "Validator for object length.";
CM_ SG_ 154 OBJ_Length_STD_16 "Standard deviation for object length.";
CM_ SG_ 154 OBJ_Length_STD_V_16 "Validator for the standard deviation of object length.";
CM_ SG_ 154 OBJ_Radar_ID_16 "Radar Object ID of the Fused Object, Only relvant when OBJ_Fusion_Source is not Camera only";
CM_ SG_ 154 OBJ_Height_16 "The height of the object in the world. ";
CM_ SG_ 154 OBJ_Height_V_16 "Validator for object height.";
CM_ SG_ 154 OBJ_Height_STD_16 "Standard deviation for object height.";
CM_ SG_ 154 OBJ_Height_STD_V_16 "Validator for the standard deviation of object height.";
CM_ SG_ 154 OBJ_Abs_Long_Velocity_16 "Absolute longitudinal velocity.";
CM_ SG_ 154 OBJ_Abs_Long_Velocity_V_16 "Validator for absolute longitudinal velocity.";
CM_ SG_ 154 OBJ_Abs_Long_Velocity_STD_16 "Standard deviation of absolute longitudinal velocity.";
CM_ SG_ 154 OBJ_Abs_Long_Vel_STD_V_16 "Validator for the standard deviation of the absolute longitudinal velocity.";
CM_ SG_ 154 OBJ_Abs_Lat_Velocity_16 "The lateral ground speed of the object.";
CM_ SG_ 154 OBJ_Abs_Lat_Velocity_V_16 "Validator for the lateral ground speed of the object.";
CM_ SG_ 154 OBJ_Abs_Lat_Velocity_STD_16 "STD of the lateral ground speed of the object.";
CM_ SG_ 154 OBJ_Abs_Lat_Vel_STD_V_16 "Validator for the STD of the lateral ground speed of the object.";
CM_ SG_ 154 OBJ_Abs_Long_Acc_16 "The longitudinal ground acceleration of the object.";
CM_ SG_ 154 OBJ_Abs_Long_Acc_V_16 "Validator for the longitudinal ground acceleration of the object.";
CM_ SG_ 154 OBJ_Abs_Long_Acc_STD_16 "STD of the longitudinal ground acceleration of the object.";
CM_ SG_ 154 OBJ_Abs_Long_Acc_STD_V_16 "Validator for the STD of the longitudinal ground acceleration of the object.";
CM_ SG_ 154 OBJ_Abs_Lat_Acc_16 "The lateral ground acceleration of the object.";
CM_ SG_ 154 OBJ_Abs_Lat_Acc_V_16 "Validator for the lateral ground acceleration of the object.";
CM_ SG_ 154 OBJ_Abs_Lat_Acc_STD_16 "STD of the lateral ground acceleration of the object.";
CM_ SG_ 154 OBJ_Abs_Lat_Acc_STD_V_16 "Validator for the STD of the lateral ground acceleration of the object.";
CM_ SG_ 154 OBJ_Abs_Acceleration_16 "The absolute ground acceleration in the target's heading direction.";
CM_ SG_ 154 OBJ_Abs_Acceleration_V_16 "Validator for the absolute ground acceleration.";
CM_ SG_ 154 OBJ_Abs_Acc_STD_16 "STD of the absolute ground acceleration.";
CM_ SG_ 154 OBJ_Abs_Acc_STD_V_16 "Validator for the STD of the absolute ground acceleration.";
CM_ SG_ 154 OBJ_Inv_TTC_16 "Inverse TTC (time to collision).";
CM_ SG_ 154 OBJ_Inv_TTC_STD_16 "STD for inverse TTC .";
CM_ SG_ 154 OBJ_Inv_TTC_STD_V_16 "Validator for the STD for inverse TTC .";
CM_ SG_ 154 OBJ_Relative_Long_Acc_16 "The relative longitudinal ground acceleration of the object.";
CM_ SG_ 154 OBJ_Relative_Long_Acc_V_16 "Validator for the relative longitudinal ground acceleration of the object.";
CM_ SG_ 154 OBJ_Relative_Long_Acc_STD_16 "STD of the relative longitudinal ground acceleration of the object.";
CM_ SG_ 154 OBJ_Rel_Long_Acc_STD_V_16 "Validator for the STD of the relative longitudinal ground acceleration.";
CM_ SG_ 154 OBJ_Relative_Long_Velocity_16 "The relative longtitudinal speed between the target and ego vehicle. ";
CM_ SG_ 154 OBJ_Relative_Long_Velocity_V_16 "Validator for the relative longtitudinal speed.";
CM_ SG_ 154 OBJ_Relative_Long_Vel_STD_16 "STD of the relative longtitudinal speed.";
CM_ SG_ 154 OBJ_Rel_Long_Vel_STD_V_16 "Validator for the STD of the relative longtitudinal speed.";
CM_ SG_ 154 OBJ_Relative_Lat_Velocity_16 "The relative lateral speed between the target and ego vehicle. ";
CM_ SG_ 154 OBJ_Relative_Lat_Velocity_V_16 "Validator for the relative lateral speed. ";
CM_ SG_ 154 OBJ_Relative_Lat_Velocity_STD_16 "STD of the relative lateral speed. ";
CM_ SG_ 154 OBJ_Rel_Lat_Vel_STD_V_16 "Validator for the STD of the relative lateral speed. ";
CM_ SG_ 154 OBJ_Long_Distance_16 "The longitudinal distance to middle of the rear bumper (middle of the RL and RR corners) of the target.";
CM_ SG_ 154 OBJ_Long_Distance_V_16 "Validator of the longtitudinal distance field";
CM_ SG_ 154 OBJ_Long_Distance_STD_16 "STD of the  longtitudinal distance.";
CM_ SG_ 154 OBJ_Long_Distance_STD_V_16 "Validator for the STD of the  longtitudinal distance.";
CM_ SG_ 154 OBJ_Lat_Distance_16 "Lateral distance to the middle of the RL and RR corners.  ";
CM_ SG_ 154 OBJ_Lat_Distance_V_16 "Validator for the lateral distance of the object.";
CM_ SG_ 154 OBJ_Lat_Distance_STD_16 "STD of the lateral distance of the object.";
CM_ SG_ 154 OBJ_Lat_Distance_STD_V_16 "Validator for the STD of the lateral distance of the object.";
CM_ SG_ 154 OBJ_Absolute_Speed_16 "The absolute ground speed in the targets' heading direction.";
CM_ SG_ 154 OBJ_Absolute_Speed_V_16 "Validator for the absolute ground speed.";
CM_ SG_ 154 OBJ_Absolute_Speed_STD_16 "STD of the absolute ground speed.";
CM_ SG_ 154 OBJ_Absolute_Speed_STD_V_16 "Validator for the STD of the absolute ground speed.";
CM_ SG_ 154 OBJ_Heading_16 "The angle beetweenthe host longitudinal axis and target's heading (clockwise, e.g. PI/2 is a target crossing from left to right).";
CM_ SG_ 154 OBJ_Heading_V_16 "Validator for the object heading.";
CM_ SG_ 154 OBJ_Heading_STD_16 "STD of the object heading.";
CM_ SG_ 154 OBJ_Heading_STD_V_16 "Validator for the STD of the object heading.";
CM_ SG_ 154 OBJ_Angle_Rate_STD_16 "Standard deviation of the angular speed. (radians)";
CM_ SG_ 154 OBJ_Angle_Rate_STD_V_16 "Validator for the STD of the angular speed.";
CM_ SG_ 154 OBJ_Angle_Rate_16 "The momentary angular speed of the object (radians). The positive side is to the host's right.";
CM_ SG_ 154 OBJ_Angle_Rate_V_16 "Validator for the angular speed.";
CM_ SG_ 154 OBJ_Angle_Right_16 "The angle between the host longitudinal axis and the right side of the front / rear of the target (the visible one). The positive side is to the host's right.";
CM_ SG_ 154 OBJ_Angle_Right_V_16 "Validator for angleRight";
CM_ SG_ 154 OBJ_Angle_Right_STD_16 "Standard deviation of angleRight";
CM_ SG_ 154 OBJ_Angle_Right_STD_V_16 "Validator for the standard deviation of angleRight.";
CM_ SG_ 154 OBJ_Angle_Left_16 "The angle between the host longitudinal axis and the left side of the front / rear of the target (the visible one). The positive side is to the host's right.";
CM_ SG_ 154 OBJ_Angle_Left_V_16 "Validator for angleLeft.";
CM_ SG_ 154 OBJ_Angle_Left_STD_16 "Standard deviation of angleLeft.";
CM_ SG_ 154 OBJ_Angle_Left_STD_V_16 "Validator for the standard deviation of angleLeft.";
CM_ SG_ 154 OBJ_Angle_Side_16 "The angle between the host longitudinal axis and the far visible edge - the visible edge of the front / rear of the target that is not visible. Currently supported for vehicles only.";
CM_ SG_ 154 OBJ_Angle_Side_V_16 "Validator for angleSide.";
CM_ SG_ 154 OBJ_Angle_Side_STD_16 "Standard deviation of angleSide.";
CM_ SG_ 154 OBJ_Angle_Side_STD_V_16 "Validator for the STD of angleSide.";
CM_ SG_ 154 OBJ_Angle_Mid_V_16 "Validator for angleMid.";
CM_ SG_ 154 OBJ_Angle_Mid_16 "The angle between the host longitudinal axis and the middle of the front / rear of the target (the visible one). The positive side is to the host's right.";
CM_ SG_ 154 OBJ_Angle_Mid_STD_16 "Standard deviation of angleMid.";
CM_ SG_ 154 OBJ_Angle_Mid_STD_V_16 "Validator for the STD of angleMid.";
CM_ SG_ 154 OBJ_Angle_Bottom_V_16 "Validator for OBJAngle_Bottom. ";
CM_ SG_ 154 OBJ_Angle_Bottom_16 "The angle between the longitudinal axis and the Bottom of the front / rear of the target (the visible one). The positive side is to the host's bottom";
CM_ SG_ 154 OBJ_Angle_Bottom_STD_16 "STD for OBJAngle_Bottom. ";
CM_ SG_ 154 OBJ_Angle_Bottom_STD_V_16 "Validator for OBJAngle_Bottom_STD. ";
CM_ SG_ 154 OBJ_Visibility_Side_V_16 "Currently Supported for VD only";
CM_ SG_ 154 OBJ_Visibility_Side_16 "From what car  side is the object visible";
CM_ SG_ 154 OBJ_Is_In_Drivable_Area_16 "Indicates whether the target is in a driveable area.";
CM_ SG_ 154 OBJ_Is_In_Drivable_Area_V_16 "Validator for OBJ_Is_In_Drivable_Area.";
CM_ SG_ 154 OBJ_Is_VeryClose_V_16 "Validator for OBJ_Is_VeryClose. ";
CM_ SG_ 154 OBJ_Is_VeryClose_16 "Indicates whether the target is very close to the host such that it is hard to measure its distance. Currently relevant for peds only";
CM_ SG_ 154 OBJ_OverlapAngleEgoLaneR_16 "Lateral distance to the middle of the RL and RR corners.";
CM_ SG_ 154 OBJ_OverlapAngleEgoLaneR_V_16 "Validator for OBJ_OverlapAngleEgoLaneR";
CM_ SG_ 154 OBJ_OverlapAngleEgoLaneL_16 "Lateral distance to the middle of the RL and RR corners.  ";
CM_ SG_ 154 OBJ_OverlapAngleEgoLaneL_V_16 "Validator for OBJ_OverlapAngleEgoLaneL";
CM_ SG_ 154 OBJ_Is_EMERGENCY_VCL_16 "Is Object an Emergency Vehicle";
CM_ SG_ 154 OBJ_EMERGENCY_LIGHT_COLOR_16 "Emergency Color";
CM_ SG_ 154 OBJ_EMERGENCY_V_16 "Are OBJ_Is_EMERGENCY_VCL and OBJ_EMERGENCY_LIGHT_COLOR Valid";
CM_ SG_ 154 OBJ_Angle_Top_16 "From VD touching point on the ground till the roof of the car";
CM_ SG_ 154 OBJ_Angle_Top_V_16 "Validator for OBJ_Angle_Top ";
CM_ SG_ 154 OBJ_Angle_Top_STD_16 "STD for OBJ_Angle_Top";
CM_ SG_ 154 OBJ_Angle_Top_STD_V_16 "Validator for OBJ_Angle_Top_STD. ";
CM_ SG_ 154 OBJ_Open_Door_Left_16 "Indicator if left door is open";
CM_ SG_ 154 OBJ_Open_Door_Right_16 "Indicator if right door is open";
CM_ SG_ 154 OBJ_Visible_Left_or_Right_16 "This signal describes the visible Left or Right side of the Target vehicle.";
CM_ SG_ 154 OBJ_Visible_Left_or_Right_V_16 "OBJ_Visible_Left_or_Right";
CM_ SG_ 154 OBJ_2W_Is_Motorbike_Probability_16 "The probability of the Two-wheeler reported object being a Motorbike";
CM_ SG_ 154 OBJ_2W_Is_Bicycle_Probability_16 "The probability of the Two-wheeler reported object being a Bicycle";
CM_ SG_ 154 OBJ_CRC_17 "Calculated over all element signals. From the signal after the CRC until the first signal in the next elements OBJ_CRC_N+1  not including";
CM_ SG_ 154 OBJ_ID_17 "The detected object ID. Range is 1-255, while 0 indicates that the field in unfilled.";
CM_ SG_ 154 OBJ_Existence_Probability_17 "The existence probability of the reported object";
CM_ SG_ 154 OBJ_Fusion_Source_17 "sources ids used for fusion";
CM_ SG_ 154 OBJ_Triggered_SDM_17 "Indicates whether the object has trigered the SDM (Safety Diagnostic Manager) alert.";
CM_ SG_ 154 OBJ_Motion_Category_17 "Relevant for VD only. Full description of values can be found at the ACC guide.";
CM_ SG_ 154 OBJ_Moving_IN_Probability_17 "The probability the object is eventually move into ego lane. (In case that the OBJ_Motion_Category signal is set to  MOVING_IN ";
CM_ SG_ 154 OBJ_Object_Age_17 "The number of frames in which the object was recognized.";
CM_ SG_ 154 OBJ_Measuring_Status_17 "Measurment status. Old vs New marks if this is the first frame in which the object is reported. Predicted vs Measured marks if the report is raw or has been predicted forward in time using the measured dynamics and ego motion.";
CM_ SG_ 154 OBJ_Object_Class_17 "Indicates the object type. Uncertain is outputted in case the probability that a vehicle is a truck is very similar to the probability that it is a car.";
CM_ SG_ 154 OBJ_Class_Probability_17 "The probability of this type classification.";
CM_ SG_ 154 OBJ_Car_Probability_17 "The probability the object is a car";
CM_ SG_ 154 OBJ_Truck_Probability_17 "The probability the object is a Truck";
CM_ SG_ 154 OBJ_Bike_Probability_17 "The probability the object is a Bike";
CM_ SG_ 154 OBJ_Camera_Source_17 "The camera in which this object was detected (best choice).";
CM_ SG_ 154 OBJ_Motion_Status_17 "MOVING - the object is moving STATIONARY - the object was never seen moving STOPPED -  the object was moving and has stopped MOVING_SLOWLY - the object is moving very slowly";
CM_ SG_ 154 OBJ_Motion_Orientation_17 "The direction of the targets heading compared to the host. ";
CM_ SG_ 154 OBJ_Has_Cut_Lane_17 "Indicates whether the object cut the host's (right or left) lane. In case there are no lanes, indicates whether the objects is at most 1 meters away from the host.";
CM_ SG_ 154 OBJ_Has_Cut_Path_17 "Indicates whether the object is in the host's path.";
CM_ SG_ 154 OBJ_Brake_Light_Validity_17 "Validator for braking light indicator";
CM_ SG_ 154 OBJ_Brake_Light_17 "Indication for brake lights ";
CM_ SG_ 154 OBJ_Turn_Indicator_Right_17 "Indication for blinking right light.";
CM_ SG_ 154 OBJ_Turn_Indicator_Left_17 "Indication for blinking left light ";
CM_ SG_ 154 OBJ_Turn_Indicator_Validity_17 "Validator for light indicators";
CM_ SG_ 154 OBJ_Right_Out_Of_Image_17 "Indicates whether the measurment are predicted out of the right side of the image bounderies.";
CM_ SG_ 154 OBJ_Left_Out_Of_Image_17 "Indicates whether if measurment are predicted out of  the left side of the image bounderies";
CM_ SG_ 154 OBJ_Right_Out_Of_Image_V_17 "validator";
CM_ SG_ 154 OBJ_Left_Out_Of_Image_V_17 "validator";
CM_ SG_ 154 OBJ_Top_Out_Of_Image_17 "Indicates whether if measurment are predicted out of  the top of the image bounderies";
BA_DEF_ SG_  "GenSigStartValue" INT 0 0;
BA_DEF_DEF_  "GenSigStartValue" 0;
BA_ "GenSigStartValue" SG_ 154 OBJ_Width_12 40;
BA_ "GenSigStartValue" SG_ 154 OBJ_Length_12 12;
BA_ "GenSigStartValue" SG_ 154 OBJ_Width_13 40;
BA_ "GenSigStartValue" SG_ 154 OBJ_Length_13 12;
BA_ "GenSigStartValue" SG_ 154 OBJ_Width_14 40;
BA_ "GenSigStartValue" SG_ 154 OBJ_Length_14 12;
BA_ "GenSigStartValue" SG_ 154 OBJ_Width_15 40;
BA_ "GenSigStartValue" SG_ 154 OBJ_Length_15 12;
BA_ "GenSigStartValue" SG_ 154 OBJ_Width_16 40;
BA_ "GenSigStartValue" SG_ 154 OBJ_Length_16 12;
VAL_ 154 OBJ_Rel_Long_Acc_STD_V_11 1 "VALID" 0 "INVALID" ;
VAL_ 154 OBJ_Relative_Long_Velocity_V_11 1 "VALID" 0 "INVALID" ;
VAL_ 154 OBJ_Rel_Long_Vel_STD_V_11 1 "VALID" 0 "INVALID" ;
VAL_ 154 OBJ_Relative_Lat_Velocity_V_11 1 "VALID" 0 "INVALID" ;
VAL_ 154 OBJ_Rel_Lat_Vel_STD_V_11 1 "VALID" 0 "INVALID" ;
VAL_ 154 OBJ_Long_Distance_V_11 1 "VALID" 0 "INVALID" ;
VAL_ 154 OBJ_Long_Distance_STD_V_11 1 "VALID" 0 "INVALID" ;
VAL_ 154 OBJ_Lat_Distance_V_11 1 "VALID" 0 "INVALID" ;
VAL_ 154 OBJ_Lat_Distance_STD_V_11 1 "VALID" 0 "INVALID" ;
VAL_ 154 OBJ_Absolute_Speed_V_11 1 "VALID" 0 "INVALID" ;
VAL_ 154 OBJ_Absolute_Speed_STD_V_11 1 "VALID" 0 "INVALID" ;
VAL_ 154 OBJ_Heading_V_11 1 "VALID" 0 "INVALID" ;
VAL_ 154 OBJ_Heading_STD_V_11 1 "VALID" 0 "INVALID" ;
VAL_ 154 OBJ_Angle_Rate_STD_V_11 1 "VALID" 0 "INVALID" ;
VAL_ 154 OBJ_Angle_Rate_V_11 1 "VALID" 0 "INVALID" ;
VAL_ 154 OBJ_Angle_Right_V_11 1 "VALID" 0 "INVALID" ;
VAL_ 154 OBJ_Angle_Right_STD_V_11 1 "VALID" 0 "INVALID" ;
VAL_ 154 OBJ_Angle_Left_V_11 1 "VALID" 0 "INVALID" ;
VAL_ 154 OBJ_Angle_Left_STD_V_11 1 "VALID" 0 "INVALID" ;
VAL_ 154 OBJ_Angle_Side_V_11 1 "VALID" 0 "INVALID" ;
VAL_ 154 OBJ_Angle_Side_STD_V_11 1 "VALID" 0 "INVALID" ;
VAL_ 154 OBJ_Angle_Mid_V_11 1 "VALID" 0 "INVALID" ;
VAL_ 154 OBJ_Angle_Mid_STD_V_11 1 "VALID" 0 "INVALID" ;
VAL_ 154 OBJ_Angle_Bottom_V_11 1 "VALID" 0 "INVALID" ;
VAL_ 154 OBJ_Angle_Bottom_STD_V_11 1 "VALID" 0 "INVALID" ;
VAL_ 154 OBJ_Visibility_Side_V_11 1 "VALID" 0 "INVALID" ;
VAL_ 154 OBJ_Visibility_Side_11 2 "REAR" 1 "FRONT" 0 "NOT_VISIBLE" ;
VAL_ 154 OBJ_Is_In_Drivable_Area_11 1 "TRUE" 0 "FALSE" ;
VAL_ 154 OBJ_Is_In_Drivable_Area_V_11 1 "VALID" 0 "INVALID" ;
VAL_ 154 OBJ_Is_VeryClose_V_11 1 "VALID" 0 "INVALID" ;
VAL_ 154 OBJ_Is_VeryClose_11 1 "TRUE" 0 "FALSE" ;
VAL_ 154 OBJ_OverlapAngleEgoLaneR_V_11 1 "VALID" 0 "INVALID" ;
VAL_ 154 OBJ_OverlapAngleEgoLaneL_V_11 1 "VALID" 0 "INVALID" ;
VAL_ 154 OBJ_Is_EMERGENCY_VCL_11 1 "TRUE" 0 "FALSE" ;
VAL_ 154 OBJ_EMERGENCY_LIGHT_COLOR_11 3 "(1000)ORANGE" 2 "(0100)BLUE" 1 "(0010)RED" 0 "(0001)OTHER" ;
VAL_ 154 OBJ_EMERGENCY_V_11 1 "TRUE" 0 "FALSE" ;
VAL_ 154 OBJ_Angle_Top_V_11 1 "VALID" 0 "INVALID" ;
VAL_ 154 OBJ_Angle_Top_STD_V_11 1 "VALID" 0 "INVALID" ;
VAL_ 154 OBJ_Open_Door_Left_11 1 "TRUE" 0 "FALSE" ;
VAL_ 154 OBJ_Open_Door_Right_11 1 "TRUE" 0 "FALSE" ;
VAL_ 154 OBJ_Visible_Left_or_Right_11 2 "RIGHT" 1 "LEFT" 0 "NOT_VISIBLE" ;
VAL_ 154 OBJ_Visible_Left_or_Right_V_11 1 "VALID" 0 "INVALID" ;
VAL_ 154 OBJ_Fusion_Source_12 2 "(BIT_2)RADAR2" 1 "(BIT_1)RADAR1" 0 "(BIT_0)CAMERA" ;
VAL_ 154 OBJ_Triggered_SDM_12 2 "NOT_TRIGGERED" 1 "TRIGGERED" 0 "NOT_AVAILABLE" ;
VAL_ 154 OBJ_Motion_Category_12 13 "ONCOMING" 12 "PRECEEDING" 11 "MOVING" 10 "RTAP" 9 "LTAP" 8 "CROSSING" 7 "MOVING_OUT" 6 "MOVING_IN" 5 "CLOSE_CUT_IN" 4 "PASSING_OUT" 3 "PASSING_IN" 2 "PASSING" 1 "UNDEFINED" 0 "UNFILLED" ;
VAL_ 154 OBJ_Measuring_Status_12 2 "(BIT_2)NOT_VALID_OR_VALID" 1 "(BIT_1)PREDICTED_OR_MEASURED" 0 "(BIT_0)OLD_OR_NEW" ;
VAL_ 154 OBJ_Object_Class_12 9 "TWO_WHEELER" 8 "UNCERTAIN_VCL" 7 "ANIMAL" 6 "GENERAL_OBJECT" 5 "PEDESTRIAN" 4 "BICYCLE" 3 "MOTORBIKE" 2 "TRUCK" 1 "CAR" 0 "UNFILLED" ;
VAL_ 154 OBJ_Camera_Source_12 11 "PARKING_RIGHT" 10 "PARKING_LEFT" 9 "PARKING_REAR" 8 "PARKING_FRONT" 7 "FRONT_CORNER_RIGHT" 6 "FRONT_CORNER_LEFT" 5 "REAR_CORNER_RIGHT" 4 "REAR_CORNER_LEFT" 3 "REAR" 2 "FRONT_FISHEYE" 1 "FRONT_NARROW" 0 "FRONT_MAIN" ;
VAL_ 154 OBJ_Motion_Status_12 5 "MOVING_SLOWLY" 4 "STOPPED" 3 "STATIONARY" 2 "MOVING" 1 "UNKNOWN" 0 "INVALID" ;
VAL_ 154 OBJ_Motion_Orientation_12 13 "INVALID" 12 "NORTH" 11 "NORTH_WEST" 9 "WEST" 7 "SOUTH_WEST" 6 "SOUTH" 5 "SOUTH_EAST" 3 "EAST" 1 "NORTH_EAST" 0 "UNKNOWN" ;
VAL_ 154 OBJ_Has_Cut_Lane_12 1 "TRUE" 0 "FALSE" ;
VAL_ 154 OBJ_Has_Cut_Path_12 1 "TRUE" 0 "FALSE" ;
VAL_ 154 OBJ_Brake_Light_Validity_12 1 "TRUE" 0 "FALSE" ;
VAL_ 154 OBJ_Brake_Light_12 1 "TRUE" 0 "FALSE" ;
VAL_ 154 OBJ_Turn_Indicator_Right_12 1 "TRUE" 0 "FALSE" ;
VAL_ 154 OBJ_Turn_Indicator_Left_12 1 "TRUE" 0 "FALSE" ;
VAL_ 154 OBJ_Turn_Indicator_Validity_12 1 "TRUE" 0 "FALSE" ;
VAL_ 154 OBJ_Right_Out_Of_Image_12 1 "TRUE" 0 "FALSE" ;
VAL_ 154 OBJ_Left_Out_Of_Image_12 1 "TRUE" 0 "FALSE" ;
VAL_ 154 OBJ_Right_Out_Of_Image_V_12 1 "TRUE" 0 "FALSE" ;
VAL_ 154 OBJ_Left_Out_Of_Image_V_12 1 "TRUE" 0 "FALSE" ;
VAL_ 154 OBJ_Top_Out_Of_Image_12 1 "TRUE" 0 "FALSE" ;
VAL_ 154 OBJ_Bottom_Out_Of_Image_12 1 "TRUE" 0 "FALSE" ;
VAL_ 154 OBJ_Top_Out_Of_Image_V_12 1 "VALID" 0 "INVALID" ;
VAL_ 154 OBJ_Bottom_Out_Of_Image_V_12 1 "VALID" 0 "INVALID" ;
VAL_ 154 OBJ_Lane_Assignment_12 5 "RIGHT_RIGHT" 4 "RIGHT" 3 "HOST" 2 "LEFT" 1 "LEFT_LEFT" 0 "UNKNOWN" ;
VAL_ 154 OBJ_Lane_Assignment_V_12 1 "VALID" 0 "INVALID" ;
VAL_ 154 OBJ_Age_Seconds_V_12 1 "VALID" 0 "INVALID" ;
VAL_ 154 OBJ_Width_V_12 1 "VALID" 0 "INVALID" ;
VAL_ 154 OBJ_Width_STD_V_12 1 "VALID" 0 "INVALID" ;
VAL_ 154 OBJ_Length_V_12 1 "VALID" 0 "INVALID" ;
VAL_ 154 OBJ_Length_STD_V_12 1 "VALID" 0 "INVALID" ;
VAL_ 154 OBJ_Height_V_12 1 "VALID" 0 "INVALID" ;
VAL_ 154 OBJ_Height_STD_V_12 1 "VALID" 0 "INVALID" ;
VAL_ 154 OBJ_Abs_Long_Velocity_V_12 1 "VALID" 0 "INVALID" ;
VAL_ 154 OBJ_Abs_Long_Vel_STD_V_12 1 "VALID" 0 "INVALID" ;
VAL_ 154 OBJ_Abs_Lat_Velocity_V_12 1 "VALID" 0 "INVALID" ;
VAL_ 154 OBJ_Abs_Lat_Vel_STD_V_12 1 "VALID" 0 "INVALID" ;
VAL_ 154 OBJ_Abs_Long_Acc_V_12 1 "VALID" 0 "INVALID" ;
VAL_ 154 OBJ_Abs_Long_Acc_STD_V_12 1 "VALID" 0 "INVALID" ;
VAL_ 154 OBJ_Abs_Lat_Acc_V_12 1 "VALID" 0 "INVALID" ;
VAL_ 154 OBJ_Abs_Lat_Acc_STD_V_12 1 "VALID" 0 "INVALID" ;
VAL_ 154 OBJ_Abs_Acceleration_V_12 1 "VALID" 0 "INVALID" ;
VAL_ 154 OBJ_Abs_Acc_STD_V_12 1 "VALID" 0 "INVALID" ;
VAL_ 154 OBJ_Inv_TTC_V_12 1 "VALID" 0 "INVALID" ;
VAL_ 154 OBJ_Inv_TTC_STD_V_12 1 "VALID" 0 "INVALID" ;
VAL_ 154 OBJ_Relative_Long_Acc_V_12 1 "VALID" 0 "INVALID" ;
VAL_ 154 OBJ_Rel_Long_Acc_STD_V_12 1 "VALID" 0 "INVALID" ;
VAL_ 154 OBJ_Relative_Long_Velocity_V_12 1 "VALID" 0 "INVALID" ;
VAL_ 154 OBJ_Rel_Long_Vel_STD_V_12 1 "VALID" 0 "INVALID" ;
VAL_ 154 OBJ_Relative_Lat_Velocity_V_12 1 "VALID" 0 "INVALID" ;
VAL_ 154 OBJ_Rel_Lat_Vel_STD_V_12 1 "VALID" 0 "INVALID" ;
VAL_ 154 OBJ_Long_Distance_V_12 1 "VALID" 0 "INVALID" ;
VAL_ 154 OBJ_Long_Distance_STD_V_12 1 "VALID" 0 "INVALID" ;
VAL_ 154 OBJ_Lat_Distance_V_12 1 "VALID" 0 "INVALID" ;
VAL_ 154 OBJ_Lat_Distance_STD_V_12 1 "VALID" 0 "INVALID" ;
VAL_ 154 OBJ_Absolute_Speed_V_12 1 "VALID" 0 "INVALID" ;
VAL_ 154 OBJ_Absolute_Speed_STD_V_12 1 "VALID" 0 "INVALID" ;
VAL_ 154 OBJ_Heading_V_12 1 "VALID" 0 "INVALID" ;
VAL_ 154 OBJ_Heading_STD_V_12 1 "VALID" 0 "INVALID" ;
VAL_ 154 OBJ_Angle_Rate_STD_V_12 1 "VALID" 0 "INVALID" ;
VAL_ 154 OBJ_Angle_Rate_V_12 1 "VALID" 0 "INVALID" ;
VAL_ 154 OBJ_Angle_Right_V_12 1 "VALID" 0 "INVALID" ;
VAL_ 154 OBJ_Angle_Right_STD_V_12 1 "VALID" 0 "INVALID" ;
VAL_ 154 OBJ_Angle_Left_V_12 1 "VALID" 0 "INVALID" ;
VAL_ 154 OBJ_Angle_Left_STD_V_12 1 "VALID" 0 "INVALID" ;
VAL_ 154 OBJ_Angle_Side_V_12 1 "VALID" 0 "INVALID" ;
VAL_ 154 OBJ_Angle_Side_STD_V_12 1 "VALID" 0 "INVALID" ;
VAL_ 154 OBJ_Angle_Mid_V_12 1 "VALID" 0 "INVALID" ;
VAL_ 154 OBJ_Angle_Mid_STD_V_12 1 "VALID" 0 "INVALID" ;
VAL_ 154 OBJ_Angle_Bottom_V_12 1 "VALID" 0 "INVALID" ;
VAL_ 154 OBJ_Angle_Bottom_STD_V_12 1 "VALID" 0 "INVALID" ;
VAL_ 154 OBJ_Visibility_Side_V_12 1 "VALID" 0 "INVALID" ;
VAL_ 154 OBJ_Visibility_Side_12 2 "REAR" 1 "FRONT" 0 "NOT_VISIBLE" ;
VAL_ 154 OBJ_Is_In_Drivable_Area_12 1 "TRUE" 0 "FALSE" ;
VAL_ 154 OBJ_Is_In_Drivable_Area_V_12 1 "VALID" 0 "INVALID" ;
VAL_ 154 OBJ_Is_VeryClose_V_12 1 "VALID" 0 "INVALID" ;
VAL_ 154 OBJ_Is_VeryClose_12 1 "TRUE" 0 "FALSE" ;
VAL_ 154 OBJ_OverlapAngleEgoLaneR_V_12 1 "VALID" 0 "INVALID" ;
VAL_ 154 OBJ_OverlapAngleEgoLaneL_V_12 1 "VALID" 0 "INVALID" ;
VAL_ 154 OBJ_Is_EMERGENCY_VCL_12 1 "TRUE" 0 "FALSE" ;
VAL_ 154 OBJ_EMERGENCY_LIGHT_COLOR_12 3 "(1000)ORANGE" 2 "(0100)BLUE" 1 "(0010)RED" 0 "(0001)OTHER" ;
VAL_ 154 OBJ_EMERGENCY_V_12 1 "TRUE" 0 "FALSE" ;
VAL_ 154 OBJ_Angle_Top_V_12 1 "VALID" 0 "INVALID" ;
VAL_ 154 OBJ_Angle_Top_STD_V_12 1 "VALID" 0 "INVALID" ;
VAL_ 154 OBJ_Open_Door_Left_12 1 "TRUE" 0 "FALSE" ;
VAL_ 154 OBJ_Open_Door_Right_12 1 "TRUE" 0 "FALSE" ;
VAL_ 154 OBJ_Visible_Left_or_Right_12 2 "RIGHT" 1 "LEFT" 0 "NOT_VISIBLE" ;
VAL_ 154 OBJ_Visible_Left_or_Right_V_12 1 "VALID" 0 "INVALID" ;
VAL_ 154 OBJ_Fusion_Source_13 2 "(BIT_2)RADAR2" 1 "(BIT_1)RADAR1" 0 "(BIT_0)CAMERA" ;
VAL_ 154 OBJ_Triggered_SDM_13 2 "NOT_TRIGGERED" 1 "TRIGGERED" 0 "NOT_AVAILABLE" ;
VAL_ 154 OBJ_Motion_Category_13 13 "ONCOMING" 12 "PRECEEDING" 11 "MOVING" 10 "RTAP" 9 "LTAP" 8 "CROSSING" 7 "MOVING_OUT" 6 "MOVING_IN" 5 "CLOSE_CUT_IN" 4 "PASSING_OUT" 3 "PASSING_IN" 2 "PASSING" 1 "UNDEFINED" 0 "UNFILLED" ;
VAL_ 154 OBJ_Measuring_Status_13 2 "(BIT_2)NOT_VALID_OR_VALID" 1 "(BIT_1)PREDICTED_OR_MEASURED" 0 "(BIT_0)OLD_OR_NEW" ;
VAL_ 154 OBJ_Object_Class_13 9 "TWO_WHEELER" 8 "UNCERTAIN_VCL" 7 "ANIMAL" 6 "GENERAL_OBJECT" 5 "PEDESTRIAN" 4 "BICYCLE" 3 "MOTORBIKE" 2 "TRUCK" 1 "CAR" 0 "UNFILLED" ;
VAL_ 154 OBJ_Camera_Source_13 11 "PARKING_RIGHT" 10 "PARKING_LEFT" 9 "PARKING_REAR" 8 "PARKING_FRONT" 7 "FRONT_CORNER_RIGHT" 6 "FRONT_CORNER_LEFT" 5 "REAR_CORNER_RIGHT" 4 "REAR_CORNER_LEFT" 3 "REAR" 2 "FRONT_FISHEYE" 1 "FRONT_NARROW" 0 "FRONT_MAIN" ;
VAL_ 154 OBJ_Motion_Status_13 5 "MOVING_SLOWLY" 4 "STOPPED" 3 "STATIONARY" 2 "MOVING" 1 "UNKNOWN" 0 "INVALID" ;
VAL_ 154 OBJ_Motion_Orientation_13 13 "INVALID" 12 "NORTH" 11 "NORTH_WEST" 9 "WEST" 7 "SOUTH_WEST" 6 "SOUTH" 5 "SOUTH_EAST" 3 "EAST" 1 "NORTH_EAST" 0 "UNKNOWN" ;
VAL_ 154 OBJ_Has_Cut_Lane_13 1 "TRUE" 0 "FALSE" ;
VAL_ 154 OBJ_Has_Cut_Path_13 1 "TRUE" 0 "FALSE" ;
VAL_ 154 OBJ_Brake_Light_Validity_13 1 "TRUE" 0 "FALSE" ;
VAL_ 154 OBJ_Brake_Light_13 1 "TRUE" 0 "FALSE" ;
VAL_ 154 OBJ_Turn_Indicator_Right_13 1 "TRUE" 0 "FALSE" ;
VAL_ 154 OBJ_Turn_Indicator_Left_13 1 "TRUE" 0 "FALSE" ;
VAL_ 154 OBJ_Turn_Indicator_Validity_13 1 "TRUE" 0 "FALSE" ;
VAL_ 154 OBJ_Right_Out_Of_Image_13 1 "TRUE" 0 "FALSE" ;
VAL_ 154 OBJ_Left_Out_Of_Image_13 1 "TRUE" 0 "FALSE" ;
VAL_ 154 OBJ_Right_Out_Of_Image_V_13 1 "TRUE" 0 "FALSE" ;
VAL_ 154 OBJ_Left_Out_Of_Image_V_13 1 "TRUE" 0 "FALSE" ;
VAL_ 154 OBJ_Top_Out_Of_Image_13 1 "TRUE" 0 "FALSE" ;
VAL_ 154 OBJ_Bottom_Out_Of_Image_13 1 "TRUE" 0 "FALSE" ;
VAL_ 154 OBJ_Top_Out_Of_Image_V_13 1 "VALID" 0 "INVALID" ;
VAL_ 154 OBJ_Bottom_Out_Of_Image_V_13 1 "VALID" 0 "INVALID" ;
VAL_ 154 OBJ_Lane_Assignment_13 5 "RIGHT_RIGHT" 4 "RIGHT" 3 "HOST" 2 "LEFT" 1 "LEFT_LEFT" 0 "UNKNOWN" ;
VAL_ 154 OBJ_Lane_Assignment_V_13 1 "VALID" 0 "INVALID" ;
VAL_ 154 OBJ_Age_Seconds_V_13 1 "VALID" 0 "INVALID" ;
VAL_ 154 OBJ_Width_V_13 1 "VALID" 0 "INVALID" ;
VAL_ 154 OBJ_Width_STD_V_13 1 "VALID" 0 "INVALID" ;
VAL_ 154 OBJ_Length_V_13 1 "VALID" 0 "INVALID" ;
VAL_ 154 OBJ_Length_STD_V_13 1 "VALID" 0 "INVALID" ;
VAL_ 154 OBJ_Height_V_13 1 "VALID" 0 "INVALID" ;
VAL_ 154 OBJ_Height_STD_V_13 1 "VALID" 0 "INVALID" ;
VAL_ 154 OBJ_Abs_Long_Velocity_V_13 1 "VALID" 0 "INVALID" ;
VAL_ 154 OBJ_Abs_Long_Vel_STD_V_13 1 "VALID" 0 "INVALID" ;
VAL_ 154 OBJ_Abs_Lat_Velocity_V_13 1 "VALID" 0 "INVALID" ;
VAL_ 154 OBJ_Abs_Lat_Vel_STD_V_13 1 "VALID" 0 "INVALID" ;
VAL_ 154 OBJ_Abs_Long_Acc_V_13 1 "VALID" 0 "INVALID" ;
VAL_ 154 OBJ_Abs_Long_Acc_STD_V_13 1 "VALID" 0 "INVALID" ;
VAL_ 154 OBJ_Abs_Lat_Acc_V_13 1 "VALID" 0 "INVALID" ;
VAL_ 154 OBJ_Abs_Lat_Acc_STD_V_13 1 "VALID" 0 "INVALID" ;
VAL_ 154 OBJ_Abs_Acceleration_V_13 1 "VALID" 0 "INVALID" ;
VAL_ 154 OBJ_Abs_Acc_STD_V_13 1 "VALID" 0 "INVALID" ;
VAL_ 154 OBJ_Inv_TTC_V_13 1 "VALID" 0 "INVALID" ;
VAL_ 154 OBJ_Inv_TTC_STD_V_13 1 "VALID" 0 "INVALID" ;
VAL_ 154 OBJ_Relative_Long_Acc_V_13 1 "VALID" 0 "INVALID" ;
VAL_ 154 OBJ_Rel_Long_Acc_STD_V_13 1 "VALID" 0 "INVALID" ;
VAL_ 154 OBJ_Relative_Long_Velocity_V_13 1 "VALID" 0 "INVALID" ;
VAL_ 154 OBJ_Rel_Long_Vel_STD_V_13 1 "VALID" 0 "INVALID" ;
VAL_ 154 OBJ_Relative_Lat_Velocity_V_13 1 "VALID" 0 "INVALID" ;
VAL_ 154 OBJ_Rel_Lat_Vel_STD_V_13 1 "VALID" 0 "INVALID" ;
VAL_ 154 OBJ_Long_Distance_V_13 1 "VALID" 0 "INVALID" ;
VAL_ 154 OBJ_Long_Distance_STD_V_13 1 "VALID" 0 "INVALID" ;
VAL_ 154 OBJ_Lat_Distance_V_13 1 "VALID" 0 "INVALID" ;
VAL_ 154 OBJ_Lat_Distance_STD_V_13 1 "VALID" 0 "INVALID" ;
VAL_ 154 OBJ_Absolute_Speed_V_13 1 "VALID" 0 "INVALID" ;
VAL_ 154 OBJ_Absolute_Speed_STD_V_13 1 "VALID" 0 "INVALID" ;
VAL_ 154 OBJ_Heading_V_13 1 "VALID" 0 "INVALID" ;
VAL_ 154 OBJ_Heading_STD_V_13 1 "VALID" 0 "INVALID" ;
VAL_ 154 OBJ_Angle_Rate_STD_V_13 1 "VALID" 0 "INVALID" ;
VAL_ 154 OBJ_Angle_Rate_V_13 1 "VALID" 0 "INVALID" ;
VAL_ 154 OBJ_Angle_Right_V_13 1 "VALID" 0 "INVALID" ;
VAL_ 154 OBJ_Angle_Right_STD_V_13 1 "VALID" 0 "INVALID" ;
VAL_ 154 OBJ_Angle_Left_V_13 1 "VALID" 0 "INVALID" ;
VAL_ 154 OBJ_Angle_Left_STD_V_13 1 "VALID" 0 "INVALID" ;
VAL_ 154 OBJ_Angle_Side_V_13 1 "VALID" 0 "INVALID" ;
VAL_ 154 OBJ_Angle_Side_STD_V_13 1 "VALID" 0 "INVALID" ;
VAL_ 154 OBJ_Angle_Mid_V_13 1 "VALID" 0 "INVALID" ;
VAL_ 154 OBJ_Angle_Mid_STD_V_13 1 "VALID" 0 "INVALID" ;
VAL_ 154 OBJ_Angle_Bottom_V_13 1 "VALID" 0 "INVALID" ;
VAL_ 154 OBJ_Angle_Bottom_STD_V_13 1 "VALID" 0 "INVALID" ;
VAL_ 154 OBJ_Visibility_Side_V_13 1 "VALID" 0 "INVALID" ;
VAL_ 154 OBJ_Visibility_Side_13 2 "REAR" 1 "FRONT" 0 "NOT_VISIBLE" ;
VAL_ 154 OBJ_Is_In_Drivable_Area_13 1 "TRUE" 0 "FALSE" ;
VAL_ 154 OBJ_Is_In_Drivable_Area_V_13 1 "VALID" 0 "INVALID" ;
VAL_ 154 OBJ_Is_VeryClose_V_13 1 "VALID" 0 "INVALID" ;
VAL_ 154 OBJ_Is_VeryClose_13 1 "TRUE" 0 "FALSE" ;
VAL_ 154 OBJ_OverlapAngleEgoLaneR_V_13 1 "VALID" 0 "INVALID" ;
VAL_ 154 OBJ_OverlapAngleEgoLaneL_V_13 1 "VALID" 0 "INVALID" ;
VAL_ 154 OBJ_Is_EMERGENCY_VCL_13 1 "TRUE" 0 "FALSE" ;
VAL_ 154 OBJ_EMERGENCY_LIGHT_COLOR_13 3 "(1000)ORANGE" 2 "(0100)BLUE" 1 "(0010)RED" 0 "(0001)OTHER" ;
VAL_ 154 OBJ_EMERGENCY_V_13 1 "TRUE" 0 "FALSE" ;
VAL_ 154 OBJ_Angle_Top_V_13 1 "VALID" 0 "INVALID" ;
VAL_ 154 OBJ_Angle_Top_STD_V_13 1 "VALID" 0 "INVALID" ;
VAL_ 154 OBJ_Open_Door_Left_13 1 "TRUE" 0 "FALSE" ;
VAL_ 154 OBJ_Open_Door_Right_13 1 "TRUE" 0 "FALSE" ;
VAL_ 154 OBJ_Visible_Left_or_Right_13 2 "RIGHT" 1 "LEFT" 0 "NOT_VISIBLE" ;
VAL_ 154 OBJ_Visible_Left_or_Right_V_13 1 "VALID" 0 "INVALID" ;
VAL_ 154 OBJ_Fusion_Source_14 2 "(BIT_2)RADAR2" 1 "(BIT_1)RADAR1" 0 "(BIT_0)CAMERA" ;
VAL_ 154 OBJ_Triggered_SDM_14 2 "NOT_TRIGGERED" 1 "TRIGGERED" 0 "NOT_AVAILABLE" ;
VAL_ 154 OBJ_Motion_Category_14 13 "ONCOMING" 12 "PRECEEDING" 11 "MOVING" 10 "RTAP" 9 "LTAP" 8 "CROSSING" 7 "MOVING_OUT" 6 "MOVING_IN" 5 "CLOSE_CUT_IN" 4 "PASSING_OUT" 3 "PASSING_IN" 2 "PASSING" 1 "UNDEFINED" 0 "UNFILLED" ;
VAL_ 154 OBJ_Measuring_Status_14 2 "(BIT_2)NOT_VALID_OR_VALID" 1 "(BIT_1)PREDICTED_OR_MEASURED" 0 "(BIT_0)OLD_OR_NEW" ;
VAL_ 154 OBJ_Object_Class_14 9 "TWO_WHEELER" 8 "UNCERTAIN_VCL" 7 "ANIMAL" 6 "GENERAL_OBJECT" 5 "PEDESTRIAN" 4 "BICYCLE" 3 "MOTORBIKE" 2 "TRUCK" 1 "CAR" 0 "UNFILLED" ;
VAL_ 154 OBJ_Camera_Source_14 11 "PARKING_RIGHT" 10 "PARKING_LEFT" 9 "PARKING_REAR" 8 "PARKING_FRONT" 7 "FRONT_CORNER_RIGHT" 6 "FRONT_CORNER_LEFT" 5 "REAR_CORNER_RIGHT" 4 "REAR_CORNER_LEFT" 3 "REAR" 2 "FRONT_FISHEYE" 1 "FRONT_NARROW" 0 "FRONT_MAIN" ;
VAL_ 154 OBJ_Motion_Status_14 5 "MOVING_SLOWLY" 4 "STOPPED" 3 "STATIONARY" 2 "MOVING" 1 "UNKNOWN" 0 "INVALID" ;
VAL_ 154 OBJ_Motion_Orientation_14 13 "INVALID" 12 "NORTH" 11 "NORTH_WEST" 9 "WEST" 7 "SOUTH_WEST" 6 "SOUTH" 5 "SOUTH_EAST" 3 "EAST" 1 "NORTH_EAST" 0 "UNKNOWN" ;
VAL_ 154 OBJ_Has_Cut_Lane_14 1 "TRUE" 0 "FALSE" ;
VAL_ 154 OBJ_Has_Cut_Path_14 1 "TRUE" 0 "FALSE" ;
VAL_ 154 OBJ_Brake_Light_Validity_14 1 "TRUE" 0 "FALSE" ;
VAL_ 154 OBJ_Brake_Light_14 1 "TRUE" 0 "FALSE" ;
VAL_ 154 OBJ_Turn_Indicator_Right_14 1 "TRUE" 0 "FALSE" ;
VAL_ 154 OBJ_Turn_Indicator_Left_14 1 "TRUE" 0 "FALSE" ;
VAL_ 154 OBJ_Turn_Indicator_Validity_14 1 "TRUE" 0 "FALSE" ;
VAL_ 154 OBJ_Right_Out_Of_Image_14 1 "TRUE" 0 "FALSE" ;
VAL_ 154 OBJ_Left_Out_Of_Image_14 1 "TRUE" 0 "FALSE" ;
VAL_ 154 OBJ_Right_Out_Of_Image_V_14 1 "TRUE" 0 "FALSE" ;
VAL_ 154 OBJ_Left_Out_Of_Image_V_14 1 "TRUE" 0 "FALSE" ;
VAL_ 154 OBJ_Top_Out_Of_Image_14 1 "TRUE" 0 "FALSE" ;
VAL_ 154 OBJ_Bottom_Out_Of_Image_14 1 "TRUE" 0 "FALSE" ;
VAL_ 154 OBJ_Top_Out_Of_Image_V_14 1 "VALID" 0 "INVALID" ;
VAL_ 154 OBJ_Bottom_Out_Of_Image_V_14 1 "VALID" 0 "INVALID" ;
VAL_ 154 OBJ_Lane_Assignment_14 5 "RIGHT_RIGHT" 4 "RIGHT" 3 "HOST" 2 "LEFT" 1 "LEFT_LEFT" 0 "UNKNOWN" ;
VAL_ 154 OBJ_Lane_Assignment_V_14 1 "VALID" 0 "INVALID" ;
VAL_ 154 OBJ_Age_Seconds_V_14 1 "VALID" 0 "INVALID" ;
VAL_ 154 OBJ_Width_V_14 1 "VALID" 0 "INVALID" ;
VAL_ 154 OBJ_Width_STD_V_14 1 "VALID" 0 "INVALID" ;
VAL_ 154 OBJ_Length_V_14 1 "VALID" 0 "INVALID" ;
VAL_ 154 OBJ_Length_STD_V_14 1 "VALID" 0 "INVALID" ;
VAL_ 154 OBJ_Height_V_14 1 "VALID" 0 "INVALID" ;
VAL_ 154 OBJ_Height_STD_V_14 1 "VALID" 0 "INVALID" ;
VAL_ 154 OBJ_Abs_Long_Velocity_V_14 1 "VALID" 0 "INVALID" ;
VAL_ 154 OBJ_Abs_Long_Vel_STD_V_14 1 "VALID" 0 "INVALID" ;
VAL_ 154 OBJ_Abs_Lat_Velocity_V_14 1 "VALID" 0 "INVALID" ;
VAL_ 154 OBJ_Abs_Lat_Vel_STD_V_14 1 "VALID" 0 "INVALID" ;
VAL_ 154 OBJ_Abs_Long_Acc_V_14 1 "VALID" 0 "INVALID" ;
VAL_ 154 OBJ_Abs_Long_Acc_STD_V_14 1 "VALID" 0 "INVALID" ;
VAL_ 154 OBJ_Abs_Lat_Acc_V_14 1 "VALID" 0 "INVALID" ;
VAL_ 154 OBJ_Abs_Lat_Acc_STD_V_14 1 "VALID" 0 "INVALID" ;
VAL_ 154 OBJ_Abs_Acceleration_V_14 1 "VALID" 0 "INVALID" ;
VAL_ 154 OBJ_Abs_Acc_STD_V_14 1 "VALID" 0 "INVALID" ;
VAL_ 154 OBJ_Inv_TTC_V_14 1 "VALID" 0 "INVALID" ;
VAL_ 154 OBJ_Inv_TTC_STD_V_14 1 "VALID" 0 "INVALID" ;
VAL_ 154 OBJ_Relative_Long_Acc_V_14 1 "VALID" 0 "INVALID" ;
VAL_ 154 OBJ_Rel_Long_Acc_STD_V_14 1 "VALID" 0 "INVALID" ;
VAL_ 154 OBJ_Relative_Long_Velocity_V_14 1 "VALID" 0 "INVALID" ;
VAL_ 154 OBJ_Rel_Long_Vel_STD_V_14 1 "VALID" 0 "INVALID" ;
VAL_ 154 OBJ_Relative_Lat_Velocity_V_14 1 "VALID" 0 "INVALID" ;
VAL_ 154 OBJ_Rel_Lat_Vel_STD_V_14 1 "VALID" 0 "INVALID" ;
VAL_ 154 OBJ_Long_Distance_V_14 1 "VALID" 0 "INVALID" ;
VAL_ 154 OBJ_Long_Distance_STD_V_14 1 "VALID" 0 "INVALID" ;
VAL_ 154 OBJ_Lat_Distance_V_14 1 "VALID" 0 "INVALID" ;
VAL_ 154 OBJ_Lat_Distance_STD_V_14 1 "VALID" 0 "INVALID" ;
VAL_ 154 OBJ_Absolute_Speed_V_14 1 "VALID" 0 "INVALID" ;
VAL_ 154 OBJ_Absolute_Speed_STD_V_14 1 "VALID" 0 "INVALID" ;
VAL_ 154 OBJ_Heading_V_14 1 "VALID" 0 "INVALID" ;
VAL_ 154 OBJ_Heading_STD_V_14 1 "VALID" 0 "INVALID" ;
VAL_ 154 OBJ_Angle_Rate_STD_V_14 1 "VALID" 0 "INVALID" ;
VAL_ 154 OBJ_Angle_Rate_V_14 1 "VALID" 0 "INVALID" ;
VAL_ 154 OBJ_Angle_Right_V_14 1 "VALID" 0 "INVALID" ;
VAL_ 154 OBJ_Angle_Right_STD_V_14 1 "VALID" 0 "INVALID" ;
VAL_ 154 OBJ_Angle_Left_V_14 1 "VALID" 0 "INVALID" ;
VAL_ 154 OBJ_Angle_Left_STD_V_14 1 "VALID" 0 "INVALID" ;
VAL_ 154 OBJ_Angle_Side_V_14 1 "VALID" 0 "INVALID" ;
VAL_ 154 OBJ_Angle_Side_STD_V_14 1 "VALID" 0 "INVALID" ;
VAL_ 154 OBJ_Angle_Mid_V_14 1 "VALID" 0 "INVALID" ;
VAL_ 154 OBJ_Angle_Mid_STD_V_14 1 "VALID" 0 "INVALID" ;
VAL_ 154 OBJ_Angle_Bottom_V_14 1 "VALID" 0 "INVALID" ;
VAL_ 154 OBJ_Angle_Bottom_STD_V_14 1 "VALID" 0 "INVALID" ;
VAL_ 154 OBJ_Visibility_Side_V_14 1 "VALID" 0 "INVALID" ;
VAL_ 154 OBJ_Visibility_Side_14 2 "REAR" 1 "FRONT" 0 "NOT_VISIBLE" ;
VAL_ 154 OBJ_Is_In_Drivable_Area_14 1 "TRUE" 0 "FALSE" ;
VAL_ 154 OBJ_Is_In_Drivable_Area_V_14 1 "VALID" 0 "INVALID" ;
VAL_ 154 OBJ_Is_VeryClose_V_14 1 "VALID" 0 "INVALID" ;
VAL_ 154 OBJ_Is_VeryClose_14 1 "TRUE" 0 "FALSE" ;
VAL_ 154 OBJ_OverlapAngleEgoLaneR_V_14 1 "VALID" 0 "INVALID" ;
VAL_ 154 OBJ_OverlapAngleEgoLaneL_V_14 1 "VALID" 0 "INVALID" ;
VAL_ 154 OBJ_Is_EMERGENCY_VCL_14 1 "TRUE" 0 "FALSE" ;
VAL_ 154 OBJ_EMERGENCY_LIGHT_COLOR_14 3 "(1000)ORANGE" 2 "(0100)BLUE" 1 "(0010)RED" 0 "(0001)OTHER" ;
VAL_ 154 OBJ_EMERGENCY_V_14 1 "TRUE" 0 "FALSE" ;
VAL_ 154 OBJ_Angle_Top_V_14 1 "VALID" 0 "INVALID" ;
VAL_ 154 OBJ_Angle_Top_STD_V_14 1 "VALID" 0 "INVALID" ;
VAL_ 154 OBJ_Open_Door_Left_14 1 "TRUE" 0 "FALSE" ;
VAL_ 154 OBJ_Open_Door_Right_14 1 "TRUE" 0 "FALSE" ;
VAL_ 154 OBJ_Visible_Left_or_Right_14 2 "RIGHT" 1 "LEFT" 0 "NOT_VISIBLE" ;
VAL_ 154 OBJ_Visible_Left_or_Right_V_14 1 "VALID" 0 "INVALID" ;
VAL_ 154 OBJ_Fusion_Source_15 2 "(BIT_2)RADAR2" 1 "(BIT_1)RADAR1" 0 "(BIT_0)CAMERA" ;
VAL_ 154 OBJ_Triggered_SDM_15 2 "NOT_TRIGGERED" 1 "TRIGGERED" 0 "NOT_AVAILABLE" ;
VAL_ 154 OBJ_Motion_Category_15 13 "ONCOMING" 12 "PRECEEDING" 11 "MOVING" 10 "RTAP" 9 "LTAP" 8 "CROSSING" 7 "MOVING_OUT" 6 "MOVING_IN" 5 "CLOSE_CUT_IN" 4 "PASSING_OUT" 3 "PASSING_IN" 2 "PASSING" 1 "UNDEFINED" 0 "UNFILLED" ;
VAL_ 154 OBJ_Measuring_Status_15 2 "(BIT_2)NOT_VALID_OR_VALID" 1 "(BIT_1)PREDICTED_OR_MEASURED" 0 "(BIT_0)OLD_OR_NEW" ;
VAL_ 154 OBJ_Object_Class_15 9 "TWO_WHEELER" 8 "UNCERTAIN_VCL" 7 "ANIMAL" 6 "GENERAL_OBJECT" 5 "PEDESTRIAN" 4 "BICYCLE" 3 "MOTORBIKE" 2 "TRUCK" 1 "CAR" 0 "UNFILLED" ;
VAL_ 154 OBJ_Camera_Source_15 11 "PARKING_RIGHT" 10 "PARKING_LEFT" 9 "PARKING_REAR" 8 "PARKING_FRONT" 7 "FRONT_CORNER_RIGHT" 6 "FRONT_CORNER_LEFT" 5 "REAR_CORNER_RIGHT" 4 "REAR_CORNER_LEFT" 3 "REAR" 2 "FRONT_FISHEYE" 1 "FRONT_NARROW" 0 "FRONT_MAIN" ;
VAL_ 154 OBJ_Motion_Status_15 5 "MOVING_SLOWLY" 4 "STOPPED" 3 "STATIONARY" 2 "MOVING" 1 "UNKNOWN" 0 "INVALID" ;
VAL_ 154 OBJ_Motion_Orientation_15 13 "INVALID" 12 "NORTH" 11 "NORTH_WEST" 9 "WEST" 7 "SOUTH_WEST" 6 "SOUTH" 5 "SOUTH_EAST" 3 "EAST" 1 "NORTH_EAST" 0 "UNKNOWN" ;
VAL_ 154 OBJ_Has_Cut_Lane_15 1 "TRUE" 0 "FALSE" ;
VAL_ 154 OBJ_Has_Cut_Path_15 1 "TRUE" 0 "FALSE" ;
VAL_ 154 OBJ_Brake_Light_Validity_15 1 "TRUE" 0 "FALSE" ;
VAL_ 154 OBJ_Brake_Light_15 1 "TRUE" 0 "FALSE" ;
VAL_ 154 OBJ_Turn_Indicator_Right_15 1 "TRUE" 0 "FALSE" ;
VAL_ 154 OBJ_Turn_Indicator_Left_15 1 "TRUE" 0 "FALSE" ;
VAL_ 154 OBJ_Turn_Indicator_Validity_15 1 "TRUE" 0 "FALSE" ;
VAL_ 154 OBJ_Right_Out_Of_Image_15 1 "TRUE" 0 "FALSE" ;
VAL_ 154 OBJ_Left_Out_Of_Image_15 1 "TRUE" 0 "FALSE" ;
VAL_ 154 OBJ_Right_Out_Of_Image_V_15 1 "TRUE" 0 "FALSE" ;
VAL_ 154 OBJ_Left_Out_Of_Image_V_15 1 "TRUE" 0 "FALSE" ;
VAL_ 154 OBJ_Top_Out_Of_Image_15 1 "TRUE" 0 "FALSE" ;
VAL_ 154 OBJ_Bottom_Out_Of_Image_15 1 "TRUE" 0 "FALSE" ;
VAL_ 154 OBJ_Top_Out_Of_Image_V_15 1 "VALID" 0 "INVALID" ;
VAL_ 154 OBJ_Bottom_Out_Of_Image_V_15 1 "VALID" 0 "INVALID" ;
VAL_ 154 OBJ_Lane_Assignment_15 5 "RIGHT_RIGHT" 4 "RIGHT" 3 "HOST" 2 "LEFT" 1 "LEFT_LEFT" 0 "UNKNOWN" ;
VAL_ 154 OBJ_Lane_Assignment_V_15 1 "VALID" 0 "INVALID" ;
VAL_ 154 OBJ_Age_Seconds_V_15 1 "VALID" 0 "INVALID" ;
VAL_ 154 OBJ_Width_V_15 1 "VALID" 0 "INVALID" ;
VAL_ 154 OBJ_Width_STD_V_15 1 "VALID" 0 "INVALID" ;
VAL_ 154 OBJ_Length_V_15 1 "VALID" 0 "INVALID" ;
VAL_ 154 OBJ_Length_STD_V_15 1 "VALID" 0 "INVALID" ;
VAL_ 154 OBJ_Height_V_15 1 "VALID" 0 "INVALID" ;
VAL_ 154 OBJ_Height_STD_V_15 1 "VALID" 0 "INVALID" ;
VAL_ 154 OBJ_Abs_Long_Velocity_V_15 1 "VALID" 0 "INVALID" ;
VAL_ 154 OBJ_Abs_Long_Vel_STD_V_15 1 "VALID" 0 "INVALID" ;
VAL_ 154 OBJ_Abs_Lat_Velocity_V_15 1 "VALID" 0 "INVALID" ;
VAL_ 154 OBJ_Abs_Lat_Vel_STD_V_15 1 "VALID" 0 "INVALID" ;
VAL_ 154 OBJ_Abs_Long_Acc_V_15 1 "VALID" 0 "INVALID" ;
VAL_ 154 OBJ_Abs_Long_Acc_STD_V_15 1 "VALID" 0 "INVALID" ;
VAL_ 154 OBJ_Abs_Lat_Acc_V_15 1 "VALID" 0 "INVALID" ;
VAL_ 154 OBJ_Abs_Lat_Acc_STD_V_15 1 "VALID" 0 "INVALID" ;
VAL_ 154 OBJ_Abs_Acceleration_V_15 1 "VALID" 0 "INVALID" ;
VAL_ 154 OBJ_Abs_Acc_STD_V_15 1 "VALID" 0 "INVALID" ;
VAL_ 154 OBJ_Inv_TTC_V_15 1 "VALID" 0 "INVALID" ;
VAL_ 154 OBJ_Inv_TTC_STD_V_15 1 "VALID" 0 "INVALID" ;
VAL_ 154 OBJ_Relative_Long_Acc_V_15 1 "VALID" 0 "INVALID" ;
VAL_ 154 OBJ_Rel_Long_Acc_STD_V_15 1 "VALID" 0 "INVALID" ;
VAL_ 154 OBJ_Relative_Long_Velocity_V_15 1 "VALID" 0 "INVALID" ;
VAL_ 154 OBJ_Rel_Long_Vel_STD_V_15 1 "VALID" 0 "INVALID" ;
VAL_ 154 OBJ_Relative_Lat_Velocity_V_15 1 "VALID" 0 "INVALID" ;
VAL_ 154 OBJ_Rel_Lat_Vel_STD_V_15 1 "VALID" 0 "INVALID" ;
VAL_ 154 OBJ_Long_Distance_V_15 1 "VALID" 0 "INVALID" ;
VAL_ 154 OBJ_Long_Distance_STD_V_15 1 "VALID" 0 "INVALID" ;
VAL_ 154 OBJ_Lat_Distance_V_15 1 "VALID" 0 "INVALID" ;
VAL_ 154 OBJ_Lat_Distance_STD_V_15 1 "VALID" 0 "INVALID" ;
VAL_ 154 OBJ_Absolute_Speed_V_15 1 "VALID" 0 "INVALID" ;
VAL_ 154 OBJ_Absolute_Speed_STD_V_15 1 "VALID" 0 "INVALID" ;
VAL_ 154 OBJ_Heading_V_15 1 "VALID" 0 "INVALID" ;
VAL_ 154 OBJ_Heading_STD_V_15 1 "VALID" 0 "INVALID" ;
VAL_ 154 OBJ_Angle_Rate_STD_V_15 1 "VALID" 0 "INVALID" ;
VAL_ 154 OBJ_Angle_Rate_V_15 1 "VALID" 0 "INVALID" ;
VAL_ 154 OBJ_Angle_Right_V_15 1 "VALID" 0 "INVALID" ;
VAL_ 154 OBJ_Angle_Right_STD_V_15 1 "VALID" 0 "INVALID" ;
VAL_ 154 OBJ_Angle_Left_V_15 1 "VALID" 0 "INVALID" ;
VAL_ 154 OBJ_Angle_Left_STD_V_15 1 "VALID" 0 "INVALID" ;
VAL_ 154 OBJ_Angle_Side_V_15 1 "VALID" 0 "INVALID" ;
VAL_ 154 OBJ_Angle_Side_STD_V_15 1 "VALID" 0 "INVALID" ;
VAL_ 154 OBJ_Angle_Mid_V_15 1 "VALID" 0 "INVALID" ;
VAL_ 154 OBJ_Angle_Mid_STD_V_15 1 "VALID" 0 "INVALID" ;
VAL_ 154 OBJ_Angle_Bottom_V_15 1 "VALID" 0 "INVALID" ;
VAL_ 154 OBJ_Angle_Bottom_STD_V_15 1 "VALID" 0 "INVALID" ;
VAL_ 154 OBJ_Visibility_Side_V_15 1 "VALID" 0 "INVALID" ;
VAL_ 154 OBJ_Visibility_Side_15 2 "REAR" 1 "FRONT" 0 "NOT_VISIBLE" ;
VAL_ 154 OBJ_Is_In_Drivable_Area_15 1 "TRUE" 0 "FALSE" ;
VAL_ 154 OBJ_Is_In_Drivable_Area_V_15 1 "VALID" 0 "INVALID" ;
VAL_ 154 OBJ_Is_VeryClose_V_15 1 "VALID" 0 "INVALID" ;
VAL_ 154 OBJ_Is_VeryClose_15 1 "TRUE" 0 "FALSE" ;
VAL_ 154 OBJ_OverlapAngleEgoLaneR_V_15 1 "VALID" 0 "INVALID" ;
VAL_ 154 OBJ_OverlapAngleEgoLaneL_V_15 1 "VALID" 0 "INVALID" ;
VAL_ 154 OBJ_Is_EMERGENCY_VCL_15 1 "TRUE" 0 "FALSE" ;
VAL_ 154 OBJ_EMERGENCY_LIGHT_COLOR_15 3 "(1000)ORANGE" 2 "(0100)BLUE" 1 "(0010)RED" 0 "(0001)OTHER" ;
VAL_ 154 OBJ_EMERGENCY_V_15 1 "TRUE" 0 "FALSE" ;
VAL_ 154 OBJ_Angle_Top_V_15 1 "VALID" 0 "INVALID" ;
VAL_ 154 OBJ_Angle_Top_STD_V_15 1 "VALID" 0 "INVALID" ;
VAL_ 154 OBJ_Open_Door_Left_15 1 "TRUE" 0 "FALSE" ;
VAL_ 154 OBJ_Open_Door_Right_15 1 "TRUE" 0 "FALSE" ;
VAL_ 154 OBJ_Visible_Left_or_Right_15 2 "RIGHT" 1 "LEFT" 0 "NOT_VISIBLE" ;
VAL_ 154 OBJ_Visible_Left_or_Right_V_15 1 "VALID" 0 "INVALID" ;
VAL_ 154 OBJ_Fusion_Source_16 2 "(BIT_2)RADAR2" 1 "(BIT_1)RADAR1" 0 "(BIT_0)CAMERA" ;
VAL_ 154 OBJ_Triggered_SDM_16 2 "NOT_TRIGGERED" 1 "TRIGGERED" 0 "NOT_AVAILABLE" ;
VAL_ 154 OBJ_Motion_Category_16 13 "ONCOMING" 12 "PRECEEDING" 11 "MOVING" 10 "RTAP" 9 "LTAP" 8 "CROSSING" 7 "MOVING_OUT" 6 "MOVING_IN" 5 "CLOSE_CUT_IN" 4 "PASSING_OUT" 3 "PASSING_IN" 2 "PASSING" 1 "UNDEFINED" 0 "UNFILLED" ;
VAL_ 154 OBJ_Measuring_Status_16 2 "(BIT_2)NOT_VALID_OR_VALID" 1 "(BIT_1)PREDICTED_OR_MEASURED" 0 "(BIT_0)OLD_OR_NEW" ;
VAL_ 154 OBJ_Object_Class_16 9 "TWO_WHEELER" 8 "UNCERTAIN_VCL" 7 "ANIMAL" 6 "GENERAL_OBJECT" 5 "PEDESTRIAN" 4 "BICYCLE" 3 "MOTORBIKE" 2 "TRUCK" 1 "CAR" 0 "UNFILLED" ;
VAL_ 154 OBJ_Camera_Source_16 11 "PARKING_RIGHT" 10 "PARKING_LEFT" 9 "PARKING_REAR" 8 "PARKING_FRONT" 7 "FRONT_CORNER_RIGHT" 6 "FRONT_CORNER_LEFT" 5 "REAR_CORNER_RIGHT" 4 "REAR_CORNER_LEFT" 3 "REAR" 2 "FRONT_FISHEYE" 1 "FRONT_NARROW" 0 "FRONT_MAIN" ;
VAL_ 154 OBJ_Motion_Status_16 5 "MOVING_SLOWLY" 4 "STOPPED" 3 "STATIONARY" 2 "MOVING" 1 "UNKNOWN" 0 "INVALID" ;
VAL_ 154 OBJ_Motion_Orientation_16 13 "INVALID" 12 "NORTH" 11 "NORTH_WEST" 9 "WEST" 7 "SOUTH_WEST" 6 "SOUTH" 5 "SOUTH_EAST" 3 "EAST" 1 "NORTH_EAST" 0 "UNKNOWN" ;
VAL_ 154 OBJ_Has_Cut_Lane_16 1 "TRUE" 0 "FALSE" ;
VAL_ 154 OBJ_Has_Cut_Path_16 1 "TRUE" 0 "FALSE" ;
VAL_ 154 OBJ_Brake_Light_Validity_16 1 "TRUE" 0 "FALSE" ;
VAL_ 154 OBJ_Brake_Light_16 1 "TRUE" 0 "FALSE" ;
VAL_ 154 OBJ_Turn_Indicator_Right_16 1 "TRUE" 0 "FALSE" ;
VAL_ 154 OBJ_Turn_Indicator_Left_16 1 "TRUE" 0 "FALSE" ;
VAL_ 154 OBJ_Turn_Indicator_Validity_16 1 "TRUE" 0 "FALSE" ;
VAL_ 154 OBJ_Right_Out_Of_Image_16 1 "TRUE" 0 "FALSE" ;
VAL_ 154 OBJ_Left_Out_Of_Image_16 1 "TRUE" 0 "FALSE" ;
VAL_ 154 OBJ_Right_Out_Of_Image_V_16 1 "TRUE" 0 "FALSE" ;
VAL_ 154 OBJ_Left_Out_Of_Image_V_16 1 "TRUE" 0 "FALSE" ;
VAL_ 154 OBJ_Top_Out_Of_Image_16 1 "TRUE" 0 "FALSE" ;
VAL_ 154 OBJ_Bottom_Out_Of_Image_16 1 "TRUE" 0 "FALSE" ;
VAL_ 154 OBJ_Top_Out_Of_Image_V_16 1 "VALID" 0 "INVALID" ;
VAL_ 154 OBJ_Bottom_Out_Of_Image_V_16 1 "VALID" 0 "INVALID" ;
VAL_ 154 OBJ_Lane_Assignment_16 5 "RIGHT_RIGHT" 4 "RIGHT" 3 "HOST" 2 "LEFT" 1 "LEFT_LEFT" 0 "UNKNOWN" ;
VAL_ 154 OBJ_Lane_Assignment_V_16 1 "VALID" 0 "INVALID" ;
VAL_ 154 OBJ_Age_Seconds_V_16 1 "VALID" 0 "INVALID" ;
VAL_ 154 OBJ_Width_V_16 1 "VALID" 0 "INVALID" ;
VAL_ 154 OBJ_Width_STD_V_16 1 "VALID" 0 "INVALID" ;
VAL_ 154 OBJ_Length_V_16 1 "VALID" 0 "INVALID" ;
VAL_ 154 OBJ_Length_STD_V_16 1 "VALID" 0 "INVALID" ;
VAL_ 154 OBJ_Height_V_16 1 "VALID" 0 "INVALID" ;
VAL_ 154 OBJ_Height_STD_V_16 1 "VALID" 0 "INVALID" ;
VAL_ 154 OBJ_Abs_Long_Velocity_V_16 1 "VALID" 0 "INVALID" ;
VAL_ 154 OBJ_Abs_Long_Vel_STD_V_16 1 "VALID" 0 "INVALID" ;
VAL_ 154 OBJ_Abs_Lat_Velocity_V_16 1 "VALID" 0 "INVALID" ;
VAL_ 154 OBJ_Abs_Lat_Vel_STD_V_16 1 "VALID" 0 "INVALID" ;
VAL_ 154 OBJ_Abs_Long_Acc_V_16 1 "VALID" 0 "INVALID" ;
VAL_ 154 OBJ_Abs_Long_Acc_STD_V_16 1 "VALID" 0 "INVALID" ;
VAL_ 154 OBJ_Abs_Lat_Acc_V_16 1 "VALID" 0 "INVALID" ;
VAL_ 154 OBJ_Abs_Lat_Acc_STD_V_16 1 "VALID" 0 "INVALID" ;
VAL_ 154 OBJ_Abs_Acceleration_V_16 1 "VALID" 0 "INVALID" ;
VAL_ 154 OBJ_Abs_Acc_STD_V_16 1 "VALID" 0 "INVALID" ;
VAL_ 154 OBJ_Inv_TTC_V_16 1 "VALID" 0 "INVALID" ;
VAL_ 154 OBJ_Inv_TTC_STD_V_16 1 "VALID" 0 "INVALID" ;
VAL_ 154 OBJ_Relative_Long_Acc_V_16 1 "VALID" 0 "INVALID" ;
VAL_ 154 OBJ_Rel_Long_Acc_STD_V_16 1 "VALID" 0 "INVALID" ;
VAL_ 154 OBJ_Relative_Long_Velocity_V_16 1 "VALID" 0 "INVALID" ;
VAL_ 154 OBJ_Rel_Long_Vel_STD_V_16 1 "VALID" 0 "INVALID" ;
VAL_ 154 OBJ_Relative_Lat_Velocity_V_16 1 "VALID" 0 "INVALID" ;
VAL_ 154 OBJ_Rel_Lat_Vel_STD_V_16 1 "VALID" 0 "INVALID" ;
VAL_ 154 OBJ_Long_Distance_V_16 1 "VALID" 0 "INVALID" ;
VAL_ 154 OBJ_Long_Distance_STD_V_16 1 "VALID" 0 "INVALID" ;
VAL_ 154 OBJ_Lat_Distance_V_16 1 "VALID" 0 "INVALID" ;
VAL_ 154 OBJ_Lat_Distance_STD_V_16 1 "VALID" 0 "INVALID" ;
VAL_ 154 OBJ_Absolute_Speed_V_16 1 "VALID" 0 "INVALID" ;
VAL_ 154 OBJ_Absolute_Speed_STD_V_16 1 "VALID" 0 "INVALID" ;
VAL_ 154 OBJ_Heading_V_16 1 "VALID" 0 "INVALID" ;
VAL_ 154 OBJ_Heading_STD_V_16 1 "VALID" 0 "INVALID" ;
VAL_ 154 OBJ_Angle_Rate_STD_V_16 1 "VALID" 0 "INVALID" ;
VAL_ 154 OBJ_Angle_Rate_V_16 1 "VALID" 0 "INVALID" ;
VAL_ 154 OBJ_Angle_Right_V_16 1 "VALID" 0 "INVALID" ;
VAL_ 154 OBJ_Angle_Right_STD_V_16 1 "VALID" 0 "INVALID" ;
VAL_ 154 OBJ_Angle_Left_V_16 1 "VALID" 0 "INVALID" ;
VAL_ 154 OBJ_Angle_Left_STD_V_16 1 "VALID" 0 "INVALID" ;
VAL_ 154 OBJ_Angle_Side_V_16 1 "VALID" 0 "INVALID" ;
VAL_ 154 OBJ_Angle_Side_STD_V_16 1 "VALID" 0 "INVALID" ;
VAL_ 154 OBJ_Angle_Mid_V_16 1 "VALID" 0 "INVALID" ;
VAL_ 154 OBJ_Angle_Mid_STD_V_16 1 "VALID" 0 "INVALID" ;
VAL_ 154 OBJ_Angle_Bottom_V_16 1 "VALID" 0 "INVALID" ;
VAL_ 154 OBJ_Angle_Bottom_STD_V_16 1 "VALID" 0 "INVALID" ;
VAL_ 154 OBJ_Visibility_Side_V_16 1 "VALID" 0 "INVALID" ;
VAL_ 154 OBJ_Visibility_Side_16 2 "REAR" 1 "FRONT" 0 "NOT_VISIBLE" ;
VAL_ 154 OBJ_Is_In_Drivable_Area_16 1 "TRUE" 0 "FALSE" ;
VAL_ 154 OBJ_Is_In_Drivable_Area_V_16 1 "VALID" 0 "INVALID" ;
VAL_ 154 OBJ_Is_VeryClose_V_16 1 "VALID" 0 "INVALID" ;
VAL_ 154 OBJ_Is_VeryClose_16 1 "TRUE" 0 "FALSE" ;
VAL_ 154 OBJ_OverlapAngleEgoLaneR_V_16 1 "VALID" 0 "INVALID" ;
VAL_ 154 OBJ_OverlapAngleEgoLaneL_V_16 1 "VALID" 0 "INVALID" ;
VAL_ 154 OBJ_Is_EMERGENCY_VCL_16 1 "TRUE" 0 "FALSE" ;
VAL_ 154 OBJ_EMERGENCY_LIGHT_COLOR_16 3 "(1000)ORANGE" 2 "(0100)BLUE" 1 "(0010)RED" 0 "(0001)OTHER" ;
VAL_ 154 OBJ_EMERGENCY_V_16 1 "TRUE" 0 "FALSE" ;
VAL_ 154 OBJ_Angle_Top_V_16 1 "VALID" 0 "INVALID" ;
VAL_ 154 OBJ_Angle_Top_STD_V_16 1 "VALID" 0 "INVALID" ;
VAL_ 154 OBJ_Open_Door_Left_16 1 "TRUE" 0 "FALSE" ;
VAL_ 154 OBJ_Open_Door_Right_16 1 "TRUE" 0 "FALSE" ;
VAL_ 154 OBJ_Visible_Left_or_Right_16 2 "RIGHT" 1 "LEFT" 0 "NOT_VISIBLE" ;
VAL_ 154 OBJ_Visible_Left_or_Right_V_16 1 "VALID" 0 "INVALID" ;
VAL_ 154 OBJ_Fusion_Source_17 2 "(BIT_2)RADAR2" 1 "(BIT_1)RADAR1" 0 "(BIT_0)CAMERA" ;
VAL_ 154 OBJ_Triggered_SDM_17 2 "NOT_TRIGGERED" 1 "TRIGGERED" 0 "NOT_AVAILABLE" ;
VAL_ 154 OBJ_Motion_Category_17 13 "ONCOMING" 12 "PRECEEDING" 11 "MOVING" 10 "RTAP" 9 "LTAP" 8 "CROSSING" 7 "MOVING_OUT" 6 "MOVING_IN" 5 "CLOSE_CUT_IN" 4 "PASSING_OUT" 3 "PASSING_IN" 2 "PASSING" 1 "UNDEFINED" 0 "UNFILLED" ;
VAL_ 154 OBJ_Measuring_Status_17 2 "(BIT_2)NOT_VALID_OR_VALID" 1 "(BIT_1)PREDICTED_OR_MEASURED" 0 "(BIT_0)OLD_OR_NEW" ;
VAL_ 154 OBJ_Object_Class_17 9 "TWO_WHEELER" 8 "UNCERTAIN_VCL" 7 "ANIMAL" 6 "GENERAL_OBJECT" 5 "PEDESTRIAN" 4 "BICYCLE" 3 "MOTORBIKE" 2 "TRUCK" 1 "CAR" 0 "UNFILLED" ;
VAL_ 154 OBJ_Camera_Source_17 11 "PARKING_RIGHT" 10 "PARKING_LEFT" 9 "PARKING_REAR" 8 "PARKING_FRONT" 7 "FRONT_CORNER_RIGHT" 6 "FRONT_CORNER_LEFT" 5 "REAR_CORNER_RIGHT" 4 "REAR_CORNER_LEFT" 3 "REAR" 2 "FRONT_FISHEYE" 1 "FRONT_NARROW" 0 "FRONT_MAIN" ;
VAL_ 154 OBJ_Motion_Status_17 5 "MOVING_SLOWLY" 4 "STOPPED" 3 "STATIONARY" 2 "MOVING" 1 "UNKNOWN" 0 "INVALID" ;
VAL_ 154 OBJ_Motion_Orientation_17 13 "INVALID" 12 "NORTH" 11 "NORTH_WEST" 9 "WEST" 7 "SOUTH_WEST" 6 "SOUTH" 5 "SOUTH_EAST" 3 "EAST" 1 "NORTH_EAST" 0 "UNKNOWN" ;
VAL_ 154 OBJ_Has_Cut_Lane_17 1 "TRUE" 0 "FALSE" ;
VAL_ 154 OBJ_Has_Cut_Path_17 1 "TRUE" 0 "FALSE" ;
VAL_ 154 OBJ_Brake_Light_Validity_17 1 "TRUE" 0 "FALSE" ;
VAL_ 154 OBJ_Brake_Light_17 1 "TRUE" 0 "FALSE" ;
VAL_ 154 OBJ_Turn_Indicator_Right_17 1 "TRUE" 0 "FALSE" ;
VAL_ 154 OBJ_Turn_Indicator_Left_17 1 "TRUE" 0 "FALSE" ;
VAL_ 154 OBJ_Turn_Indicator_Validity_17 1 "TRUE" 0 "FALSE" ;
VAL_ 154 OBJ_Right_Out_Of_Image_17 1 "TRUE" 0 "FALSE" ;
VAL_ 154 OBJ_Left_Out_Of_Image_17 1 "TRUE" 0 "FALSE" ;
VAL_ 154 OBJ_Right_Out_Of_Image_V_17 1 "TRUE" 0 "FALSE" ;
VAL_ 154 OBJ_Left_Out_Of_Image_V_17 1 "TRUE" 0 "FALSE" ;
VAL_ 154 OBJ_Top_Out_Of_Image_17 1 "TRUE" 0 "FALSE" ;
