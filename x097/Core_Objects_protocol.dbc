VERSION "15"
// BundelVersion=v4.21.5_CF1
NS_ :

BS_:

BU_: EyeQ4 MCU

BO_ 154 Core_Objects_protocol: 4820 EyeQ4
 SG_ OBJ_Zero_byte : 0|8@1+ (1,0) [0|255] "NA" MCU
 SG_ Reserved_1 : 8|24@1+ (1,0) [0|0] "NA" MCU
 SG_ OBJ_Header_CRC : 32|32@1+ (1,0) [0|4294967295] "NA" MCU
 SG_ OBJ_Protocol_Version : 64|8@1+ (1,0) [15|15] "counter" MCU
 SG_ OBJ_Sync_ID : 72|8@1+ (1,0) [0|255] "counter" MCU
 SG_ OBJ_VRU_Count : 80|5@1+ (1,0) [0|20] "counter" MCU
 SG_ OBJ_VD_Count : 85|5@1+ (1,0) [0|20] "counter" MCU
 SG_ OBJ_General_OBJ_Count : 90|4@1+ (1,0) [0|10] "counter" MCU
 SG_ Reserved_2 : 94|2@1+ (1,0) [0|0] "NA" MCU
 SG_ OBJ_Animal_Count : 96|4@1+ (1,0) [0|10] "counter" MCU
 SG_ OBJ_VD_NIV_Left : 100|8@1+ (1,0) [0|255] "ID" MCU
 SG_ OBJ_VD_NIV_Right : 108|8@1+ (1,0) [0|255] "ID" MCU
 SG_ OBJ_VD_CIPV_ID : 116|8@1+ (1,0) [0|255] "ID" MCU
 SG_ OBJ_VD_CIPV_Lost : 124|2@1+ (1,0) [0|2] "ENUM" MCU
 SG_ OBJ_VD_Allow_Acc : 126|2@1+ (1,0) [0|2] "ENUM" MCU
 SG_ OBJ_Is_Blocked_Left : 128|1@1+ (1,0) [0|1] "bool" MCU
 SG_ OBJ_Is_Blocked_Right : 129|1@1+ (1,0) [0|1] "bool" MCU
 SG_ OBJ_CIPBIC_ID : 130|8@1+ (1,0) [0|255] "ID" MCU
 SG_ OBJ_CIPBIC_Lost : 138|2@1+ (1,0) [0|2] "ENUM" MCU
 SG_ Reserved_3 : 140|20@1+ (1,0) [0|0] "NA" MCU
 SG_ OBJ_CRC_0 : 160|32@1+ (1,0) [0|4294967295] "NA" MCU
 SG_ OBJ_ID_0 : 192|8@1+ (1,0) [0|255] "counter" MCU
 SG_ OBJ_Existence_Probability_0 : 200|8@1+ (0.01,0) [0|1] "NA" MCU
 SG_ OBJ_Fusion_Source_0 : 208|16@1+ (1,0) [0|65535] "BITWIZE" MCU
 SG_ OBJ_Triggered_SDM_0 : 224|2@1+ (1,0) [0|2] "ENUM" MCU
 SG_ OBJ_Motion_Category_0 : 226|4@1+ (1,0) [0|13] "ENUM" MCU
 SG_ OBJ_Moving_IN_Probability_0 : 230|7@1+ (0.01,0) [0|1] "NA" MCU
 SG_ OBJ_Object_Age_0 : 237|11@1+ (1,0) [0|2047] "frames" MCU
 SG_ OBJ_Measuring_Status_0 : 248|3@1+ (1,0) [0|7] "BITWIZE" MCU
 SG_ OBJ_Object_Class_0 : 251|4@1+ (1,0) [0|9] "ENUM" MCU
 SG_ Reserved_4_0 : 255|1@1+ (1,0) [0|0] "NA" MCU
 SG_ OBJ_Class_Probability_0 : 256|7@1+ (0.01,0) [0|1] "NA" MCU
 SG_ OBJ_Car_Probability_0 : 263|7@1+ (0.01,0) [0|1] "NA" MCU
 SG_ OBJ_Truck_Probability_0 : 270|7@1+ (0.01,0) [0|1] "NA" MCU
 SG_ OBJ_Bike_Probability_0 : 277|7@1+ (0.01,0) [0|1] "NA" MCU
 SG_ OBJ_Camera_Source_0 : 284|4@1+ (1,0) [0|15] "ENUM" MCU
 SG_ OBJ_Motion_Status_0 : 288|3@1+ (1,0) [0|5] "ENUM" MCU
 SG_ OBJ_Motion_Orientation_0 : 291|4@1+ (1,0) [0|13] "ENUM" MCU
 SG_ OBJ_Has_Cut_Lane_0 : 295|1@1+ (1,0) [0|1] "bool" MCU
 SG_ OBJ_Has_Cut_Path_0 : 296|1@1+ (1,0) [0|1] "bool" MCU
 SG_ OBJ_Brake_Light_Validity_0 : 297|1@1+ (1,0) [0|1] "bool" MCU
 SG_ OBJ_Brake_Light_0 : 298|1@1+ (1,0) [0|1] "bool" MCU
 SG_ OBJ_Turn_Indicator_Right_0 : 299|1@1+ (1,0) [0|1] "bool" MCU
 SG_ OBJ_Turn_Indicator_Left_0 : 300|1@1+ (1,0) [0|1] "bool" MCU
 SG_ OBJ_Turn_Indicator_Validity_0 : 301|1@1+ (1,0) [0|1] "bool" MCU
 SG_ OBJ_Right_Out_Of_Image_0 : 302|1@1+ (1,0) [0|1] "bool" MCU
 SG_ OBJ_Left_Out_Of_Image_0 : 303|1@1+ (1,0) [0|1] "bool" MCU
 SG_ OBJ_Right_Out_Of_Image_V_0 : 304|1@1+ (1,0) [0|1] "bool" MCU
 SG_ OBJ_Left_Out_Of_Image_V_0 : 305|1@1+ (1,0) [0|1] "bool" MCU
 SG_ OBJ_Top_Out_Of_Image_0 : 306|1@1+ (1,0) [0|1] "bool" MCU
 SG_ OBJ_Bottom_Out_Of_Image_0 : 307|1@1+ (1,0) [0|1] "bool" MCU
 SG_ OBJ_Top_Out_Of_Image_V_0 : 308|1@1+ (1,0) [0|1] "bool" MCU
 SG_ OBJ_Bottom_Out_Of_Image_V_0 : 309|1@1+ (1,0) [0|1] "bool" MCU
 SG_ OBJ_Lane_Assignment_0 : 310|3@1+ (1,0) [0|5] "ENUM" MCU
 SG_ OBJ_Lane_Assignment_V_0 : 313|1@1+ (1,0) [0|1] "bool" MCU
 SG_ Reserved_5_0 : 314|6@1+ (1,0) [0|0] "NA" MCU
 SG_ OBJ_Age_Seconds_0 : 320|7@1+ (1,0) [0|100] "s" MCU
 SG_ OBJ_Age_Seconds_V_0 : 327|1@1+ (1,0) [0|1] "bool" MCU
 SG_ OBJ_Width_0 : 328|9@1+ (0.01,0) [0.4|2.95] "m" MCU
 SG_ OBJ_Width_V_0 : 337|1@1+ (1,0) [0|1] "bool" MCU
 SG_ OBJ_Width_STD_0 : 338|11@1+ (0.001,0) [0|2] "m" MCU
 SG_ OBJ_Width_STD_V_0 : 349|1@1+ (1,0) [0|1] "bool" MCU
 SG_ Reserved_6_0 : 350|2@1+ (1,0) [0|0] "NA" MCU
 SG_ OBJ_Length_0 : 352|9@1+ (0.05,0) [0.6|21] "m" MCU
 SG_ OBJ_Length_V_0 : 361|1@1+ (1,0) [0|1] "bool" MCU
 SG_ OBJ_Length_STD_0 : 362|10@1+ (0.01,0) [0|10] "m" MCU
 SG_ OBJ_Length_STD_V_0 : 372|1@1+ (1,0) [0|1] "bool" MCU
 SG_ OBJ_Radar_ID_0 : 373|8@1+ (1,0) [0|255] "counter" MCU
 SG_ Reserved_7_0 : 381|3@1+ (1,0) [0|0] "NA" MCU
 SG_ OBJ_Height_0 : 384|9@1+ (0.01,0) [0|2.95] "m" MCU
 SG_ OBJ_Height_V_0 : 393|1@1+ (1,0) [0|1] "bool" MCU
 SG_ OBJ_Height_STD_0 : 394|11@1+ (0.001,0) [0|2] "m" MCU
 SG_ OBJ_Height_STD_V_0 : 405|1@1+ (1,0) [0|1] "bool" MCU
 SG_ Reserved_8_0 : 406|10@1+ (1,0) [0|0] "NA" MCU
 SG_ OBJ_Abs_Long_Velocity_0 : 416|12@1+ (0.05,-100) [-100|100] "m_per_s" MCU
 SG_ OBJ_Abs_Long_Velocity_V_0 : 428|1@1+ (1,0) [0|1] "bool" MCU
 SG_ OBJ_Abs_Long_Velocity_STD_0 : 429|13@1+ (0.01,0) [0|65] "m_per_s" MCU
 SG_ OBJ_Abs_Long_Vel_STD_V_0 : 442|1@1+ (1,0) [0|1] "bool" MCU
 SG_ Reserved_9_0 : 443|5@1+ (1,0) [0|0] "NA" MCU
 SG_ OBJ_Abs_Lat_Velocity_0 : 448|11@1+ (0.05,-50) [-50|50] "m_per_s" MCU
 SG_ OBJ_Abs_Lat_Velocity_V_0 : 459|1@1+ (1,0) [0|1] "bool" MCU
 SG_ OBJ_Abs_Lat_Velocity_STD_0 : 460|13@1+ (0.01,0) [0|50] "m_per_s" MCU
 SG_ OBJ_Abs_Lat_Vel_STD_V_0 : 473|1@1+ (1,0) [0|1] "bool" MCU
 SG_ Reserved_10_0 : 474|6@1+ (1,0) [0|0] "NA" MCU
 SG_ OBJ_Abs_Long_Acc_0 : 480|9@1+ (0.05,-10) [-10|10] "m_per_s2" MCU
 SG_ OBJ_Abs_Long_Acc_V_0 : 489|1@1+ (1,0) [0|1] "bool" MCU
 SG_ OBJ_Abs_Long_Acc_STD_0 : 490|10@1+ (0.01,0) [0|7.3] "m_per_s2" MCU
 SG_ OBJ_Abs_Long_Acc_STD_V_0 : 500|1@1+ (1,0) [0|1] "bool" MCU
 SG_ OBJ_Abs_Lat_Acc_0 : 501|9@1+ (0.05,-10) [-10|10] "m_per_s2" MCU
 SG_ OBJ_Abs_Lat_Acc_V_0 : 510|1@1+ (1,0) [0|1] "bool" MCU
 SG_ Reserved_11_0 : 511|1@1+ (1,0) [0|0] "NA" MCU
 SG_ OBJ_Abs_Lat_Acc_STD_0 : 512|10@1+ (0.01,0) [0|7.3] "m_per_s2" MCU
 SG_ OBJ_Abs_Lat_Acc_STD_V_0 : 522|1@1+ (1,0) [0|1] "bool" MCU
 SG_ OBJ_Abs_Acceleration_0 : 523|9@1+ (0.05,-12.7) [-12.7|12.7] "m_per_s2" MCU
 SG_ OBJ_Abs_Acceleration_V_0 : 532|1@1+ (1,0) [0|1] "bool" MCU
 SG_ OBJ_Abs_Acc_STD_0 : 533|10@1+ (0.01,0) [0|7.3] "m_per_s2" MCU
 SG_ OBJ_Abs_Acc_STD_V_0 : 543|1@1+ (1,0) [0|1] "bool" MCU
 SG_ OBJ_Inv_TTC_0 : 544|11@1+ (0.01,-8) [-8|8] "INV(s)" MCU
 SG_ OBJ_Inv_TTC_V_0 : 555|1@1+ (1,0) [0|1] "bool" MCU
 SG_ OBJ_Inv_TTC_STD_0 : 556|12@1+ (0.001,0) [0|4] "INV(s)" MCU
 SG_ OBJ_Inv_TTC_STD_V_0 : 568|1@1+ (1,0) [0|1] "bool" MCU
 SG_ Reserved_12_0 : 569|7@1+ (1,0) [0|0] "NA" MCU
 SG_ OBJ_Relative_Long_Acc_0 : 576|10@1+ (0.05,-20) [-20|20] "m_per_s2" MCU
 SG_ OBJ_Relative_Long_Acc_V_0 : 586|1@1+ (1,0) [0|1] "bool" MCU
 SG_ OBJ_Relative_Long_Acc_STD_0 : 587|10@1+ (0.01,0) [0|7.3] "m_per_s2" MCU
 SG_ OBJ_Rel_Long_Acc_STD_V_0 : 597|1@1+ (1,0) [0|1] "bool" MCU
 SG_ Reserved_13_0 : 598|10@1+ (1,0) [0|0] "NA" MCU
 SG_ OBJ_Relative_Long_Velocity_0 : 608|13@1+ (0.05,-120) [-120|130] "m_per_s" MCU
 SG_ OBJ_Relative_Long_Velocity_V_0 : 621|1@1+ (1,0) [0|1] "bool" MCU
 SG_ OBJ_Relative_Long_Vel_STD_0 : 622|14@1+ (0.01,0) [0|130] "m_per_s" MCU
 SG_ OBJ_Rel_Long_Vel_STD_V_0 : 636|1@1+ (1,0) [0|1] "bool" MCU
 SG_ Reserved_14_0 : 637|3@1+ (1,0) [0|0] "NA" MCU
 SG_ OBJ_Relative_Lat_Velocity_0 : 640|11@1+ (0.05,-50) [-50|50] "m_per_s" MCU
 SG_ OBJ_Relative_Lat_Velocity_V_0 : 651|1@1+ (1,0) [0|1] "bool" MCU
 SG_ OBJ_Relative_Lat_Velocity_STD_0 : 652|13@1+ (0.01,0) [0|50] "m_per_s" MCU
 SG_ OBJ_Rel_Lat_Vel_STD_V_0 : 665|1@1+ (1,0) [0|1] "bool" MCU
 SG_ Reserved_15_0 : 666|6@1+ (1,0) [0|0] "NA" MCU
 SG_ OBJ_Long_Distance_0 : 672|14@1+ (0.05,-200) [-200|500] "m" MCU
 SG_ OBJ_Long_Distance_V_0 : 686|1@1+ (1,0) [0|1] "bool" MCU
 SG_ OBJ_Long_Distance_STD_0 : 687|15@1+ (0.01,0) [0|250] "m" MCU
 SG_ OBJ_Long_Distance_STD_V_0 : 702|1@1+ (1,0) [0|1] "bool" MCU
 SG_ Reserved_16_0 : 703|1@1+ (1,0) [0|0] "NA" MCU
 SG_ OBJ_Lat_Distance_0 : 704|12@1+ (0.05,-100) [-100|100] "m" MCU
 SG_ OBJ_Lat_Distance_V_0 : 716|1@1+ (1,0) [0|1] "bool" MCU
 SG_ OBJ_Lat_Distance_STD_0 : 717|14@1+ (0.01,0) [0|100] "m" MCU
 SG_ OBJ_Lat_Distance_STD_V_0 : 731|1@1+ (1,0) [0|1] "bool" MCU
 SG_ Reserved_17_0 : 732|4@1+ (1,0) [0|0] "NA" MCU
 SG_ OBJ_Absolute_Speed_0 : 736|12@1+ (0.05,-65) [-65|65] "m_per_s" MCU
 SG_ OBJ_Absolute_Speed_V_0 : 748|1@1+ (1,0) [0|1] "bool" MCU
 SG_ OBJ_Absolute_Speed_STD_0 : 749|13@1+ (0.01,0) [0|65] "m_per_s" MCU
 SG_ OBJ_Absolute_Speed_STD_V_0 : 762|1@1+ (1,0) [0|1] "bool" MCU
 SG_ Reserved_18_0 : 763|5@1+ (1,0) [0|0] "NA" MCU
 SG_ OBJ_Heading_0 : 768|10@1+ (0.01,-3.14) [-3.14|3.14] "rad" MCU
 SG_ OBJ_Heading_V_0 : 778|1@1+ (1,0) [0|1] "bool" MCU
 SG_ OBJ_Heading_STD_0 : 779|15@1+ (0.0001,0) [0|3.14] "rad" MCU
 SG_ OBJ_Heading_STD_V_0 : 794|1@1+ (1,0) [0|1] "bool" MCU
 SG_ Reserved_19_0 : 795|5@1+ (1,0) [0|0] "NA" MCU
 SG_ OBJ_Angle_Rate_STD_0 : 800|15@1+ (0.0001,0) [0|2.2318] "RPS" MCU
 SG_ OBJ_Angle_Rate_STD_V_0 : 815|1@1+ (1,0) [0|1] "bool" MCU
 SG_ OBJ_Angle_Rate_0 : 816|12@1+ (0.002,-2.234) [-2.234|2.2318] "RPS" MCU
 SG_ OBJ_Angle_Rate_V_0 : 828|1@1+ (1,0) [0|1] "bool" MCU
 SG_ Reserved_20_0 : 829|3@1+ (1,0) [0|0] "NA" MCU
 SG_ OBJ_Angle_Right_0 : 832|14@1+ (0.0002,-1.571) [-1.571|1.571] "rad" MCU
 SG_ OBJ_Angle_Right_V_0 : 846|1@1+ (1,0) [0|1] "bool" MCU
 SG_ OBJ_Angle_Right_STD_0 : 847|14@1+ (0.0001,0) [0|1.571] "rad" MCU
 SG_ OBJ_Angle_Right_STD_V_0 : 861|1@1+ (1,0) [0|1] "bool" MCU
 SG_ Reserved_21_0 : 862|2@1+ (1,0) [0|0] "NA" MCU
 SG_ OBJ_Angle_Left_0 : 864|14@1+ (0.0002,-1.571) [-1.571|1.571] "rad" MCU
 SG_ OBJ_Angle_Left_V_0 : 878|1@1+ (1,0) [0|1] "bool" MCU
 SG_ OBJ_Angle_Left_STD_0 : 879|14@1+ (0.0001,0) [0|1.571] "rad" MCU
 SG_ OBJ_Angle_Left_STD_V_0 : 893|1@1+ (1,0) [0|1] "bool" MCU
 SG_ Reserved_22_0 : 894|2@1+ (1,0) [0|0] "NA" MCU
 SG_ OBJ_Angle_Side_0 : 896|14@1+ (0.0002,-1.571) [-1.571|1.571] "rad" MCU
 SG_ OBJ_Angle_Side_V_0 : 910|1@1+ (1,0) [0|1] "bool" MCU
 SG_ OBJ_Angle_Side_STD_0 : 911|14@1+ (0.0001,0) [0|1.571] "rad" MCU
 SG_ OBJ_Angle_Side_STD_V_0 : 925|1@1+ (1,0) [0|1] "bool" MCU
 SG_ OBJ_Angle_Mid_V_0 : 926|1@1+ (1,0) [0|1] "bool" MCU
 SG_ Reserved_23_0 : 927|1@1+ (1,0) [0|0] "NA" MCU
 SG_ OBJ_Angle_Mid_0 : 928|14@1+ (0.0002,-1.571) [-1.571|1.571] "rad" MCU
 SG_ OBJ_Angle_Mid_STD_0 : 942|14@1+ (0.0001,0) [0|1.571] "rad" MCU
 SG_ OBJ_Angle_Mid_STD_V_0 : 956|1@1+ (1,0) [0|1] "bool" MCU
 SG_ OBJ_Angle_Bottom_V_0 : 957|1@1+ (1,0) [0|1] "bool" MCU
 SG_ Reserved_24_0 : 958|2@1+ (1,0) [0|0] "NA" MCU
 SG_ OBJ_Angle_Bottom_0 : 960|14@1+ (0.0002,-1.571) [-1.571|1.571] "rad" MCU
 SG_ OBJ_Angle_Bottom_STD_0 : 974|14@1+ (0.0001,0) [0|1.571] "rad" MCU
 SG_ OBJ_Angle_Bottom_STD_V_0 : 988|1@1+ (1,0) [0|1] "bool" MCU
 SG_ OBJ_Visibility_Side_V_0 : 989|1@1+ (1,0) [0|1] "bool" MCU
 SG_ OBJ_Visibility_Side_0 : 990|2@1+ (1,0) [0|2] "ENUM" MCU
 SG_ OBJ_Is_In_Drivable_Area_0 : 992|1@1+ (1,0) [0|1] "bool" MCU
 SG_ OBJ_Is_In_Drivable_Area_V_0 : 993|1@1+ (1,0) [0|1] "bool" MCU
 SG_ OBJ_Is_VeryClose_V_0 : 994|1@1+ (1,0) [0|1] "bool" MCU
 SG_ OBJ_Is_VeryClose_0 : 995|1@1+ (1,0) [0|1] "bool" MCU
 SG_ OBJ_Buffer_C4_0 : 996|2@1+ (1,0) [0|2] "NA" MCU
 SG_ OBJ_Buffer_C5_0 : 998|2@1+ (1,0) [0|2] "NA" MCU
 SG_ OBJ_Buffer_C6_0 : 1000|2@1+ (1,0) [0|2] "NA" MCU
 SG_ OBJ_Buffer_C7_0 : 1002|2@1+ (1,0) [0|2] "NA" MCU
 SG_ OBJ_OverlapAngleEgoLaneR_0 : 1004|10@1+ (0.01,-3.14) [-3.14|3.14] "rad" MCU
 SG_ OBJ_OverlapAngleEgoLaneR_V_0 : 1014|1@1+ (1,0) [0|1] "bool" MCU
 SG_ Reserved_25_0 : 1015|9@1+ (1,0) [0|0] "NA" MCU
 SG_ OBJ_OverlapAngleEgoLaneL_0 : 1024|10@1+ (0.01,-3.14) [-3.14|3.14] "rad" MCU
 SG_ OBJ_OverlapAngleEgoLaneL_V_0 : 1034|1@1+ (1,0) [0|1] "bool" MCU
 SG_ OBJ_Is_EMERGENCY_VCL_0 : 1035|1@1+ (1,0) [0|1] "bool" MCU
 SG_ OBJ_EMERGENCY_LIGHT_COLOR_0 : 1036|4@1+ (1,0) [0|15] "BITWIZE" MCU
 SG_ OBJ_EMERGENCY_V_0 : 1040|1@1+ (1,0) [0|1] "bool" MCU
 SG_ OBJ_Angle_Top_0 : 1041|14@1+ (0.0002,0) [0|3.1415] "rad" MCU
 SG_ OBJ_Angle_Top_V_0 : 1055|1@1+ (1,0) [0|1] "bool" MCU
 SG_ OBJ_Angle_Top_STD_0 : 1056|15@1+ (0.0001,0) [0|3.1415] "rad" MCU
 SG_ OBJ_Angle_Top_STD_V_0 : 1071|1@1+ (1,0) [0|1] "bool" MCU
 SG_ OBJ_Open_Door_Left_0 : 1072|1@1+ (1,0) [0|1] "bool" MCU
 SG_ OBJ_Open_Door_Right_0 : 1073|1@1+ (1,0) [0|1] "bool" MCU
 SG_ OBJ_Visible_Left_or_Right_0 : 1074|2@1+ (1,0) [0|2] "ENUM" MCU
 SG_ OBJ_Visible_Left_or_Right_V_0 : 1076|1@1+ (1,0) [0|1] "bool" MCU
 SG_ OBJ_2W_Is_Motorbike_Probability_0 : 1077|8@1+ (0.01,0) [0|1] "NA" MCU
 SG_ Reserved_26_0 : 1085|3@1+ (1,0) [0|0] "NA" MCU
 SG_ OBJ_2W_Is_Bicycle_Probability_0 : 1088|8@1+ (0.01,0) [0|1] "NA" MCU
 SG_ Reserved_27_0 : 1096|24@1+ (1,0) [0|0] "NA" MCU
 SG_ OBJ_CRC_1 : 1120|32@1+ (1,0) [0|4294967295] "NA" MCU
 SG_ OBJ_ID_1 : 1152|8@1+ (1,0) [0|255] "counter" MCU
 SG_ OBJ_Existence_Probability_1 : 1160|8@1+ (0.01,0) [0|1] "NA" MCU
 SG_ OBJ_Fusion_Source_1 : 1168|16@1+ (1,0) [0|65535] "BITWIZE" MCU
 SG_ OBJ_Triggered_SDM_1 : 1184|2@1+ (1,0) [0|2] "ENUM" MCU
 SG_ OBJ_Motion_Category_1 : 1186|4@1+ (1,0) [0|13] "ENUM" MCU
 SG_ OBJ_Moving_IN_Probability_1 : 1190|7@1+ (0.01,0) [0|1] "NA" MCU
 SG_ OBJ_Object_Age_1 : 1197|11@1+ (1,0) [0|2047] "frames" MCU
 SG_ OBJ_Measuring_Status_1 : 1208|3@1+ (1,0) [0|7] "BITWIZE" MCU
 SG_ OBJ_Object_Class_1 : 1211|4@1+ (1,0) [0|9] "ENUM" MCU
 SG_ Reserved_4_1 : 1215|1@1+ (1,0) [0|0] "NA" MCU
 SG_ OBJ_Class_Probability_1 : 1216|7@1+ (0.01,0) [0|1] "NA" MCU
 SG_ OBJ_Car_Probability_1 : 1223|7@1+ (0.01,0) [0|1] "NA" MCU
 SG_ OBJ_Truck_Probability_1 : 1230|7@1+ (0.01,0) [0|1] "NA" MCU
 SG_ OBJ_Bike_Probability_1 : 1237|7@1+ (0.01,0) [0|1] "NA" MCU
 SG_ OBJ_Camera_Source_1 : 1244|4@1+ (1,0) [0|15] "ENUM" MCU
 SG_ OBJ_Motion_Status_1 : 1248|3@1+ (1,0) [0|5] "ENUM" MCU
 SG_ OBJ_Motion_Orientation_1 : 1251|4@1+ (1,0) [0|13] "ENUM" MCU
 SG_ OBJ_Has_Cut_Lane_1 : 1255|1@1+ (1,0) [0|1] "bool" MCU
 SG_ OBJ_Has_Cut_Path_1 : 1256|1@1+ (1,0) [0|1] "bool" MCU
 SG_ OBJ_Brake_Light_Validity_1 : 1257|1@1+ (1,0) [0|1] "bool" MCU
 SG_ OBJ_Brake_Light_1 : 1258|1@1+ (1,0) [0|1] "bool" MCU
 SG_ OBJ_Turn_Indicator_Right_1 : 1259|1@1+ (1,0) [0|1] "bool" MCU
 SG_ OBJ_Turn_Indicator_Left_1 : 1260|1@1+ (1,0) [0|1] "bool" MCU
 SG_ OBJ_Turn_Indicator_Validity_1 : 1261|1@1+ (1,0) [0|1] "bool" MCU
 SG_ OBJ_Right_Out_Of_Image_1 : 1262|1@1+ (1,0) [0|1] "bool" MCU
 SG_ OBJ_Left_Out_Of_Image_1 : 1263|1@1+ (1,0) [0|1] "bool" MCU
 SG_ OBJ_Right_Out_Of_Image_V_1 : 1264|1@1+ (1,0) [0|1] "bool" MCU
 SG_ OBJ_Left_Out_Of_Image_V_1 : 1265|1@1+ (1,0) [0|1] "bool" MCU
 SG_ OBJ_Top_Out_Of_Image_1 : 1266|1@1+ (1,0) [0|1] "bool" MCU
 SG_ OBJ_Bottom_Out_Of_Image_1 : 1267|1@1+ (1,0) [0|1] "bool" MCU
 SG_ OBJ_Top_Out_Of_Image_V_1 : 1268|1@1+ (1,0) [0|1] "bool" MCU
 SG_ OBJ_Bottom_Out_Of_Image_V_1 : 1269|1@1+ (1,0) [0|1] "bool" MCU
 SG_ OBJ_Lane_Assignment_1 : 1270|3@1+ (1,0) [0|5] "ENUM" MCU
 SG_ OBJ_Lane_Assignment_V_1 : 1273|1@1+ (1,0) [0|1] "bool" MCU
 SG_ Reserved_5_1 : 1274|6@1+ (1,0) [0|0] "NA" MCU
 SG_ OBJ_Age_Seconds_1 : 1280|7@1+ (1,0) [0|100] "s" MCU
 SG_ OBJ_Age_Seconds_V_1 : 1287|1@1+ (1,0) [0|1] "bool" MCU
 SG_ OBJ_Width_1 : 1288|9@1+ (0.01,0) [0.4|2.95] "m" MCU
 SG_ OBJ_Width_V_1 : 1297|1@1+ (1,0) [0|1] "bool" MCU
 SG_ OBJ_Width_STD_1 : 1298|11@1+ (0.001,0) [0|2] "m" MCU
 SG_ OBJ_Width_STD_V_1 : 1309|1@1+ (1,0) [0|1] "bool" MCU
 SG_ Reserved_6_1 : 1310|2@1+ (1,0) [0|0] "NA" MCU
 SG_ OBJ_Length_1 : 1312|9@1+ (0.05,0) [0.6|21] "m" MCU
 SG_ OBJ_Length_V_1 : 1321|1@1+ (1,0) [0|1] "bool" MCU
 SG_ OBJ_Length_STD_1 : 1322|10@1+ (0.01,0) [0|10] "m" MCU
 SG_ OBJ_Length_STD_V_1 : 1332|1@1+ (1,0) [0|1] "bool" MCU
 SG_ OBJ_Radar_ID_1 : 1333|8@1+ (1,0) [0|255] "counter" MCU
 SG_ Reserved_7_1 : 1341|3@1+ (1,0) [0|0] "NA" MCU
 SG_ OBJ_Height_1 : 1344|9@1+ (0.01,0) [0|2.95] "m" MCU
 SG_ OBJ_Height_V_1 : 1353|1@1+ (1,0) [0|1] "bool" MCU
 SG_ OBJ_Height_STD_1 : 1354|11@1+ (0.001,0) [0|2] "m" MCU
 SG_ OBJ_Height_STD_V_1 : 1365|1@1+ (1,0) [0|1] "bool" MCU
 SG_ Reserved_8_1 : 1366|10@1+ (1,0) [0|0] "NA" MCU
 SG_ OBJ_Abs_Long_Velocity_1 : 1376|12@1+ (0.05,-100) [-100|100] "m_per_s" MCU
 SG_ OBJ_Abs_Long_Velocity_V_1 : 1388|1@1+ (1,0) [0|1] "bool" MCU
 SG_ OBJ_Abs_Long_Velocity_STD_1 : 1389|13@1+ (0.01,0) [0|65] "m_per_s" MCU
 SG_ OBJ_Abs_Long_Vel_STD_V_1 : 1402|1@1+ (1,0) [0|1] "bool" MCU
 SG_ Reserved_9_1 : 1403|5@1+ (1,0) [0|0] "NA" MCU
 SG_ OBJ_Abs_Lat_Velocity_1 : 1408|11@1+ (0.05,-50) [-50|50] "m_per_s" MCU
 SG_ OBJ_Abs_Lat_Velocity_V_1 : 1419|1@1+ (1,0) [0|1] "bool" MCU
 SG_ OBJ_Abs_Lat_Velocity_STD_1 : 1420|13@1+ (0.01,0) [0|50] "m_per_s" MCU
 SG_ OBJ_Abs_Lat_Vel_STD_V_1 : 1433|1@1+ (1,0) [0|1] "bool" MCU
 SG_ Reserved_10_1 : 1434|6@1+ (1,0) [0|0] "NA" MCU
 SG_ OBJ_Abs_Long_Acc_1 : 1440|9@1+ (0.05,-10) [-10|10] "m_per_s2" MCU
 SG_ OBJ_Abs_Long_Acc_V_1 : 1449|1@1+ (1,0) [0|1] "bool" MCU
 SG_ OBJ_Abs_Long_Acc_STD_1 : 1450|10@1+ (0.01,0) [0|7.3] "m_per_s2" MCU
 SG_ OBJ_Abs_Long_Acc_STD_V_1 : 1460|1@1+ (1,0) [0|1] "bool" MCU
 SG_ OBJ_Abs_Lat_Acc_1 : 1461|9@1+ (0.05,-10) [-10|10] "m_per_s2" MCU
 SG_ OBJ_Abs_Lat_Acc_V_1 : 1470|1@1+ (1,0) [0|1] "bool" MCU
 SG_ Reserved_11_1 : 1471|1@1+ (1,0) [0|0] "NA" MCU
 SG_ OBJ_Abs_Lat_Acc_STD_1 : 1472|10@1+ (0.01,0) [0|7.3] "m_per_s2" MCU
 SG_ OBJ_Abs_Lat_Acc_STD_V_1 : 1482|1@1+ (1,0) [0|1] "bool" MCU
 SG_ OBJ_Abs_Acceleration_1 : 1483|9@1+ (0.05,-12.7) [-12.7|12.7] "m_per_s2" MCU
 SG_ OBJ_Abs_Acceleration_V_1 : 1492|1@1+ (1,0) [0|1] "bool" MCU
 SG_ OBJ_Abs_Acc_STD_1 : 1493|10@1+ (0.01,0) [0|7.3] "m_per_s2" MCU
 SG_ OBJ_Abs_Acc_STD_V_1 : 1503|1@1+ (1,0) [0|1] "bool" MCU
 SG_ OBJ_Inv_TTC_1 : 1504|11@1+ (0.01,-8) [-8|8] "INV(s)" MCU
 SG_ OBJ_Inv_TTC_V_1 : 1515|1@1+ (1,0) [0|1] "bool" MCU
 SG_ OBJ_Inv_TTC_STD_1 : 1516|12@1+ (0.001,0) [0|4] "INV(s)" MCU
 SG_ OBJ_Inv_TTC_STD_V_1 : 1528|1@1+ (1,0) [0|1] "bool" MCU
 SG_ Reserved_12_1 : 1529|7@1+ (1,0) [0|0] "NA" MCU
 SG_ OBJ_Relative_Long_Acc_1 : 1536|10@1+ (0.05,-20) [-20|20] "m_per_s2" MCU
 SG_ OBJ_Relative_Long_Acc_V_1 : 1546|1@1+ (1,0) [0|1] "bool" MCU
 SG_ OBJ_Relative_Long_Acc_STD_1 : 1547|10@1+ (0.01,0) [0|7.3] "m_per_s2" MCU
 SG_ OBJ_Rel_Long_Acc_STD_V_1 : 1557|1@1+ (1,0) [0|1] "bool" MCU
 SG_ Reserved_13_1 : 1558|10@1+ (1,0) [0|0] "NA" MCU
 SG_ OBJ_Relative_Long_Velocity_1 : 1568|13@1+ (0.05,-120) [-120|130] "m_per_s" MCU
 SG_ OBJ_Relative_Long_Velocity_V_1 : 1581|1@1+ (1,0) [0|1] "bool" MCU
 SG_ OBJ_Relative_Long_Vel_STD_1 : 1582|14@1+ (0.01,0) [0|130] "m_per_s" MCU
 SG_ OBJ_Rel_Long_Vel_STD_V_1 : 1596|1@1+ (1,0) [0|1] "bool" MCU
 SG_ Reserved_14_1 : 1597|3@1+ (1,0) [0|0] "NA" MCU
 SG_ OBJ_Relative_Lat_Velocity_1 : 1600|11@1+ (0.05,-50) [-50|50] "m_per_s" MCU
 SG_ OBJ_Relative_Lat_Velocity_V_1 : 1611|1@1+ (1,0) [0|1] "bool" MCU
 SG_ OBJ_Relative_Lat_Velocity_STD_1 : 1612|13@1+ (0.01,0) [0|50] "m_per_s" MCU
 SG_ OBJ_Rel_Lat_Vel_STD_V_1 : 1625|1@1+ (1,0) [0|1] "bool" MCU
 SG_ Reserved_15_1 : 1626|6@1+ (1,0) [0|0] "NA" MCU
 SG_ OBJ_Long_Distance_1 : 1632|14@1+ (0.05,-200) [-200|500] "m" MCU
 SG_ OBJ_Long_Distance_V_1 : 1646|1@1+ (1,0) [0|1] "bool" MCU
 SG_ OBJ_Long_Distance_STD_1 : 1647|15@1+ (0.01,0) [0|250] "m" MCU
 SG_ OBJ_Long_Distance_STD_V_1 : 1662|1@1+ (1,0) [0|1] "bool" MCU
 SG_ Reserved_16_1 : 1663|1@1+ (1,0) [0|0] "NA" MCU
 SG_ OBJ_Lat_Distance_1 : 1664|12@1+ (0.05,-100) [-100|100] "m" MCU
 SG_ OBJ_Lat_Distance_V_1 : 1676|1@1+ (1,0) [0|1] "bool" MCU
 SG_ OBJ_Lat_Distance_STD_1 : 1677|14@1+ (0.01,0) [0|100] "m" MCU
 SG_ OBJ_Lat_Distance_STD_V_1 : 1691|1@1+ (1,0) [0|1] "bool" MCU
 SG_ Reserved_17_1 : 1692|4@1+ (1,0) [0|0] "NA" MCU
 SG_ OBJ_Absolute_Speed_1 : 1696|12@1+ (0.05,-65) [-65|65] "m_per_s" MCU
 SG_ OBJ_Absolute_Speed_V_1 : 1708|1@1+ (1,0) [0|1] "bool" MCU
 SG_ OBJ_Absolute_Speed_STD_1 : 1709|13@1+ (0.01,0) [0|65] "m_per_s" MCU
 SG_ OBJ_Absolute_Speed_STD_V_1 : 1722|1@1+ (1,0) [0|1] "bool" MCU
 SG_ Reserved_18_1 : 1723|5@1+ (1,0) [0|0] "NA" MCU
 SG_ OBJ_Heading_1 : 1728|10@1+ (0.01,-3.14) [-3.14|3.14] "rad" MCU
 SG_ OBJ_Heading_V_1 : 1738|1@1+ (1,0) [0|1] "bool" MCU
 SG_ OBJ_Heading_STD_1 : 1739|15@1+ (0.0001,0) [0|3.14] "rad" MCU
 SG_ OBJ_Heading_STD_V_1 : 1754|1@1+ (1,0) [0|1] "bool" MCU
 SG_ Reserved_19_1 : 1755|5@1+ (1,0) [0|0] "NA" MCU
 SG_ OBJ_Angle_Rate_STD_1 : 1760|15@1+ (0.0001,0) [0|2.2318] "RPS" MCU
 SG_ OBJ_Angle_Rate_STD_V_1 : 1775|1@1+ (1,0) [0|1] "bool" MCU
 SG_ OBJ_Angle_Rate_1 : 1776|12@1+ (0.002,-2.234) [-2.234|2.2318] "RPS" MCU
 SG_ OBJ_Angle_Rate_V_1 : 1788|1@1+ (1,0) [0|1] "bool" MCU
 SG_ Reserved_20_1 : 1789|3@1+ (1,0) [0|0] "NA" MCU
 SG_ OBJ_Angle_Right_1 : 1792|14@1+ (0.0002,-1.571) [-1.571|1.571] "rad" MCU
 SG_ OBJ_Angle_Right_V_1 : 1806|1@1+ (1,0) [0|1] "bool" MCU
 SG_ OBJ_Angle_Right_STD_1 : 1807|14@1+ (0.0001,0) [0|1.571] "rad" MCU
 SG_ OBJ_Angle_Right_STD_V_1 : 1821|1@1+ (1,0) [0|1] "bool" MCU
 SG_ Reserved_21_1 : 1822|2@1+ (1,0) [0|0] "NA" MCU
 SG_ OBJ_Angle_Left_1 : 1824|14@1+ (0.0002,-1.571) [-1.571|1.571] "rad" MCU
 SG_ OBJ_Angle_Left_V_1 : 1838|1@1+ (1,0) [0|1] "bool" MCU
 SG_ OBJ_Angle_Left_STD_1 : 1839|14@1+ (0.0001,0) [0|1.571] "rad" MCU
 SG_ OBJ_Angle_Left_STD_V_1 : 1853|1@1+ (1,0) [0|1] "bool" MCU
 SG_ Reserved_22_1 : 1854|2@1+ (1,0) [0|0] "NA" MCU
 SG_ OBJ_Angle_Side_1 : 1856|14@1+ (0.0002,-1.571) [-1.571|1.571] "rad" MCU
 SG_ OBJ_Angle_Side_V_1 : 1870|1@1+ (1,0) [0|1] "bool" MCU
 SG_ OBJ_Angle_Side_STD_1 : 1871|14@1+ (0.0001,0) [0|1.571] "rad" MCU
 SG_ OBJ_Angle_Side_STD_V_1 : 1885|1@1+ (1,0) [0|1] "bool" MCU
 SG_ OBJ_Angle_Mid_V_1 : 1886|1@1+ (1,0) [0|1] "bool" MCU
 SG_ Reserved_23_1 : 1887|1@1+ (1,0) [0|0] "NA" MCU
 SG_ OBJ_Angle_Mid_1 : 1888|14@1+ (0.0002,-1.571) [-1.571|1.571] "rad" MCU
 SG_ OBJ_Angle_Mid_STD_1 : 1902|14@1+ (0.0001,0) [0|1.571] "rad" MCU
 SG_ OBJ_Angle_Mid_STD_V_1 : 1916|1@1+ (1,0) [0|1] "bool" MCU
 SG_ OBJ_Angle_Bottom_V_1 : 1917|1@1+ (1,0) [0|1] "bool" MCU
 SG_ Reserved_24_1 : 1918|2@1+ (1,0) [0|0] "NA" MCU
 SG_ OBJ_Angle_Bottom_1 : 1920|14@1+ (0.0002,-1.571) [-1.571|1.571] "rad" MCU
 SG_ OBJ_Angle_Bottom_STD_1 : 1934|14@1+ (0.0001,0) [0|1.571] "rad" MCU
 SG_ OBJ_Angle_Bottom_STD_V_1 : 1948|1@1+ (1,0) [0|1] "bool" MCU
 SG_ OBJ_Visibility_Side_V_1 : 1949|1@1+ (1,0) [0|1] "bool" MCU
 SG_ OBJ_Visibility_Side_1 : 1950|2@1+ (1,0) [0|2] "ENUM" MCU
 SG_ OBJ_Is_In_Drivable_Area_1 : 1952|1@1+ (1,0) [0|1] "bool" MCU
 SG_ OBJ_Is_In_Drivable_Area_V_1 : 1953|1@1+ (1,0) [0|1] "bool" MCU
 SG_ OBJ_Is_VeryClose_V_1 : 1954|1@1+ (1,0) [0|1] "bool" MCU
 SG_ OBJ_Is_VeryClose_1 : 1955|1@1+ (1,0) [0|1] "bool" MCU
 SG_ OBJ_Buffer_C4_1 : 1956|2@1+ (1,0) [0|2] "NA" MCU
 SG_ OBJ_Buffer_C5_1 : 1958|2@1+ (1,0) [0|2] "NA" MCU
 SG_ OBJ_Buffer_C6_1 : 1960|2@1+ (1,0) [0|2] "NA" MCU
 SG_ OBJ_Buffer_C7_1 : 1962|2@1+ (1,0) [0|2] "NA" MCU
 SG_ OBJ_OverlapAngleEgoLaneR_1 : 1964|10@1+ (0.01,-3.14) [-3.14|3.14] "rad" MCU
 SG_ OBJ_OverlapAngleEgoLaneR_V_1 : 1974|1@1+ (1,0) [0|1] "bool" MCU
 SG_ Reserved_25_1 : 1975|9@1+ (1,0) [0|0] "NA" MCU
 SG_ OBJ_OverlapAngleEgoLaneL_1 : 1984|10@1+ (0.01,-3.14) [-3.14|3.14] "rad" MCU
 SG_ OBJ_OverlapAngleEgoLaneL_V_1 : 1994|1@1+ (1,0) [0|1] "bool" MCU
 SG_ OBJ_Is_EMERGENCY_VCL_1 : 1995|1@1+ (1,0) [0|1] "bool" MCU
 SG_ OBJ_EMERGENCY_LIGHT_COLOR_1 : 1996|4@1+ (1,0) [0|15] "BITWIZE" MCU
 SG_ OBJ_EMERGENCY_V_1 : 2000|1@1+ (1,0) [0|1] "bool" MCU
 SG_ OBJ_Angle_Top_1 : 2001|14@1+ (0.0002,0) [0|3.1415] "rad" MCU
 SG_ OBJ_Angle_Top_V_1 : 2015|1@1+ (1,0) [0|1] "bool" MCU
 SG_ OBJ_Angle_Top_STD_1 : 2016|15@1+ (0.0001,0) [0|3.1415] "rad" MCU
 SG_ OBJ_Angle_Top_STD_V_1 : 2031|1@1+ (1,0) [0|1] "bool" MCU
 SG_ OBJ_Open_Door_Left_1 : 2032|1@1+ (1,0) [0|1] "bool" MCU
 SG_ OBJ_Open_Door_Right_1 : 2033|1@1+ (1,0) [0|1] "bool" MCU
 SG_ OBJ_Visible_Left_or_Right_1 : 2034|2@1+ (1,0) [0|2] "ENUM" MCU
 SG_ OBJ_Visible_Left_or_Right_V_1 : 2036|1@1+ (1,0) [0|1] "bool" MCU
 SG_ OBJ_2W_Is_Motorbike_Probability_1 : 2037|8@1+ (0.01,0) [0|1] "NA" MCU
 SG_ Reserved_26_1 : 2045|3@1+ (1,0) [0|0] "NA" MCU
 SG_ OBJ_2W_Is_Bicycle_Probability_1 : 2048|8@1+ (0.01,0) [0|1] "NA" MCU
 SG_ Reserved_27_1 : 2056|24@1+ (1,0) [0|0] "NA" MCU
 SG_ OBJ_CRC_2 : 2080|32@1+ (1,0) [0|4294967295] "NA" MCU
 SG_ OBJ_ID_2 : 2112|8@1+ (1,0) [0|255] "counter" MCU
 SG_ OBJ_Existence_Probability_2 : 2120|8@1+ (0.01,0) [0|1] "NA" MCU
 SG_ OBJ_Fusion_Source_2 : 2128|16@1+ (1,0) [0|65535] "BITWIZE" MCU
 SG_ OBJ_Triggered_SDM_2 : 2144|2@1+ (1,0) [0|2] "ENUM" MCU
 SG_ OBJ_Motion_Category_2 : 2146|4@1+ (1,0) [0|13] "ENUM" MCU
 SG_ OBJ_Moving_IN_Probability_2 : 2150|7@1+ (0.01,0) [0|1] "NA" MCU
 SG_ OBJ_Object_Age_2 : 2157|11@1+ (1,0) [0|2047] "frames" MCU
 SG_ OBJ_Measuring_Status_2 : 2168|3@1+ (1,0) [0|7] "BITWIZE" MCU
 SG_ OBJ_Object_Class_2 : 2171|4@1+ (1,0) [0|9] "ENUM" MCU
 SG_ Reserved_4_2 : 2175|1@1+ (1,0) [0|0] "NA" MCU
 SG_ OBJ_Class_Probability_2 : 2176|7@1+ (0.01,0) [0|1] "NA" MCU
 SG_ OBJ_Car_Probability_2 : 2183|7@1+ (0.01,0) [0|1] "NA" MCU
 SG_ OBJ_Truck_Probability_2 : 2190|7@1+ (0.01,0) [0|1] "NA" MCU
 SG_ OBJ_Bike_Probability_2 : 2197|7@1+ (0.01,0) [0|1] "NA" MCU
 SG_ OBJ_Camera_Source_2 : 2204|4@1+ (1,0) [0|15] "ENUM" MCU
 SG_ OBJ_Motion_Status_2 : 2208|3@1+ (1,0) [0|5] "ENUM" MCU
 SG_ OBJ_Motion_Orientation_2 : 2211|4@1+ (1,0) [0|13] "ENUM" MCU
 SG_ OBJ_Has_Cut_Lane_2 : 2215|1@1+ (1,0) [0|1] "bool" MCU
 SG_ OBJ_Has_Cut_Path_2 : 2216|1@1+ (1,0) [0|1] "bool" MCU
 SG_ OBJ_Brake_Light_Validity_2 : 2217|1@1+ (1,0) [0|1] "bool" MCU
 SG_ OBJ_Brake_Light_2 : 2218|1@1+ (1,0) [0|1] "bool" MCU
 SG_ OBJ_Turn_Indicator_Right_2 : 2219|1@1+ (1,0) [0|1] "bool" MCU
 SG_ OBJ_Turn_Indicator_Left_2 : 2220|1@1+ (1,0) [0|1] "bool" MCU
 SG_ OBJ_Turn_Indicator_Validity_2 : 2221|1@1+ (1,0) [0|1] "bool" MCU
 SG_ OBJ_Right_Out_Of_Image_2 : 2222|1@1+ (1,0) [0|1] "bool" MCU
 SG_ OBJ_Left_Out_Of_Image_2 : 2223|1@1+ (1,0) [0|1] "bool" MCU
 SG_ OBJ_Right_Out_Of_Image_V_2 : 2224|1@1+ (1,0) [0|1] "bool" MCU
 SG_ OBJ_Left_Out_Of_Image_V_2 : 2225|1@1+ (1,0) [0|1] "bool" MCU
 SG_ OBJ_Top_Out_Of_Image_2 : 2226|1@1+ (1,0) [0|1] "bool" MCU
 SG_ OBJ_Bottom_Out_Of_Image_2 : 2227|1@1+ (1,0) [0|1] "bool" MCU
 SG_ OBJ_Top_Out_Of_Image_V_2 : 2228|1@1+ (1,0) [0|1] "bool" MCU
 SG_ OBJ_Bottom_Out_Of_Image_V_2 : 2229|1@1+ (1,0) [0|1] "bool" MCU
 SG_ OBJ_Lane_Assignment_2 : 2230|3@1+ (1,0) [0|5] "ENUM" MCU
 SG_ OBJ_Lane_Assignment_V_2 : 2233|1@1+ (1,0) [0|1] "bool" MCU
 SG_ Reserved_5_2 : 2234|6@1+ (1,0) [0|0] "NA" MCU
 SG_ OBJ_Age_Seconds_2 : 2240|7@1+ (1,0) [0|100] "s" MCU
 SG_ OBJ_Age_Seconds_V_2 : 2247|1@1+ (1,0) [0|1] "bool" MCU
 SG_ OBJ_Width_2 : 2248|9@1+ (0.01,0) [0.4|2.95] "m" MCU
 SG_ OBJ_Width_V_2 : 2257|1@1+ (1,0) [0|1] "bool" MCU
 SG_ OBJ_Width_STD_2 : 2258|11@1+ (0.001,0) [0|2] "m" MCU
 SG_ OBJ_Width_STD_V_2 : 2269|1@1+ (1,0) [0|1] "bool" MCU
 SG_ Reserved_6_2 : 2270|2@1+ (1,0) [0|0] "NA" MCU
 SG_ OBJ_Length_2 : 2272|9@1+ (0.05,0) [0.6|21] "m" MCU
 SG_ OBJ_Length_V_2 : 2281|1@1+ (1,0) [0|1] "bool" MCU
 SG_ OBJ_Length_STD_2 : 2282|10@1+ (0.01,0) [0|10] "m" MCU
 SG_ OBJ_Length_STD_V_2 : 2292|1@1+ (1,0) [0|1] "bool" MCU
 SG_ OBJ_Radar_ID_2 : 2293|8@1+ (1,0) [0|255] "counter" MCU
 SG_ Reserved_7_2 : 2301|3@1+ (1,0) [0|0] "NA" MCU
 SG_ OBJ_Height_2 : 2304|9@1+ (0.01,0) [0|2.95] "m" MCU
 SG_ OBJ_Height_V_2 : 2313|1@1+ (1,0) [0|1] "bool" MCU
 SG_ OBJ_Height_STD_2 : 2314|11@1+ (0.001,0) [0|2] "m" MCU
 SG_ OBJ_Height_STD_V_2 : 2325|1@1+ (1,0) [0|1] "bool" MCU
 SG_ Reserved_8_2 : 2326|10@1+ (1,0) [0|0] "NA" MCU
 SG_ OBJ_Abs_Long_Velocity_2 : 2336|12@1+ (0.05,-100) [-100|100] "m_per_s" MCU
 SG_ OBJ_Abs_Long_Velocity_V_2 : 2348|1@1+ (1,0) [0|1] "bool" MCU
 SG_ OBJ_Abs_Long_Velocity_STD_2 : 2349|13@1+ (0.01,0) [0|65] "m_per_s" MCU
 SG_ OBJ_Abs_Long_Vel_STD_V_2 : 2362|1@1+ (1,0) [0|1] "bool" MCU
 SG_ Reserved_9_2 : 2363|5@1+ (1,0) [0|0] "NA" MCU
 SG_ OBJ_Abs_Lat_Velocity_2 : 2368|11@1+ (0.05,-50) [-50|50] "m_per_s" MCU
 SG_ OBJ_Abs_Lat_Velocity_V_2 : 2379|1@1+ (1,0) [0|1] "bool" MCU
 SG_ OBJ_Abs_Lat_Velocity_STD_2 : 2380|13@1+ (0.01,0) [0|50] "m_per_s" MCU
 SG_ OBJ_Abs_Lat_Vel_STD_V_2 : 2393|1@1+ (1,0) [0|1] "bool" MCU
 SG_ Reserved_10_2 : 2394|6@1+ (1,0) [0|0] "NA" MCU
 SG_ OBJ_Abs_Long_Acc_2 : 2400|9@1+ (0.05,-10) [-10|10] "m_per_s2" MCU
 SG_ OBJ_Abs_Long_Acc_V_2 : 2409|1@1+ (1,0) [0|1] "bool" MCU
 SG_ OBJ_Abs_Long_Acc_STD_2 : 2410|10@1+ (0.01,0) [0|7.3] "m_per_s2" MCU
 SG_ OBJ_Abs_Long_Acc_STD_V_2 : 2420|1@1+ (1,0) [0|1] "bool" MCU
 SG_ OBJ_Abs_Lat_Acc_2 : 2421|9@1+ (0.05,-10) [-10|10] "m_per_s2" MCU
 SG_ OBJ_Abs_Lat_Acc_V_2 : 2430|1@1+ (1,0) [0|1] "bool" MCU
 SG_ Reserved_11_2 : 2431|1@1+ (1,0) [0|0] "NA" MCU
 SG_ OBJ_Abs_Lat_Acc_STD_2 : 2432|10@1+ (0.01,0) [0|7.3] "m_per_s2" MCU
 SG_ OBJ_Abs_Lat_Acc_STD_V_2 : 2442|1@1+ (1,0) [0|1] "bool" MCU
 SG_ OBJ_Abs_Acceleration_2 : 2443|9@1+ (0.05,-12.7) [-12.7|12.7] "m_per_s2" MCU
 SG_ OBJ_Abs_Acceleration_V_2 : 2452|1@1+ (1,0) [0|1] "bool" MCU
 SG_ OBJ_Abs_Acc_STD_2 : 2453|10@1+ (0.01,0) [0|7.3] "m_per_s2" MCU
 SG_ OBJ_Abs_Acc_STD_V_2 : 2463|1@1+ (1,0) [0|1] "bool" MCU
 SG_ OBJ_Inv_TTC_2 : 2464|11@1+ (0.01,-8) [-8|8] "INV(s)" MCU
 SG_ OBJ_Inv_TTC_V_2 : 2475|1@1+ (1,0) [0|1] "bool" MCU
 SG_ OBJ_Inv_TTC_STD_2 : 2476|12@1+ (0.001,0) [0|4] "INV(s)" MCU
 SG_ OBJ_Inv_TTC_STD_V_2 : 2488|1@1+ (1,0) [0|1] "bool" MCU
 SG_ Reserved_12_2 : 2489|7@1+ (1,0) [0|0] "NA" MCU
 SG_ OBJ_Relative_Long_Acc_2 : 2496|10@1+ (0.05,-20) [-20|20] "m_per_s2" MCU
 SG_ OBJ_Relative_Long_Acc_V_2 : 2506|1@1+ (1,0) [0|1] "bool" MCU
 SG_ OBJ_Relative_Long_Acc_STD_2 : 2507|10@1+ (0.01,0) [0|7.3] "m_per_s2" MCU
 SG_ OBJ_Rel_Long_Acc_STD_V_2 : 2517|1@1+ (1,0) [0|1] "bool" MCU
 SG_ Reserved_13_2 : 2518|10@1+ (1,0) [0|0] "NA" MCU
 SG_ OBJ_Relative_Long_Velocity_2 : 2528|13@1+ (0.05,-120) [-120|130] "m_per_s" MCU
 SG_ OBJ_Relative_Long_Velocity_V_2 : 2541|1@1+ (1,0) [0|1] "bool" MCU
 SG_ OBJ_Relative_Long_Vel_STD_2 : 2542|14@1+ (0.01,0) [0|130] "m_per_s" MCU
 SG_ OBJ_Rel_Long_Vel_STD_V_2 : 2556|1@1+ (1,0) [0|1] "bool" MCU
 SG_ Reserved_14_2 : 2557|3@1+ (1,0) [0|0] "NA" MCU
 SG_ OBJ_Relative_Lat_Velocity_2 : 2560|11@1+ (0.05,-50) [-50|50] "m_per_s" MCU
 SG_ OBJ_Relative_Lat_Velocity_V_2 : 2571|1@1+ (1,0) [0|1] "bool" MCU
 SG_ OBJ_Relative_Lat_Velocity_STD_2 : 2572|13@1+ (0.01,0) [0|50] "m_per_s" MCU
 SG_ OBJ_Rel_Lat_Vel_STD_V_2 : 2585|1@1+ (1,0) [0|1] "bool" MCU
 SG_ Reserved_15_2 : 2586|6@1+ (1,0) [0|0] "NA" MCU
 SG_ OBJ_Long_Distance_2 : 2592|14@1+ (0.05,-200) [-200|500] "m" MCU
 SG_ OBJ_Long_Distance_V_2 : 2606|1@1+ (1,0) [0|1] "bool" MCU
 SG_ OBJ_Long_Distance_STD_2 : 2607|15@1+ (0.01,0) [0|250] "m" MCU
 SG_ OBJ_Long_Distance_STD_V_2 : 2622|1@1+ (1,0) [0|1] "bool" MCU
 SG_ Reserved_16_2 : 2623|1@1+ (1,0) [0|0] "NA" MCU
 SG_ OBJ_Lat_Distance_2 : 2624|12@1+ (0.05,-100) [-100|100] "m" MCU
 SG_ OBJ_Lat_Distance_V_2 : 2636|1@1+ (1,0) [0|1] "bool" MCU
 SG_ OBJ_Lat_Distance_STD_2 : 2637|14@1+ (0.01,0) [0|100] "m" MCU
 SG_ OBJ_Lat_Distance_STD_V_2 : 2651|1@1+ (1,0) [0|1] "bool" MCU
 SG_ Reserved_17_2 : 2652|4@1+ (1,0) [0|0] "NA" MCU
 SG_ OBJ_Absolute_Speed_2 : 2656|12@1+ (0.05,-65) [-65|65] "m_per_s" MCU
 SG_ OBJ_Absolute_Speed_V_2 : 2668|1@1+ (1,0) [0|1] "bool" MCU
 SG_ OBJ_Absolute_Speed_STD_2 : 2669|13@1+ (0.01,0) [0|65] "m_per_s" MCU
 SG_ OBJ_Absolute_Speed_STD_V_2 : 2682|1@1+ (1,0) [0|1] "bool" MCU
 SG_ Reserved_18_2 : 2683|5@1+ (1,0) [0|0] "NA" MCU
 SG_ OBJ_Heading_2 : 2688|10@1+ (0.01,-3.14) [-3.14|3.14] "rad" MCU
 SG_ OBJ_Heading_V_2 : 2698|1@1+ (1,0) [0|1] "bool" MCU
 SG_ OBJ_Heading_STD_2 : 2699|15@1+ (0.0001,0) [0|3.14] "rad" MCU
 SG_ OBJ_Heading_STD_V_2 : 2714|1@1+ (1,0) [0|1] "bool" MCU
 SG_ Reserved_19_2 : 2715|5@1+ (1,0) [0|0] "NA" MCU
 SG_ OBJ_Angle_Rate_STD_2 : 2720|15@1+ (0.0001,0) [0|2.2318] "RPS" MCU
 SG_ OBJ_Angle_Rate_STD_V_2 : 2735|1@1+ (1,0) [0|1] "bool" MCU
 SG_ OBJ_Angle_Rate_2 : 2736|12@1+ (0.002,-2.234) [-2.234|2.2318] "RPS" MCU
 SG_ OBJ_Angle_Rate_V_2 : 2748|1@1+ (1,0) [0|1] "bool" MCU
 SG_ Reserved_20_2 : 2749|3@1+ (1,0) [0|0] "NA" MCU
 SG_ OBJ_Angle_Right_2 : 2752|14@1+ (0.0002,-1.571) [-1.571|1.571] "rad" MCU
 SG_ OBJ_Angle_Right_V_2 : 2766|1@1+ (1,0) [0|1] "bool" MCU
 SG_ OBJ_Angle_Right_STD_2 : 2767|14@1+ (0.0001,0) [0|1.571] "rad" MCU
 SG_ OBJ_Angle_Right_STD_V_2 : 2781|1@1+ (1,0) [0|1] "bool" MCU
 SG_ Reserved_21_2 : 2782|2@1+ (1,0) [0|0] "NA" MCU
 SG_ OBJ_Angle_Left_2 : 2784|14@1+ (0.0002,-1.571) [-1.571|1.571] "rad" MCU
 SG_ OBJ_Angle_Left_V_2 : 2798|1@1+ (1,0) [0|1] "bool" MCU
 SG_ OBJ_Angle_Left_STD_2 : 2799|14@1+ (0.0001,0) [0|1.571] "rad" MCU
 SG_ OBJ_Angle_Left_STD_V_2 : 2813|1@1+ (1,0) [0|1] "bool" MCU
 SG_ Reserved_22_2 : 2814|2@1+ (1,0) [0|0] "NA" MCU
 SG_ OBJ_Angle_Side_2 : 2816|14@1+ (0.0002,-1.571) [-1.571|1.571] "rad" MCU
 SG_ OBJ_Angle_Side_V_2 : 2830|1@1+ (1,0) [0|1] "bool" MCU
 SG_ OBJ_Angle_Side_STD_2 : 2831|14@1+ (0.0001,0) [0|1.571] "rad" MCU
 SG_ OBJ_Angle_Side_STD_V_2 : 2845|1@1+ (1,0) [0|1] "bool" MCU
 SG_ OBJ_Angle_Mid_V_2 : 2846|1@1+ (1,0) [0|1] "bool" MCU
 SG_ Reserved_23_2 : 2847|1@1+ (1,0) [0|0] "NA" MCU
 SG_ OBJ_Angle_Mid_2 : 2848|14@1+ (0.0002,-1.571) [-1.571|1.571] "rad" MCU
 SG_ OBJ_Angle_Mid_STD_2 : 2862|14@1+ (0.0001,0) [0|1.571] "rad" MCU
 SG_ OBJ_Angle_Mid_STD_V_2 : 2876|1@1+ (1,0) [0|1] "bool" MCU
 SG_ OBJ_Angle_Bottom_V_2 : 2877|1@1+ (1,0) [0|1] "bool" MCU
 SG_ Reserved_24_2 : 2878|2@1+ (1,0) [0|0] "NA" MCU
 SG_ OBJ_Angle_Bottom_2 : 2880|14@1+ (0.0002,-1.571) [-1.571|1.571] "rad" MCU
 SG_ OBJ_Angle_Bottom_STD_2 : 2894|14@1+ (0.0001,0) [0|1.571] "rad" MCU
 SG_ OBJ_Angle_Bottom_STD_V_2 : 2908|1@1+ (1,0) [0|1] "bool" MCU
 SG_ OBJ_Visibility_Side_V_2 : 2909|1@1+ (1,0) [0|1] "bool" MCU
 SG_ OBJ_Visibility_Side_2 : 2910|2@1+ (1,0) [0|2] "ENUM" MCU
 SG_ OBJ_Is_In_Drivable_Area_2 : 2912|1@1+ (1,0) [0|1] "bool" MCU
 SG_ OBJ_Is_In_Drivable_Area_V_2 : 2913|1@1+ (1,0) [0|1] "bool" MCU
 SG_ OBJ_Is_VeryClose_V_2 : 2914|1@1+ (1,0) [0|1] "bool" MCU
 SG_ OBJ_Is_VeryClose_2 : 2915|1@1+ (1,0) [0|1] "bool" MCU
 SG_ OBJ_Buffer_C4_2 : 2916|2@1+ (1,0) [0|2] "NA" MCU
 SG_ OBJ_Buffer_C5_2 : 2918|2@1+ (1,0) [0|2] "NA" MCU
 SG_ OBJ_Buffer_C6_2 : 2920|2@1+ (1,0) [0|2] "NA" MCU
 SG_ OBJ_Buffer_C7_2 : 2922|2@1+ (1,0) [0|2] "NA" MCU
 SG_ OBJ_OverlapAngleEgoLaneR_2 : 2924|10@1+ (0.01,-3.14) [-3.14|3.14] "rad" MCU
 SG_ OBJ_OverlapAngleEgoLaneR_V_2 : 2934|1@1+ (1,0) [0|1] "bool" MCU
 SG_ Reserved_25_2 : 2935|9@1+ (1,0) [0|0] "NA" MCU
 SG_ OBJ_OverlapAngleEgoLaneL_2 : 2944|10@1+ (0.01,-3.14) [-3.14|3.14] "rad" MCU
 SG_ OBJ_OverlapAngleEgoLaneL_V_2 : 2954|1@1+ (1,0) [0|1] "bool" MCU
 SG_ OBJ_Is_EMERGENCY_VCL_2 : 2955|1@1+ (1,0) [0|1] "bool" MCU
 SG_ OBJ_EMERGENCY_LIGHT_COLOR_2 : 2956|4@1+ (1,0) [0|15] "BITWIZE" MCU
 SG_ OBJ_EMERGENCY_V_2 : 2960|1@1+ (1,0) [0|1] "bool" MCU
 SG_ OBJ_Angle_Top_2 : 2961|14@1+ (0.0002,0) [0|3.1415] "rad" MCU
 SG_ OBJ_Angle_Top_V_2 : 2975|1@1+ (1,0) [0|1] "bool" MCU
 SG_ OBJ_Angle_Top_STD_2 : 2976|15@1+ (0.0001,0) [0|3.1415] "rad" MCU
 SG_ OBJ_Angle_Top_STD_V_2 : 2991|1@1+ (1,0) [0|1] "bool" MCU
 SG_ OBJ_Open_Door_Left_2 : 2992|1@1+ (1,0) [0|1] "bool" MCU
 SG_ OBJ_Open_Door_Right_2 : 2993|1@1+ (1,0) [0|1] "bool" MCU
 SG_ OBJ_Visible_Left_or_Right_2 : 2994|2@1+ (1,0) [0|2] "ENUM" MCU
 SG_ OBJ_Visible_Left_or_Right_V_2 : 2996|1@1+ (1,0) [0|1] "bool" MCU
 SG_ OBJ_2W_Is_Motorbike_Probability_2 : 2997|8@1+ (0.01,0) [0|1] "NA" MCU
 SG_ Reserved_26_2 : 3005|3@1+ (1,0) [0|0] "NA" MCU
 SG_ OBJ_2W_Is_Bicycle_Probability_2 : 3008|8@1+ (0.01,0) [0|1] "NA" MCU
 SG_ Reserved_27_2 : 3016|24@1+ (1,0) [0|0] "NA" MCU
 SG_ OBJ_CRC_3 : 3040|32@1+ (1,0) [0|4294967295] "NA" MCU
 SG_ OBJ_ID_3 : 3072|8@1+ (1,0) [0|255] "counter" MCU
 SG_ OBJ_Existence_Probability_3 : 3080|8@1+ (0.01,0) [0|1] "NA" MCU
 SG_ OBJ_Fusion_Source_3 : 3088|16@1+ (1,0) [0|65535] "BITWIZE" MCU
 SG_ OBJ_Triggered_SDM_3 : 3104|2@1+ (1,0) [0|2] "ENUM" MCU
 SG_ OBJ_Motion_Category_3 : 3106|4@1+ (1,0) [0|13] "ENUM" MCU
 SG_ OBJ_Moving_IN_Probability_3 : 3110|7@1+ (0.01,0) [0|1] "NA" MCU
 SG_ OBJ_Object_Age_3 : 3117|11@1+ (1,0) [0|2047] "frames" MCU
 SG_ OBJ_Measuring_Status_3 : 3128|3@1+ (1,0) [0|7] "BITWIZE" MCU
 SG_ OBJ_Object_Class_3 : 3131|4@1+ (1,0) [0|9] "ENUM" MCU
 SG_ Reserved_4_3 : 3135|1@1+ (1,0) [0|0] "NA" MCU
 SG_ OBJ_Class_Probability_3 : 3136|7@1+ (0.01,0) [0|1] "NA" MCU
 SG_ OBJ_Car_Probability_3 : 3143|7@1+ (0.01,0) [0|1] "NA" MCU
 SG_ OBJ_Truck_Probability_3 : 3150|7@1+ (0.01,0) [0|1] "NA" MCU
 SG_ OBJ_Bike_Probability_3 : 3157|7@1+ (0.01,0) [0|1] "NA" MCU
 SG_ OBJ_Camera_Source_3 : 3164|4@1+ (1,0) [0|15] "ENUM" MCU
 SG_ OBJ_Motion_Status_3 : 3168|3@1+ (1,0) [0|5] "ENUM" MCU
 SG_ OBJ_Motion_Orientation_3 : 3171|4@1+ (1,0) [0|13] "ENUM" MCU
 SG_ OBJ_Has_Cut_Lane_3 : 3175|1@1+ (1,0) [0|1] "bool" MCU
 SG_ OBJ_Has_Cut_Path_3 : 3176|1@1+ (1,0) [0|1] "bool" MCU
 SG_ OBJ_Brake_Light_Validity_3 : 3177|1@1+ (1,0) [0|1] "bool" MCU
 SG_ OBJ_Brake_Light_3 : 3178|1@1+ (1,0) [0|1] "bool" MCU
 SG_ OBJ_Turn_Indicator_Right_3 : 3179|1@1+ (1,0) [0|1] "bool" MCU
 SG_ OBJ_Turn_Indicator_Left_3 : 3180|1@1+ (1,0) [0|1] "bool" MCU
 SG_ OBJ_Turn_Indicator_Validity_3 : 3181|1@1+ (1,0) [0|1] "bool" MCU
 SG_ OBJ_Right_Out_Of_Image_3 : 3182|1@1+ (1,0) [0|1] "bool" MCU
 SG_ OBJ_Left_Out_Of_Image_3 : 3183|1@1+ (1,0) [0|1] "bool" MCU
 SG_ OBJ_Right_Out_Of_Image_V_3 : 3184|1@1+ (1,0) [0|1] "bool" MCU
 SG_ OBJ_Left_Out_Of_Image_V_3 : 3185|1@1+ (1,0) [0|1] "bool" MCU
 SG_ OBJ_Top_Out_Of_Image_3 : 3186|1@1+ (1,0) [0|1] "bool" MCU
 SG_ OBJ_Bottom_Out_Of_Image_3 : 3187|1@1+ (1,0) [0|1] "bool" MCU
 SG_ OBJ_Top_Out_Of_Image_V_3 : 3188|1@1+ (1,0) [0|1] "bool" MCU
 SG_ OBJ_Bottom_Out_Of_Image_V_3 : 3189|1@1+ (1,0) [0|1] "bool" MCU
 SG_ OBJ_Lane_Assignment_3 : 3190|3@1+ (1,0) [0|5] "ENUM" MCU
 SG_ OBJ_Lane_Assignment_V_3 : 3193|1@1+ (1,0) [0|1] "bool" MCU
 SG_ Reserved_5_3 : 3194|6@1+ (1,0) [0|0] "NA" MCU
 SG_ OBJ_Age_Seconds_3 : 3200|7@1+ (1,0) [0|100] "s" MCU
 SG_ OBJ_Age_Seconds_V_3 : 3207|1@1+ (1,0) [0|1] "bool" MCU
 SG_ OBJ_Width_3 : 3208|9@1+ (0.01,0) [0.4|2.95] "m" MCU
 SG_ OBJ_Width_V_3 : 3217|1@1+ (1,0) [0|1] "bool" MCU
 SG_ OBJ_Width_STD_3 : 3218|11@1+ (0.001,0) [0|2] "m" MCU
 SG_ OBJ_Width_STD_V_3 : 3229|1@1+ (1,0) [0|1] "bool" MCU
 SG_ Reserved_6_3 : 3230|2@1+ (1,0) [0|0] "NA" MCU
 SG_ OBJ_Length_3 : 3232|9@1+ (0.05,0) [0.6|21] "m" MCU
 SG_ OBJ_Length_V_3 : 3241|1@1+ (1,0) [0|1] "bool" MCU
 SG_ OBJ_Length_STD_3 : 3242|10@1+ (0.01,0) [0|10] "m" MCU
 SG_ OBJ_Length_STD_V_3 : 3252|1@1+ (1,0) [0|1] "bool" MCU
 SG_ OBJ_Radar_ID_3 : 3253|8@1+ (1,0) [0|255] "counter" MCU
 SG_ Reserved_7_3 : 3261|3@1+ (1,0) [0|0] "NA" MCU
 SG_ OBJ_Height_3 : 3264|9@1+ (0.01,0) [0|2.95] "m" MCU
 SG_ OBJ_Height_V_3 : 3273|1@1+ (1,0) [0|1] "bool" MCU
 SG_ OBJ_Height_STD_3 : 3274|11@1+ (0.001,0) [0|2] "m" MCU
 SG_ OBJ_Height_STD_V_3 : 3285|1@1+ (1,0) [0|1] "bool" MCU
 SG_ Reserved_8_3 : 3286|10@1+ (1,0) [0|0] "NA" MCU
 SG_ OBJ_Abs_Long_Velocity_3 : 3296|12@1+ (0.05,-100) [-100|100] "m_per_s" MCU
 SG_ OBJ_Abs_Long_Velocity_V_3 : 3308|1@1+ (1,0) [0|1] "bool" MCU
 SG_ OBJ_Abs_Long_Velocity_STD_3 : 3309|13@1+ (0.01,0) [0|65] "m_per_s" MCU
 SG_ OBJ_Abs_Long_Vel_STD_V_3 : 3322|1@1+ (1,0) [0|1] "bool" MCU
 SG_ Reserved_9_3 : 3323|5@1+ (1,0) [0|0] "NA" MCU
 SG_ OBJ_Abs_Lat_Velocity_3 : 3328|11@1+ (0.05,-50) [-50|50] "m_per_s" MCU
 SG_ OBJ_Abs_Lat_Velocity_V_3 : 3339|1@1+ (1,0) [0|1] "bool" MCU
 SG_ OBJ_Abs_Lat_Velocity_STD_3 : 3340|13@1+ (0.01,0) [0|50] "m_per_s" MCU
 SG_ OBJ_Abs_Lat_Vel_STD_V_3 : 3353|1@1+ (1,0) [0|1] "bool" MCU
 SG_ Reserved_10_3 : 3354|6@1+ (1,0) [0|0] "NA" MCU
 SG_ OBJ_Abs_Long_Acc_3 : 3360|9@1+ (0.05,-10) [-10|10] "m_per_s2" MCU
 SG_ OBJ_Abs_Long_Acc_V_3 : 3369|1@1+ (1,0) [0|1] "bool" MCU
 SG_ OBJ_Abs_Long_Acc_STD_3 : 3370|10@1+ (0.01,0) [0|7.3] "m_per_s2" MCU
 SG_ OBJ_Abs_Long_Acc_STD_V_3 : 3380|1@1+ (1,0) [0|1] "bool" MCU
 SG_ OBJ_Abs_Lat_Acc_3 : 3381|9@1+ (0.05,-10) [-10|10] "m_per_s2" MCU
 SG_ OBJ_Abs_Lat_Acc_V_3 : 3390|1@1+ (1,0) [0|1] "bool" MCU
 SG_ Reserved_11_3 : 3391|1@1+ (1,0) [0|0] "NA" MCU
 SG_ OBJ_Abs_Lat_Acc_STD_3 : 3392|10@1+ (0.01,0) [0|7.3] "m_per_s2" MCU
 SG_ OBJ_Abs_Lat_Acc_STD_V_3 : 3402|1@1+ (1,0) [0|1] "bool" MCU
 SG_ OBJ_Abs_Acceleration_3 : 3403|9@1+ (0.05,-12.7) [-12.7|12.7] "m_per_s2" MCU
 SG_ OBJ_Abs_Acceleration_V_3 : 3412|1@1+ (1,0) [0|1] "bool" MCU
 SG_ OBJ_Abs_Acc_STD_3 : 3413|10@1+ (0.01,0) [0|7.3] "m_per_s2" MCU
 SG_ OBJ_Abs_Acc_STD_V_3 : 3423|1@1+ (1,0) [0|1] "bool" MCU
 SG_ OBJ_Inv_TTC_3 : 3424|11@1+ (0.01,-8) [-8|8] "INV(s)" MCU
 SG_ OBJ_Inv_TTC_V_3 : 3435|1@1+ (1,0) [0|1] "bool" MCU
 SG_ OBJ_Inv_TTC_STD_3 : 3436|12@1+ (0.001,0) [0|4] "INV(s)" MCU
 SG_ OBJ_Inv_TTC_STD_V_3 : 3448|1@1+ (1,0) [0|1] "bool" MCU
 SG_ Reserved_12_3 : 3449|7@1+ (1,0) [0|0] "NA" MCU
 SG_ OBJ_Relative_Long_Acc_3 : 3456|10@1+ (0.05,-20) [-20|20] "m_per_s2" MCU
 SG_ OBJ_Relative_Long_Acc_V_3 : 3466|1@1+ (1,0) [0|1] "bool" MCU
 SG_ OBJ_Relative_Long_Acc_STD_3 : 3467|10@1+ (0.01,0) [0|7.3] "m_per_s2" MCU
 SG_ OBJ_Rel_Long_Acc_STD_V_3 : 3477|1@1+ (1,0) [0|1] "bool" MCU
 SG_ Reserved_13_3 : 3478|10@1+ (1,0) [0|0] "NA" MCU
 SG_ OBJ_Relative_Long_Velocity_3 : 3488|13@1+ (0.05,-120) [-120|130] "m_per_s" MCU
 SG_ OBJ_Relative_Long_Velocity_V_3 : 3501|1@1+ (1,0) [0|1] "bool" MCU
 SG_ OBJ_Relative_Long_Vel_STD_3 : 3502|14@1+ (0.01,0) [0|130] "m_per_s" MCU
 SG_ OBJ_Rel_Long_Vel_STD_V_3 : 3516|1@1+ (1,0) [0|1] "bool" MCU
 SG_ Reserved_14_3 : 3517|3@1+ (1,0) [0|0] "NA" MCU
 SG_ OBJ_Relative_Lat_Velocity_3 : 3520|11@1+ (0.05,-50) [-50|50] "m_per_s" MCU
 SG_ OBJ_Relative_Lat_Velocity_V_3 : 3531|1@1+ (1,0) [0|1] "bool" MCU
 SG_ OBJ_Relative_Lat_Velocity_STD_3 : 3532|13@1+ (0.01,0) [0|50] "m_per_s" MCU
 SG_ OBJ_Rel_Lat_Vel_STD_V_3 : 3545|1@1+ (1,0) [0|1] "bool" MCU
 SG_ Reserved_15_3 : 3546|6@1+ (1,0) [0|0] "NA" MCU
 SG_ OBJ_Long_Distance_3 : 3552|14@1+ (0.05,-200) [-200|500] "m" MCU
 SG_ OBJ_Long_Distance_V_3 : 3566|1@1+ (1,0) [0|1] "bool" MCU
 SG_ OBJ_Long_Distance_STD_3 : 3567|15@1+ (0.01,0) [0|250] "m" MCU
 SG_ OBJ_Long_Distance_STD_V_3 : 3582|1@1+ (1,0) [0|1] "bool" MCU
 SG_ Reserved_16_3 : 3583|1@1+ (1,0) [0|0] "NA" MCU
 SG_ OBJ_Lat_Distance_3 : 3584|12@1+ (0.05,-100) [-100|100] "m" MCU
 SG_ OBJ_Lat_Distance_V_3 : 3596|1@1+ (1,0) [0|1] "bool" MCU
 SG_ OBJ_Lat_Distance_STD_3 : 3597|14@1+ (0.01,0) [0|100] "m" MCU
 SG_ OBJ_Lat_Distance_STD_V_3 : 3611|1@1+ (1,0) [0|1] "bool" MCU
 SG_ Reserved_17_3 : 3612|4@1+ (1,0) [0|0] "NA" MCU
 SG_ OBJ_Absolute_Speed_3 : 3616|12@1+ (0.05,-65) [-65|65] "m_per_s" MCU
 SG_ OBJ_Absolute_Speed_V_3 : 3628|1@1+ (1,0) [0|1] "bool" MCU
 SG_ OBJ_Absolute_Speed_STD_3 : 3629|13@1+ (0.01,0) [0|65] "m_per_s" MCU
 SG_ OBJ_Absolute_Speed_STD_V_3 : 3642|1@1+ (1,0) [0|1] "bool" MCU
 SG_ Reserved_18_3 : 3643|5@1+ (1,0) [0|0] "NA" MCU
 SG_ OBJ_Heading_3 : 3648|10@1+ (0.01,-3.14) [-3.14|3.14] "rad" MCU
 SG_ OBJ_Heading_V_3 : 3658|1@1+ (1,0) [0|1] "bool" MCU
 SG_ OBJ_Heading_STD_3 : 3659|15@1+ (0.0001,0) [0|3.14] "rad" MCU
 SG_ OBJ_Heading_STD_V_3 : 3674|1@1+ (1,0) [0|1] "bool" MCU
 SG_ Reserved_19_3 : 3675|5@1+ (1,0) [0|0] "NA" MCU
 SG_ OBJ_Angle_Rate_STD_3 : 3680|15@1+ (0.0001,0) [0|2.2318] "RPS" MCU
 SG_ OBJ_Angle_Rate_STD_V_3 : 3695|1@1+ (1,0) [0|1] "bool" MCU
 SG_ OBJ_Angle_Rate_3 : 3696|12@1+ (0.002,-2.234) [-2.234|2.2318] "RPS" MCU
 SG_ OBJ_Angle_Rate_V_3 : 3708|1@1+ (1,0) [0|1] "bool" MCU
 SG_ Reserved_20_3 : 3709|3@1+ (1,0) [0|0] "NA" MCU
 SG_ OBJ_Angle_Right_3 : 3712|14@1+ (0.0002,-1.571) [-1.571|1.571] "rad" MCU
 SG_ OBJ_Angle_Right_V_3 : 3726|1@1+ (1,0) [0|1] "bool" MCU
 SG_ OBJ_Angle_Right_STD_3 : 3727|14@1+ (0.0001,0) [0|1.571] "rad" MCU
 SG_ OBJ_Angle_Right_STD_V_3 : 3741|1@1+ (1,0) [0|1] "bool" MCU
 SG_ Reserved_21_3 : 3742|2@1+ (1,0) [0|0] "NA" MCU
 SG_ OBJ_Angle_Left_3 : 3744|14@1+ (0.0002,-1.571) [-1.571|1.571] "rad" MCU
 SG_ OBJ_Angle_Left_V_3 : 3758|1@1+ (1,0) [0|1] "bool" MCU
 SG_ OBJ_Angle_Left_STD_3 : 3759|14@1+ (0.0001,0) [0|1.571] "rad" MCU
 SG_ OBJ_Angle_Left_STD_V_3 : 3773|1@1+ (1,0) [0|1] "bool" MCU
 SG_ Reserved_22_3 : 3774|2@1+ (1,0) [0|0] "NA" MCU
 SG_ OBJ_Angle_Side_3 : 3776|14@1+ (0.0002,-1.571) [-1.571|1.571] "rad" MCU
 SG_ OBJ_Angle_Side_V_3 : 3790|1@1+ (1,0) [0|1] "bool" MCU
 SG_ OBJ_Angle_Side_STD_3 : 3791|14@1+ (0.0001,0) [0|1.571] "rad" MCU
 SG_ OBJ_Angle_Side_STD_V_3 : 3805|1@1+ (1,0) [0|1] "bool" MCU
 SG_ OBJ_Angle_Mid_V_3 : 3806|1@1+ (1,0) [0|1] "bool" MCU
 SG_ Reserved_23_3 : 3807|1@1+ (1,0) [0|0] "NA" MCU
 SG_ OBJ_Angle_Mid_3 : 3808|14@1+ (0.0002,-1.571) [-1.571|1.571] "rad" MCU
 SG_ OBJ_Angle_Mid_STD_3 : 3822|14@1+ (0.0001,0) [0|1.571] "rad" MCU
 SG_ OBJ_Angle_Mid_STD_V_3 : 3836|1@1+ (1,0) [0|1] "bool" MCU
 SG_ OBJ_Angle_Bottom_V_3 : 3837|1@1+ (1,0) [0|1] "bool" MCU
 SG_ Reserved_24_3 : 3838|2@1+ (1,0) [0|0] "NA" MCU
 SG_ OBJ_Angle_Bottom_3 : 3840|14@1+ (0.0002,-1.571) [-1.571|1.571] "rad" MCU
 SG_ OBJ_Angle_Bottom_STD_3 : 3854|14@1+ (0.0001,0) [0|1.571] "rad" MCU
 SG_ OBJ_Angle_Bottom_STD_V_3 : 3868|1@1+ (1,0) [0|1] "bool" MCU
 SG_ OBJ_Visibility_Side_V_3 : 3869|1@1+ (1,0) [0|1] "bool" MCU
 SG_ OBJ_Visibility_Side_3 : 3870|2@1+ (1,0) [0|2] "ENUM" MCU
 SG_ OBJ_Is_In_Drivable_Area_3 : 3872|1@1+ (1,0) [0|1] "bool" MCU
 SG_ OBJ_Is_In_Drivable_Area_V_3 : 3873|1@1+ (1,0) [0|1] "bool" MCU
 SG_ OBJ_Is_VeryClose_V_3 : 3874|1@1+ (1,0) [0|1] "bool" MCU
 SG_ OBJ_Is_VeryClose_3 : 3875|1@1+ (1,0) [0|1] "bool" MCU
 SG_ OBJ_Buffer_C4_3 : 3876|2@1+ (1,0) [0|2] "NA" MCU
 SG_ OBJ_Buffer_C5_3 : 3878|2@1+ (1,0) [0|2] "NA" MCU
 SG_ OBJ_Buffer_C6_3 : 3880|2@1+ (1,0) [0|2] "NA" MCU
 SG_ OBJ_Buffer_C7_3 : 3882|2@1+ (1,0) [0|2] "NA" MCU
 SG_ OBJ_OverlapAngleEgoLaneR_3 : 3884|10@1+ (0.01,-3.14) [-3.14|3.14] "rad" MCU
 SG_ OBJ_OverlapAngleEgoLaneR_V_3 : 3894|1@1+ (1,0) [0|1] "bool" MCU
 SG_ Reserved_25_3 : 3895|9@1+ (1,0) [0|0] "NA" MCU
 SG_ OBJ_OverlapAngleEgoLaneL_3 : 3904|10@1+ (0.01,-3.14) [-3.14|3.14] "rad" MCU
 SG_ OBJ_OverlapAngleEgoLaneL_V_3 : 3914|1@1+ (1,0) [0|1] "bool" MCU
 SG_ OBJ_Is_EMERGENCY_VCL_3 : 3915|1@1+ (1,0) [0|1] "bool" MCU
 SG_ OBJ_EMERGENCY_LIGHT_COLOR_3 : 3916|4@1+ (1,0) [0|15] "BITWIZE" MCU
 SG_ OBJ_EMERGENCY_V_3 : 3920|1@1+ (1,0) [0|1] "bool" MCU
 SG_ OBJ_Angle_Top_3 : 3921|14@1+ (0.0002,0) [0|3.1415] "rad" MCU
 SG_ OBJ_Angle_Top_V_3 : 3935|1@1+ (1,0) [0|1] "bool" MCU
 SG_ OBJ_Angle_Top_STD_3 : 3936|15@1+ (0.0001,0) [0|3.1415] "rad" MCU
 SG_ OBJ_Angle_Top_STD_V_3 : 3951|1@1+ (1,0) [0|1] "bool" MCU
 SG_ OBJ_Open_Door_Left_3 : 3952|1@1+ (1,0) [0|1] "bool" MCU
 SG_ OBJ_Open_Door_Right_3 : 3953|1@1+ (1,0) [0|1] "bool" MCU
 SG_ OBJ_Visible_Left_or_Right_3 : 3954|2@1+ (1,0) [0|2] "ENUM" MCU
 SG_ OBJ_Visible_Left_or_Right_V_3 : 3956|1@1+ (1,0) [0|1] "bool" MCU
 SG_ OBJ_2W_Is_Motorbike_Probability_3 : 3957|8@1+ (0.01,0) [0|1] "NA" MCU
 SG_ Reserved_26_3 : 3965|3@1+ (1,0) [0|0] "NA" MCU
 SG_ OBJ_2W_Is_Bicycle_Probability_3 : 3968|8@1+ (0.01,0) [0|1] "NA" MCU
 SG_ Reserved_27_3 : 3976|24@1+ (1,0) [0|0] "NA" MCU
 SG_ OBJ_CRC_4 : 4000|32@1+ (1,0) [0|4294967295] "NA" MCU
 SG_ OBJ_ID_4 : 4032|8@1+ (1,0) [0|255] "counter" MCU
 SG_ OBJ_Existence_Probability_4 : 4040|8@1+ (0.01,0) [0|1] "NA" MCU
 SG_ OBJ_Fusion_Source_4 : 4048|16@1+ (1,0) [0|65535] "BITWIZE" MCU
 SG_ OBJ_Triggered_SDM_4 : 4064|2@1+ (1,0) [0|2] "ENUM" MCU
 SG_ OBJ_Motion_Category_4 : 4066|4@1+ (1,0) [0|13] "ENUM" MCU
 SG_ OBJ_Moving_IN_Probability_4 : 4070|7@1+ (0.01,0) [0|1] "NA" MCU
 SG_ OBJ_Object_Age_4 : 4077|11@1+ (1,0) [0|2047] "frames" MCU
 SG_ OBJ_Measuring_Status_4 : 4088|3@1+ (1,0) [0|7] "BITWIZE" MCU
 SG_ OBJ_Object_Class_4 : 4091|4@1+ (1,0) [0|9] "ENUM" MCU
 SG_ Reserved_4_4 : 4095|1@1+ (1,0) [0|0] "NA" MCU
 SG_ OBJ_Class_Probability_4 : 4096|7@1+ (0.01,0) [0|1] "NA" MCU
 SG_ OBJ_Car_Probability_4 : 4103|7@1+ (0.01,0) [0|1] "NA" MCU
 SG_ OBJ_Truck_Probability_4 : 4110|7@1+ (0.01,0) [0|1] "NA" MCU
 SG_ OBJ_Bike_Probability_4 : 4117|7@1+ (0.01,0) [0|1] "NA" MCU
 SG_ OBJ_Camera_Source_4 : 4124|4@1+ (1,0) [0|15] "ENUM" MCU
 SG_ OBJ_Motion_Status_4 : 4128|3@1+ (1,0) [0|5] "ENUM" MCU
 SG_ OBJ_Motion_Orientation_4 : 4131|4@1+ (1,0) [0|13] "ENUM" MCU
 SG_ OBJ_Has_Cut_Lane_4 : 4135|1@1+ (1,0) [0|1] "bool" MCU
 SG_ OBJ_Has_Cut_Path_4 : 4136|1@1+ (1,0) [0|1] "bool" MCU
 SG_ OBJ_Brake_Light_Validity_4 : 4137|1@1+ (1,0) [0|1] "bool" MCU
 SG_ OBJ_Brake_Light_4 : 4138|1@1+ (1,0) [0|1] "bool" MCU
 SG_ OBJ_Turn_Indicator_Right_4 : 4139|1@1+ (1,0) [0|1] "bool" MCU
 SG_ OBJ_Turn_Indicator_Left_4 : 4140|1@1+ (1,0) [0|1] "bool" MCU
 SG_ OBJ_Turn_Indicator_Validity_4 : 4141|1@1+ (1,0) [0|1] "bool" MCU
 SG_ OBJ_Right_Out_Of_Image_4 : 4142|1@1+ (1,0) [0|1] "bool" MCU
 SG_ OBJ_Left_Out_Of_Image_4 : 4143|1@1+ (1,0) [0|1] "bool" MCU
 SG_ OBJ_Right_Out_Of_Image_V_4 : 4144|1@1+ (1,0) [0|1] "bool" MCU
 SG_ OBJ_Left_Out_Of_Image_V_4 : 4145|1@1+ (1,0) [0|1] "bool" MCU
 SG_ OBJ_Top_Out_Of_Image_4 : 4146|1@1+ (1,0) [0|1] "bool" MCU
 SG_ OBJ_Bottom_Out_Of_Image_4 : 4147|1@1+ (1,0) [0|1] "bool" MCU
 SG_ OBJ_Top_Out_Of_Image_V_4 : 4148|1@1+ (1,0) [0|1] "bool" MCU
 SG_ OBJ_Bottom_Out_Of_Image_V_4 : 4149|1@1+ (1,0) [0|1] "bool" MCU
 SG_ OBJ_Lane_Assignment_4 : 4150|3@1+ (1,0) [0|5] "ENUM" MCU
 SG_ OBJ_Lane_Assignment_V_4 : 4153|1@1+ (1,0) [0|1] "bool" MCU
 SG_ Reserved_5_4 : 4154|6@1+ (1,0) [0|0] "NA" MCU
 SG_ OBJ_Age_Seconds_4 : 4160|7@1+ (1,0) [0|100] "s" MCU
 SG_ OBJ_Age_Seconds_V_4 : 4167|1@1+ (1,0) [0|1] "bool" MCU
 SG_ OBJ_Width_4 : 4168|9@1+ (0.01,0) [0.4|2.95] "m" MCU
 SG_ OBJ_Width_V_4 : 4177|1@1+ (1,0) [0|1] "bool" MCU
 SG_ OBJ_Width_STD_4 : 4178|11@1+ (0.001,0) [0|2] "m" MCU
 SG_ OBJ_Width_STD_V_4 : 4189|1@1+ (1,0) [0|1] "bool" MCU
 SG_ Reserved_6_4 : 4190|2@1+ (1,0) [0|0] "NA" MCU
 SG_ OBJ_Length_4 : 4192|9@1+ (0.05,0) [0.6|21] "m" MCU
 SG_ OBJ_Length_V_4 : 4201|1@1+ (1,0) [0|1] "bool" MCU
 SG_ OBJ_Length_STD_4 : 4202|10@1+ (0.01,0) [0|10] "m" MCU
 SG_ OBJ_Length_STD_V_4 : 4212|1@1+ (1,0) [0|1] "bool" MCU
 SG_ OBJ_Radar_ID_4 : 4213|8@1+ (1,0) [0|255] "counter" MCU
 SG_ Reserved_7_4 : 4221|3@1+ (1,0) [0|0] "NA" MCU
 SG_ OBJ_Height_4 : 4224|9@1+ (0.01,0) [0|2.95] "m" MCU
 SG_ OBJ_Height_V_4 : 4233|1@1+ (1,0) [0|1] "bool" MCU
 SG_ OBJ_Height_STD_4 : 4234|11@1+ (0.001,0) [0|2] "m" MCU
 SG_ OBJ_Height_STD_V_4 : 4245|1@1+ (1,0) [0|1] "bool" MCU
 SG_ Reserved_8_4 : 4246|10@1+ (1,0) [0|0] "NA" MCU
 SG_ OBJ_Abs_Long_Velocity_4 : 4256|12@1+ (0.05,-100) [-100|100] "m_per_s" MCU
 SG_ OBJ_Abs_Long_Velocity_V_4 : 4268|1@1+ (1,0) [0|1] "bool" MCU
 SG_ OBJ_Abs_Long_Velocity_STD_4 : 4269|13@1+ (0.01,0) [0|65] "m_per_s" MCU
 SG_ OBJ_Abs_Long_Vel_STD_V_4 : 4282|1@1+ (1,0) [0|1] "bool" MCU
 SG_ Reserved_9_4 : 4283|5@1+ (1,0) [0|0] "NA" MCU
 SG_ OBJ_Abs_Lat_Velocity_4 : 4288|11@1+ (0.05,-50) [-50|50] "m_per_s" MCU
 SG_ OBJ_Abs_Lat_Velocity_V_4 : 4299|1@1+ (1,0) [0|1] "bool" MCU
 SG_ OBJ_Abs_Lat_Velocity_STD_4 : 4300|13@1+ (0.01,0) [0|50] "m_per_s" MCU
 SG_ OBJ_Abs_Lat_Vel_STD_V_4 : 4313|1@1+ (1,0) [0|1] "bool" MCU
 SG_ Reserved_10_4 : 4314|6@1+ (1,0) [0|0] "NA" MCU
 SG_ OBJ_Abs_Long_Acc_4 : 4320|9@1+ (0.05,-10) [-10|10] "m_per_s2" MCU
 SG_ OBJ_Abs_Long_Acc_V_4 : 4329|1@1+ (1,0) [0|1] "bool" MCU
 SG_ OBJ_Abs_Long_Acc_STD_4 : 4330|10@1+ (0.01,0) [0|7.3] "m_per_s2" MCU
 SG_ OBJ_Abs_Long_Acc_STD_V_4 : 4340|1@1+ (1,0) [0|1] "bool" MCU
 SG_ OBJ_Abs_Lat_Acc_4 : 4341|9@1+ (0.05,-10) [-10|10] "m_per_s2" MCU
 SG_ OBJ_Abs_Lat_Acc_V_4 : 4350|1@1+ (1,0) [0|1] "bool" MCU
 SG_ Reserved_11_4 : 4351|1@1+ (1,0) [0|0] "NA" MCU
 SG_ OBJ_Abs_Lat_Acc_STD_4 : 4352|10@1+ (0.01,0) [0|7.3] "m_per_s2" MCU
 SG_ OBJ_Abs_Lat_Acc_STD_V_4 : 4362|1@1+ (1,0) [0|1] "bool" MCU
 SG_ OBJ_Abs_Acceleration_4 : 4363|9@1+ (0.05,-12.7) [-12.7|12.7] "m_per_s2" MCU
 SG_ OBJ_Abs_Acceleration_V_4 : 4372|1@1+ (1,0) [0|1] "bool" MCU
 SG_ OBJ_Abs_Acc_STD_4 : 4373|10@1+ (0.01,0) [0|7.3] "m_per_s2" MCU
 SG_ OBJ_Abs_Acc_STD_V_4 : 4383|1@1+ (1,0) [0|1] "bool" MCU
 SG_ OBJ_Inv_TTC_4 : 4384|11@1+ (0.01,-8) [-8|8] "INV(s)" MCU
 SG_ OBJ_Inv_TTC_V_4 : 4395|1@1+ (1,0) [0|1] "bool" MCU
 SG_ OBJ_Inv_TTC_STD_4 : 4396|12@1+ (0.001,0) [0|4] "INV(s)" MCU
 SG_ OBJ_Inv_TTC_STD_V_4 : 4408|1@1+ (1,0) [0|1] "bool" MCU
 SG_ Reserved_12_4 : 4409|7@1+ (1,0) [0|0] "NA" MCU
 SG_ OBJ_Relative_Long_Acc_4 : 4416|10@1+ (0.05,-20) [-20|20] "m_per_s2" MCU
 SG_ OBJ_Relative_Long_Acc_V_4 : 4426|1@1+ (1,0) [0|1] "bool" MCU
 SG_ OBJ_Relative_Long_Acc_STD_4 : 4427|10@1+ (0.01,0) [0|7.3] "m_per_s2" MCU
 SG_ OBJ_Rel_Long_Acc_STD_V_4 : 4437|1@1+ (1,0) [0|1] "bool" MCU
 SG_ Reserved_13_4 : 4438|10@1+ (1,0) [0|0] "NA" MCU
 SG_ OBJ_Relative_Long_Velocity_4 : 4448|13@1+ (0.05,-120) [-120|130] "m_per_s" MCU
 SG_ OBJ_Relative_Long_Velocity_V_4 : 4461|1@1+ (1,0) [0|1] "bool" MCU
 SG_ OBJ_Relative_Long_Vel_STD_4 : 4462|14@1+ (0.01,0) [0|130] "m_per_s" MCU
 SG_ OBJ_Rel_Long_Vel_STD_V_4 : 4476|1@1+ (1,0) [0|1] "bool" MCU
 SG_ Reserved_14_4 : 4477|3@1+ (1,0) [0|0] "NA" MCU
 SG_ OBJ_Relative_Lat_Velocity_4 : 4480|11@1+ (0.05,-50) [-50|50] "m_per_s" MCU
 SG_ OBJ_Relative_Lat_Velocity_V_4 : 4491|1@1+ (1,0) [0|1] "bool" MCU
 SG_ OBJ_Relative_Lat_Velocity_STD_4 : 4492|13@1+ (0.01,0) [0|50] "m_per_s" MCU
 SG_ OBJ_Rel_Lat_Vel_STD_V_4 : 4505|1@1+ (1,0) [0|1] "bool" MCU
 SG_ Reserved_15_4 : 4506|6@1+ (1,0) [0|0] "NA" MCU
 SG_ OBJ_Long_Distance_4 : 4512|14@1+ (0.05,-200) [-200|500] "m" MCU
 SG_ OBJ_Long_Distance_V_4 : 4526|1@1+ (1,0) [0|1] "bool" MCU
 SG_ OBJ_Long_Distance_STD_4 : 4527|15@1+ (0.01,0) [0|250] "m" MCU
 SG_ OBJ_Long_Distance_STD_V_4 : 4542|1@1+ (1,0) [0|1] "bool" MCU
 SG_ Reserved_16_4 : 4543|1@1+ (1,0) [0|0] "NA" MCU
 SG_ OBJ_Lat_Distance_4 : 4544|12@1+ (0.05,-100) [-100|100] "m" MCU
 SG_ OBJ_Lat_Distance_V_4 : 4556|1@1+ (1,0) [0|1] "bool" MCU
 SG_ OBJ_Lat_Distance_STD_4 : 4557|14@1+ (0.01,0) [0|100] "m" MCU
 SG_ OBJ_Lat_Distance_STD_V_4 : 4571|1@1+ (1,0) [0|1] "bool" MCU
 SG_ Reserved_17_4 : 4572|4@1+ (1,0) [0|0] "NA" MCU
 SG_ OBJ_Absolute_Speed_4 : 4576|12@1+ (0.05,-65) [-65|65] "m_per_s" MCU
 SG_ OBJ_Absolute_Speed_V_4 : 4588|1@1+ (1,0) [0|1] "bool" MCU
 SG_ OBJ_Absolute_Speed_STD_4 : 4589|13@1+ (0.01,0) [0|65] "m_per_s" MCU
 SG_ OBJ_Absolute_Speed_STD_V_4 : 4602|1@1+ (1,0) [0|1] "bool" MCU
 SG_ Reserved_18_4 : 4603|5@1+ (1,0) [0|0] "NA" MCU
 SG_ OBJ_Heading_4 : 4608|10@1+ (0.01,-3.14) [-3.14|3.14] "rad" MCU
 SG_ OBJ_Heading_V_4 : 4618|1@1+ (1,0) [0|1] "bool" MCU
 SG_ OBJ_Heading_STD_4 : 4619|15@1+ (0.0001,0) [0|3.14] "rad" MCU
 SG_ OBJ_Heading_STD_V_4 : 4634|1@1+ (1,0) [0|1] "bool" MCU
 SG_ Reserved_19_4 : 4635|5@1+ (1,0) [0|0] "NA" MCU
 SG_ OBJ_Angle_Rate_STD_4 : 4640|15@1+ (0.0001,0) [0|2.2318] "RPS" MCU
 SG_ OBJ_Angle_Rate_STD_V_4 : 4655|1@1+ (1,0) [0|1] "bool" MCU
 SG_ OBJ_Angle_Rate_4 : 4656|12@1+ (0.002,-2.234) [-2.234|2.2318] "RPS" MCU
 SG_ OBJ_Angle_Rate_V_4 : 4668|1@1+ (1,0) [0|1] "bool" MCU
 SG_ Reserved_20_4 : 4669|3@1+ (1,0) [0|0] "NA" MCU
 SG_ OBJ_Angle_Right_4 : 4672|14@1+ (0.0002,-1.571) [-1.571|1.571] "rad" MCU
 SG_ OBJ_Angle_Right_V_4 : 4686|1@1+ (1,0) [0|1] "bool" MCU
 SG_ OBJ_Angle_Right_STD_4 : 4687|14@1+ (0.0001,0) [0|1.571] "rad" MCU
 SG_ OBJ_Angle_Right_STD_V_4 : 4701|1@1+ (1,0) [0|1] "bool" MCU
 SG_ Reserved_21_4 : 4702|2@1+ (1,0) [0|0] "NA" MCU
 SG_ OBJ_Angle_Left_4 : 4704|14@1+ (0.0002,-1.571) [-1.571|1.571] "rad" MCU
 SG_ OBJ_Angle_Left_V_4 : 4718|1@1+ (1,0) [0|1] "bool" MCU
 SG_ OBJ_Angle_Left_STD_4 : 4719|14@1+ (0.0001,0) [0|1.571] "rad" MCU
 SG_ OBJ_Angle_Left_STD_V_4 : 4733|1@1+ (1,0) [0|1] "bool" MCU
 SG_ Reserved_22_4 : 4734|2@1+ (1,0) [0|0] "NA" MCU
 SG_ OBJ_Angle_Side_4 : 4736|14@1+ (0.0002,-1.571) [-1.571|1.571] "rad" MCU
 SG_ OBJ_Angle_Side_V_4 : 4750|1@1+ (1,0) [0|1] "bool" MCU
 SG_ OBJ_Angle_Side_STD_4 : 4751|14@1+ (0.0001,0) [0|1.571] "rad" MCU
 SG_ OBJ_Angle_Side_STD_V_4 : 4765|1@1+ (1,0) [0|1] "bool" MCU
 SG_ OBJ_Angle_Mid_V_4 : 4766|1@1+ (1,0) [0|1] "bool" MCU
 SG_ Reserved_23_4 : 4767|1@1+ (1,0) [0|0] "NA" MCU
 SG_ OBJ_Angle_Mid_4 : 4768|14@1+ (0.0002,-1.571) [-1.571|1.571] "rad" MCU
 SG_ OBJ_Angle_Mid_STD_4 : 4782|14@1+ (0.0001,0) [0|1.571] "rad" MCU
 SG_ OBJ_Angle_Mid_STD_V_4 : 4796|1@1+ (1,0) [0|1] "bool" MCU
 SG_ OBJ_Angle_Bottom_V_4 : 4797|1@1+ (1,0) [0|1] "bool" MCU
 SG_ Reserved_24_4 : 4798|2@1+ (1,0) [0|0] "NA" MCU
 SG_ OBJ_Angle_Bottom_4 : 4800|14@1+ (0.0002,-1.571) [-1.571|1.571] "rad" MCU
 SG_ OBJ_Angle_Bottom_STD_4 : 4814|14@1+ (0.0001,0) [0|1.571] "rad" MCU
 SG_ OBJ_Angle_Bottom_STD_V_4 : 4828|1@1+ (1,0) [0|1] "bool" MCU
 SG_ OBJ_Visibility_Side_V_4 : 4829|1@1+ (1,0) [0|1] "bool" MCU
 SG_ OBJ_Visibility_Side_4 : 4830|2@1+ (1,0) [0|2] "ENUM" MCU
 SG_ OBJ_Is_In_Drivable_Area_4 : 4832|1@1+ (1,0) [0|1] "bool" MCU
 SG_ OBJ_Is_In_Drivable_Area_V_4 : 4833|1@1+ (1,0) [0|1] "bool" MCU
 SG_ OBJ_Is_VeryClose_V_4 : 4834|1@1+ (1,0) [0|1] "bool" MCU
 SG_ OBJ_Is_VeryClose_4 : 4835|1@1+ (1,0) [0|1] "bool" MCU
 SG_ OBJ_Buffer_C4_4 : 4836|2@1+ (1,0) [0|2] "NA" MCU
 SG_ OBJ_Buffer_C5_4 : 4838|2@1+ (1,0) [0|2] "NA" MCU
 SG_ OBJ_Buffer_C6_4 : 4840|2@1+ (1,0) [0|2] "NA" MCU
 SG_ OBJ_Buffer_C7_4 : 4842|2@1+ (1,0) [0|2] "NA" MCU
 SG_ OBJ_OverlapAngleEgoLaneR_4 : 4844|10@1+ (0.01,-3.14) [-3.14|3.14] "rad" MCU
 SG_ OBJ_OverlapAngleEgoLaneR_V_4 : 4854|1@1+ (1,0) [0|1] "bool" MCU
 SG_ Reserved_25_4 : 4855|9@1+ (1,0) [0|0] "NA" MCU
 SG_ OBJ_OverlapAngleEgoLaneL_4 : 4864|10@1+ (0.01,-3.14) [-3.14|3.14] "rad" MCU
 SG_ OBJ_OverlapAngleEgoLaneL_V_4 : 4874|1@1+ (1,0) [0|1] "bool" MCU
 SG_ OBJ_Is_EMERGENCY_VCL_4 : 4875|1@1+ (1,0) [0|1] "bool" MCU
 SG_ OBJ_EMERGENCY_LIGHT_COLOR_4 : 4876|4@1+ (1,0) [0|15] "BITWIZE" MCU
 SG_ OBJ_EMERGENCY_V_4 : 4880|1@1+ (1,0) [0|1] "bool" MCU
 SG_ OBJ_Angle_Top_4 : 4881|14@1+ (0.0002,0) [0|3.1415] "rad" MCU
 SG_ OBJ_Angle_Top_V_4 : 4895|1@1+ (1,0) [0|1] "bool" MCU
 SG_ OBJ_Angle_Top_STD_4 : 4896|15@1+ (0.0001,0) [0|3.1415] "rad" MCU
 SG_ OBJ_Angle_Top_STD_V_4 : 4911|1@1+ (1,0) [0|1] "bool" MCU
 SG_ OBJ_Open_Door_Left_4 : 4912|1@1+ (1,0) [0|1] "bool" MCU
 SG_ OBJ_Open_Door_Right_4 : 4913|1@1+ (1,0) [0|1] "bool" MCU
 SG_ OBJ_Visible_Left_or_Right_4 : 4914|2@1+ (1,0) [0|2] "ENUM" MCU
 SG_ OBJ_Visible_Left_or_Right_V_4 : 4916|1@1+ (1,0) [0|1] "bool" MCU
 SG_ OBJ_2W_Is_Motorbike_Probability_4 : 4917|8@1+ (0.01,0) [0|1] "NA" MCU
 SG_ Reserved_26_4 : 4925|3@1+ (1,0) [0|0] "NA" MCU
 SG_ OBJ_2W_Is_Bicycle_Probability_4 : 4928|8@1+ (0.01,0) [0|1] "NA" MCU
 SG_ Reserved_27_4 : 4936|24@1+ (1,0) [0|0] "NA" MCU
 SG_ OBJ_CRC_5 : 4960|32@1+ (1,0) [0|4294967295] "NA" MCU
 SG_ OBJ_ID_5 : 4992|8@1+ (1,0) [0|255] "counter" MCU
 SG_ OBJ_Existence_Probability_5 : 5000|8@1+ (0.01,0) [0|1] "NA" MCU
 SG_ OBJ_Fusion_Source_5 : 5008|16@1+ (1,0) [0|65535] "BITWIZE" MCU
 SG_ OBJ_Triggered_SDM_5 : 5024|2@1+ (1,0) [0|2] "ENUM" MCU
 SG_ OBJ_Motion_Category_5 : 5026|4@1+ (1,0) [0|13] "ENUM" MCU
 SG_ OBJ_Moving_IN_Probability_5 : 5030|7@1+ (0.01,0) [0|1] "NA" MCU
 SG_ OBJ_Object_Age_5 : 5037|11@1+ (1,0) [0|2047] "frames" MCU
 SG_ OBJ_Measuring_Status_5 : 5048|3@1+ (1,0) [0|7] "BITWIZE" MCU
 SG_ OBJ_Object_Class_5 : 5051|4@1+ (1,0) [0|9] "ENUM" MCU
 SG_ Reserved_4_5 : 5055|1@1+ (1,0) [0|0] "NA" MCU
 SG_ OBJ_Class_Probability_5 : 5056|7@1+ (0.01,0) [0|1] "NA" MCU
 SG_ OBJ_Car_Probability_5 : 5063|7@1+ (0.01,0) [0|1] "NA" MCU
 SG_ OBJ_Truck_Probability_5 : 5070|7@1+ (0.01,0) [0|1] "NA" MCU
 SG_ OBJ_Bike_Probability_5 : 5077|7@1+ (0.01,0) [0|1] "NA" MCU
 SG_ OBJ_Camera_Source_5 : 5084|4@1+ (1,0) [0|15] "ENUM" MCU
 SG_ OBJ_Motion_Status_5 : 5088|3@1+ (1,0) [0|5] "ENUM" MCU
 SG_ OBJ_Motion_Orientation_5 : 5091|4@1+ (1,0) [0|13] "ENUM" MCU
 SG_ OBJ_Has_Cut_Lane_5 : 5095|1@1+ (1,0) [0|1] "bool" MCU
 SG_ OBJ_Has_Cut_Path_5 : 5096|1@1+ (1,0) [0|1] "bool" MCU
 SG_ OBJ_Brake_Light_Validity_5 : 5097|1@1+ (1,0) [0|1] "bool" MCU
 SG_ OBJ_Brake_Light_5 : 5098|1@1+ (1,0) [0|1] "bool" MCU
 SG_ OBJ_Turn_Indicator_Right_5 : 5099|1@1+ (1,0) [0|1] "bool" MCU
 SG_ OBJ_Turn_Indicator_Left_5 : 5100|1@1+ (1,0) [0|1] "bool" MCU
 SG_ OBJ_Turn_Indicator_Validity_5 : 5101|1@1+ (1,0) [0|1] "bool" MCU
 SG_ OBJ_Right_Out_Of_Image_5 : 5102|1@1+ (1,0) [0|1] "bool" MCU
 SG_ OBJ_Left_Out_Of_Image_5 : 5103|1@1+ (1,0) [0|1] "bool" MCU
 SG_ OBJ_Right_Out_Of_Image_V_5 : 5104|1@1+ (1,0) [0|1] "bool" MCU
 SG_ OBJ_Left_Out_Of_Image_V_5 : 5105|1@1+ (1,0) [0|1] "bool" MCU
 SG_ OBJ_Top_Out_Of_Image_5 : 5106|1@1+ (1,0) [0|1] "bool" MCU
 SG_ OBJ_Bottom_Out_Of_Image_5 : 5107|1@1+ (1,0) [0|1] "bool" MCU
 SG_ OBJ_Top_Out_Of_Image_V_5 : 5108|1@1+ (1,0) [0|1] "bool" MCU
 SG_ OBJ_Bottom_Out_Of_Image_V_5 : 5109|1@1+ (1,0) [0|1] "bool" MCU
 SG_ OBJ_Lane_Assignment_5 : 5110|3@1+ (1,0) [0|5] "ENUM" MCU
 SG_ OBJ_Lane_Assignment_V_5 : 5113|1@1+ (1,0) [0|1] "bool" MCU
 SG_ Reserved_5_5 : 5114|6@1+ (1,0) [0|0] "NA" MCU
 SG_ OBJ_Age_Seconds_5 : 5120|7@1+ (1,0) [0|100] "s" MCU
 SG_ OBJ_Age_Seconds_V_5 : 5127|1@1+ (1,0) [0|1] "bool" MCU
 SG_ OBJ_Width_5 : 5128|9@1+ (0.01,0) [0.4|2.95] "m" MCU
 SG_ OBJ_Width_V_5 : 5137|1@1+ (1,0) [0|1] "bool" MCU
 SG_ OBJ_Width_STD_5 : 5138|11@1+ (0.001,0) [0|2] "m" MCU
 SG_ OBJ_Width_STD_V_5 : 5149|1@1+ (1,0) [0|1] "bool" MCU
 SG_ Reserved_6_5 : 5150|2@1+ (1,0) [0|0] "NA" MCU
 SG_ OBJ_Length_5 : 5152|9@1+ (0.05,0) [0.6|21] "m" MCU
 SG_ OBJ_Length_V_5 : 5161|1@1+ (1,0) [0|1] "bool" MCU
 SG_ OBJ_Length_STD_5 : 5162|10@1+ (0.01,0) [0|10] "m" MCU
 SG_ OBJ_Length_STD_V_5 : 5172|1@1+ (1,0) [0|1] "bool" MCU
 SG_ OBJ_Radar_ID_5 : 5173|8@1+ (1,0) [0|255] "counter" MCU
 SG_ Reserved_7_5 : 5181|3@1+ (1,0) [0|0] "NA" MCU
 SG_ OBJ_Height_5 : 5184|9@1+ (0.01,0) [0|2.95] "m" MCU
 SG_ OBJ_Height_V_5 : 5193|1@1+ (1,0) [0|1] "bool" MCU
 SG_ OBJ_Height_STD_5 : 5194|11@1+ (0.001,0) [0|2] "m" MCU
 SG_ OBJ_Height_STD_V_5 : 5205|1@1+ (1,0) [0|1] "bool" MCU
 SG_ Reserved_8_5 : 5206|10@1+ (1,0) [0|0] "NA" MCU
 SG_ OBJ_Abs_Long_Velocity_5 : 5216|12@1+ (0.05,-100) [-100|100] "m_per_s" MCU
 SG_ OBJ_Abs_Long_Velocity_V_5 : 5228|1@1+ (1,0) [0|1] "bool" MCU
 SG_ OBJ_Abs_Long_Velocity_STD_5 : 5229|13@1+ (0.01,0) [0|65] "m_per_s" MCU
 SG_ OBJ_Abs_Long_Vel_STD_V_5 : 5242|1@1+ (1,0) [0|1] "bool" MCU
 SG_ Reserved_9_5 : 5243|5@1+ (1,0) [0|0] "NA" MCU
 SG_ OBJ_Abs_Lat_Velocity_5 : 5248|11@1+ (0.05,-50) [-50|50] "m_per_s" MCU
 SG_ OBJ_Abs_Lat_Velocity_V_5 : 5259|1@1+ (1,0) [0|1] "bool" MCU
 SG_ OBJ_Abs_Lat_Velocity_STD_5 : 5260|13@1+ (0.01,0) [0|50] "m_per_s" MCU
 SG_ OBJ_Abs_Lat_Vel_STD_V_5 : 5273|1@1+ (1,0) [0|1] "bool" MCU
 SG_ Reserved_10_5 : 5274|6@1+ (1,0) [0|0] "NA" MCU
 SG_ OBJ_Abs_Long_Acc_5 : 5280|9@1+ (0.05,-10) [-10|10] "m_per_s2" MCU
 SG_ OBJ_Abs_Long_Acc_V_5 : 5289|1@1+ (1,0) [0|1] "bool" MCU
 SG_ OBJ_Abs_Long_Acc_STD_5 : 5290|10@1+ (0.01,0) [0|7.3] "m_per_s2" MCU
 SG_ OBJ_Abs_Long_Acc_STD_V_5 : 5300|1@1+ (1,0) [0|1] "bool" MCU
 SG_ OBJ_Abs_Lat_Acc_5 : 5301|9@1+ (0.05,-10) [-10|10] "m_per_s2" MCU
 SG_ OBJ_Abs_Lat_Acc_V_5 : 5310|1@1+ (1,0) [0|1] "bool" MCU
 SG_ Reserved_11_5 : 5311|1@1+ (1,0) [0|0] "NA" MCU
 SG_ OBJ_Abs_Lat_Acc_STD_5 : 5312|10@1+ (0.01,0) [0|7.3] "m_per_s2" MCU
 SG_ OBJ_Abs_Lat_Acc_STD_V_5 : 5322|1@1+ (1,0) [0|1] "bool" MCU
 SG_ OBJ_Abs_Acceleration_5 : 5323|9@1+ (0.05,-12.7) [-12.7|12.7] "m_per_s2" MCU
 SG_ OBJ_Abs_Acceleration_V_5 : 5332|1@1+ (1,0) [0|1] "bool" MCU
 SG_ OBJ_Abs_Acc_STD_5 : 5333|10@1+ (0.01,0) [0|7.3] "m_per_s2" MCU
 SG_ OBJ_Abs_Acc_STD_V_5 : 5343|1@1+ (1,0) [0|1] "bool" MCU
 SG_ OBJ_Inv_TTC_5 : 5344|11@1+ (0.01,-8) [-8|8] "INV(s)" MCU
 SG_ OBJ_Inv_TTC_V_5 : 5355|1@1+ (1,0) [0|1] "bool" MCU
 SG_ OBJ_Inv_TTC_STD_5 : 5356|12@1+ (0.001,0) [0|4] "INV(s)" MCU
 SG_ OBJ_Inv_TTC_STD_V_5 : 5368|1@1+ (1,0) [0|1] "bool" MCU
 SG_ Reserved_12_5 : 5369|7@1+ (1,0) [0|0] "NA" MCU
 SG_ OBJ_Relative_Long_Acc_5 : 5376|10@1+ (0.05,-20) [-20|20] "m_per_s2" MCU
 SG_ OBJ_Relative_Long_Acc_V_5 : 5386|1@1+ (1,0) [0|1] "bool" MCU
 SG_ OBJ_Relative_Long_Acc_STD_5 : 5387|10@1+ (0.01,0) [0|7.3] "m_per_s2" MCU
 SG_ OBJ_Rel_Long_Acc_STD_V_5 : 5397|1@1+ (1,0) [0|1] "bool" MCU
 SG_ Reserved_13_5 : 5398|10@1+ (1,0) [0|0] "NA" MCU
 SG_ OBJ_Relative_Long_Velocity_5 : 5408|13@1+ (0.05,-120) [-120|130] "m_per_s" MCU
 SG_ OBJ_Relative_Long_Velocity_V_5 : 5421|1@1+ (1,0) [0|1] "bool" MCU
 SG_ OBJ_Relative_Long_Vel_STD_5 : 5422|14@1+ (0.01,0) [0|130] "m_per_s" MCU
 SG_ OBJ_Rel_Long_Vel_STD_V_5 : 5436|1@1+ (1,0) [0|1] "bool" MCU
 SG_ Reserved_14_5 : 5437|3@1+ (1,0) [0|0] "NA" MCU
 SG_ OBJ_Relative_Lat_Velocity_5 : 5440|11@1+ (0.05,-50) [-50|50] "m_per_s" MCU
 SG_ OBJ_Relative_Lat_Velocity_V_5 : 5451|1@1+ (1,0) [0|1] "bool" MCU
 SG_ OBJ_Relative_Lat_Velocity_STD_5 : 5452|13@1+ (0.01,0) [0|50] "m_per_s" MCU
 SG_ OBJ_Rel_Lat_Vel_STD_V_5 : 5465|1@1+ (1,0) [0|1] "bool" MCU
 SG_ Reserved_15_5 : 5466|6@1+ (1,0) [0|0] "NA" MCU
 SG_ OBJ_Long_Distance_5 : 5472|14@1+ (0.05,-200) [-200|500] "m" MCU
 SG_ OBJ_Long_Distance_V_5 : 5486|1@1+ (1,0) [0|1] "bool" MCU
 SG_ OBJ_Long_Distance_STD_5 : 5487|15@1+ (0.01,0) [0|250] "m" MCU
 SG_ OBJ_Long_Distance_STD_V_5 : 5502|1@1+ (1,0) [0|1] "bool" MCU
 SG_ Reserved_16_5 : 5503|1@1+ (1,0) [0|0] "NA" MCU
 SG_ OBJ_Lat_Distance_5 : 5504|12@1+ (0.05,-100) [-100|100] "m" MCU
 SG_ OBJ_Lat_Distance_V_5 : 5516|1@1+ (1,0) [0|1] "bool" MCU
 SG_ OBJ_Lat_Distance_STD_5 : 5517|14@1+ (0.01,0) [0|100] "m" MCU
 SG_ OBJ_Lat_Distance_STD_V_5 : 5531|1@1+ (1,0) [0|1] "bool" MCU
 SG_ Reserved_17_5 : 5532|4@1+ (1,0) [0|0] "NA" MCU
 SG_ OBJ_Absolute_Speed_5 : 5536|12@1+ (0.05,-65) [-65|65] "m_per_s" MCU
 SG_ OBJ_Absolute_Speed_V_5 : 5548|1@1+ (1,0) [0|1] "bool" MCU
 SG_ OBJ_Absolute_Speed_STD_5 : 5549|13@1+ (0.01,0) [0|65] "m_per_s" MCU
 SG_ OBJ_Absolute_Speed_STD_V_5 : 5562|1@1+ (1,0) [0|1] "bool" MCU
 SG_ Reserved_18_5 : 5563|5@1+ (1,0) [0|0] "NA" MCU
 SG_ OBJ_Heading_5 : 5568|10@1+ (0.01,-3.14) [-3.14|3.14] "rad" MCU
 SG_ OBJ_Heading_V_5 : 5578|1@1+ (1,0) [0|1] "bool" MCU
 SG_ OBJ_Heading_STD_5 : 5579|15@1+ (0.0001,0) [0|3.14] "rad" MCU
 SG_ OBJ_Heading_STD_V_5 : 5594|1@1+ (1,0) [0|1] "bool" MCU
 SG_ Reserved_19_5 : 5595|5@1+ (1,0) [0|0] "NA" MCU
 SG_ OBJ_Angle_Rate_STD_5 : 5600|15@1+ (0.0001,0) [0|2.2318] "RPS" MCU
 SG_ OBJ_Angle_Rate_STD_V_5 : 5615|1@1+ (1,0) [0|1] "bool" MCU
 SG_ OBJ_Angle_Rate_5 : 5616|12@1+ (0.002,-2.234) [-2.234|2.2318] "RPS" MCU
 SG_ OBJ_Angle_Rate_V_5 : 5628|1@1+ (1,0) [0|1] "bool" MCU
 SG_ Reserved_20_5 : 5629|3@1+ (1,0) [0|0] "NA" MCU
 SG_ OBJ_Angle_Right_5 : 5632|14@1+ (0.0002,-1.571) [-1.571|1.571] "rad" MCU
 SG_ OBJ_Angle_Right_V_5 : 5646|1@1+ (1,0) [0|1] "bool" MCU

CM_ SG_ 154 OBJ_Zero_byte "in case set to FF message is not available.";
CM_ SG_ 154 OBJ_Header_CRC "Calculated over all header signals. From the signal after the CRC until the first signal in the elements OBJ_CRC_0  not including";
CM_ SG_ 154 OBJ_Protocol_Version "Denotes the protocol version";
CM_ SG_ 154 OBJ_Sync_ID "The ID of the Sync message, used to synchronize between signals in the system. Every new frame promotes the sync ID by one.";
CM_ SG_ 154 OBJ_VRU_Count "The number of recognized Vulnerable Road Users (pedestrians, bicycles) in the scene.";
CM_ SG_ 154 OBJ_VD_Count "The number of recognized vehicles in the scene.";
CM_ SG_ 154 OBJ_General_OBJ_Count "The number of recognized General Objects in the scene.";
CM_ SG_ 154 OBJ_Animal_Count "The number of recognized animals in the scene.";
CM_ SG_ 154 OBJ_VD_NIV_Left "The ID of the closet VD object to the left of the host.";
CM_ SG_ 154 OBJ_VD_NIV_Right "The ID of the closet VD object to the right of the host.";
CM_ SG_ 154 OBJ_VD_CIPV_ID "The Current In Path Vehicle (CIPV) object ID.";
CM_ SG_ 154 OBJ_VD_CIPV_Lost "Reports a CIPV loss that cannot be explained to initiate a take over request.   ";
CM_ SG_ 154 OBJ_VD_Allow_Acc "This signal is intended to suppress acceleration in stop and go ACC scenarios when we suspect something is in our way.  ";
CM_ SG_ 154 OBJ_Is_Blocked_Left "Indicates whether the left side is blocked for lane change.";
CM_ SG_ 154 OBJ_Is_Blocked_Right "Indicates whether the right side is blocked for lane change.";
CM_ SG_ 154 OBJ_CIPBIC_ID "The Current In Path Bicycle object ID.";
CM_ SG_ 154 OBJ_CIPBIC_Lost "Reports a Bicycle loss that cannot be explained to initiate a take over request.   ";
CM_ SG_ 154 OBJ_CRC_0 "Calculated over all element signals. From the signal after the CRC until the first signal in the next elements OBJ_CRC_N+1  not including";
CM_ SG_ 154 OBJ_ID_0 "The detected object ID. Range is 1-255, while 0 indicates that the field in unfilled.";
CM_ SG_ 154 OBJ_Existence_Probability_0 "The existence probability of the reported object";
CM_ SG_ 154 OBJ_Fusion_Source_0 "sources ids used for fusion";
CM_ SG_ 154 OBJ_Triggered_SDM_0 "Indicates whether the object has trigered the SDM (Safety Diagnostic Manager) alert.";
CM_ SG_ 154 OBJ_Motion_Category_0 "Relevant for VD only. Full description of values can be found at the ACC guide.";
CM_ SG_ 154 OBJ_Moving_IN_Probability_0 "The probability the object is eventually move into ego lane. (In case that the OBJ_Motion_Category signal is set to  MOVING_IN ";
CM_ SG_ 154 OBJ_Object_Age_0 "The number of frames in which the object was recognized.";
CM_ SG_ 154 OBJ_Measuring_Status_0 "Measurment status. Old vs New marks if this is the first frame in which the object is reported. Predicted vs Measured marks if the report is raw or has been predicted forward in time using the measured dynamics and ego motion.";
CM_ SG_ 154 OBJ_Object_Class_0 "Indicates the object type. Uncertain is outputted in case the probability that a vehicle is a truck is very similar to the probability that it is a car.";
CM_ SG_ 154 OBJ_Class_Probability_0 "The probability of this type classification.";
CM_ SG_ 154 OBJ_Car_Probability_0 "The probability the object is a car";
CM_ SG_ 154 OBJ_Truck_Probability_0 "The probability the object is a Truck";
CM_ SG_ 154 OBJ_Bike_Probability_0 "The probability the object is a Bike";
CM_ SG_ 154 OBJ_Camera_Source_0 "The camera in which this object was detected (best choice).";
CM_ SG_ 154 OBJ_Motion_Status_0 "MOVING - the object is moving STATIONARY - the object was never seen moving STOPPED -  the object was moving and has stopped MOVING_SLOWLY - the object is moving very slowly";
CM_ SG_ 154 OBJ_Motion_Orientation_0 "The direction of the targets heading compared to the host. ";
CM_ SG_ 154 OBJ_Has_Cut_Lane_0 "Indicates whether the object cut the host's (right or left) lane. In case there are no lanes, indicates whether the objects is at most 1 meters away from the host.";
CM_ SG_ 154 OBJ_Has_Cut_Path_0 "Indicates whether the object is in the host's path.";
CM_ SG_ 154 OBJ_Brake_Light_Validity_0 "Validator for braking light indicator";
CM_ SG_ 154 OBJ_Brake_Light_0 "Indication for brake lights ";
CM_ SG_ 154 OBJ_Turn_Indicator_Right_0 "Indication for blinking right light.";
CM_ SG_ 154 OBJ_Turn_Indicator_Left_0 "Indication for blinking left light ";
CM_ SG_ 154 OBJ_Turn_Indicator_Validity_0 "Validator for light indicators";
CM_ SG_ 154 OBJ_Right_Out_Of_Image_0 "Indicates whether the measurment are predicted out of the right side of the image bounderies.";
CM_ SG_ 154 OBJ_Left_Out_Of_Image_0 "Indicates whether if measurment are predicted out of  the left side of the image bounderies";
CM_ SG_ 154 OBJ_Right_Out_Of_Image_V_0 "validator";
CM_ SG_ 154 OBJ_Left_Out_Of_Image_V_0 "validator";
CM_ SG_ 154 OBJ_Top_Out_Of_Image_0 "Indicates whether if measurment are predicted out of  the top of the image bounderies";
CM_ SG_ 154 OBJ_Bottom_Out_Of_Image_0 "Indicates whether if measurment are predicted out of  the bottom of the image bounderies";
CM_ SG_ 154 OBJ_Top_Out_Of_Image_V_0 "validator";
CM_ SG_ 154 OBJ_Bottom_Out_Of_Image_V_0 "validator";
CM_ SG_ 154 OBJ_Lane_Assignment_0 "The object's lane relative to the host lane.";
CM_ SG_ 154 OBJ_Lane_Assignment_V_0 "Validator for lane assignment";
CM_ SG_ 154 OBJ_Age_Seconds_0 "Time in seconds in which the object was recognized. ";
CM_ SG_ 154 OBJ_Age_Seconds_V_0 "Validator for object age";
CM_ SG_ 154 OBJ_Width_0 "The width of the target vehicle in the world (not to be mistaken with the width of the visible part of the vehicle).";
CM_ SG_ 154 OBJ_Width_V_0 "Validator for object width";
CM_ SG_ 154 OBJ_Width_STD_0 "Standard deviation for object width";
CM_ SG_ 154 OBJ_Width_STD_V_0 "Validator for the standard deviation of object width";
CM_ SG_ 154 OBJ_Length_0 "The length of the vehicle in the world. For crossing bicycles it gives the viewed length of the bicycle.";
CM_ SG_ 154 OBJ_Length_V_0 "Validator for object length.";
CM_ SG_ 154 OBJ_Length_STD_0 "Standard deviation for object length.";
CM_ SG_ 154 OBJ_Length_STD_V_0 "Validator for the standard deviation of object length.";
CM_ SG_ 154 OBJ_Radar_ID_0 "Radar Object ID of the Fused Object, Only relvant when OBJ_Fusion_Source is not Camera only";
CM_ SG_ 154 OBJ_Height_0 "The height of the object in the world. ";
CM_ SG_ 154 OBJ_Height_V_0 "Validator for object height.";
CM_ SG_ 154 OBJ_Height_STD_0 "Standard deviation for object height.";
CM_ SG_ 154 OBJ_Height_STD_V_0 "Validator for the standard deviation of object height.";
CM_ SG_ 154 OBJ_Abs_Long_Velocity_0 "Absolute longitudinal velocity.";
CM_ SG_ 154 OBJ_Abs_Long_Velocity_V_0 "Validator for absolute longitudinal velocity.";
CM_ SG_ 154 OBJ_Abs_Long_Velocity_STD_0 "Standard deviation of absolute longitudinal velocity.";
CM_ SG_ 154 OBJ_Abs_Long_Vel_STD_V_0 "Validator for the standard deviation of the absolute longitudinal velocity.";
CM_ SG_ 154 OBJ_Abs_Lat_Velocity_0 "The lateral ground speed of the object.";
CM_ SG_ 154 OBJ_Abs_Lat_Velocity_V_0 "Validator for the lateral ground speed of the object.";
CM_ SG_ 154 OBJ_Abs_Lat_Velocity_STD_0 "STD of the lateral ground speed of the object.";
CM_ SG_ 154 OBJ_Abs_Lat_Vel_STD_V_0 "Validator for the STD of the lateral ground speed of the object.";
CM_ SG_ 154 OBJ_Abs_Long_Acc_0 "The longitudinal ground acceleration of the object.";
CM_ SG_ 154 OBJ_Abs_Long_Acc_V_0 "Validator for the longitudinal ground acceleration of the object.";
CM_ SG_ 154 OBJ_Abs_Long_Acc_STD_0 "STD of the longitudinal ground acceleration of the object.";
CM_ SG_ 154 OBJ_Abs_Long_Acc_STD_V_0 "Validator for the STD of the longitudinal ground acceleration of the object.";
CM_ SG_ 154 OBJ_Abs_Lat_Acc_0 "The lateral ground acceleration of the object.";
CM_ SG_ 154 OBJ_Abs_Lat_Acc_V_0 "Validator for the lateral ground acceleration of the object.";
CM_ SG_ 154 OBJ_Abs_Lat_Acc_STD_0 "STD of the lateral ground acceleration of the object.";
CM_ SG_ 154 OBJ_Abs_Lat_Acc_STD_V_0 "Validator for the STD of the lateral ground acceleration of the object.";
CM_ SG_ 154 OBJ_Abs_Acceleration_0 "The absolute ground acceleration in the target's heading direction.";
CM_ SG_ 154 OBJ_Abs_Acceleration_V_0 "Validator for the absolute ground acceleration.";
CM_ SG_ 154 OBJ_Abs_Acc_STD_0 "STD of the absolute ground acceleration.";
CM_ SG_ 154 OBJ_Abs_Acc_STD_V_0 "Validator for the STD of the absolute ground acceleration.";
CM_ SG_ 154 OBJ_Inv_TTC_0 "Inverse TTC (time to collision).";
CM_ SG_ 154 OBJ_Inv_TTC_STD_0 "STD for inverse TTC .";
CM_ SG_ 154 OBJ_Inv_TTC_STD_V_0 "Validator for the STD for inverse TTC .";
CM_ SG_ 154 OBJ_Relative_Long_Acc_0 "The relative longitudinal ground acceleration of the object.";
CM_ SG_ 154 OBJ_Relative_Long_Acc_V_0 "Validator for the relative longitudinal ground acceleration of the object.";
CM_ SG_ 154 OBJ_Relative_Long_Acc_STD_0 "STD of the relative longitudinal ground acceleration of the object.";
CM_ SG_ 154 OBJ_Rel_Long_Acc_STD_V_0 "Validator for the STD of the relative longitudinal ground acceleration.";
CM_ SG_ 154 OBJ_Relative_Long_Velocity_0 "The relative longtitudinal speed between the target and ego vehicle. ";
CM_ SG_ 154 OBJ_Relative_Long_Velocity_V_0 "Validator for the relative longtitudinal speed.";
CM_ SG_ 154 OBJ_Relative_Long_Vel_STD_0 "STD of the relative longtitudinal speed.";
CM_ SG_ 154 OBJ_Rel_Long_Vel_STD_V_0 "Validator for the STD of the relative longtitudinal speed.";
CM_ SG_ 154 OBJ_Relative_Lat_Velocity_0 "The relative lateral speed between the target and ego vehicle. ";
CM_ SG_ 154 OBJ_Relative_Lat_Velocity_V_0 "Validator for the relative lateral speed. ";
CM_ SG_ 154 OBJ_Relative_Lat_Velocity_STD_0 "STD of the relative lateral speed. ";
CM_ SG_ 154 OBJ_Rel_Lat_Vel_STD_V_0 "Validator for the STD of the relative lateral speed. ";
CM_ SG_ 154 OBJ_Long_Distance_0 "The longitudinal distance to middle of the rear bumper (middle of the RL and RR corners) of the target.";
CM_ SG_ 154 OBJ_Long_Distance_V_0 "Validator of the longtitudinal distance field";
CM_ SG_ 154 OBJ_Long_Distance_STD_0 "STD of the  longtitudinal distance.";
CM_ SG_ 154 OBJ_Long_Distance_STD_V_0 "Validator for the STD of the  longtitudinal distance.";
CM_ SG_ 154 OBJ_Lat_Distance_0 "Lateral distance to the middle of the RL and RR corners.  ";
CM_ SG_ 154 OBJ_Lat_Distance_V_0 "Validator for the lateral distance of the object.";
CM_ SG_ 154 OBJ_Lat_Distance_STD_0 "STD of the lateral distance of the object.";
CM_ SG_ 154 OBJ_Lat_Distance_STD_V_0 "Validator for the STD of the lateral distance of the object.";
CM_ SG_ 154 OBJ_Absolute_Speed_0 "The absolute ground speed in the targets' heading direction.";
CM_ SG_ 154 OBJ_Absolute_Speed_V_0 "Validator for the absolute ground speed.";
CM_ SG_ 154 OBJ_Absolute_Speed_STD_0 "STD of the absolute ground speed.";
CM_ SG_ 154 OBJ_Absolute_Speed_STD_V_0 "Validator for the STD of the absolute ground speed.";
CM_ SG_ 154 OBJ_Heading_0 "The angle beetweenthe host longitudinal axis and target's heading (clockwise, e.g. PI/2 is a target crossing from left to right).";
CM_ SG_ 154 OBJ_Heading_V_0 "Validator for the object heading.";
CM_ SG_ 154 OBJ_Heading_STD_0 "STD of the object heading.";
CM_ SG_ 154 OBJ_Heading_STD_V_0 "Validator for the STD of the object heading.";
CM_ SG_ 154 OBJ_Angle_Rate_STD_0 "Standard deviation of the angular speed. (radians)";
CM_ SG_ 154 OBJ_Angle_Rate_STD_V_0 "Validator for the STD of the angular speed.";
CM_ SG_ 154 OBJ_Angle_Rate_0 "The momentary angular speed of the object (radians). The positive side is to the host's right.";
CM_ SG_ 154 OBJ_Angle_Rate_V_0 "Validator for the angular speed.";
CM_ SG_ 154 OBJ_Angle_Right_0 "The angle between the host longitudinal axis and the right side of the front / rear of the target (the visible one). The positive side is to the host's right.";
CM_ SG_ 154 OBJ_Angle_Right_V_0 "Validator for angleRight";
CM_ SG_ 154 OBJ_Angle_Right_STD_0 "Standard deviation of angleRight";
CM_ SG_ 154 OBJ_Angle_Right_STD_V_0 "Validator for the standard deviation of angleRight.";
CM_ SG_ 154 OBJ_Angle_Left_0 "The angle between the host longitudinal axis and the left side of the front / rear of the target (the visible one). The positive side is to the host's right.";
CM_ SG_ 154 OBJ_Angle_Left_V_0 "Validator for angleLeft.";
CM_ SG_ 154 OBJ_Angle_Left_STD_0 "Standard deviation of angleLeft.";
CM_ SG_ 154 OBJ_Angle_Left_STD_V_0 "Validator for the standard deviation of angleLeft.";
CM_ SG_ 154 OBJ_Angle_Side_0 "The angle between the host longitudinal axis and the far visible edge - the visible edge of the front / rear of the target that is not visible. Currently supported for vehicles only.";
CM_ SG_ 154 OBJ_Angle_Side_V_0 "Validator for angleSide.";
CM_ SG_ 154 OBJ_Angle_Side_STD_0 "Standard deviation of angleSide.";
CM_ SG_ 154 OBJ_Angle_Side_STD_V_0 "Validator for the STD of angleSide.";
CM_ SG_ 154 OBJ_Angle_Mid_V_0 "Validator for angleMid.";
CM_ SG_ 154 OBJ_Angle_Mid_0 "The angle between the host longitudinal axis and the middle of the front / rear of the target (the visible one). The positive side is to the host's right.";
CM_ SG_ 154 OBJ_Angle_Mid_STD_0 "Standard deviation of angleMid.";
CM_ SG_ 154 OBJ_Angle_Mid_STD_V_0 "Validator for the STD of angleMid.";
CM_ SG_ 154 OBJ_Angle_Bottom_V_0 "Validator for OBJAngle_Bottom. ";
CM_ SG_ 154 OBJ_Angle_Bottom_0 "The angle between the longitudinal axis and the Bottom of the front / rear of the target (the visible one). The positive side is to the host's bottom";
CM_ SG_ 154 OBJ_Angle_Bottom_STD_0 "STD for OBJAngle_Bottom. ";
CM_ SG_ 154 OBJ_Angle_Bottom_STD_V_0 "Validator for OBJAngle_Bottom_STD. ";
CM_ SG_ 154 OBJ_Visibility_Side_V_0 "Currently Supported for VD only";
CM_ SG_ 154 OBJ_Visibility_Side_0 "From what car  side is the object visible";
CM_ SG_ 154 OBJ_Is_In_Drivable_Area_0 "Indicates whether the target is in a driveable area.";
CM_ SG_ 154 OBJ_Is_In_Drivable_Area_V_0 "Validator for OBJ_Is_In_Drivable_Area.";
CM_ SG_ 154 OBJ_Is_VeryClose_V_0 "Validator for OBJ_Is_VeryClose. ";
CM_ SG_ 154 OBJ_Is_VeryClose_0 "Indicates whether the target is very close to the host such that it is hard to measure its distance. Currently relevant for peds only";
CM_ SG_ 154 OBJ_OverlapAngleEgoLaneR_0 "Lateral distance to the middle of the RL and RR corners.";
CM_ SG_ 154 OBJ_OverlapAngleEgoLaneR_V_0 "Validator for OBJ_OverlapAngleEgoLaneR";
CM_ SG_ 154 OBJ_OverlapAngleEgoLaneL_0 "Lateral distance to the middle of the RL and RR corners.  ";
CM_ SG_ 154 OBJ_OverlapAngleEgoLaneL_V_0 "Validator for OBJ_OverlapAngleEgoLaneL";
CM_ SG_ 154 OBJ_Is_EMERGENCY_VCL_0 "Is Object an Emergency Vehicle";
CM_ SG_ 154 OBJ_EMERGENCY_LIGHT_COLOR_0 "Emergency Color";
CM_ SG_ 154 OBJ_EMERGENCY_V_0 "Are OBJ_Is_EMERGENCY_VCL and OBJ_EMERGENCY_LIGHT_COLOR Valid";
CM_ SG_ 154 OBJ_Angle_Top_0 "From VD touching point on the ground till the roof of the car";
CM_ SG_ 154 OBJ_Angle_Top_V_0 "Validator for OBJ_Angle_Top ";
CM_ SG_ 154 OBJ_Angle_Top_STD_0 "STD for OBJ_Angle_Top";
CM_ SG_ 154 OBJ_Angle_Top_STD_V_0 "Validator for OBJ_Angle_Top_STD. ";
CM_ SG_ 154 OBJ_Open_Door_Left_0 "Indicator if left door is open";
CM_ SG_ 154 OBJ_Open_Door_Right_0 "Indicator if right door is open";
CM_ SG_ 154 OBJ_Visible_Left_or_Right_0 "This signal describes the visible Left or Right side of the Target vehicle.";
CM_ SG_ 154 OBJ_Visible_Left_or_Right_V_0 "OBJ_Visible_Left_or_Right";
CM_ SG_ 154 OBJ_2W_Is_Motorbike_Probability_0 "The probability of the Two-wheeler reported object being a Motorbike";
CM_ SG_ 154 OBJ_2W_Is_Bicycle_Probability_0 "The probability of the Two-wheeler reported object being a Bicycle";
CM_ SG_ 154 OBJ_CRC_1 "Calculated over all element signals. From the signal after the CRC until the first signal in the next elements OBJ_CRC_N+1  not including";
CM_ SG_ 154 OBJ_ID_1 "The detected object ID. Range is 1-255, while 0 indicates that the field in unfilled.";
CM_ SG_ 154 OBJ_Existence_Probability_1 "The existence probability of the reported object";
CM_ SG_ 154 OBJ_Fusion_Source_1 "sources ids used for fusion";
CM_ SG_ 154 OBJ_Triggered_SDM_1 "Indicates whether the object has trigered the SDM (Safety Diagnostic Manager) alert.";
CM_ SG_ 154 OBJ_Motion_Category_1 "Relevant for VD only. Full description of values can be found at the ACC guide.";
CM_ SG_ 154 OBJ_Moving_IN_Probability_1 "The probability the object is eventually move into ego lane. (In case that the OBJ_Motion_Category signal is set to  MOVING_IN ";
CM_ SG_ 154 OBJ_Object_Age_1 "The number of frames in which the object was recognized.";
CM_ SG_ 154 OBJ_Measuring_Status_1 "Measurment status. Old vs New marks if this is the first frame in which the object is reported. Predicted vs Measured marks if the report is raw or has been predicted forward in time using the measured dynamics and ego motion.";
CM_ SG_ 154 OBJ_Object_Class_1 "Indicates the object type. Uncertain is outputted in case the probability that a vehicle is a truck is very similar to the probability that it is a car.";
CM_ SG_ 154 OBJ_Class_Probability_1 "The probability of this type classification.";
CM_ SG_ 154 OBJ_Car_Probability_1 "The probability the object is a car";
CM_ SG_ 154 OBJ_Truck_Probability_1 "The probability the object is a Truck";
CM_ SG_ 154 OBJ_Bike_Probability_1 "The probability the object is a Bike";
CM_ SG_ 154 OBJ_Camera_Source_1 "The camera in which this object was detected (best choice).";
CM_ SG_ 154 OBJ_Motion_Status_1 "MOVING - the object is moving STATIONARY - the object was never seen moving STOPPED -  the object was moving and has stopped MOVING_SLOWLY - the object is moving very slowly";
CM_ SG_ 154 OBJ_Motion_Orientation_1 "The direction of the targets heading compared to the host. ";
CM_ SG_ 154 OBJ_Has_Cut_Lane_1 "Indicates whether the object cut the host's (right or left) lane. In case there are no lanes, indicates whether the objects is at most 1 meters away from the host.";
CM_ SG_ 154 OBJ_Has_Cut_Path_1 "Indicates whether the object is in the host's path.";
CM_ SG_ 154 OBJ_Brake_Light_Validity_1 "Validator for braking light indicator";
CM_ SG_ 154 OBJ_Brake_Light_1 "Indication for brake lights ";
CM_ SG_ 154 OBJ_Turn_Indicator_Right_1 "Indication for blinking right light.";
CM_ SG_ 154 OBJ_Turn_Indicator_Left_1 "Indication for blinking left light ";
CM_ SG_ 154 OBJ_Turn_Indicator_Validity_1 "Validator for light indicators";
CM_ SG_ 154 OBJ_Right_Out_Of_Image_1 "Indicates whether the measurment are predicted out of the right side of the image bounderies.";
CM_ SG_ 154 OBJ_Left_Out_Of_Image_1 "Indicates whether if measurment are predicted out of  the left side of the image bounderies";
CM_ SG_ 154 OBJ_Right_Out_Of_Image_V_1 "validator";
CM_ SG_ 154 OBJ_Left_Out_Of_Image_V_1 "validator";
CM_ SG_ 154 OBJ_Top_Out_Of_Image_1 "Indicates whether if measurment are predicted out of  the top of the image bounderies";
CM_ SG_ 154 OBJ_Bottom_Out_Of_Image_1 "Indicates whether if measurment are predicted out of  the bottom of the image bounderies";
CM_ SG_ 154 OBJ_Top_Out_Of_Image_V_1 "validator";
CM_ SG_ 154 OBJ_Bottom_Out_Of_Image_V_1 "validator";
CM_ SG_ 154 OBJ_Lane_Assignment_1 "The object's lane relative to the host lane.";
CM_ SG_ 154 OBJ_Lane_Assignment_V_1 "Validator for lane assignment";
CM_ SG_ 154 OBJ_Age_Seconds_1 "Time in seconds in which the object was recognized. ";
CM_ SG_ 154 OBJ_Age_Seconds_V_1 "Validator for object age";
CM_ SG_ 154 OBJ_Width_1 "The width of the target vehicle in the world (not to be mistaken with the width of the visible part of the vehicle).";
CM_ SG_ 154 OBJ_Width_V_1 "Validator for object width";
CM_ SG_ 154 OBJ_Width_STD_1 "Standard deviation for object width";
CM_ SG_ 154 OBJ_Width_STD_V_1 "Validator for the standard deviation of object width";
CM_ SG_ 154 OBJ_Length_1 "The length of the vehicle in the world. For crossing bicycles it gives the viewed length of the bicycle.";
CM_ SG_ 154 OBJ_Length_V_1 "Validator for object length.";
CM_ SG_ 154 OBJ_Length_STD_1 "Standard deviation for object length.";
CM_ SG_ 154 OBJ_Length_STD_V_1 "Validator for the standard deviation of object length.";
CM_ SG_ 154 OBJ_Radar_ID_1 "Radar Object ID of the Fused Object, Only relvant when OBJ_Fusion_Source is not Camera only";
CM_ SG_ 154 OBJ_Height_1 "The height of the object in the world. ";
CM_ SG_ 154 OBJ_Height_V_1 "Validator for object height.";
CM_ SG_ 154 OBJ_Height_STD_1 "Standard deviation for object height.";
CM_ SG_ 154 OBJ_Height_STD_V_1 "Validator for the standard deviation of object height.";
CM_ SG_ 154 OBJ_Abs_Long_Velocity_1 "Absolute longitudinal velocity.";
CM_ SG_ 154 OBJ_Abs_Long_Velocity_V_1 "Validator for absolute longitudinal velocity.";
CM_ SG_ 154 OBJ_Abs_Long_Velocity_STD_1 "Standard deviation of absolute longitudinal velocity.";
CM_ SG_ 154 OBJ_Abs_Long_Vel_STD_V_1 "Validator for the standard deviation of the absolute longitudinal velocity.";
CM_ SG_ 154 OBJ_Abs_Lat_Velocity_1 "The lateral ground speed of the object.";
CM_ SG_ 154 OBJ_Abs_Lat_Velocity_V_1 "Validator for the lateral ground speed of the object.";
CM_ SG_ 154 OBJ_Abs_Lat_Velocity_STD_1 "STD of the lateral ground speed of the object.";
CM_ SG_ 154 OBJ_Abs_Lat_Vel_STD_V_1 "Validator for the STD of the lateral ground speed of the object.";
CM_ SG_ 154 OBJ_Abs_Long_Acc_1 "The longitudinal ground acceleration of the object.";
CM_ SG_ 154 OBJ_Abs_Long_Acc_V_1 "Validator for the longitudinal ground acceleration of the object.";
CM_ SG_ 154 OBJ_Abs_Long_Acc_STD_1 "STD of the longitudinal ground acceleration of the object.";
CM_ SG_ 154 OBJ_Abs_Long_Acc_STD_V_1 "Validator for the STD of the longitudinal ground acceleration of the object.";
CM_ SG_ 154 OBJ_Abs_Lat_Acc_1 "The lateral ground acceleration of the object.";
CM_ SG_ 154 OBJ_Abs_Lat_Acc_V_1 "Validator for the lateral ground acceleration of the object.";
CM_ SG_ 154 OBJ_Abs_Lat_Acc_STD_1 "STD of the lateral ground acceleration of the object.";
CM_ SG_ 154 OBJ_Abs_Lat_Acc_STD_V_1 "Validator for the STD of the lateral ground acceleration of the object.";
CM_ SG_ 154 OBJ_Abs_Acceleration_1 "The absolute ground acceleration in the target's heading direction.";
CM_ SG_ 154 OBJ_Abs_Acceleration_V_1 "Validator for the absolute ground acceleration.";
CM_ SG_ 154 OBJ_Abs_Acc_STD_1 "STD of the absolute ground acceleration.";
CM_ SG_ 154 OBJ_Abs_Acc_STD_V_1 "Validator for the STD of the absolute ground acceleration.";
CM_ SG_ 154 OBJ_Inv_TTC_1 "Inverse TTC (time to collision).";
CM_ SG_ 154 OBJ_Inv_TTC_STD_1 "STD for inverse TTC .";
CM_ SG_ 154 OBJ_Inv_TTC_STD_V_1 "Validator for the STD for inverse TTC .";
CM_ SG_ 154 OBJ_Relative_Long_Acc_1 "The relative longitudinal ground acceleration of the object.";
CM_ SG_ 154 OBJ_Relative_Long_Acc_V_1 "Validator for the relative longitudinal ground acceleration of the object.";
CM_ SG_ 154 OBJ_Relative_Long_Acc_STD_1 "STD of the relative longitudinal ground acceleration of the object.";
CM_ SG_ 154 OBJ_Rel_Long_Acc_STD_V_1 "Validator for the STD of the relative longitudinal ground acceleration.";
CM_ SG_ 154 OBJ_Relative_Long_Velocity_1 "The relative longtitudinal speed between the target and ego vehicle. ";
CM_ SG_ 154 OBJ_Relative_Long_Velocity_V_1 "Validator for the relative longtitudinal speed.";
CM_ SG_ 154 OBJ_Relative_Long_Vel_STD_1 "STD of the relative longtitudinal speed.";
CM_ SG_ 154 OBJ_Rel_Long_Vel_STD_V_1 "Validator for the STD of the relative longtitudinal speed.";
CM_ SG_ 154 OBJ_Relative_Lat_Velocity_1 "The relative lateral speed between the target and ego vehicle. ";
CM_ SG_ 154 OBJ_Relative_Lat_Velocity_V_1 "Validator for the relative lateral speed. ";
CM_ SG_ 154 OBJ_Relative_Lat_Velocity_STD_1 "STD of the relative lateral speed. ";
CM_ SG_ 154 OBJ_Rel_Lat_Vel_STD_V_1 "Validator for the STD of the relative lateral speed. ";
CM_ SG_ 154 OBJ_Long_Distance_1 "The longitudinal distance to middle of the rear bumper (middle of the RL and RR corners) of the target.";
CM_ SG_ 154 OBJ_Long_Distance_V_1 "Validator of the longtitudinal distance field";
CM_ SG_ 154 OBJ_Long_Distance_STD_1 "STD of the  longtitudinal distance.";
CM_ SG_ 154 OBJ_Long_Distance_STD_V_1 "Validator for the STD of the  longtitudinal distance.";
CM_ SG_ 154 OBJ_Lat_Distance_1 "Lateral distance to the middle of the RL and RR corners.  ";
CM_ SG_ 154 OBJ_Lat_Distance_V_1 "Validator for the lateral distance of the object.";
CM_ SG_ 154 OBJ_Lat_Distance_STD_1 "STD of the lateral distance of the object.";
CM_ SG_ 154 OBJ_Lat_Distance_STD_V_1 "Validator for the STD of the lateral distance of the object.";
CM_ SG_ 154 OBJ_Absolute_Speed_1 "The absolute ground speed in the targets' heading direction.";
CM_ SG_ 154 OBJ_Absolute_Speed_V_1 "Validator for the absolute ground speed.";
CM_ SG_ 154 OBJ_Absolute_Speed_STD_1 "STD of the absolute ground speed.";
CM_ SG_ 154 OBJ_Absolute_Speed_STD_V_1 "Validator for the STD of the absolute ground speed.";
CM_ SG_ 154 OBJ_Heading_1 "The angle beetweenthe host longitudinal axis and target's heading (clockwise, e.g. PI/2 is a target crossing from left to right).";
CM_ SG_ 154 OBJ_Heading_V_1 "Validator for the object heading.";
CM_ SG_ 154 OBJ_Heading_STD_1 "STD of the object heading.";
CM_ SG_ 154 OBJ_Heading_STD_V_1 "Validator for the STD of the object heading.";
CM_ SG_ 154 OBJ_Angle_Rate_STD_1 "Standard deviation of the angular speed. (radians)";
CM_ SG_ 154 OBJ_Angle_Rate_STD_V_1 "Validator for the STD of the angular speed.";
CM_ SG_ 154 OBJ_Angle_Rate_1 "The momentary angular speed of the object (radians). The positive side is to the host's right.";
CM_ SG_ 154 OBJ_Angle_Rate_V_1 "Validator for the angular speed.";
CM_ SG_ 154 OBJ_Angle_Right_1 "The angle between the host longitudinal axis and the right side of the front / rear of the target (the visible one). The positive side is to the host's right.";
CM_ SG_ 154 OBJ_Angle_Right_V_1 "Validator for angleRight";
CM_ SG_ 154 OBJ_Angle_Right_STD_1 "Standard deviation of angleRight";
CM_ SG_ 154 OBJ_Angle_Right_STD_V_1 "Validator for the standard deviation of angleRight.";
CM_ SG_ 154 OBJ_Angle_Left_1 "The angle between the host longitudinal axis and the left side of the front / rear of the target (the visible one). The positive side is to the host's right.";
CM_ SG_ 154 OBJ_Angle_Left_V_1 "Validator for angleLeft.";
CM_ SG_ 154 OBJ_Angle_Left_STD_1 "Standard deviation of angleLeft.";
CM_ SG_ 154 OBJ_Angle_Left_STD_V_1 "Validator for the standard deviation of angleLeft.";
CM_ SG_ 154 OBJ_Angle_Side_1 "The angle between the host longitudinal axis and the far visible edge - the visible edge of the front / rear of the target that is not visible. Currently supported for vehicles only.";
CM_ SG_ 154 OBJ_Angle_Side_V_1 "Validator for angleSide.";
CM_ SG_ 154 OBJ_Angle_Side_STD_1 "Standard deviation of angleSide.";
CM_ SG_ 154 OBJ_Angle_Side_STD_V_1 "Validator for the STD of angleSide.";
CM_ SG_ 154 OBJ_Angle_Mid_V_1 "Validator for angleMid.";
CM_ SG_ 154 OBJ_Angle_Mid_1 "The angle between the host longitudinal axis and the middle of the front / rear of the target (the visible one). The positive side is to the host's right.";
CM_ SG_ 154 OBJ_Angle_Mid_STD_1 "Standard deviation of angleMid.";
CM_ SG_ 154 OBJ_Angle_Mid_STD_V_1 "Validator for the STD of angleMid.";
CM_ SG_ 154 OBJ_Angle_Bottom_V_1 "Validator for OBJAngle_Bottom. ";
CM_ SG_ 154 OBJ_Angle_Bottom_1 "The angle between the longitudinal axis and the Bottom of the front / rear of the target (the visible one). The positive side is to the host's bottom";
CM_ SG_ 154 OBJ_Angle_Bottom_STD_1 "STD for OBJAngle_Bottom. ";
CM_ SG_ 154 OBJ_Angle_Bottom_STD_V_1 "Validator for OBJAngle_Bottom_STD. ";
CM_ SG_ 154 OBJ_Visibility_Side_V_1 "Currently Supported for VD only";
CM_ SG_ 154 OBJ_Visibility_Side_1 "From what car  side is the object visible";
CM_ SG_ 154 OBJ_Is_In_Drivable_Area_1 "Indicates whether the target is in a driveable area.";
CM_ SG_ 154 OBJ_Is_In_Drivable_Area_V_1 "Validator for OBJ_Is_In_Drivable_Area.";
CM_ SG_ 154 OBJ_Is_VeryClose_V_1 "Validator for OBJ_Is_VeryClose. ";
CM_ SG_ 154 OBJ_Is_VeryClose_1 "Indicates whether the target is very close to the host such that it is hard to measure its distance. Currently relevant for peds only";
CM_ SG_ 154 OBJ_OverlapAngleEgoLaneR_1 "Lateral distance to the middle of the RL and RR corners.";
CM_ SG_ 154 OBJ_OverlapAngleEgoLaneR_V_1 "Validator for OBJ_OverlapAngleEgoLaneR";
CM_ SG_ 154 OBJ_OverlapAngleEgoLaneL_1 "Lateral distance to the middle of the RL and RR corners.  ";
CM_ SG_ 154 OBJ_OverlapAngleEgoLaneL_V_1 "Validator for OBJ_OverlapAngleEgoLaneL";
CM_ SG_ 154 OBJ_Is_EMERGENCY_VCL_1 "Is Object an Emergency Vehicle";
CM_ SG_ 154 OBJ_EMERGENCY_LIGHT_COLOR_1 "Emergency Color";
CM_ SG_ 154 OBJ_EMERGENCY_V_1 "Are OBJ_Is_EMERGENCY_VCL and OBJ_EMERGENCY_LIGHT_COLOR Valid";
CM_ SG_ 154 OBJ_Angle_Top_1 "From VD touching point on the ground till the roof of the car";
CM_ SG_ 154 OBJ_Angle_Top_V_1 "Validator for OBJ_Angle_Top ";
CM_ SG_ 154 OBJ_Angle_Top_STD_1 "STD for OBJ_Angle_Top";
CM_ SG_ 154 OBJ_Angle_Top_STD_V_1 "Validator for OBJ_Angle_Top_STD. ";
CM_ SG_ 154 OBJ_Open_Door_Left_1 "Indicator if left door is open";
CM_ SG_ 154 OBJ_Open_Door_Right_1 "Indicator if right door is open";
CM_ SG_ 154 OBJ_Visible_Left_or_Right_1 "This signal describes the visible Left or Right side of the Target vehicle.";
CM_ SG_ 154 OBJ_Visible_Left_or_Right_V_1 "OBJ_Visible_Left_or_Right";
CM_ SG_ 154 OBJ_2W_Is_Motorbike_Probability_1 "The probability of the Two-wheeler reported object being a Motorbike";
CM_ SG_ 154 OBJ_2W_Is_Bicycle_Probability_1 "The probability of the Two-wheeler reported object being a Bicycle";
CM_ SG_ 154 OBJ_CRC_2 "Calculated over all element signals. From the signal after the CRC until the first signal in the next elements OBJ_CRC_N+1  not including";
CM_ SG_ 154 OBJ_ID_2 "The detected object ID. Range is 1-255, while 0 indicates that the field in unfilled.";
CM_ SG_ 154 OBJ_Existence_Probability_2 "The existence probability of the reported object";
CM_ SG_ 154 OBJ_Fusion_Source_2 "sources ids used for fusion";
CM_ SG_ 154 OBJ_Triggered_SDM_2 "Indicates whether the object has trigered the SDM (Safety Diagnostic Manager) alert.";
CM_ SG_ 154 OBJ_Motion_Category_2 "Relevant for VD only. Full description of values can be found at the ACC guide.";
CM_ SG_ 154 OBJ_Moving_IN_Probability_2 "The probability the object is eventually move into ego lane. (In case that the OBJ_Motion_Category signal is set to  MOVING_IN ";
CM_ SG_ 154 OBJ_Object_Age_2 "The number of frames in which the object was recognized.";
CM_ SG_ 154 OBJ_Measuring_Status_2 "Measurment status. Old vs New marks if this is the first frame in which the object is reported. Predicted vs Measured marks if the report is raw or has been predicted forward in time using the measured dynamics and ego motion.";
CM_ SG_ 154 OBJ_Object_Class_2 "Indicates the object type. Uncertain is outputted in case the probability that a vehicle is a truck is very similar to the probability that it is a car.";
CM_ SG_ 154 OBJ_Class_Probability_2 "The probability of this type classification.";
CM_ SG_ 154 OBJ_Car_Probability_2 "The probability the object is a car";
CM_ SG_ 154 OBJ_Truck_Probability_2 "The probability the object is a Truck";
CM_ SG_ 154 OBJ_Bike_Probability_2 "The probability the object is a Bike";
CM_ SG_ 154 OBJ_Camera_Source_2 "The camera in which this object was detected (best choice).";
CM_ SG_ 154 OBJ_Motion_Status_2 "MOVING - the object is moving STATIONARY - the object was never seen moving STOPPED -  the object was moving and has stopped MOVING_SLOWLY - the object is moving very slowly";
CM_ SG_ 154 OBJ_Motion_Orientation_2 "The direction of the targets heading compared to the host. ";
CM_ SG_ 154 OBJ_Has_Cut_Lane_2 "Indicates whether the object cut the host's (right or left) lane. In case there are no lanes, indicates whether the objects is at most 1 meters away from the host.";
CM_ SG_ 154 OBJ_Has_Cut_Path_2 "Indicates whether the object is in the host's path.";
CM_ SG_ 154 OBJ_Brake_Light_Validity_2 "Validator for braking light indicator";
CM_ SG_ 154 OBJ_Brake_Light_2 "Indication for brake lights ";
CM_ SG_ 154 OBJ_Turn_Indicator_Right_2 "Indication for blinking right light.";
CM_ SG_ 154 OBJ_Turn_Indicator_Left_2 "Indication for blinking left light ";
CM_ SG_ 154 OBJ_Turn_Indicator_Validity_2 "Validator for light indicators";
CM_ SG_ 154 OBJ_Right_Out_Of_Image_2 "Indicates whether the measurment are predicted out of the right side of the image bounderies.";
CM_ SG_ 154 OBJ_Left_Out_Of_Image_2 "Indicates whether if measurment are predicted out of  the left side of the image bounderies";
CM_ SG_ 154 OBJ_Right_Out_Of_Image_V_2 "validator";
CM_ SG_ 154 OBJ_Left_Out_Of_Image_V_2 "validator";
CM_ SG_ 154 OBJ_Top_Out_Of_Image_2 "Indicates whether if measurment are predicted out of  the top of the image bounderies";
CM_ SG_ 154 OBJ_Bottom_Out_Of_Image_2 "Indicates whether if measurment are predicted out of  the bottom of the image bounderies";
CM_ SG_ 154 OBJ_Top_Out_Of_Image_V_2 "validator";
CM_ SG_ 154 OBJ_Bottom_Out_Of_Image_V_2 "validator";
CM_ SG_ 154 OBJ_Lane_Assignment_2 "The object's lane relative to the host lane.";
CM_ SG_ 154 OBJ_Lane_Assignment_V_2 "Validator for lane assignment";
CM_ SG_ 154 OBJ_Age_Seconds_2 "Time in seconds in which the object was recognized. ";
CM_ SG_ 154 OBJ_Age_Seconds_V_2 "Validator for object age";
CM_ SG_ 154 OBJ_Width_2 "The width of the target vehicle in the world (not to be mistaken with the width of the visible part of the vehicle).";
CM_ SG_ 154 OBJ_Width_V_2 "Validator for object width";
CM_ SG_ 154 OBJ_Width_STD_2 "Standard deviation for object width";
CM_ SG_ 154 OBJ_Width_STD_V_2 "Validator for the standard deviation of object width";
CM_ SG_ 154 OBJ_Length_2 "The length of the vehicle in the world. For crossing bicycles it gives the viewed length of the bicycle.";
CM_ SG_ 154 OBJ_Length_V_2 "Validator for object length.";
CM_ SG_ 154 OBJ_Length_STD_2 "Standard deviation for object length.";
CM_ SG_ 154 OBJ_Length_STD_V_2 "Validator for the standard deviation of object length.";
CM_ SG_ 154 OBJ_Radar_ID_2 "Radar Object ID of the Fused Object, Only relvant when OBJ_Fusion_Source is not Camera only";
CM_ SG_ 154 OBJ_Height_2 "The height of the object in the world. ";
CM_ SG_ 154 OBJ_Height_V_2 "Validator for object height.";
CM_ SG_ 154 OBJ_Height_STD_2 "Standard deviation for object height.";
CM_ SG_ 154 OBJ_Height_STD_V_2 "Validator for the standard deviation of object height.";
CM_ SG_ 154 OBJ_Abs_Long_Velocity_2 "Absolute longitudinal velocity.";
CM_ SG_ 154 OBJ_Abs_Long_Velocity_V_2 "Validator for absolute longitudinal velocity.";
CM_ SG_ 154 OBJ_Abs_Long_Velocity_STD_2 "Standard deviation of absolute longitudinal velocity.";
CM_ SG_ 154 OBJ_Abs_Long_Vel_STD_V_2 "Validator for the standard deviation of the absolute longitudinal velocity.";
CM_ SG_ 154 OBJ_Abs_Lat_Velocity_2 "The lateral ground speed of the object.";
CM_ SG_ 154 OBJ_Abs_Lat_Velocity_V_2 "Validator for the lateral ground speed of the object.";
CM_ SG_ 154 OBJ_Abs_Lat_Velocity_STD_2 "STD of the lateral ground speed of the object.";
CM_ SG_ 154 OBJ_Abs_Lat_Vel_STD_V_2 "Validator for the STD of the lateral ground speed of the object.";
CM_ SG_ 154 OBJ_Abs_Long_Acc_2 "The longitudinal ground acceleration of the object.";
CM_ SG_ 154 OBJ_Abs_Long_Acc_V_2 "Validator for the longitudinal ground acceleration of the object.";
CM_ SG_ 154 OBJ_Abs_Long_Acc_STD_2 "STD of the longitudinal ground acceleration of the object.";
CM_ SG_ 154 OBJ_Abs_Long_Acc_STD_V_2 "Validator for the STD of the longitudinal ground acceleration of the object.";
CM_ SG_ 154 OBJ_Abs_Lat_Acc_2 "The lateral ground acceleration of the object.";
CM_ SG_ 154 OBJ_Abs_Lat_Acc_V_2 "Validator for the lateral ground acceleration of the object.";
CM_ SG_ 154 OBJ_Abs_Lat_Acc_STD_2 "STD of the lateral ground acceleration of the object.";
CM_ SG_ 154 OBJ_Abs_Lat_Acc_STD_V_2 "Validator for the STD of the lateral ground acceleration of the object.";
CM_ SG_ 154 OBJ_Abs_Acceleration_2 "The absolute ground acceleration in the target's heading direction.";
CM_ SG_ 154 OBJ_Abs_Acceleration_V_2 "Validator for the absolute ground acceleration.";
CM_ SG_ 154 OBJ_Abs_Acc_STD_2 "STD of the absolute ground acceleration.";
CM_ SG_ 154 OBJ_Abs_Acc_STD_V_2 "Validator for the STD of the absolute ground acceleration.";
CM_ SG_ 154 OBJ_Inv_TTC_2 "Inverse TTC (time to collision).";
CM_ SG_ 154 OBJ_Inv_TTC_STD_2 "STD for inverse TTC .";
CM_ SG_ 154 OBJ_Inv_TTC_STD_V_2 "Validator for the STD for inverse TTC .";
CM_ SG_ 154 OBJ_Relative_Long_Acc_2 "The relative longitudinal ground acceleration of the object.";
CM_ SG_ 154 OBJ_Relative_Long_Acc_V_2 "Validator for the relative longitudinal ground acceleration of the object.";
CM_ SG_ 154 OBJ_Relative_Long_Acc_STD_2 "STD of the relative longitudinal ground acceleration of the object.";
CM_ SG_ 154 OBJ_Rel_Long_Acc_STD_V_2 "Validator for the STD of the relative longitudinal ground acceleration.";
CM_ SG_ 154 OBJ_Relative_Long_Velocity_2 "The relative longtitudinal speed between the target and ego vehicle. ";
CM_ SG_ 154 OBJ_Relative_Long_Velocity_V_2 "Validator for the relative longtitudinal speed.";
CM_ SG_ 154 OBJ_Relative_Long_Vel_STD_2 "STD of the relative longtitudinal speed.";
CM_ SG_ 154 OBJ_Rel_Long_Vel_STD_V_2 "Validator for the STD of the relative longtitudinal speed.";
CM_ SG_ 154 OBJ_Relative_Lat_Velocity_2 "The relative lateral speed between the target and ego vehicle. ";
CM_ SG_ 154 OBJ_Relative_Lat_Velocity_V_2 "Validator for the relative lateral speed. ";
CM_ SG_ 154 OBJ_Relative_Lat_Velocity_STD_2 "STD of the relative lateral speed. ";
CM_ SG_ 154 OBJ_Rel_Lat_Vel_STD_V_2 "Validator for the STD of the relative lateral speed. ";
CM_ SG_ 154 OBJ_Long_Distance_2 "The longitudinal distance to middle of the rear bumper (middle of the RL and RR corners) of the target.";
CM_ SG_ 154 OBJ_Long_Distance_V_2 "Validator of the longtitudinal distance field";
CM_ SG_ 154 OBJ_Long_Distance_STD_2 "STD of the  longtitudinal distance.";
CM_ SG_ 154 OBJ_Long_Distance_STD_V_2 "Validator for the STD of the  longtitudinal distance.";
CM_ SG_ 154 OBJ_Lat_Distance_2 "Lateral distance to the middle of the RL and RR corners.  ";
CM_ SG_ 154 OBJ_Lat_Distance_V_2 "Validator for the lateral distance of the object.";
CM_ SG_ 154 OBJ_Lat_Distance_STD_2 "STD of the lateral distance of the object.";
CM_ SG_ 154 OBJ_Lat_Distance_STD_V_2 "Validator for the STD of the lateral distance of the object.";
CM_ SG_ 154 OBJ_Absolute_Speed_2 "The absolute ground speed in the targets' heading direction.";
CM_ SG_ 154 OBJ_Absolute_Speed_V_2 "Validator for the absolute ground speed.";
CM_ SG_ 154 OBJ_Absolute_Speed_STD_2 "STD of the absolute ground speed.";
CM_ SG_ 154 OBJ_Absolute_Speed_STD_V_2 "Validator for the STD of the absolute ground speed.";
CM_ SG_ 154 OBJ_Heading_2 "The angle beetweenthe host longitudinal axis and target's heading (clockwise, e.g. PI/2 is a target crossing from left to right).";
CM_ SG_ 154 OBJ_Heading_V_2 "Validator for the object heading.";
CM_ SG_ 154 OBJ_Heading_STD_2 "STD of the object heading.";
CM_ SG_ 154 OBJ_Heading_STD_V_2 "Validator for the STD of the object heading.";
CM_ SG_ 154 OBJ_Angle_Rate_STD_2 "Standard deviation of the angular speed. (radians)";
CM_ SG_ 154 OBJ_Angle_Rate_STD_V_2 "Validator for the STD of the angular speed.";
CM_ SG_ 154 OBJ_Angle_Rate_2 "The momentary angular speed of the object (radians). The positive side is to the host's right.";
CM_ SG_ 154 OBJ_Angle_Rate_V_2 "Validator for the angular speed.";
CM_ SG_ 154 OBJ_Angle_Right_2 "The angle between the host longitudinal axis and the right side of the front / rear of the target (the visible one). The positive side is to the host's right.";
CM_ SG_ 154 OBJ_Angle_Right_V_2 "Validator for angleRight";
CM_ SG_ 154 OBJ_Angle_Right_STD_2 "Standard deviation of angleRight";
CM_ SG_ 154 OBJ_Angle_Right_STD_V_2 "Validator for the standard deviation of angleRight.";
CM_ SG_ 154 OBJ_Angle_Left_2 "The angle between the host longitudinal axis and the left side of the front / rear of the target (the visible one). The positive side is to the host's right.";
CM_ SG_ 154 OBJ_Angle_Left_V_2 "Validator for angleLeft.";
CM_ SG_ 154 OBJ_Angle_Left_STD_2 "Standard deviation of angleLeft.";
CM_ SG_ 154 OBJ_Angle_Left_STD_V_2 "Validator for the standard deviation of angleLeft.";
CM_ SG_ 154 OBJ_Angle_Side_2 "The angle between the host longitudinal axis and the far visible edge - the visible edge of the front / rear of the target that is not visible. Currently supported for vehicles only.";
CM_ SG_ 154 OBJ_Angle_Side_V_2 "Validator for angleSide.";
CM_ SG_ 154 OBJ_Angle_Side_STD_2 "Standard deviation of angleSide.";
CM_ SG_ 154 OBJ_Angle_Side_STD_V_2 "Validator for the STD of angleSide.";
CM_ SG_ 154 OBJ_Angle_Mid_V_2 "Validator for angleMid.";
CM_ SG_ 154 OBJ_Angle_Mid_2 "The angle between the host longitudinal axis and the middle of the front / rear of the target (the visible one). The positive side is to the host's right.";
CM_ SG_ 154 OBJ_Angle_Mid_STD_2 "Standard deviation of angleMid.";
CM_ SG_ 154 OBJ_Angle_Mid_STD_V_2 "Validator for the STD of angleMid.";
CM_ SG_ 154 OBJ_Angle_Bottom_V_2 "Validator for OBJAngle_Bottom. ";
CM_ SG_ 154 OBJ_Angle_Bottom_2 "The angle between the longitudinal axis and the Bottom of the front / rear of the target (the visible one). The positive side is to the host's bottom";
CM_ SG_ 154 OBJ_Angle_Bottom_STD_2 "STD for OBJAngle_Bottom. ";
CM_ SG_ 154 OBJ_Angle_Bottom_STD_V_2 "Validator for OBJAngle_Bottom_STD. ";
CM_ SG_ 154 OBJ_Visibility_Side_V_2 "Currently Supported for VD only";
CM_ SG_ 154 OBJ_Visibility_Side_2 "From what car  side is the object visible";
CM_ SG_ 154 OBJ_Is_In_Drivable_Area_2 "Indicates whether the target is in a driveable area.";
CM_ SG_ 154 OBJ_Is_In_Drivable_Area_V_2 "Validator for OBJ_Is_In_Drivable_Area.";
CM_ SG_ 154 OBJ_Is_VeryClose_V_2 "Validator for OBJ_Is_VeryClose. ";
CM_ SG_ 154 OBJ_Is_VeryClose_2 "Indicates whether the target is very close to the host such that it is hard to measure its distance. Currently relevant for peds only";
CM_ SG_ 154 OBJ_OverlapAngleEgoLaneR_2 "Lateral distance to the middle of the RL and RR corners.";
CM_ SG_ 154 OBJ_OverlapAngleEgoLaneR_V_2 "Validator for OBJ_OverlapAngleEgoLaneR";
CM_ SG_ 154 OBJ_OverlapAngleEgoLaneL_2 "Lateral distance to the middle of the RL and RR corners.  ";
CM_ SG_ 154 OBJ_OverlapAngleEgoLaneL_V_2 "Validator for OBJ_OverlapAngleEgoLaneL";
CM_ SG_ 154 OBJ_Is_EMERGENCY_VCL_2 "Is Object an Emergency Vehicle";
CM_ SG_ 154 OBJ_EMERGENCY_LIGHT_COLOR_2 "Emergency Color";
CM_ SG_ 154 OBJ_EMERGENCY_V_2 "Are OBJ_Is_EMERGENCY_VCL and OBJ_EMERGENCY_LIGHT_COLOR Valid";
CM_ SG_ 154 OBJ_Angle_Top_2 "From VD touching point on the ground till the roof of the car";
CM_ SG_ 154 OBJ_Angle_Top_V_2 "Validator for OBJ_Angle_Top ";
CM_ SG_ 154 OBJ_Angle_Top_STD_2 "STD for OBJ_Angle_Top";
CM_ SG_ 154 OBJ_Angle_Top_STD_V_2 "Validator for OBJ_Angle_Top_STD. ";
CM_ SG_ 154 OBJ_Open_Door_Left_2 "Indicator if left door is open";
CM_ SG_ 154 OBJ_Open_Door_Right_2 "Indicator if right door is open";
CM_ SG_ 154 OBJ_Visible_Left_or_Right_2 "This signal describes the visible Left or Right side of the Target vehicle.";
CM_ SG_ 154 OBJ_Visible_Left_or_Right_V_2 "OBJ_Visible_Left_or_Right";
CM_ SG_ 154 OBJ_2W_Is_Motorbike_Probability_2 "The probability of the Two-wheeler reported object being a Motorbike";
CM_ SG_ 154 OBJ_2W_Is_Bicycle_Probability_2 "The probability of the Two-wheeler reported object being a Bicycle";
CM_ SG_ 154 OBJ_CRC_3 "Calculated over all element signals. From the signal after the CRC until the first signal in the next elements OBJ_CRC_N+1  not including";
CM_ SG_ 154 OBJ_ID_3 "The detected object ID. Range is 1-255, while 0 indicates that the field in unfilled.";
CM_ SG_ 154 OBJ_Existence_Probability_3 "The existence probability of the reported object";
CM_ SG_ 154 OBJ_Fusion_Source_3 "sources ids used for fusion";
CM_ SG_ 154 OBJ_Triggered_SDM_3 "Indicates whether the object has trigered the SDM (Safety Diagnostic Manager) alert.";
CM_ SG_ 154 OBJ_Motion_Category_3 "Relevant for VD only. Full description of values can be found at the ACC guide.";
CM_ SG_ 154 OBJ_Moving_IN_Probability_3 "The probability the object is eventually move into ego lane. (In case that the OBJ_Motion_Category signal is set to  MOVING_IN ";
CM_ SG_ 154 OBJ_Object_Age_3 "The number of frames in which the object was recognized.";
CM_ SG_ 154 OBJ_Measuring_Status_3 "Measurment status. Old vs New marks if this is the first frame in which the object is reported. Predicted vs Measured marks if the report is raw or has been predicted forward in time using the measured dynamics and ego motion.";
CM_ SG_ 154 OBJ_Object_Class_3 "Indicates the object type. Uncertain is outputted in case the probability that a vehicle is a truck is very similar to the probability that it is a car.";
CM_ SG_ 154 OBJ_Class_Probability_3 "The probability of this type classification.";
CM_ SG_ 154 OBJ_Car_Probability_3 "The probability the object is a car";
CM_ SG_ 154 OBJ_Truck_Probability_3 "The probability the object is a Truck";
CM_ SG_ 154 OBJ_Bike_Probability_3 "The probability the object is a Bike";
CM_ SG_ 154 OBJ_Camera_Source_3 "The camera in which this object was detected (best choice).";
CM_ SG_ 154 OBJ_Motion_Status_3 "MOVING - the object is moving STATIONARY - the object was never seen moving STOPPED -  the object was moving and has stopped MOVING_SLOWLY - the object is moving very slowly";
CM_ SG_ 154 OBJ_Motion_Orientation_3 "The direction of the targets heading compared to the host. ";
CM_ SG_ 154 OBJ_Has_Cut_Lane_3 "Indicates whether the object cut the host's (right or left) lane. In case there are no lanes, indicates whether the objects is at most 1 meters away from the host.";
CM_ SG_ 154 OBJ_Has_Cut_Path_3 "Indicates whether the object is in the host's path.";
CM_ SG_ 154 OBJ_Brake_Light_Validity_3 "Validator for braking light indicator";
CM_ SG_ 154 OBJ_Brake_Light_3 "Indication for brake lights ";
CM_ SG_ 154 OBJ_Turn_Indicator_Right_3 "Indication for blinking right light.";
CM_ SG_ 154 OBJ_Turn_Indicator_Left_3 "Indication for blinking left light ";
CM_ SG_ 154 OBJ_Turn_Indicator_Validity_3 "Validator for light indicators";
CM_ SG_ 154 OBJ_Right_Out_Of_Image_3 "Indicates whether the measurment are predicted out of the right side of the image bounderies.";
CM_ SG_ 154 OBJ_Left_Out_Of_Image_3 "Indicates whether if measurment are predicted out of  the left side of the image bounderies";
CM_ SG_ 154 OBJ_Right_Out_Of_Image_V_3 "validator";
CM_ SG_ 154 OBJ_Left_Out_Of_Image_V_3 "validator";
CM_ SG_ 154 OBJ_Top_Out_Of_Image_3 "Indicates whether if measurment are predicted out of  the top of the image bounderies";
CM_ SG_ 154 OBJ_Bottom_Out_Of_Image_3 "Indicates whether if measurment are predicted out of  the bottom of the image bounderies";
CM_ SG_ 154 OBJ_Top_Out_Of_Image_V_3 "validator";
CM_ SG_ 154 OBJ_Bottom_Out_Of_Image_V_3 "validator";
CM_ SG_ 154 OBJ_Lane_Assignment_3 "The object's lane relative to the host lane.";
CM_ SG_ 154 OBJ_Lane_Assignment_V_3 "Validator for lane assignment";
CM_ SG_ 154 OBJ_Age_Seconds_3 "Time in seconds in which the object was recognized. ";
CM_ SG_ 154 OBJ_Age_Seconds_V_3 "Validator for object age";
CM_ SG_ 154 OBJ_Width_3 "The width of the target vehicle in the world (not to be mistaken with the width of the visible part of the vehicle).";
CM_ SG_ 154 OBJ_Width_V_3 "Validator for object width";
CM_ SG_ 154 OBJ_Width_STD_3 "Standard deviation for object width";
CM_ SG_ 154 OBJ_Width_STD_V_3 "Validator for the standard deviation of object width";
CM_ SG_ 154 OBJ_Length_3 "The length of the vehicle in the world. For crossing bicycles it gives the viewed length of the bicycle.";
CM_ SG_ 154 OBJ_Length_V_3 "Validator for object length.";
CM_ SG_ 154 OBJ_Length_STD_3 "Standard deviation for object length.";
CM_ SG_ 154 OBJ_Length_STD_V_3 "Validator for the standard deviation of object length.";
CM_ SG_ 154 OBJ_Radar_ID_3 "Radar Object ID of the Fused Object, Only relvant when OBJ_Fusion_Source is not Camera only";
CM_ SG_ 154 OBJ_Height_3 "The height of the object in the world. ";
CM_ SG_ 154 OBJ_Height_V_3 "Validator for object height.";
CM_ SG_ 154 OBJ_Height_STD_3 "Standard deviation for object height.";
CM_ SG_ 154 OBJ_Height_STD_V_3 "Validator for the standard deviation of object height.";
CM_ SG_ 154 OBJ_Abs_Long_Velocity_3 "Absolute longitudinal velocity.";
CM_ SG_ 154 OBJ_Abs_Long_Velocity_V_3 "Validator for absolute longitudinal velocity.";
CM_ SG_ 154 OBJ_Abs_Long_Velocity_STD_3 "Standard deviation of absolute longitudinal velocity.";
CM_ SG_ 154 OBJ_Abs_Long_Vel_STD_V_3 "Validator for the standard deviation of the absolute longitudinal velocity.";
CM_ SG_ 154 OBJ_Abs_Lat_Velocity_3 "The lateral ground speed of the object.";
CM_ SG_ 154 OBJ_Abs_Lat_Velocity_V_3 "Validator for the lateral ground speed of the object.";
CM_ SG_ 154 OBJ_Abs_Lat_Velocity_STD_3 "STD of the lateral ground speed of the object.";
CM_ SG_ 154 OBJ_Abs_Lat_Vel_STD_V_3 "Validator for the STD of the lateral ground speed of the object.";
CM_ SG_ 154 OBJ_Abs_Long_Acc_3 "The longitudinal ground acceleration of the object.";
CM_ SG_ 154 OBJ_Abs_Long_Acc_V_3 "Validator for the longitudinal ground acceleration of the object.";
CM_ SG_ 154 OBJ_Abs_Long_Acc_STD_3 "STD of the longitudinal ground acceleration of the object.";
CM_ SG_ 154 OBJ_Abs_Long_Acc_STD_V_3 "Validator for the STD of the longitudinal ground acceleration of the object.";
CM_ SG_ 154 OBJ_Abs_Lat_Acc_3 "The lateral ground acceleration of the object.";
CM_ SG_ 154 OBJ_Abs_Lat_Acc_V_3 "Validator for the lateral ground acceleration of the object.";
CM_ SG_ 154 OBJ_Abs_Lat_Acc_STD_3 "STD of the lateral ground acceleration of the object.";
CM_ SG_ 154 OBJ_Abs_Lat_Acc_STD_V_3 "Validator for the STD of the lateral ground acceleration of the object.";
CM_ SG_ 154 OBJ_Abs_Acceleration_3 "The absolute ground acceleration in the target's heading direction.";
CM_ SG_ 154 OBJ_Abs_Acceleration_V_3 "Validator for the absolute ground acceleration.";
CM_ SG_ 154 OBJ_Abs_Acc_STD_3 "STD of the absolute ground acceleration.";
CM_ SG_ 154 OBJ_Abs_Acc_STD_V_3 "Validator for the STD of the absolute ground acceleration.";
CM_ SG_ 154 OBJ_Inv_TTC_3 "Inverse TTC (time to collision).";
CM_ SG_ 154 OBJ_Inv_TTC_STD_3 "STD for inverse TTC .";
CM_ SG_ 154 OBJ_Inv_TTC_STD_V_3 "Validator for the STD for inverse TTC .";
CM_ SG_ 154 OBJ_Relative_Long_Acc_3 "The relative longitudinal ground acceleration of the object.";
CM_ SG_ 154 OBJ_Relative_Long_Acc_V_3 "Validator for the relative longitudinal ground acceleration of the object.";
CM_ SG_ 154 OBJ_Relative_Long_Acc_STD_3 "STD of the relative longitudinal ground acceleration of the object.";
CM_ SG_ 154 OBJ_Rel_Long_Acc_STD_V_3 "Validator for the STD of the relative longitudinal ground acceleration.";
CM_ SG_ 154 OBJ_Relative_Long_Velocity_3 "The relative longtitudinal speed between the target and ego vehicle. ";
CM_ SG_ 154 OBJ_Relative_Long_Velocity_V_3 "Validator for the relative longtitudinal speed.";
CM_ SG_ 154 OBJ_Relative_Long_Vel_STD_3 "STD of the relative longtitudinal speed.";
CM_ SG_ 154 OBJ_Rel_Long_Vel_STD_V_3 "Validator for the STD of the relative longtitudinal speed.";
CM_ SG_ 154 OBJ_Relative_Lat_Velocity_3 "The relative lateral speed between the target and ego vehicle. ";
CM_ SG_ 154 OBJ_Relative_Lat_Velocity_V_3 "Validator for the relative lateral speed. ";
CM_ SG_ 154 OBJ_Relative_Lat_Velocity_STD_3 "STD of the relative lateral speed. ";
CM_ SG_ 154 OBJ_Rel_Lat_Vel_STD_V_3 "Validator for the STD of the relative lateral speed. ";
CM_ SG_ 154 OBJ_Long_Distance_3 "The longitudinal distance to middle of the rear bumper (middle of the RL and RR corners) of the target.";
CM_ SG_ 154 OBJ_Long_Distance_V_3 "Validator of the longtitudinal distance field";
CM_ SG_ 154 OBJ_Long_Distance_STD_3 "STD of the  longtitudinal distance.";
CM_ SG_ 154 OBJ_Long_Distance_STD_V_3 "Validator for the STD of the  longtitudinal distance.";
CM_ SG_ 154 OBJ_Lat_Distance_3 "Lateral distance to the middle of the RL and RR corners.  ";
CM_ SG_ 154 OBJ_Lat_Distance_V_3 "Validator for the lateral distance of the object.";
CM_ SG_ 154 OBJ_Lat_Distance_STD_3 "STD of the lateral distance of the object.";
CM_ SG_ 154 OBJ_Lat_Distance_STD_V_3 "Validator for the STD of the lateral distance of the object.";
CM_ SG_ 154 OBJ_Absolute_Speed_3 "The absolute ground speed in the targets' heading direction.";
CM_ SG_ 154 OBJ_Absolute_Speed_V_3 "Validator for the absolute ground speed.";
CM_ SG_ 154 OBJ_Absolute_Speed_STD_3 "STD of the absolute ground speed.";
CM_ SG_ 154 OBJ_Absolute_Speed_STD_V_3 "Validator for the STD of the absolute ground speed.";
CM_ SG_ 154 OBJ_Heading_3 "The angle beetweenthe host longitudinal axis and target's heading (clockwise, e.g. PI/2 is a target crossing from left to right).";
CM_ SG_ 154 OBJ_Heading_V_3 "Validator for the object heading.";
CM_ SG_ 154 OBJ_Heading_STD_3 "STD of the object heading.";
CM_ SG_ 154 OBJ_Heading_STD_V_3 "Validator for the STD of the object heading.";
CM_ SG_ 154 OBJ_Angle_Rate_STD_3 "Standard deviation of the angular speed. (radians)";
CM_ SG_ 154 OBJ_Angle_Rate_STD_V_3 "Validator for the STD of the angular speed.";
CM_ SG_ 154 OBJ_Angle_Rate_3 "The momentary angular speed of the object (radians). The positive side is to the host's right.";
CM_ SG_ 154 OBJ_Angle_Rate_V_3 "Validator for the angular speed.";
CM_ SG_ 154 OBJ_Angle_Right_3 "The angle between the host longitudinal axis and the right side of the front / rear of the target (the visible one). The positive side is to the host's right.";
CM_ SG_ 154 OBJ_Angle_Right_V_3 "Validator for angleRight";
CM_ SG_ 154 OBJ_Angle_Right_STD_3 "Standard deviation of angleRight";
CM_ SG_ 154 OBJ_Angle_Right_STD_V_3 "Validator for the standard deviation of angleRight.";
CM_ SG_ 154 OBJ_Angle_Left_3 "The angle between the host longitudinal axis and the left side of the front / rear of the target (the visible one). The positive side is to the host's right.";
CM_ SG_ 154 OBJ_Angle_Left_V_3 "Validator for angleLeft.";
CM_ SG_ 154 OBJ_Angle_Left_STD_3 "Standard deviation of angleLeft.";
CM_ SG_ 154 OBJ_Angle_Left_STD_V_3 "Validator for the standard deviation of angleLeft.";
CM_ SG_ 154 OBJ_Angle_Side_3 "The angle between the host longitudinal axis and the far visible edge - the visible edge of the front / rear of the target that is not visible. Currently supported for vehicles only.";
CM_ SG_ 154 OBJ_Angle_Side_V_3 "Validator for angleSide.";
CM_ SG_ 154 OBJ_Angle_Side_STD_3 "Standard deviation of angleSide.";
CM_ SG_ 154 OBJ_Angle_Side_STD_V_3 "Validator for the STD of angleSide.";
CM_ SG_ 154 OBJ_Angle_Mid_V_3 "Validator for angleMid.";
CM_ SG_ 154 OBJ_Angle_Mid_3 "The angle between the host longitudinal axis and the middle of the front / rear of the target (the visible one). The positive side is to the host's right.";
CM_ SG_ 154 OBJ_Angle_Mid_STD_3 "Standard deviation of angleMid.";
CM_ SG_ 154 OBJ_Angle_Mid_STD_V_3 "Validator for the STD of angleMid.";
CM_ SG_ 154 OBJ_Angle_Bottom_V_3 "Validator for OBJAngle_Bottom. ";
CM_ SG_ 154 OBJ_Angle_Bottom_3 "The angle between the longitudinal axis and the Bottom of the front / rear of the target (the visible one). The positive side is to the host's bottom";
CM_ SG_ 154 OBJ_Angle_Bottom_STD_3 "STD for OBJAngle_Bottom. ";
CM_ SG_ 154 OBJ_Angle_Bottom_STD_V_3 "Validator for OBJAngle_Bottom_STD. ";
CM_ SG_ 154 OBJ_Visibility_Side_V_3 "Currently Supported for VD only";
CM_ SG_ 154 OBJ_Visibility_Side_3 "From what car  side is the object visible";
CM_ SG_ 154 OBJ_Is_In_Drivable_Area_3 "Indicates whether the target is in a driveable area.";
CM_ SG_ 154 OBJ_Is_In_Drivable_Area_V_3 "Validator for OBJ_Is_In_Drivable_Area.";
CM_ SG_ 154 OBJ_Is_VeryClose_V_3 "Validator for OBJ_Is_VeryClose. ";
CM_ SG_ 154 OBJ_Is_VeryClose_3 "Indicates whether the target is very close to the host such that it is hard to measure its distance. Currently relevant for peds only";
CM_ SG_ 154 OBJ_OverlapAngleEgoLaneR_3 "Lateral distance to the middle of the RL and RR corners.";
CM_ SG_ 154 OBJ_OverlapAngleEgoLaneR_V_3 "Validator for OBJ_OverlapAngleEgoLaneR";
CM_ SG_ 154 OBJ_OverlapAngleEgoLaneL_3 "Lateral distance to the middle of the RL and RR corners.  ";
CM_ SG_ 154 OBJ_OverlapAngleEgoLaneL_V_3 "Validator for OBJ_OverlapAngleEgoLaneL";
CM_ SG_ 154 OBJ_Is_EMERGENCY_VCL_3 "Is Object an Emergency Vehicle";
CM_ SG_ 154 OBJ_EMERGENCY_LIGHT_COLOR_3 "Emergency Color";
CM_ SG_ 154 OBJ_EMERGENCY_V_3 "Are OBJ_Is_EMERGENCY_VCL and OBJ_EMERGENCY_LIGHT_COLOR Valid";
CM_ SG_ 154 OBJ_Angle_Top_3 "From VD touching point on the ground till the roof of the car";
CM_ SG_ 154 OBJ_Angle_Top_V_3 "Validator for OBJ_Angle_Top ";
CM_ SG_ 154 OBJ_Angle_Top_STD_3 "STD for OBJ_Angle_Top";
CM_ SG_ 154 OBJ_Angle_Top_STD_V_3 "Validator for OBJ_Angle_Top_STD. ";
CM_ SG_ 154 OBJ_Open_Door_Left_3 "Indicator if left door is open";
CM_ SG_ 154 OBJ_Open_Door_Right_3 "Indicator if right door is open";
CM_ SG_ 154 OBJ_Visible_Left_or_Right_3 "This signal describes the visible Left or Right side of the Target vehicle.";
CM_ SG_ 154 OBJ_Visible_Left_or_Right_V_3 "OBJ_Visible_Left_or_Right";
CM_ SG_ 154 OBJ_2W_Is_Motorbike_Probability_3 "The probability of the Two-wheeler reported object being a Motorbike";
CM_ SG_ 154 OBJ_2W_Is_Bicycle_Probability_3 "The probability of the Two-wheeler reported object being a Bicycle";
CM_ SG_ 154 OBJ_CRC_4 "Calculated over all element signals. From the signal after the CRC until the first signal in the next elements OBJ_CRC_N+1  not including";
CM_ SG_ 154 OBJ_ID_4 "The detected object ID. Range is 1-255, while 0 indicates that the field in unfilled.";
CM_ SG_ 154 OBJ_Existence_Probability_4 "The existence probability of the reported object";
CM_ SG_ 154 OBJ_Fusion_Source_4 "sources ids used for fusion";
CM_ SG_ 154 OBJ_Triggered_SDM_4 "Indicates whether the object has trigered the SDM (Safety Diagnostic Manager) alert.";
CM_ SG_ 154 OBJ_Motion_Category_4 "Relevant for VD only. Full description of values can be found at the ACC guide.";
CM_ SG_ 154 OBJ_Moving_IN_Probability_4 "The probability the object is eventually move into ego lane. (In case that the OBJ_Motion_Category signal is set to  MOVING_IN ";
CM_ SG_ 154 OBJ_Object_Age_4 "The number of frames in which the object was recognized.";
CM_ SG_ 154 OBJ_Measuring_Status_4 "Measurment status. Old vs New marks if this is the first frame in which the object is reported. Predicted vs Measured marks if the report is raw or has been predicted forward in time using the measured dynamics and ego motion.";
CM_ SG_ 154 OBJ_Object_Class_4 "Indicates the object type. Uncertain is outputted in case the probability that a vehicle is a truck is very similar to the probability that it is a car.";
CM_ SG_ 154 OBJ_Class_Probability_4 "The probability of this type classification.";
CM_ SG_ 154 OBJ_Car_Probability_4 "The probability the object is a car";
CM_ SG_ 154 OBJ_Truck_Probability_4 "The probability the object is a Truck";
CM_ SG_ 154 OBJ_Bike_Probability_4 "The probability the object is a Bike";
CM_ SG_ 154 OBJ_Camera_Source_4 "The camera in which this object was detected (best choice).";
CM_ SG_ 154 OBJ_Motion_Status_4 "MOVING - the object is moving STATIONARY - the object was never seen moving STOPPED -  the object was moving and has stopped MOVING_SLOWLY - the object is moving very slowly";
CM_ SG_ 154 OBJ_Motion_Orientation_4 "The direction of the targets heading compared to the host. ";
CM_ SG_ 154 OBJ_Has_Cut_Lane_4 "Indicates whether the object cut the host's (right or left) lane. In case there are no lanes, indicates whether the objects is at most 1 meters away from the host.";
CM_ SG_ 154 OBJ_Has_Cut_Path_4 "Indicates whether the object is in the host's path.";
CM_ SG_ 154 OBJ_Brake_Light_Validity_4 "Validator for braking light indicator";
CM_ SG_ 154 OBJ_Brake_Light_4 "Indication for brake lights ";
CM_ SG_ 154 OBJ_Turn_Indicator_Right_4 "Indication for blinking right light.";
CM_ SG_ 154 OBJ_Turn_Indicator_Left_4 "Indication for blinking left light ";
CM_ SG_ 154 OBJ_Turn_Indicator_Validity_4 "Validator for light indicators";
CM_ SG_ 154 OBJ_Right_Out_Of_Image_4 "Indicates whether the measurment are predicted out of the right side of the image bounderies.";
CM_ SG_ 154 OBJ_Left_Out_Of_Image_4 "Indicates whether if measurment are predicted out of  the left side of the image bounderies";
CM_ SG_ 154 OBJ_Right_Out_Of_Image_V_4 "validator";
CM_ SG_ 154 OBJ_Left_Out_Of_Image_V_4 "validator";
CM_ SG_ 154 OBJ_Top_Out_Of_Image_4 "Indicates whether if measurment are predicted out of  the top of the image bounderies";
CM_ SG_ 154 OBJ_Bottom_Out_Of_Image_4 "Indicates whether if measurment are predicted out of  the bottom of the image bounderies";
CM_ SG_ 154 OBJ_Top_Out_Of_Image_V_4 "validator";
CM_ SG_ 154 OBJ_Bottom_Out_Of_Image_V_4 "validator";
CM_ SG_ 154 OBJ_Lane_Assignment_4 "The object's lane relative to the host lane.";
CM_ SG_ 154 OBJ_Lane_Assignment_V_4 "Validator for lane assignment";
CM_ SG_ 154 OBJ_Age_Seconds_4 "Time in seconds in which the object was recognized. ";
CM_ SG_ 154 OBJ_Age_Seconds_V_4 "Validator for object age";
CM_ SG_ 154 OBJ_Width_4 "The width of the target vehicle in the world (not to be mistaken with the width of the visible part of the vehicle).";
CM_ SG_ 154 OBJ_Width_V_4 "Validator for object width";
CM_ SG_ 154 OBJ_Width_STD_4 "Standard deviation for object width";
CM_ SG_ 154 OBJ_Width_STD_V_4 "Validator for the standard deviation of object width";
CM_ SG_ 154 OBJ_Length_4 "The length of the vehicle in the world. For crossing bicycles it gives the viewed length of the bicycle.";
CM_ SG_ 154 OBJ_Length_V_4 "Validator for object length.";
CM_ SG_ 154 OBJ_Length_STD_4 "Standard deviation for object length.";
CM_ SG_ 154 OBJ_Length_STD_V_4 "Validator for the standard deviation of object length.";
CM_ SG_ 154 OBJ_Radar_ID_4 "Radar Object ID of the Fused Object, Only relvant when OBJ_Fusion_Source is not Camera only";
CM_ SG_ 154 OBJ_Height_4 "The height of the object in the world. ";
CM_ SG_ 154 OBJ_Height_V_4 "Validator for object height.";
CM_ SG_ 154 OBJ_Height_STD_4 "Standard deviation for object height.";
CM_ SG_ 154 OBJ_Height_STD_V_4 "Validator for the standard deviation of object height.";
CM_ SG_ 154 OBJ_Abs_Long_Velocity_4 "Absolute longitudinal velocity.";
CM_ SG_ 154 OBJ_Abs_Long_Velocity_V_4 "Validator for absolute longitudinal velocity.";
CM_ SG_ 154 OBJ_Abs_Long_Velocity_STD_4 "Standard deviation of absolute longitudinal velocity.";
CM_ SG_ 154 OBJ_Abs_Long_Vel_STD_V_4 "Validator for the standard deviation of the absolute longitudinal velocity.";
CM_ SG_ 154 OBJ_Abs_Lat_Velocity_4 "The lateral ground speed of the object.";
CM_ SG_ 154 OBJ_Abs_Lat_Velocity_V_4 "Validator for the lateral ground speed of the object.";
CM_ SG_ 154 OBJ_Abs_Lat_Velocity_STD_4 "STD of the lateral ground speed of the object.";
CM_ SG_ 154 OBJ_Abs_Lat_Vel_STD_V_4 "Validator for the STD of the lateral ground speed of the object.";
CM_ SG_ 154 OBJ_Abs_Long_Acc_4 "The longitudinal ground acceleration of the object.";
CM_ SG_ 154 OBJ_Abs_Long_Acc_V_4 "Validator for the longitudinal ground acceleration of the object.";
CM_ SG_ 154 OBJ_Abs_Long_Acc_STD_4 "STD of the longitudinal ground acceleration of the object.";
CM_ SG_ 154 OBJ_Abs_Long_Acc_STD_V_4 "Validator for the STD of the longitudinal ground acceleration of the object.";
CM_ SG_ 154 OBJ_Abs_Lat_Acc_4 "The lateral ground acceleration of the object.";
CM_ SG_ 154 OBJ_Abs_Lat_Acc_V_4 "Validator for the lateral ground acceleration of the object.";
CM_ SG_ 154 OBJ_Abs_Lat_Acc_STD_4 "STD of the lateral ground acceleration of the object.";
CM_ SG_ 154 OBJ_Abs_Lat_Acc_STD_V_4 "Validator for the STD of the lateral ground acceleration of the object.";
CM_ SG_ 154 OBJ_Abs_Acceleration_4 "The absolute ground acceleration in the target's heading direction.";
CM_ SG_ 154 OBJ_Abs_Acceleration_V_4 "Validator for the absolute ground acceleration.";
CM_ SG_ 154 OBJ_Abs_Acc_STD_4 "STD of the absolute ground acceleration.";
CM_ SG_ 154 OBJ_Abs_Acc_STD_V_4 "Validator for the STD of the absolute ground acceleration.";
CM_ SG_ 154 OBJ_Inv_TTC_4 "Inverse TTC (time to collision).";
CM_ SG_ 154 OBJ_Inv_TTC_STD_4 "STD for inverse TTC .";
CM_ SG_ 154 OBJ_Inv_TTC_STD_V_4 "Validator for the STD for inverse TTC .";
CM_ SG_ 154 OBJ_Relative_Long_Acc_4 "The relative longitudinal ground acceleration of the object.";
CM_ SG_ 154 OBJ_Relative_Long_Acc_V_4 "Validator for the relative longitudinal ground acceleration of the object.";
CM_ SG_ 154 OBJ_Relative_Long_Acc_STD_4 "STD of the relative longitudinal ground acceleration of the object.";
CM_ SG_ 154 OBJ_Rel_Long_Acc_STD_V_4 "Validator for the STD of the relative longitudinal ground acceleration.";
CM_ SG_ 154 OBJ_Relative_Long_Velocity_4 "The relative longtitudinal speed between the target and ego vehicle. ";
CM_ SG_ 154 OBJ_Relative_Long_Velocity_V_4 "Validator for the relative longtitudinal speed.";
CM_ SG_ 154 OBJ_Relative_Long_Vel_STD_4 "STD of the relative longtitudinal speed.";
CM_ SG_ 154 OBJ_Rel_Long_Vel_STD_V_4 "Validator for the STD of the relative longtitudinal speed.";
CM_ SG_ 154 OBJ_Relative_Lat_Velocity_4 "The relative lateral speed between the target and ego vehicle. ";
CM_ SG_ 154 OBJ_Relative_Lat_Velocity_V_4 "Validator for the relative lateral speed. ";
CM_ SG_ 154 OBJ_Relative_Lat_Velocity_STD_4 "STD of the relative lateral speed. ";
CM_ SG_ 154 OBJ_Rel_Lat_Vel_STD_V_4 "Validator for the STD of the relative lateral speed. ";
CM_ SG_ 154 OBJ_Long_Distance_4 "The longitudinal distance to middle of the rear bumper (middle of the RL and RR corners) of the target.";
CM_ SG_ 154 OBJ_Long_Distance_V_4 "Validator of the longtitudinal distance field";
CM_ SG_ 154 OBJ_Long_Distance_STD_4 "STD of the  longtitudinal distance.";
CM_ SG_ 154 OBJ_Long_Distance_STD_V_4 "Validator for the STD of the  longtitudinal distance.";
CM_ SG_ 154 OBJ_Lat_Distance_4 "Lateral distance to the middle of the RL and RR corners.  ";
CM_ SG_ 154 OBJ_Lat_Distance_V_4 "Validator for the lateral distance of the object.";
CM_ SG_ 154 OBJ_Lat_Distance_STD_4 "STD of the lateral distance of the object.";
CM_ SG_ 154 OBJ_Lat_Distance_STD_V_4 "Validator for the STD of the lateral distance of the object.";
CM_ SG_ 154 OBJ_Absolute_Speed_4 "The absolute ground speed in the targets' heading direction.";
CM_ SG_ 154 OBJ_Absolute_Speed_V_4 "Validator for the absolute ground speed.";
CM_ SG_ 154 OBJ_Absolute_Speed_STD_4 "STD of the absolute ground speed.";
CM_ SG_ 154 OBJ_Absolute_Speed_STD_V_4 "Validator for the STD of the absolute ground speed.";
CM_ SG_ 154 OBJ_Heading_4 "The angle beetweenthe host longitudinal axis and target's heading (clockwise, e.g. PI/2 is a target crossing from left to right).";
CM_ SG_ 154 OBJ_Heading_V_4 "Validator for the object heading.";
CM_ SG_ 154 OBJ_Heading_STD_4 "STD of the object heading.";
CM_ SG_ 154 OBJ_Heading_STD_V_4 "Validator for the STD of the object heading.";
CM_ SG_ 154 OBJ_Angle_Rate_STD_4 "Standard deviation of the angular speed. (radians)";
CM_ SG_ 154 OBJ_Angle_Rate_STD_V_4 "Validator for the STD of the angular speed.";
CM_ SG_ 154 OBJ_Angle_Rate_4 "The momentary angular speed of the object (radians). The positive side is to the host's right.";
CM_ SG_ 154 OBJ_Angle_Rate_V_4 "Validator for the angular speed.";
CM_ SG_ 154 OBJ_Angle_Right_4 "The angle between the host longitudinal axis and the right side of the front / rear of the target (the visible one). The positive side is to the host's right.";
CM_ SG_ 154 OBJ_Angle_Right_V_4 "Validator for angleRight";
CM_ SG_ 154 OBJ_Angle_Right_STD_4 "Standard deviation of angleRight";
CM_ SG_ 154 OBJ_Angle_Right_STD_V_4 "Validator for the standard deviation of angleRight.";
CM_ SG_ 154 OBJ_Angle_Left_4 "The angle between the host longitudinal axis and the left side of the front / rear of the target (the visible one). The positive side is to the host's right.";
CM_ SG_ 154 OBJ_Angle_Left_V_4 "Validator for angleLeft.";
CM_ SG_ 154 OBJ_Angle_Left_STD_4 "Standard deviation of angleLeft.";
CM_ SG_ 154 OBJ_Angle_Left_STD_V_4 "Validator for the standard deviation of angleLeft.";
CM_ SG_ 154 OBJ_Angle_Side_4 "The angle between the host longitudinal axis and the far visible edge - the visible edge of the front / rear of the target that is not visible. Currently supported for vehicles only.";
CM_ SG_ 154 OBJ_Angle_Side_V_4 "Validator for angleSide.";
CM_ SG_ 154 OBJ_Angle_Side_STD_4 "Standard deviation of angleSide.";
CM_ SG_ 154 OBJ_Angle_Side_STD_V_4 "Validator for the STD of angleSide.";
CM_ SG_ 154 OBJ_Angle_Mid_V_4 "Validator for angleMid.";
CM_ SG_ 154 OBJ_Angle_Mid_4 "The angle between the host longitudinal axis and the middle of the front / rear of the target (the visible one). The positive side is to the host's right.";
CM_ SG_ 154 OBJ_Angle_Mid_STD_4 "Standard deviation of angleMid.";
CM_ SG_ 154 OBJ_Angle_Mid_STD_V_4 "Validator for the STD of angleMid.";
CM_ SG_ 154 OBJ_Angle_Bottom_V_4 "Validator for OBJAngle_Bottom. ";
CM_ SG_ 154 OBJ_Angle_Bottom_4 "The angle between the longitudinal axis and the Bottom of the front / rear of the target (the visible one). The positive side is to the host's bottom";
CM_ SG_ 154 OBJ_Angle_Bottom_STD_4 "STD for OBJAngle_Bottom. ";
CM_ SG_ 154 OBJ_Angle_Bottom_STD_V_4 "Validator for OBJAngle_Bottom_STD. ";
CM_ SG_ 154 OBJ_Visibility_Side_V_4 "Currently Supported for VD only";
CM_ SG_ 154 OBJ_Visibility_Side_4 "From what car  side is the object visible";
CM_ SG_ 154 OBJ_Is_In_Drivable_Area_4 "Indicates whether the target is in a driveable area.";
CM_ SG_ 154 OBJ_Is_In_Drivable_Area_V_4 "Validator for OBJ_Is_In_Drivable_Area.";
CM_ SG_ 154 OBJ_Is_VeryClose_V_4 "Validator for OBJ_Is_VeryClose. ";
CM_ SG_ 154 OBJ_Is_VeryClose_4 "Indicates whether the target is very close to the host such that it is hard to measure its distance. Currently relevant for peds only";
CM_ SG_ 154 OBJ_OverlapAngleEgoLaneR_4 "Lateral distance to the middle of the RL and RR corners.";
CM_ SG_ 154 OBJ_OverlapAngleEgoLaneR_V_4 "Validator for OBJ_OverlapAngleEgoLaneR";
CM_ SG_ 154 OBJ_OverlapAngleEgoLaneL_4 "Lateral distance to the middle of the RL and RR corners.  ";
CM_ SG_ 154 OBJ_OverlapAngleEgoLaneL_V_4 "Validator for OBJ_OverlapAngleEgoLaneL";
CM_ SG_ 154 OBJ_Is_EMERGENCY_VCL_4 "Is Object an Emergency Vehicle";
CM_ SG_ 154 OBJ_EMERGENCY_LIGHT_COLOR_4 "Emergency Color";
CM_ SG_ 154 OBJ_EMERGENCY_V_4 "Are OBJ_Is_EMERGENCY_VCL and OBJ_EMERGENCY_LIGHT_COLOR Valid";
CM_ SG_ 154 OBJ_Angle_Top_4 "From VD touching point on the ground till the roof of the car";
CM_ SG_ 154 OBJ_Angle_Top_V_4 "Validator for OBJ_Angle_Top ";
CM_ SG_ 154 OBJ_Angle_Top_STD_4 "STD for OBJ_Angle_Top";
CM_ SG_ 154 OBJ_Angle_Top_STD_V_4 "Validator for OBJ_Angle_Top_STD. ";
CM_ SG_ 154 OBJ_Open_Door_Left_4 "Indicator if left door is open";
CM_ SG_ 154 OBJ_Open_Door_Right_4 "Indicator if right door is open";
CM_ SG_ 154 OBJ_Visible_Left_or_Right_4 "This signal describes the visible Left or Right side of the Target vehicle.";
CM_ SG_ 154 OBJ_Visible_Left_or_Right_V_4 "OBJ_Visible_Left_or_Right";
CM_ SG_ 154 OBJ_2W_Is_Motorbike_Probability_4 "The probability of the Two-wheeler reported object being a Motorbike";
CM_ SG_ 154 OBJ_2W_Is_Bicycle_Probability_4 "The probability of the Two-wheeler reported object being a Bicycle";
CM_ SG_ 154 OBJ_CRC_5 "Calculated over all element signals. From the signal after the CRC until the first signal in the next elements OBJ_CRC_N+1  not including";
CM_ SG_ 154 OBJ_ID_5 "The detected object ID. Range is 1-255, while 0 indicates that the field in unfilled.";
CM_ SG_ 154 OBJ_Existence_Probability_5 "The existence probability of the reported object";
CM_ SG_ 154 OBJ_Fusion_Source_5 "sources ids used for fusion";
CM_ SG_ 154 OBJ_Triggered_SDM_5 "Indicates whether the object has trigered the SDM (Safety Diagnostic Manager) alert.";
CM_ SG_ 154 OBJ_Motion_Category_5 "Relevant for VD only. Full description of values can be found at the ACC guide.";
CM_ SG_ 154 OBJ_Moving_IN_Probability_5 "The probability the object is eventually move into ego lane. (In case that the OBJ_Motion_Category signal is set to  MOVING_IN ";
CM_ SG_ 154 OBJ_Object_Age_5 "The number of frames in which the object was recognized.";
CM_ SG_ 154 OBJ_Measuring_Status_5 "Measurment status. Old vs New marks if this is the first frame in which the object is reported. Predicted vs Measured marks if the report is raw or has been predicted forward in time using the measured dynamics and ego motion.";
CM_ SG_ 154 OBJ_Object_Class_5 "Indicates the object type. Uncertain is outputted in case the probability that a vehicle is a truck is very similar to the probability that it is a car.";
CM_ SG_ 154 OBJ_Class_Probability_5 "The probability of this type classification.";
CM_ SG_ 154 OBJ_Car_Probability_5 "The probability the object is a car";
CM_ SG_ 154 OBJ_Truck_Probability_5 "The probability the object is a Truck";
CM_ SG_ 154 OBJ_Bike_Probability_5 "The probability the object is a Bike";
CM_ SG_ 154 OBJ_Camera_Source_5 "The camera in which this object was detected (best choice).";
CM_ SG_ 154 OBJ_Motion_Status_5 "MOVING - the object is moving STATIONARY - the object was never seen moving STOPPED -  the object was moving and has stopped MOVING_SLOWLY - the object is moving very slowly";
CM_ SG_ 154 OBJ_Motion_Orientation_5 "The direction of the targets heading compared to the host. ";
CM_ SG_ 154 OBJ_Has_Cut_Lane_5 "Indicates whether the object cut the host's (right or left) lane. In case there are no lanes, indicates whether the objects is at most 1 meters away from the host.";
CM_ SG_ 154 OBJ_Has_Cut_Path_5 "Indicates whether the object is in the host's path.";
CM_ SG_ 154 OBJ_Brake_Light_Validity_5 "Validator for braking light indicator";
CM_ SG_ 154 OBJ_Brake_Light_5 "Indication for brake lights ";
CM_ SG_ 154 OBJ_Turn_Indicator_Right_5 "Indication for blinking right light.";
CM_ SG_ 154 OBJ_Turn_Indicator_Left_5 "Indication for blinking left light ";
CM_ SG_ 154 OBJ_Turn_Indicator_Validity_5 "Validator for light indicators";
CM_ SG_ 154 OBJ_Right_Out_Of_Image_5 "Indicates whether the measurment are predicted out of the right side of the image bounderies.";
CM_ SG_ 154 OBJ_Left_Out_Of_Image_5 "Indicates whether if measurment are predicted out of  the left side of the image bounderies";
CM_ SG_ 154 OBJ_Right_Out_Of_Image_V_5 "validator";
CM_ SG_ 154 OBJ_Left_Out_Of_Image_V_5 "validator";
CM_ SG_ 154 OBJ_Top_Out_Of_Image_5 "Indicates whether if measurment are predicted out of  the top of the image bounderies";
CM_ SG_ 154 OBJ_Bottom_Out_Of_Image_5 "Indicates whether if measurment are predicted out of  the bottom of the image bounderies";
CM_ SG_ 154 OBJ_Top_Out_Of_Image_V_5 "validator";
CM_ SG_ 154 OBJ_Bottom_Out_Of_Image_V_5 "validator";
CM_ SG_ 154 OBJ_Lane_Assignment_5 "The object's lane relative to the host lane.";
CM_ SG_ 154 OBJ_Lane_Assignment_V_5 "Validator for lane assignment";
CM_ SG_ 154 OBJ_Age_Seconds_5 "Time in seconds in which the object was recognized. ";
CM_ SG_ 154 OBJ_Age_Seconds_V_5 "Validator for object age";
CM_ SG_ 154 OBJ_Width_5 "The width of the target vehicle in the world (not to be mistaken with the width of the visible part of the vehicle).";
CM_ SG_ 154 OBJ_Width_V_5 "Validator for object width";
CM_ SG_ 154 OBJ_Width_STD_5 "Standard deviation for object width";
CM_ SG_ 154 OBJ_Width_STD_V_5 "Validator for the standard deviation of object width";
CM_ SG_ 154 OBJ_Length_5 "The length of the vehicle in the world. For crossing bicycles it gives the viewed length of the bicycle.";
CM_ SG_ 154 OBJ_Length_V_5 "Validator for object length.";
CM_ SG_ 154 OBJ_Length_STD_5 "Standard deviation for object length.";
CM_ SG_ 154 OBJ_Length_STD_V_5 "Validator for the standard deviation of object length.";
CM_ SG_ 154 OBJ_Radar_ID_5 "Radar Object ID of the Fused Object, Only relvant when OBJ_Fusion_Source is not Camera only";
CM_ SG_ 154 OBJ_Height_5 "The height of the object in the world. ";
CM_ SG_ 154 OBJ_Height_V_5 "Validator for object height.";
CM_ SG_ 154 OBJ_Height_STD_5 "Standard deviation for object height.";
CM_ SG_ 154 OBJ_Height_STD_V_5 "Validator for the standard deviation of object height.";
CM_ SG_ 154 OBJ_Abs_Long_Velocity_5 "Absolute longitudinal velocity.";
CM_ SG_ 154 OBJ_Abs_Long_Velocity_V_5 "Validator for absolute longitudinal velocity.";
CM_ SG_ 154 OBJ_Abs_Long_Velocity_STD_5 "Standard deviation of absolute longitudinal velocity.";
CM_ SG_ 154 OBJ_Abs_Long_Vel_STD_V_5 "Validator for the standard deviation of the absolute longitudinal velocity.";
CM_ SG_ 154 OBJ_Abs_Lat_Velocity_5 "The lateral ground speed of the object.";
CM_ SG_ 154 OBJ_Abs_Lat_Velocity_V_5 "Validator for the lateral ground speed of the object.";
CM_ SG_ 154 OBJ_Abs_Lat_Velocity_STD_5 "STD of the lateral ground speed of the object.";
CM_ SG_ 154 OBJ_Abs_Lat_Vel_STD_V_5 "Validator for the STD of the lateral ground speed of the object.";
CM_ SG_ 154 OBJ_Abs_Long_Acc_5 "The longitudinal ground acceleration of the object.";
CM_ SG_ 154 OBJ_Abs_Long_Acc_V_5 "Validator for the longitudinal ground acceleration of the object.";
CM_ SG_ 154 OBJ_Abs_Long_Acc_STD_5 "STD of the longitudinal ground acceleration of the object.";
CM_ SG_ 154 OBJ_Abs_Long_Acc_STD_V_5 "Validator for the STD of the longitudinal ground acceleration of the object.";
CM_ SG_ 154 OBJ_Abs_Lat_Acc_5 "The lateral ground acceleration of the object.";
CM_ SG_ 154 OBJ_Abs_Lat_Acc_V_5 "Validator for the lateral ground acceleration of the object.";
CM_ SG_ 154 OBJ_Abs_Lat_Acc_STD_5 "STD of the lateral ground acceleration of the object.";
CM_ SG_ 154 OBJ_Abs_Lat_Acc_STD_V_5 "Validator for the STD of the lateral ground acceleration of the object.";
CM_ SG_ 154 OBJ_Abs_Acceleration_5 "The absolute ground acceleration in the target's heading direction.";
CM_ SG_ 154 OBJ_Abs_Acceleration_V_5 "Validator for the absolute ground acceleration.";
CM_ SG_ 154 OBJ_Abs_Acc_STD_5 "STD of the absolute ground acceleration.";
CM_ SG_ 154 OBJ_Abs_Acc_STD_V_5 "Validator for the STD of the absolute ground acceleration.";
CM_ SG_ 154 OBJ_Inv_TTC_5 "Inverse TTC (time to collision).";
CM_ SG_ 154 OBJ_Inv_TTC_STD_5 "STD for inverse TTC .";
CM_ SG_ 154 OBJ_Inv_TTC_STD_V_5 "Validator for the STD for inverse TTC .";
CM_ SG_ 154 OBJ_Relative_Long_Acc_5 "The relative longitudinal ground acceleration of the object.";
CM_ SG_ 154 OBJ_Relative_Long_Acc_V_5 "Validator for the relative longitudinal ground acceleration of the object.";
CM_ SG_ 154 OBJ_Relative_Long_Acc_STD_5 "STD of the relative longitudinal ground acceleration of the object.";
CM_ SG_ 154 OBJ_Rel_Long_Acc_STD_V_5 "Validator for the STD of the relative longitudinal ground acceleration.";
CM_ SG_ 154 OBJ_Relative_Long_Velocity_5 "The relative longtitudinal speed between the target and ego vehicle. ";
CM_ SG_ 154 OBJ_Relative_Long_Velocity_V_5 "Validator for the relative longtitudinal speed.";
CM_ SG_ 154 OBJ_Relative_Long_Vel_STD_5 "STD of the relative longtitudinal speed.";
CM_ SG_ 154 OBJ_Rel_Long_Vel_STD_V_5 "Validator for the STD of the relative longtitudinal speed.";
CM_ SG_ 154 OBJ_Relative_Lat_Velocity_5 "The relative lateral speed between the target and ego vehicle. ";
CM_ SG_ 154 OBJ_Relative_Lat_Velocity_V_5 "Validator for the relative lateral speed. ";
CM_ SG_ 154 OBJ_Relative_Lat_Velocity_STD_5 "STD of the relative lateral speed. ";
CM_ SG_ 154 OBJ_Rel_Lat_Vel_STD_V_5 "Validator for the STD of the relative lateral speed. ";
CM_ SG_ 154 OBJ_Long_Distance_5 "The longitudinal distance to middle of the rear bumper (middle of the RL and RR corners) of the target.";
CM_ SG_ 154 OBJ_Long_Distance_V_5 "Validator of the longtitudinal distance field";
CM_ SG_ 154 OBJ_Long_Distance_STD_5 "STD of the  longtitudinal distance.";
CM_ SG_ 154 OBJ_Long_Distance_STD_V_5 "Validator for the STD of the  longtitudinal distance.";
CM_ SG_ 154 OBJ_Lat_Distance_5 "Lateral distance to the middle of the RL and RR corners.  ";
CM_ SG_ 154 OBJ_Lat_Distance_V_5 "Validator for the lateral distance of the object.";
CM_ SG_ 154 OBJ_Lat_Distance_STD_5 "STD of the lateral distance of the object.";
CM_ SG_ 154 OBJ_Lat_Distance_STD_V_5 "Validator for the STD of the lateral distance of the object.";
CM_ SG_ 154 OBJ_Absolute_Speed_5 "The absolute ground speed in the targets' heading direction.";
CM_ SG_ 154 OBJ_Absolute_Speed_V_5 "Validator for the absolute ground speed.";
CM_ SG_ 154 OBJ_Absolute_Speed_STD_5 "STD of the absolute ground speed.";
CM_ SG_ 154 OBJ_Absolute_Speed_STD_V_5 "Validator for the STD of the absolute ground speed.";
CM_ SG_ 154 OBJ_Heading_5 "The angle beetweenthe host longitudinal axis and target's heading (clockwise, e.g. PI/2 is a target crossing from left to right).";
CM_ SG_ 154 OBJ_Heading_V_5 "Validator for the object heading.";
CM_ SG_ 154 OBJ_Heading_STD_5 "STD of the object heading.";
CM_ SG_ 154 OBJ_Heading_STD_V_5 "Validator for the STD of the object heading.";
CM_ SG_ 154 OBJ_Angle_Rate_STD_5 "Standard deviation of the angular speed. (radians)";
CM_ SG_ 154 OBJ_Angle_Rate_STD_V_5 "Validator for the STD of the angular speed.";
CM_ SG_ 154 OBJ_Angle_Rate_5 "The momentary angular speed of the object (radians). The positive side is to the host's right.";
CM_ SG_ 154 OBJ_Angle_Rate_V_5 "Validator for the angular speed.";
CM_ SG_ 154 OBJ_Angle_Right_5 "The angle between the host longitudinal axis and the right side of the front / rear of the target (the visible one). The positive side is to the host's right.";
CM_ SG_ 154 OBJ_Angle_Right_V_5 "Validator for angleRight";

BA_DEF_  "BusType" STRING ;
BA_DEF_ SG_  "GenSigStartValue" INT 0 0;
BA_DEF_DEF_  "GenSigStartValue" 0;
BA_DEF_DEF_  "BusType" "Ethernet";

BA_ "GenSigStartValue" SG_ 154 OBJ_Protocol_Version 15;
BA_ "GenSigStartValue" SG_ 154 OBJ_Width_0 40;
BA_ "GenSigStartValue" SG_ 154 OBJ_Length_0 12;
BA_ "GenSigStartValue" SG_ 154 OBJ_Width_1 40;
BA_ "GenSigStartValue" SG_ 154 OBJ_Length_1 12;
BA_ "GenSigStartValue" SG_ 154 OBJ_Width_2 40;
BA_ "GenSigStartValue" SG_ 154 OBJ_Length_2 12;
BA_ "GenSigStartValue" SG_ 154 OBJ_Width_3 40;
BA_ "GenSigStartValue" SG_ 154 OBJ_Length_3 12;
BA_ "GenSigStartValue" SG_ 154 OBJ_Width_4 40;
BA_ "GenSigStartValue" SG_ 154 OBJ_Length_4 12;
BA_ "GenSigStartValue" SG_ 154 OBJ_Width_5 40;
BA_ "GenSigStartValue" SG_ 154 OBJ_Length_5 12;

VAL_ 154 OBJ_VD_CIPV_Lost 2 "LOST_TARGET_FOV_IN" 1 "LOST_TARGET_FOV_OUT" 0 "NO_LOSS" ;
VAL_ 154 OBJ_VD_Allow_Acc 2 "FREE_SPACE_UNKNOWN" 1 "SPACE_NOT_FREE" 0 "FREE_SPACE" ;
VAL_ 154 OBJ_Is_Blocked_Left 1 "TRUE" 0 "FALSE" ;
VAL_ 154 OBJ_Is_Blocked_Right 1 "TRUE" 0 "FALSE" ;
VAL_ 154 OBJ_CIPBIC_Lost 2 "LOST_TARGET_FOV_IN" 1 "LOST_TARGET_FOV_OUT" 0 "NO_LOSS" ;
VAL_ 154 OBJ_Fusion_Source_0 2 "(BIT_2)RADAR2" 1 "(BIT_1)RADAR1" 0 "(BIT_0)CAMERA" ;
VAL_ 154 OBJ_Triggered_SDM_0 2 "NOT_TRIGGERED" 1 "TRIGGERED" 0 "NOT_AVAILABLE" ;
VAL_ 154 OBJ_Motion_Category_0 13 "ONCOMING" 12 "PRECEEDING" 11 "MOVING" 10 "RTAP" 9 "LTAP" 8 "CROSSING" 7 "MOVING_OUT" 6 "MOVING_IN" 5 "CLOSE_CUT_IN" 4 "PASSING_OUT" 3 "PASSING_IN" 2 "PASSING" 1 "UNDEFINED" 0 "UNFILLED" ;
VAL_ 154 OBJ_Measuring_Status_0 2 "(BIT_2)NOT_VALID_OR_VALID" 1 "(BIT_1)PREDICTED_OR_MEASURED" 0 "(BIT_0)OLD_OR_NEW" ;
VAL_ 154 OBJ_Object_Class_0 9 "TWO_WHEELER" 8 "UNCERTAIN_VCL" 7 "ANIMAL" 6 "GENERAL_OBJECT" 5 "PEDESTRIAN" 4 "BICYCLE" 3 "MOTORBIKE" 2 "TRUCK" 1 "CAR" 0 "UNFILLED" ;
VAL_ 154 OBJ_Camera_Source_0 11 "PARKING_RIGHT" 10 "PARKING_LEFT" 9 "PARKING_REAR" 8 "PARKING_FRONT" 7 "FRONT_CORNER_RIGHT" 6 "FRONT_CORNER_LEFT" 5 "REAR_CORNER_RIGHT" 4 "REAR_CORNER_LEFT" 3 "REAR" 2 "FRONT_FISHEYE" 1 "FRONT_NARROW" 0 "FRONT_MAIN" ;
VAL_ 154 OBJ_Motion_Status_0 5 "MOVING_SLOWLY" 4 "STOPPED" 3 "STATIONARY" 2 "MOVING" 1 "UNKNOWN" 0 "INVALID" ;
VAL_ 154 OBJ_Motion_Orientation_0 13 "INVALID" 12 "NORTH" 11 "NORTH_WEST" 9 "WEST" 7 "SOUTH_WEST" 6 "SOUTH" 5 "SOUTH_EAST" 3 "EAST" 1 "NORTH_EAST" 0 "UNKNOWN" ;
VAL_ 154 OBJ_Has_Cut_Lane_0 1 "TRUE" 0 "FALSE" ;
VAL_ 154 OBJ_Has_Cut_Path_0 1 "TRUE" 0 "FALSE" ;
VAL_ 154 OBJ_Brake_Light_Validity_0 1 "TRUE" 0 "FALSE" ;
VAL_ 154 OBJ_Brake_Light_0 1 "TRUE" 0 "FALSE" ;
VAL_ 154 OBJ_Turn_Indicator_Right_0 1 "TRUE" 0 "FALSE" ;
VAL_ 154 OBJ_Turn_Indicator_Left_0 1 "TRUE" 0 "FALSE" ;
VAL_ 154 OBJ_Turn_Indicator_Validity_0 1 "TRUE" 0 "FALSE" ;
VAL_ 154 OBJ_Right_Out_Of_Image_0 1 "TRUE" 0 "FALSE" ;
VAL_ 154 OBJ_Left_Out_Of_Image_0 1 "TRUE" 0 "FALSE" ;
VAL_ 154 OBJ_Right_Out_Of_Image_V_0 1 "TRUE" 0 "FALSE" ;
VAL_ 154 OBJ_Left_Out_Of_Image_V_0 1 "TRUE" 0 "FALSE" ;
VAL_ 154 OBJ_Top_Out_Of_Image_0 1 "TRUE" 0 "FALSE" ;
VAL_ 154 OBJ_Bottom_Out_Of_Image_0 1 "TRUE" 0 "FALSE" ;
VAL_ 154 OBJ_Top_Out_Of_Image_V_0 1 "VALID" 0 "INVALID" ;
VAL_ 154 OBJ_Bottom_Out_Of_Image_V_0 1 "VALID" 0 "INVALID" ;
VAL_ 154 OBJ_Lane_Assignment_0 5 "RIGHT_RIGHT" 4 "RIGHT" 3 "HOST" 2 "LEFT" 1 "LEFT_LEFT" 0 "UNKNOWN" ;
VAL_ 154 OBJ_Lane_Assignment_V_0 1 "VALID" 0 "INVALID" ;
VAL_ 154 OBJ_Age_Seconds_V_0 1 "VALID" 0 "INVALID" ;
VAL_ 154 OBJ_Width_V_0 1 "VALID" 0 "INVALID" ;
VAL_ 154 OBJ_Width_STD_V_0 1 "VALID" 0 "INVALID" ;
VAL_ 154 OBJ_Length_V_0 1 "VALID" 0 "INVALID" ;
VAL_ 154 OBJ_Length_STD_V_0 1 "VALID" 0 "INVALID" ;
VAL_ 154 OBJ_Height_V_0 1 "VALID" 0 "INVALID" ;
VAL_ 154 OBJ_Height_STD_V_0 1 "VALID" 0 "INVALID" ;
VAL_ 154 OBJ_Abs_Long_Velocity_V_0 1 "VALID" 0 "INVALID" ;
VAL_ 154 OBJ_Abs_Long_Vel_STD_V_0 1 "VALID" 0 "INVALID" ;
VAL_ 154 OBJ_Abs_Lat_Velocity_V_0 1 "VALID" 0 "INVALID" ;
VAL_ 154 OBJ_Abs_Lat_Vel_STD_V_0 1 "VALID" 0 "INVALID" ;
VAL_ 154 OBJ_Abs_Long_Acc_V_0 1 "VALID" 0 "INVALID" ;
VAL_ 154 OBJ_Abs_Long_Acc_STD_V_0 1 "VALID" 0 "INVALID" ;
VAL_ 154 OBJ_Abs_Lat_Acc_V_0 1 "VALID" 0 "INVALID" ;
VAL_ 154 OBJ_Abs_Lat_Acc_STD_V_0 1 "VALID" 0 "INVALID" ;
VAL_ 154 OBJ_Abs_Acceleration_V_0 1 "VALID" 0 "INVALID" ;
VAL_ 154 OBJ_Abs_Acc_STD_V_0 1 "VALID" 0 "INVALID" ;
VAL_ 154 OBJ_Inv_TTC_V_0 1 "VALID" 0 "INVALID" ;
VAL_ 154 OBJ_Inv_TTC_STD_V_0 1 "VALID" 0 "INVALID" ;
VAL_ 154 OBJ_Relative_Long_Acc_V_0 1 "VALID" 0 "INVALID" ;
VAL_ 154 OBJ_Rel_Long_Acc_STD_V_0 1 "VALID" 0 "INVALID" ;
VAL_ 154 OBJ_Relative_Long_Velocity_V_0 1 "VALID" 0 "INVALID" ;
VAL_ 154 OBJ_Rel_Long_Vel_STD_V_0 1 "VALID" 0 "INVALID" ;
VAL_ 154 OBJ_Relative_Lat_Velocity_V_0 1 "VALID" 0 "INVALID" ;
VAL_ 154 OBJ_Rel_Lat_Vel_STD_V_0 1 "VALID" 0 "INVALID" ;
VAL_ 154 OBJ_Long_Distance_V_0 1 "VALID" 0 "INVALID" ;
VAL_ 154 OBJ_Long_Distance_STD_V_0 1 "VALID" 0 "INVALID" ;
VAL_ 154 OBJ_Lat_Distance_V_0 1 "VALID" 0 "INVALID" ;
VAL_ 154 OBJ_Lat_Distance_STD_V_0 1 "VALID" 0 "INVALID" ;
VAL_ 154 OBJ_Absolute_Speed_V_0 1 "VALID" 0 "INVALID" ;
VAL_ 154 OBJ_Absolute_Speed_STD_V_0 1 "VALID" 0 "INVALID" ;
VAL_ 154 OBJ_Heading_V_0 1 "VALID" 0 "INVALID" ;
VAL_ 154 OBJ_Heading_STD_V_0 1 "VALID" 0 "INVALID" ;
VAL_ 154 OBJ_Angle_Rate_STD_V_0 1 "VALID" 0 "INVALID" ;
VAL_ 154 OBJ_Angle_Rate_V_0 1 "VALID" 0 "INVALID" ;
VAL_ 154 OBJ_Angle_Right_V_0 1 "VALID" 0 "INVALID" ;
VAL_ 154 OBJ_Angle_Right_STD_V_0 1 "VALID" 0 "INVALID" ;
VAL_ 154 OBJ_Angle_Left_V_0 1 "VALID" 0 "INVALID" ;
VAL_ 154 OBJ_Angle_Left_STD_V_0 1 "VALID" 0 "INVALID" ;
VAL_ 154 OBJ_Angle_Side_V_0 1 "VALID" 0 "INVALID" ;
VAL_ 154 OBJ_Angle_Side_STD_V_0 1 "VALID" 0 "INVALID" ;
VAL_ 154 OBJ_Angle_Mid_V_0 1 "VALID" 0 "INVALID" ;
VAL_ 154 OBJ_Angle_Mid_STD_V_0 1 "VALID" 0 "INVALID" ;
VAL_ 154 OBJ_Angle_Bottom_V_0 1 "VALID" 0 "INVALID" ;
VAL_ 154 OBJ_Angle_Bottom_STD_V_0 1 "VALID" 0 "INVALID" ;
VAL_ 154 OBJ_Visibility_Side_V_0 1 "VALID" 0 "INVALID" ;
VAL_ 154 OBJ_Visibility_Side_0 2 "REAR" 1 "FRONT" 0 "NOT_VISIBLE" ;
VAL_ 154 OBJ_Is_In_Drivable_Area_0 1 "TRUE" 0 "FALSE" ;
VAL_ 154 OBJ_Is_In_Drivable_Area_V_0 1 "VALID" 0 "INVALID" ;
VAL_ 154 OBJ_Is_VeryClose_V_0 1 "VALID" 0 "INVALID" ;
VAL_ 154 OBJ_Is_VeryClose_0 1 "TRUE" 0 "FALSE" ;
VAL_ 154 OBJ_OverlapAngleEgoLaneR_V_0 1 "VALID" 0 "INVALID" ;
VAL_ 154 OBJ_OverlapAngleEgoLaneL_V_0 1 "VALID" 0 "INVALID" ;
VAL_ 154 OBJ_Is_EMERGENCY_VCL_0 1 "TRUE" 0 "FALSE" ;
VAL_ 154 OBJ_EMERGENCY_LIGHT_COLOR_0 3 "(1000)ORANGE" 2 "(0100)BLUE" 1 "(0010)RED" 0 "(0001)OTHER" ;
VAL_ 154 OBJ_EMERGENCY_V_0 1 "TRUE" 0 "FALSE" ;
VAL_ 154 OBJ_Angle_Top_V_0 1 "VALID" 0 "INVALID" ;
VAL_ 154 OBJ_Angle_Top_STD_V_0 1 "VALID" 0 "INVALID" ;
VAL_ 154 OBJ_Open_Door_Left_0 1 "TRUE" 0 "FALSE" ;
VAL_ 154 OBJ_Open_Door_Right_0 1 "TRUE" 0 "FALSE" ;
VAL_ 154 OBJ_Visible_Left_or_Right_0 2 "RIGHT" 1 "LEFT" 0 "NOT_VISIBLE" ;
VAL_ 154 OBJ_Visible_Left_or_Right_V_0 1 "VALID" 0 "INVALID" ;
VAL_ 154 OBJ_Fusion_Source_1 2 "(BIT_2)RADAR2" 1 "(BIT_1)RADAR1" 0 "(BIT_0)CAMERA" ;
VAL_ 154 OBJ_Triggered_SDM_1 2 "NOT_TRIGGERED" 1 "TRIGGERED" 0 "NOT_AVAILABLE" ;
VAL_ 154 OBJ_Motion_Category_1 13 "ONCOMING" 12 "PRECEEDING" 11 "MOVING" 10 "RTAP" 9 "LTAP" 8 "CROSSING" 7 "MOVING_OUT" 6 "MOVING_IN" 5 "CLOSE_CUT_IN" 4 "PASSING_OUT" 3 "PASSING_IN" 2 "PASSING" 1 "UNDEFINED" 0 "UNFILLED" ;
VAL_ 154 OBJ_Measuring_Status_1 2 "(BIT_2)NOT_VALID_OR_VALID" 1 "(BIT_1)PREDICTED_OR_MEASURED" 0 "(BIT_0)OLD_OR_NEW" ;
VAL_ 154 OBJ_Object_Class_1 9 "TWO_WHEELER" 8 "UNCERTAIN_VCL" 7 "ANIMAL" 6 "GENERAL_OBJECT" 5 "PEDESTRIAN" 4 "BICYCLE" 3 "MOTORBIKE" 2 "TRUCK" 1 "CAR" 0 "UNFILLED" ;
VAL_ 154 OBJ_Camera_Source_1 11 "PARKING_RIGHT" 10 "PARKING_LEFT" 9 "PARKING_REAR" 8 "PARKING_FRONT" 7 "FRONT_CORNER_RIGHT" 6 "FRONT_CORNER_LEFT" 5 "REAR_CORNER_RIGHT" 4 "REAR_CORNER_LEFT" 3 "REAR" 2 "FRONT_FISHEYE" 1 "FRONT_NARROW" 0 "FRONT_MAIN" ;
VAL_ 154 OBJ_Motion_Status_1 5 "MOVING_SLOWLY" 4 "STOPPED" 3 "STATIONARY" 2 "MOVING" 1 "UNKNOWN" 0 "INVALID" ;
VAL_ 154 OBJ_Motion_Orientation_1 13 "INVALID" 12 "NORTH" 11 "NORTH_WEST" 9 "WEST" 7 "SOUTH_WEST" 6 "SOUTH" 5 "SOUTH_EAST" 3 "EAST" 1 "NORTH_EAST" 0 "UNKNOWN" ;
VAL_ 154 OBJ_Has_Cut_Lane_1 1 "TRUE" 0 "FALSE" ;
VAL_ 154 OBJ_Has_Cut_Path_1 1 "TRUE" 0 "FALSE" ;
VAL_ 154 OBJ_Brake_Light_Validity_1 1 "TRUE" 0 "FALSE" ;
VAL_ 154 OBJ_Brake_Light_1 1 "TRUE" 0 "FALSE" ;
VAL_ 154 OBJ_Turn_Indicator_Right_1 1 "TRUE" 0 "FALSE" ;
VAL_ 154 OBJ_Turn_Indicator_Left_1 1 "TRUE" 0 "FALSE" ;
VAL_ 154 OBJ_Turn_Indicator_Validity_1 1 "TRUE" 0 "FALSE" ;
VAL_ 154 OBJ_Right_Out_Of_Image_1 1 "TRUE" 0 "FALSE" ;
VAL_ 154 OBJ_Left_Out_Of_Image_1 1 "TRUE" 0 "FALSE" ;
VAL_ 154 OBJ_Right_Out_Of_Image_V_1 1 "TRUE" 0 "FALSE" ;
VAL_ 154 OBJ_Left_Out_Of_Image_V_1 1 "TRUE" 0 "FALSE" ;
VAL_ 154 OBJ_Top_Out_Of_Image_1 1 "TRUE" 0 "FALSE" ;
VAL_ 154 OBJ_Bottom_Out_Of_Image_1 1 "TRUE" 0 "FALSE" ;
VAL_ 154 OBJ_Top_Out_Of_Image_V_1 1 "VALID" 0 "INVALID" ;
VAL_ 154 OBJ_Bottom_Out_Of_Image_V_1 1 "VALID" 0 "INVALID" ;
VAL_ 154 OBJ_Lane_Assignment_1 5 "RIGHT_RIGHT" 4 "RIGHT" 3 "HOST" 2 "LEFT" 1 "LEFT_LEFT" 0 "UNKNOWN" ;
VAL_ 154 OBJ_Lane_Assignment_V_1 1 "VALID" 0 "INVALID" ;
VAL_ 154 OBJ_Age_Seconds_V_1 1 "VALID" 0 "INVALID" ;
VAL_ 154 OBJ_Width_V_1 1 "VALID" 0 "INVALID" ;
VAL_ 154 OBJ_Width_STD_V_1 1 "VALID" 0 "INVALID" ;
VAL_ 154 OBJ_Length_V_1 1 "VALID" 0 "INVALID" ;
VAL_ 154 OBJ_Length_STD_V_1 1 "VALID" 0 "INVALID" ;
VAL_ 154 OBJ_Height_V_1 1 "VALID" 0 "INVALID" ;
VAL_ 154 OBJ_Height_STD_V_1 1 "VALID" 0 "INVALID" ;
VAL_ 154 OBJ_Abs_Long_Velocity_V_1 1 "VALID" 0 "INVALID" ;
VAL_ 154 OBJ_Abs_Long_Vel_STD_V_1 1 "VALID" 0 "INVALID" ;
VAL_ 154 OBJ_Abs_Lat_Velocity_V_1 1 "VALID" 0 "INVALID" ;
VAL_ 154 OBJ_Abs_Lat_Vel_STD_V_1 1 "VALID" 0 "INVALID" ;
VAL_ 154 OBJ_Abs_Long_Acc_V_1 1 "VALID" 0 "INVALID" ;
VAL_ 154 OBJ_Abs_Long_Acc_STD_V_1 1 "VALID" 0 "INVALID" ;
VAL_ 154 OBJ_Abs_Lat_Acc_V_1 1 "VALID" 0 "INVALID" ;
VAL_ 154 OBJ_Abs_Lat_Acc_STD_V_1 1 "VALID" 0 "INVALID" ;
VAL_ 154 OBJ_Abs_Acceleration_V_1 1 "VALID" 0 "INVALID" ;
VAL_ 154 OBJ_Abs_Acc_STD_V_1 1 "VALID" 0 "INVALID" ;
VAL_ 154 OBJ_Inv_TTC_V_1 1 "VALID" 0 "INVALID" ;
VAL_ 154 OBJ_Inv_TTC_STD_V_1 1 "VALID" 0 "INVALID" ;
VAL_ 154 OBJ_Relative_Long_Acc_V_1 1 "VALID" 0 "INVALID" ;
VAL_ 154 OBJ_Rel_Long_Acc_STD_V_1 1 "VALID" 0 "INVALID" ;
VAL_ 154 OBJ_Relative_Long_Velocity_V_1 1 "VALID" 0 "INVALID" ;
VAL_ 154 OBJ_Rel_Long_Vel_STD_V_1 1 "VALID" 0 "INVALID" ;
VAL_ 154 OBJ_Relative_Lat_Velocity_V_1 1 "VALID" 0 "INVALID" ;
VAL_ 154 OBJ_Rel_Lat_Vel_STD_V_1 1 "VALID" 0 "INVALID" ;
VAL_ 154 OBJ_Long_Distance_V_1 1 "VALID" 0 "INVALID" ;
VAL_ 154 OBJ_Long_Distance_STD_V_1 1 "VALID" 0 "INVALID" ;
VAL_ 154 OBJ_Lat_Distance_V_1 1 "VALID" 0 "INVALID" ;
VAL_ 154 OBJ_Lat_Distance_STD_V_1 1 "VALID" 0 "INVALID" ;
VAL_ 154 OBJ_Absolute_Speed_V_1 1 "VALID" 0 "INVALID" ;
VAL_ 154 OBJ_Absolute_Speed_STD_V_1 1 "VALID" 0 "INVALID" ;
VAL_ 154 OBJ_Heading_V_1 1 "VALID" 0 "INVALID" ;
VAL_ 154 OBJ_Heading_STD_V_1 1 "VALID" 0 "INVALID" ;
VAL_ 154 OBJ_Angle_Rate_STD_V_1 1 "VALID" 0 "INVALID" ;
VAL_ 154 OBJ_Angle_Rate_V_1 1 "VALID" 0 "INVALID" ;
VAL_ 154 OBJ_Angle_Right_V_1 1 "VALID" 0 "INVALID" ;
VAL_ 154 OBJ_Angle_Right_STD_V_1 1 "VALID" 0 "INVALID" ;
VAL_ 154 OBJ_Angle_Left_V_1 1 "VALID" 0 "INVALID" ;
VAL_ 154 OBJ_Angle_Left_STD_V_1 1 "VALID" 0 "INVALID" ;
VAL_ 154 OBJ_Angle_Side_V_1 1 "VALID" 0 "INVALID" ;
VAL_ 154 OBJ_Angle_Side_STD_V_1 1 "VALID" 0 "INVALID" ;
VAL_ 154 OBJ_Angle_Mid_V_1 1 "VALID" 0 "INVALID" ;
VAL_ 154 OBJ_Angle_Mid_STD_V_1 1 "VALID" 0 "INVALID" ;
VAL_ 154 OBJ_Angle_Bottom_V_1 1 "VALID" 0 "INVALID" ;
VAL_ 154 OBJ_Angle_Bottom_STD_V_1 1 "VALID" 0 "INVALID" ;
VAL_ 154 OBJ_Visibility_Side_V_1 1 "VALID" 0 "INVALID" ;
VAL_ 154 OBJ_Visibility_Side_1 2 "REAR" 1 "FRONT" 0 "NOT_VISIBLE" ;
VAL_ 154 OBJ_Is_In_Drivable_Area_1 1 "TRUE" 0 "FALSE" ;
VAL_ 154 OBJ_Is_In_Drivable_Area_V_1 1 "VALID" 0 "INVALID" ;
VAL_ 154 OBJ_Is_VeryClose_V_1 1 "VALID" 0 "INVALID" ;
VAL_ 154 OBJ_Is_VeryClose_1 1 "TRUE" 0 "FALSE" ;
VAL_ 154 OBJ_OverlapAngleEgoLaneR_V_1 1 "VALID" 0 "INVALID" ;
VAL_ 154 OBJ_OverlapAngleEgoLaneL_V_1 1 "VALID" 0 "INVALID" ;
VAL_ 154 OBJ_Is_EMERGENCY_VCL_1 1 "TRUE" 0 "FALSE" ;
VAL_ 154 OBJ_EMERGENCY_LIGHT_COLOR_1 3 "(1000)ORANGE" 2 "(0100)BLUE" 1 "(0010)RED" 0 "(0001)OTHER" ;
VAL_ 154 OBJ_EMERGENCY_V_1 1 "TRUE" 0 "FALSE" ;
VAL_ 154 OBJ_Angle_Top_V_1 1 "VALID" 0 "INVALID" ;
VAL_ 154 OBJ_Angle_Top_STD_V_1 1 "VALID" 0 "INVALID" ;
VAL_ 154 OBJ_Open_Door_Left_1 1 "TRUE" 0 "FALSE" ;
VAL_ 154 OBJ_Open_Door_Right_1 1 "TRUE" 0 "FALSE" ;
VAL_ 154 OBJ_Visible_Left_or_Right_1 2 "RIGHT" 1 "LEFT" 0 "NOT_VISIBLE" ;
VAL_ 154 OBJ_Visible_Left_or_Right_V_1 1 "VALID" 0 "INVALID" ;
VAL_ 154 OBJ_Fusion_Source_2 2 "(BIT_2)RADAR2" 1 "(BIT_1)RADAR1" 0 "(BIT_0)CAMERA" ;
VAL_ 154 OBJ_Triggered_SDM_2 2 "NOT_TRIGGERED" 1 "TRIGGERED" 0 "NOT_AVAILABLE" ;
VAL_ 154 OBJ_Motion_Category_2 13 "ONCOMING" 12 "PRECEEDING" 11 "MOVING" 10 "RTAP" 9 "LTAP" 8 "CROSSING" 7 "MOVING_OUT" 6 "MOVING_IN" 5 "CLOSE_CUT_IN" 4 "PASSING_OUT" 3 "PASSING_IN" 2 "PASSING" 1 "UNDEFINED" 0 "UNFILLED" ;
VAL_ 154 OBJ_Measuring_Status_2 2 "(BIT_2)NOT_VALID_OR_VALID" 1 "(BIT_1)PREDICTED_OR_MEASURED" 0 "(BIT_0)OLD_OR_NEW" ;
VAL_ 154 OBJ_Object_Class_2 9 "TWO_WHEELER" 8 "UNCERTAIN_VCL" 7 "ANIMAL" 6 "GENERAL_OBJECT" 5 "PEDESTRIAN" 4 "BICYCLE" 3 "MOTORBIKE" 2 "TRUCK" 1 "CAR" 0 "UNFILLED" ;
VAL_ 154 OBJ_Camera_Source_2 11 "PARKING_RIGHT" 10 "PARKING_LEFT" 9 "PARKING_REAR" 8 "PARKING_FRONT" 7 "FRONT_CORNER_RIGHT" 6 "FRONT_CORNER_LEFT" 5 "REAR_CORNER_RIGHT" 4 "REAR_CORNER_LEFT" 3 "REAR" 2 "FRONT_FISHEYE" 1 "FRONT_NARROW" 0 "FRONT_MAIN" ;
VAL_ 154 OBJ_Motion_Status_2 5 "MOVING_SLOWLY" 4 "STOPPED" 3 "STATIONARY" 2 "MOVING" 1 "UNKNOWN" 0 "INVALID" ;
VAL_ 154 OBJ_Motion_Orientation_2 13 "INVALID" 12 "NORTH" 11 "NORTH_WEST" 9 "WEST" 7 "SOUTH_WEST" 6 "SOUTH" 5 "SOUTH_EAST" 3 "EAST" 1 "NORTH_EAST" 0 "UNKNOWN" ;
VAL_ 154 OBJ_Has_Cut_Lane_2 1 "TRUE" 0 "FALSE" ;
VAL_ 154 OBJ_Has_Cut_Path_2 1 "TRUE" 0 "FALSE" ;
VAL_ 154 OBJ_Brake_Light_Validity_2 1 "TRUE" 0 "FALSE" ;
VAL_ 154 OBJ_Brake_Light_2 1 "TRUE" 0 "FALSE" ;
VAL_ 154 OBJ_Turn_Indicator_Right_2 1 "TRUE" 0 "FALSE" ;
VAL_ 154 OBJ_Turn_Indicator_Left_2 1 "TRUE" 0 "FALSE" ;
VAL_ 154 OBJ_Turn_Indicator_Validity_2 1 "TRUE" 0 "FALSE" ;
VAL_ 154 OBJ_Right_Out_Of_Image_2 1 "TRUE" 0 "FALSE" ;
VAL_ 154 OBJ_Left_Out_Of_Image_2 1 "TRUE" 0 "FALSE" ;
VAL_ 154 OBJ_Right_Out_Of_Image_V_2 1 "TRUE" 0 "FALSE" ;
VAL_ 154 OBJ_Left_Out_Of_Image_V_2 1 "TRUE" 0 "FALSE" ;
VAL_ 154 OBJ_Top_Out_Of_Image_2 1 "TRUE" 0 "FALSE" ;
VAL_ 154 OBJ_Bottom_Out_Of_Image_2 1 "TRUE" 0 "FALSE" ;
VAL_ 154 OBJ_Top_Out_Of_Image_V_2 1 "VALID" 0 "INVALID" ;
VAL_ 154 OBJ_Bottom_Out_Of_Image_V_2 1 "VALID" 0 "INVALID" ;
VAL_ 154 OBJ_Lane_Assignment_2 5 "RIGHT_RIGHT" 4 "RIGHT" 3 "HOST" 2 "LEFT" 1 "LEFT_LEFT" 0 "UNKNOWN" ;
VAL_ 154 OBJ_Lane_Assignment_V_2 1 "VALID" 0 "INVALID" ;
VAL_ 154 OBJ_Age_Seconds_V_2 1 "VALID" 0 "INVALID" ;
VAL_ 154 OBJ_Width_V_2 1 "VALID" 0 "INVALID" ;
VAL_ 154 OBJ_Width_STD_V_2 1 "VALID" 0 "INVALID" ;
VAL_ 154 OBJ_Length_V_2 1 "VALID" 0 "INVALID" ;
VAL_ 154 OBJ_Length_STD_V_2 1 "VALID" 0 "INVALID" ;
VAL_ 154 OBJ_Height_V_2 1 "VALID" 0 "INVALID" ;
VAL_ 154 OBJ_Height_STD_V_2 1 "VALID" 0 "INVALID" ;
VAL_ 154 OBJ_Abs_Long_Velocity_V_2 1 "VALID" 0 "INVALID" ;
VAL_ 154 OBJ_Abs_Long_Vel_STD_V_2 1 "VALID" 0 "INVALID" ;
VAL_ 154 OBJ_Abs_Lat_Velocity_V_2 1 "VALID" 0 "INVALID" ;
VAL_ 154 OBJ_Abs_Lat_Vel_STD_V_2 1 "VALID" 0 "INVALID" ;
VAL_ 154 OBJ_Abs_Long_Acc_V_2 1 "VALID" 0 "INVALID" ;
VAL_ 154 OBJ_Abs_Long_Acc_STD_V_2 1 "VALID" 0 "INVALID" ;
VAL_ 154 OBJ_Abs_Lat_Acc_V_2 1 "VALID" 0 "INVALID" ;
VAL_ 154 OBJ_Abs_Lat_Acc_STD_V_2 1 "VALID" 0 "INVALID" ;
VAL_ 154 OBJ_Abs_Acceleration_V_2 1 "VALID" 0 "INVALID" ;
VAL_ 154 OBJ_Abs_Acc_STD_V_2 1 "VALID" 0 "INVALID" ;
VAL_ 154 OBJ_Inv_TTC_V_2 1 "VALID" 0 "INVALID" ;
VAL_ 154 OBJ_Inv_TTC_STD_V_2 1 "VALID" 0 "INVALID" ;
VAL_ 154 OBJ_Relative_Long_Acc_V_2 1 "VALID" 0 "INVALID" ;
VAL_ 154 OBJ_Rel_Long_Acc_STD_V_2 1 "VALID" 0 "INVALID" ;
VAL_ 154 OBJ_Relative_Long_Velocity_V_2 1 "VALID" 0 "INVALID" ;
VAL_ 154 OBJ_Rel_Long_Vel_STD_V_2 1 "VALID" 0 "INVALID" ;
VAL_ 154 OBJ_Relative_Lat_Velocity_V_2 1 "VALID" 0 "INVALID" ;
VAL_ 154 OBJ_Rel_Lat_Vel_STD_V_2 1 "VALID" 0 "INVALID" ;
VAL_ 154 OBJ_Long_Distance_V_2 1 "VALID" 0 "INVALID" ;
VAL_ 154 OBJ_Long_Distance_STD_V_2 1 "VALID" 0 "INVALID" ;
VAL_ 154 OBJ_Lat_Distance_V_2 1 "VALID" 0 "INVALID" ;
VAL_ 154 OBJ_Lat_Distance_STD_V_2 1 "VALID" 0 "INVALID" ;
VAL_ 154 OBJ_Absolute_Speed_V_2 1 "VALID" 0 "INVALID" ;
VAL_ 154 OBJ_Absolute_Speed_STD_V_2 1 "VALID" 0 "INVALID" ;
VAL_ 154 OBJ_Heading_V_2 1 "VALID" 0 "INVALID" ;
VAL_ 154 OBJ_Heading_STD_V_2 1 "VALID" 0 "INVALID" ;
VAL_ 154 OBJ_Angle_Rate_STD_V_2 1 "VALID" 0 "INVALID" ;
VAL_ 154 OBJ_Angle_Rate_V_2 1 "VALID" 0 "INVALID" ;
VAL_ 154 OBJ_Angle_Right_V_2 1 "VALID" 0 "INVALID" ;
VAL_ 154 OBJ_Angle_Right_STD_V_2 1 "VALID" 0 "INVALID" ;
VAL_ 154 OBJ_Angle_Left_V_2 1 "VALID" 0 "INVALID" ;
VAL_ 154 OBJ_Angle_Left_STD_V_2 1 "VALID" 0 "INVALID" ;
VAL_ 154 OBJ_Angle_Side_V_2 1 "VALID" 0 "INVALID" ;
VAL_ 154 OBJ_Angle_Side_STD_V_2 1 "VALID" 0 "INVALID" ;
VAL_ 154 OBJ_Angle_Mid_V_2 1 "VALID" 0 "INVALID" ;
VAL_ 154 OBJ_Angle_Mid_STD_V_2 1 "VALID" 0 "INVALID" ;
VAL_ 154 OBJ_Angle_Bottom_V_2 1 "VALID" 0 "INVALID" ;
VAL_ 154 OBJ_Angle_Bottom_STD_V_2 1 "VALID" 0 "INVALID" ;
VAL_ 154 OBJ_Visibility_Side_V_2 1 "VALID" 0 "INVALID" ;
VAL_ 154 OBJ_Visibility_Side_2 2 "REAR" 1 "FRONT" 0 "NOT_VISIBLE" ;
VAL_ 154 OBJ_Is_In_Drivable_Area_2 1 "TRUE" 0 "FALSE" ;
VAL_ 154 OBJ_Is_In_Drivable_Area_V_2 1 "VALID" 0 "INVALID" ;
VAL_ 154 OBJ_Is_VeryClose_V_2 1 "VALID" 0 "INVALID" ;
VAL_ 154 OBJ_Is_VeryClose_2 1 "TRUE" 0 "FALSE" ;
VAL_ 154 OBJ_OverlapAngleEgoLaneR_V_2 1 "VALID" 0 "INVALID" ;
VAL_ 154 OBJ_OverlapAngleEgoLaneL_V_2 1 "VALID" 0 "INVALID" ;
VAL_ 154 OBJ_Is_EMERGENCY_VCL_2 1 "TRUE" 0 "FALSE" ;
VAL_ 154 OBJ_EMERGENCY_LIGHT_COLOR_2 3 "(1000)ORANGE" 2 "(0100)BLUE" 1 "(0010)RED" 0 "(0001)OTHER" ;
VAL_ 154 OBJ_EMERGENCY_V_2 1 "TRUE" 0 "FALSE" ;
VAL_ 154 OBJ_Angle_Top_V_2 1 "VALID" 0 "INVALID" ;
VAL_ 154 OBJ_Angle_Top_STD_V_2 1 "VALID" 0 "INVALID" ;
VAL_ 154 OBJ_Open_Door_Left_2 1 "TRUE" 0 "FALSE" ;
VAL_ 154 OBJ_Open_Door_Right_2 1 "TRUE" 0 "FALSE" ;
VAL_ 154 OBJ_Visible_Left_or_Right_2 2 "RIGHT" 1 "LEFT" 0 "NOT_VISIBLE" ;
VAL_ 154 OBJ_Visible_Left_or_Right_V_2 1 "VALID" 0 "INVALID" ;
VAL_ 154 OBJ_Fusion_Source_3 2 "(BIT_2)RADAR2" 1 "(BIT_1)RADAR1" 0 "(BIT_0)CAMERA" ;
VAL_ 154 OBJ_Triggered_SDM_3 2 "NOT_TRIGGERED" 1 "TRIGGERED" 0 "NOT_AVAILABLE" ;
VAL_ 154 OBJ_Motion_Category_3 13 "ONCOMING" 12 "PRECEEDING" 11 "MOVING" 10 "RTAP" 9 "LTAP" 8 "CROSSING" 7 "MOVING_OUT" 6 "MOVING_IN" 5 "CLOSE_CUT_IN" 4 "PASSING_OUT" 3 "PASSING_IN" 2 "PASSING" 1 "UNDEFINED" 0 "UNFILLED" ;
VAL_ 154 OBJ_Measuring_Status_3 2 "(BIT_2)NOT_VALID_OR_VALID" 1 "(BIT_1)PREDICTED_OR_MEASURED" 0 "(BIT_0)OLD_OR_NEW" ;
VAL_ 154 OBJ_Object_Class_3 9 "TWO_WHEELER" 8 "UNCERTAIN_VCL" 7 "ANIMAL" 6 "GENERAL_OBJECT" 5 "PEDESTRIAN" 4 "BICYCLE" 3 "MOTORBIKE" 2 "TRUCK" 1 "CAR" 0 "UNFILLED" ;
VAL_ 154 OBJ_Camera_Source_3 11 "PARKING_RIGHT" 10 "PARKING_LEFT" 9 "PARKING_REAR" 8 "PARKING_FRONT" 7 "FRONT_CORNER_RIGHT" 6 "FRONT_CORNER_LEFT" 5 "REAR_CORNER_RIGHT" 4 "REAR_CORNER_LEFT" 3 "REAR" 2 "FRONT_FISHEYE" 1 "FRONT_NARROW" 0 "FRONT_MAIN" ;
VAL_ 154 OBJ_Motion_Status_3 5 "MOVING_SLOWLY" 4 "STOPPED" 3 "STATIONARY" 2 "MOVING" 1 "UNKNOWN" 0 "INVALID" ;
VAL_ 154 OBJ_Motion_Orientation_3 13 "INVALID" 12 "NORTH" 11 "NORTH_WEST" 9 "WEST" 7 "SOUTH_WEST" 6 "SOUTH" 5 "SOUTH_EAST" 3 "EAST" 1 "NORTH_EAST" 0 "UNKNOWN" ;
VAL_ 154 OBJ_Has_Cut_Lane_3 1 "TRUE" 0 "FALSE" ;
VAL_ 154 OBJ_Has_Cut_Path_3 1 "TRUE" 0 "FALSE" ;
VAL_ 154 OBJ_Brake_Light_Validity_3 1 "TRUE" 0 "FALSE" ;
VAL_ 154 OBJ_Brake_Light_3 1 "TRUE" 0 "FALSE" ;
VAL_ 154 OBJ_Turn_Indicator_Right_3 1 "TRUE" 0 "FALSE" ;
VAL_ 154 OBJ_Turn_Indicator_Left_3 1 "TRUE" 0 "FALSE" ;
VAL_ 154 OBJ_Turn_Indicator_Validity_3 1 "TRUE" 0 "FALSE" ;
VAL_ 154 OBJ_Right_Out_Of_Image_3 1 "TRUE" 0 "FALSE" ;
VAL_ 154 OBJ_Left_Out_Of_Image_3 1 "TRUE" 0 "FALSE" ;
VAL_ 154 OBJ_Right_Out_Of_Image_V_3 1 "TRUE" 0 "FALSE" ;
VAL_ 154 OBJ_Left_Out_Of_Image_V_3 1 "TRUE" 0 "FALSE" ;
VAL_ 154 OBJ_Top_Out_Of_Image_3 1 "TRUE" 0 "FALSE" ;
VAL_ 154 OBJ_Bottom_Out_Of_Image_3 1 "TRUE" 0 "FALSE" ;
VAL_ 154 OBJ_Top_Out_Of_Image_V_3 1 "VALID" 0 "INVALID" ;
VAL_ 154 OBJ_Bottom_Out_Of_Image_V_3 1 "VALID" 0 "INVALID" ;
VAL_ 154 OBJ_Lane_Assignment_3 5 "RIGHT_RIGHT" 4 "RIGHT" 3 "HOST" 2 "LEFT" 1 "LEFT_LEFT" 0 "UNKNOWN" ;
VAL_ 154 OBJ_Lane_Assignment_V_3 1 "VALID" 0 "INVALID" ;
VAL_ 154 OBJ_Age_Seconds_V_3 1 "VALID" 0 "INVALID" ;
VAL_ 154 OBJ_Width_V_3 1 "VALID" 0 "INVALID" ;
VAL_ 154 OBJ_Width_STD_V_3 1 "VALID" 0 "INVALID" ;
VAL_ 154 OBJ_Length_V_3 1 "VALID" 0 "INVALID" ;
VAL_ 154 OBJ_Length_STD_V_3 1 "VALID" 0 "INVALID" ;
VAL_ 154 OBJ_Height_V_3 1 "VALID" 0 "INVALID" ;
VAL_ 154 OBJ_Height_STD_V_3 1 "VALID" 0 "INVALID" ;
VAL_ 154 OBJ_Abs_Long_Velocity_V_3 1 "VALID" 0 "INVALID" ;
VAL_ 154 OBJ_Abs_Long_Vel_STD_V_3 1 "VALID" 0 "INVALID" ;
VAL_ 154 OBJ_Abs_Lat_Velocity_V_3 1 "VALID" 0 "INVALID" ;
VAL_ 154 OBJ_Abs_Lat_Vel_STD_V_3 1 "VALID" 0 "INVALID" ;
VAL_ 154 OBJ_Abs_Long_Acc_V_3 1 "VALID" 0 "INVALID" ;
VAL_ 154 OBJ_Abs_Long_Acc_STD_V_3 1 "VALID" 0 "INVALID" ;
VAL_ 154 OBJ_Abs_Lat_Acc_V_3 1 "VALID" 0 "INVALID" ;
VAL_ 154 OBJ_Abs_Lat_Acc_STD_V_3 1 "VALID" 0 "INVALID" ;
VAL_ 154 OBJ_Abs_Acceleration_V_3 1 "VALID" 0 "INVALID" ;
VAL_ 154 OBJ_Abs_Acc_STD_V_3 1 "VALID" 0 "INVALID" ;
VAL_ 154 OBJ_Inv_TTC_V_3 1 "VALID" 0 "INVALID" ;
VAL_ 154 OBJ_Inv_TTC_STD_V_3 1 "VALID" 0 "INVALID" ;
VAL_ 154 OBJ_Relative_Long_Acc_V_3 1 "VALID" 0 "INVALID" ;
VAL_ 154 OBJ_Rel_Long_Acc_STD_V_3 1 "VALID" 0 "INVALID" ;
VAL_ 154 OBJ_Relative_Long_Velocity_V_3 1 "VALID" 0 "INVALID" ;
VAL_ 154 OBJ_Rel_Long_Vel_STD_V_3 1 "VALID" 0 "INVALID" ;
VAL_ 154 OBJ_Relative_Lat_Velocity_V_3 1 "VALID" 0 "INVALID" ;
VAL_ 154 OBJ_Rel_Lat_Vel_STD_V_3 1 "VALID" 0 "INVALID" ;
VAL_ 154 OBJ_Long_Distance_V_3 1 "VALID" 0 "INVALID" ;
VAL_ 154 OBJ_Long_Distance_STD_V_3 1 "VALID" 0 "INVALID" ;
VAL_ 154 OBJ_Lat_Distance_V_3 1 "VALID" 0 "INVALID" ;
VAL_ 154 OBJ_Lat_Distance_STD_V_3 1 "VALID" 0 "INVALID" ;
VAL_ 154 OBJ_Absolute_Speed_V_3 1 "VALID" 0 "INVALID" ;
VAL_ 154 OBJ_Absolute_Speed_STD_V_3 1 "VALID" 0 "INVALID" ;
VAL_ 154 OBJ_Heading_V_3 1 "VALID" 0 "INVALID" ;
VAL_ 154 OBJ_Heading_STD_V_3 1 "VALID" 0 "INVALID" ;
VAL_ 154 OBJ_Angle_Rate_STD_V_3 1 "VALID" 0 "INVALID" ;
VAL_ 154 OBJ_Angle_Rate_V_3 1 "VALID" 0 "INVALID" ;
VAL_ 154 OBJ_Angle_Right_V_3 1 "VALID" 0 "INVALID" ;
VAL_ 154 OBJ_Angle_Right_STD_V_3 1 "VALID" 0 "INVALID" ;
VAL_ 154 OBJ_Angle_Left_V_3 1 "VALID" 0 "INVALID" ;
VAL_ 154 OBJ_Angle_Left_STD_V_3 1 "VALID" 0 "INVALID" ;
VAL_ 154 OBJ_Angle_Side_V_3 1 "VALID" 0 "INVALID" ;
VAL_ 154 OBJ_Angle_Side_STD_V_3 1 "VALID" 0 "INVALID" ;
VAL_ 154 OBJ_Angle_Mid_V_3 1 "VALID" 0 "INVALID" ;
VAL_ 154 OBJ_Angle_Mid_STD_V_3 1 "VALID" 0 "INVALID" ;
VAL_ 154 OBJ_Angle_Bottom_V_3 1 "VALID" 0 "INVALID" ;
VAL_ 154 OBJ_Angle_Bottom_STD_V_3 1 "VALID" 0 "INVALID" ;
VAL_ 154 OBJ_Visibility_Side_V_3 1 "VALID" 0 "INVALID" ;
VAL_ 154 OBJ_Visibility_Side_3 2 "REAR" 1 "FRONT" 0 "NOT_VISIBLE" ;
VAL_ 154 OBJ_Is_In_Drivable_Area_3 1 "TRUE" 0 "FALSE" ;
VAL_ 154 OBJ_Is_In_Drivable_Area_V_3 1 "VALID" 0 "INVALID" ;
VAL_ 154 OBJ_Is_VeryClose_V_3 1 "VALID" 0 "INVALID" ;
VAL_ 154 OBJ_Is_VeryClose_3 1 "TRUE" 0 "FALSE" ;
VAL_ 154 OBJ_OverlapAngleEgoLaneR_V_3 1 "VALID" 0 "INVALID" ;
VAL_ 154 OBJ_OverlapAngleEgoLaneL_V_3 1 "VALID" 0 "INVALID" ;
VAL_ 154 OBJ_Is_EMERGENCY_VCL_3 1 "TRUE" 0 "FALSE" ;
VAL_ 154 OBJ_EMERGENCY_LIGHT_COLOR_3 3 "(1000)ORANGE" 2 "(0100)BLUE" 1 "(0010)RED" 0 "(0001)OTHER" ;
VAL_ 154 OBJ_EMERGENCY_V_3 1 "TRUE" 0 "FALSE" ;
VAL_ 154 OBJ_Angle_Top_V_3 1 "VALID" 0 "INVALID" ;
VAL_ 154 OBJ_Angle_Top_STD_V_3 1 "VALID" 0 "INVALID" ;
VAL_ 154 OBJ_Open_Door_Left_3 1 "TRUE" 0 "FALSE" ;
VAL_ 154 OBJ_Open_Door_Right_3 1 "TRUE" 0 "FALSE" ;
VAL_ 154 OBJ_Visible_Left_or_Right_3 2 "RIGHT" 1 "LEFT" 0 "NOT_VISIBLE" ;
VAL_ 154 OBJ_Visible_Left_or_Right_V_3 1 "VALID" 0 "INVALID" ;
VAL_ 154 OBJ_Fusion_Source_4 2 "(BIT_2)RADAR2" 1 "(BIT_1)RADAR1" 0 "(BIT_0)CAMERA" ;
VAL_ 154 OBJ_Triggered_SDM_4 2 "NOT_TRIGGERED" 1 "TRIGGERED" 0 "NOT_AVAILABLE" ;
VAL_ 154 OBJ_Motion_Category_4 13 "ONCOMING" 12 "PRECEEDING" 11 "MOVING" 10 "RTAP" 9 "LTAP" 8 "CROSSING" 7 "MOVING_OUT" 6 "MOVING_IN" 5 "CLOSE_CUT_IN" 4 "PASSING_OUT" 3 "PASSING_IN" 2 "PASSING" 1 "UNDEFINED" 0 "UNFILLED" ;
VAL_ 154 OBJ_Measuring_Status_4 2 "(BIT_2)NOT_VALID_OR_VALID" 1 "(BIT_1)PREDICTED_OR_MEASURED" 0 "(BIT_0)OLD_OR_NEW" ;
VAL_ 154 OBJ_Object_Class_4 9 "TWO_WHEELER" 8 "UNCERTAIN_VCL" 7 "ANIMAL" 6 "GENERAL_OBJECT" 5 "PEDESTRIAN" 4 "BICYCLE" 3 "MOTORBIKE" 2 "TRUCK" 1 "CAR" 0 "UNFILLED" ;
VAL_ 154 OBJ_Camera_Source_4 11 "PARKING_RIGHT" 10 "PARKING_LEFT" 9 "PARKING_REAR" 8 "PARKING_FRONT" 7 "FRONT_CORNER_RIGHT" 6 "FRONT_CORNER_LEFT" 5 "REAR_CORNER_RIGHT" 4 "REAR_CORNER_LEFT" 3 "REAR" 2 "FRONT_FISHEYE" 1 "FRONT_NARROW" 0 "FRONT_MAIN" ;
VAL_ 154 OBJ_Motion_Status_4 5 "MOVING_SLOWLY" 4 "STOPPED" 3 "STATIONARY" 2 "MOVING" 1 "UNKNOWN" 0 "INVALID" ;
VAL_ 154 OBJ_Motion_Orientation_4 13 "INVALID" 12 "NORTH" 11 "NORTH_WEST" 9 "WEST" 7 "SOUTH_WEST" 6 "SOUTH" 5 "SOUTH_EAST" 3 "EAST" 1 "NORTH_EAST" 0 "UNKNOWN" ;
VAL_ 154 OBJ_Has_Cut_Lane_4 1 "TRUE" 0 "FALSE" ;
VAL_ 154 OBJ_Has_Cut_Path_4 1 "TRUE" 0 "FALSE" ;
VAL_ 154 OBJ_Brake_Light_Validity_4 1 "TRUE" 0 "FALSE" ;
VAL_ 154 OBJ_Brake_Light_4 1 "TRUE" 0 "FALSE" ;
VAL_ 154 OBJ_Turn_Indicator_Right_4 1 "TRUE" 0 "FALSE" ;
VAL_ 154 OBJ_Turn_Indicator_Left_4 1 "TRUE" 0 "FALSE" ;
VAL_ 154 OBJ_Turn_Indicator_Validity_4 1 "TRUE" 0 "FALSE" ;
VAL_ 154 OBJ_Right_Out_Of_Image_4 1 "TRUE" 0 "FALSE" ;
VAL_ 154 OBJ_Left_Out_Of_Image_4 1 "TRUE" 0 "FALSE" ;
VAL_ 154 OBJ_Right_Out_Of_Image_V_4 1 "TRUE" 0 "FALSE" ;
VAL_ 154 OBJ_Left_Out_Of_Image_V_4 1 "TRUE" 0 "FALSE" ;
VAL_ 154 OBJ_Top_Out_Of_Image_4 1 "TRUE" 0 "FALSE" ;
VAL_ 154 OBJ_Bottom_Out_Of_Image_4 1 "TRUE" 0 "FALSE" ;
VAL_ 154 OBJ_Top_Out_Of_Image_V_4 1 "VALID" 0 "INVALID" ;
VAL_ 154 OBJ_Bottom_Out_Of_Image_V_4 1 "VALID" 0 "INVALID" ;
VAL_ 154 OBJ_Lane_Assignment_4 5 "RIGHT_RIGHT" 4 "RIGHT" 3 "HOST" 2 "LEFT" 1 "LEFT_LEFT" 0 "UNKNOWN" ;
VAL_ 154 OBJ_Lane_Assignment_V_4 1 "VALID" 0 "INVALID" ;
VAL_ 154 OBJ_Age_Seconds_V_4 1 "VALID" 0 "INVALID" ;
VAL_ 154 OBJ_Width_V_4 1 "VALID" 0 "INVALID" ;
VAL_ 154 OBJ_Width_STD_V_4 1 "VALID" 0 "INVALID" ;
VAL_ 154 OBJ_Length_V_4 1 "VALID" 0 "INVALID" ;
VAL_ 154 OBJ_Length_STD_V_4 1 "VALID" 0 "INVALID" ;
VAL_ 154 OBJ_Height_V_4 1 "VALID" 0 "INVALID" ;
VAL_ 154 OBJ_Height_STD_V_4 1 "VALID" 0 "INVALID" ;
VAL_ 154 OBJ_Abs_Long_Velocity_V_4 1 "VALID" 0 "INVALID" ;
VAL_ 154 OBJ_Abs_Long_Vel_STD_V_4 1 "VALID" 0 "INVALID" ;
VAL_ 154 OBJ_Abs_Lat_Velocity_V_4 1 "VALID" 0 "INVALID" ;
VAL_ 154 OBJ_Abs_Lat_Vel_STD_V_4 1 "VALID" 0 "INVALID" ;
VAL_ 154 OBJ_Abs_Long_Acc_V_4 1 "VALID" 0 "INVALID" ;
VAL_ 154 OBJ_Abs_Long_Acc_STD_V_4 1 "VALID" 0 "INVALID" ;
VAL_ 154 OBJ_Abs_Lat_Acc_V_4 1 "VALID" 0 "INVALID" ;
VAL_ 154 OBJ_Abs_Lat_Acc_STD_V_4 1 "VALID" 0 "INVALID" ;
VAL_ 154 OBJ_Abs_Acceleration_V_4 1 "VALID" 0 "INVALID" ;
VAL_ 154 OBJ_Abs_Acc_STD_V_4 1 "VALID" 0 "INVALID" ;
VAL_ 154 OBJ_Inv_TTC_V_4 1 "VALID" 0 "INVALID" ;
VAL_ 154 OBJ_Inv_TTC_STD_V_4 1 "VALID" 0 "INVALID" ;
VAL_ 154 OBJ_Relative_Long_Acc_V_4 1 "VALID" 0 "INVALID" ;
VAL_ 154 OBJ_Rel_Long_Acc_STD_V_4 1 "VALID" 0 "INVALID" ;
VAL_ 154 OBJ_Relative_Long_Velocity_V_4 1 "VALID" 0 "INVALID" ;
VAL_ 154 OBJ_Rel_Long_Vel_STD_V_4 1 "VALID" 0 "INVALID" ;
VAL_ 154 OBJ_Relative_Lat_Velocity_V_4 1 "VALID" 0 "INVALID" ;
VAL_ 154 OBJ_Rel_Lat_Vel_STD_V_4 1 "VALID" 0 "INVALID" ;
VAL_ 154 OBJ_Long_Distance_V_4 1 "VALID" 0 "INVALID" ;
VAL_ 154 OBJ_Long_Distance_STD_V_4 1 "VALID" 0 "INVALID" ;
VAL_ 154 OBJ_Lat_Distance_V_4 1 "VALID" 0 "INVALID" ;
VAL_ 154 OBJ_Lat_Distance_STD_V_4 1 "VALID" 0 "INVALID" ;
VAL_ 154 OBJ_Absolute_Speed_V_4 1 "VALID" 0 "INVALID" ;
VAL_ 154 OBJ_Absolute_Speed_STD_V_4 1 "VALID" 0 "INVALID" ;
VAL_ 154 OBJ_Heading_V_4 1 "VALID" 0 "INVALID" ;
VAL_ 154 OBJ_Heading_STD_V_4 1 "VALID" 0 "INVALID" ;
VAL_ 154 OBJ_Angle_Rate_STD_V_4 1 "VALID" 0 "INVALID" ;
VAL_ 154 OBJ_Angle_Rate_V_4 1 "VALID" 0 "INVALID" ;
VAL_ 154 OBJ_Angle_Right_V_4 1 "VALID" 0 "INVALID" ;
VAL_ 154 OBJ_Angle_Right_STD_V_4 1 "VALID" 0 "INVALID" ;
VAL_ 154 OBJ_Angle_Left_V_4 1 "VALID" 0 "INVALID" ;
VAL_ 154 OBJ_Angle_Left_STD_V_4 1 "VALID" 0 "INVALID" ;
VAL_ 154 OBJ_Angle_Side_V_4 1 "VALID" 0 "INVALID" ;
VAL_ 154 OBJ_Angle_Side_STD_V_4 1 "VALID" 0 "INVALID" ;
VAL_ 154 OBJ_Angle_Mid_V_4 1 "VALID" 0 "INVALID" ;
VAL_ 154 OBJ_Angle_Mid_STD_V_4 1 "VALID" 0 "INVALID" ;
VAL_ 154 OBJ_Angle_Bottom_V_4 1 "VALID" 0 "INVALID" ;
VAL_ 154 OBJ_Angle_Bottom_STD_V_4 1 "VALID" 0 "INVALID" ;
VAL_ 154 OBJ_Visibility_Side_V_4 1 "VALID" 0 "INVALID" ;
VAL_ 154 OBJ_Visibility_Side_4 2 "REAR" 1 "FRONT" 0 "NOT_VISIBLE" ;
VAL_ 154 OBJ_Is_In_Drivable_Area_4 1 "TRUE" 0 "FALSE" ;
VAL_ 154 OBJ_Is_In_Drivable_Area_V_4 1 "VALID" 0 "INVALID" ;
VAL_ 154 OBJ_Is_VeryClose_V_4 1 "VALID" 0 "INVALID" ;
VAL_ 154 OBJ_Is_VeryClose_4 1 "TRUE" 0 "FALSE" ;
VAL_ 154 OBJ_OverlapAngleEgoLaneR_V_4 1 "VALID" 0 "INVALID" ;
VAL_ 154 OBJ_OverlapAngleEgoLaneL_V_4 1 "VALID" 0 "INVALID" ;
VAL_ 154 OBJ_Is_EMERGENCY_VCL_4 1 "TRUE" 0 "FALSE" ;
VAL_ 154 OBJ_EMERGENCY_LIGHT_COLOR_4 3 "(1000)ORANGE" 2 "(0100)BLUE" 1 "(0010)RED" 0 "(0001)OTHER" ;
VAL_ 154 OBJ_EMERGENCY_V_4 1 "TRUE" 0 "FALSE" ;
VAL_ 154 OBJ_Angle_Top_V_4 1 "VALID" 0 "INVALID" ;
VAL_ 154 OBJ_Angle_Top_STD_V_4 1 "VALID" 0 "INVALID" ;
VAL_ 154 OBJ_Open_Door_Left_4 1 "TRUE" 0 "FALSE" ;
VAL_ 154 OBJ_Open_Door_Right_4 1 "TRUE" 0 "FALSE" ;
VAL_ 154 OBJ_Visible_Left_or_Right_4 2 "RIGHT" 1 "LEFT" 0 "NOT_VISIBLE" ;
VAL_ 154 OBJ_Visible_Left_or_Right_V_4 1 "VALID" 0 "INVALID" ;
VAL_ 154 OBJ_Fusion_Source_5 2 "(BIT_2)RADAR2" 1 "(BIT_1)RADAR1" 0 "(BIT_0)CAMERA" ;
VAL_ 154 OBJ_Triggered_SDM_5 2 "NOT_TRIGGERED" 1 "TRIGGERED" 0 "NOT_AVAILABLE" ;
VAL_ 154 OBJ_Motion_Category_5 13 "ONCOMING" 12 "PRECEEDING" 11 "MOVING" 10 "RTAP" 9 "LTAP" 8 "CROSSING" 7 "MOVING_OUT" 6 "MOVING_IN" 5 "CLOSE_CUT_IN" 4 "PASSING_OUT" 3 "PASSING_IN" 2 "PASSING" 1 "UNDEFINED" 0 "UNFILLED" ;
VAL_ 154 OBJ_Measuring_Status_5 2 "(BIT_2)NOT_VALID_OR_VALID" 1 "(BIT_1)PREDICTED_OR_MEASURED" 0 "(BIT_0)OLD_OR_NEW" ;
VAL_ 154 OBJ_Object_Class_5 9 "TWO_WHEELER" 8 "UNCERTAIN_VCL" 7 "ANIMAL" 6 "GENERAL_OBJECT" 5 "PEDESTRIAN" 4 "BICYCLE" 3 "MOTORBIKE" 2 "TRUCK" 1 "CAR" 0 "UNFILLED" ;
VAL_ 154 OBJ_Camera_Source_5 11 "PARKING_RIGHT" 10 "PARKING_LEFT" 9 "PARKING_REAR" 8 "PARKING_FRONT" 7 "FRONT_CORNER_RIGHT" 6 "FRONT_CORNER_LEFT" 5 "REAR_CORNER_RIGHT" 4 "REAR_CORNER_LEFT" 3 "REAR" 2 "FRONT_FISHEYE" 1 "FRONT_NARROW" 0 "FRONT_MAIN" ;
VAL_ 154 OBJ_Motion_Status_5 5 "MOVING_SLOWLY" 4 "STOPPED" 3 "STATIONARY" 2 "MOVING" 1 "UNKNOWN" 0 "INVALID" ;
VAL_ 154 OBJ_Motion_Orientation_5 13 "INVALID" 12 "NORTH" 11 "NORTH_WEST" 9 "WEST" 7 "SOUTH_WEST" 6 "SOUTH" 5 "SOUTH_EAST" 3 "EAST" 1 "NORTH_EAST" 0 "UNKNOWN" ;
VAL_ 154 OBJ_Has_Cut_Lane_5 1 "TRUE" 0 "FALSE" ;
VAL_ 154 OBJ_Has_Cut_Path_5 1 "TRUE" 0 "FALSE" ;
VAL_ 154 OBJ_Brake_Light_Validity_5 1 "TRUE" 0 "FALSE" ;
VAL_ 154 OBJ_Brake_Light_5 1 "TRUE" 0 "FALSE" ;
VAL_ 154 OBJ_Turn_Indicator_Right_5 1 "TRUE" 0 "FALSE" ;
VAL_ 154 OBJ_Turn_Indicator_Left_5 1 "TRUE" 0 "FALSE" ;
VAL_ 154 OBJ_Turn_Indicator_Validity_5 1 "TRUE" 0 "FALSE" ;
VAL_ 154 OBJ_Right_Out_Of_Image_5 1 "TRUE" 0 "FALSE" ;
VAL_ 154 OBJ_Left_Out_Of_Image_5 1 "TRUE" 0 "FALSE" ;
VAL_ 154 OBJ_Right_Out_Of_Image_V_5 1 "TRUE" 0 "FALSE" ;
VAL_ 154 OBJ_Left_Out_Of_Image_V_5 1 "TRUE" 0 "FALSE" ;
VAL_ 154 OBJ_Top_Out_Of_Image_5 1 "TRUE" 0 "FALSE" ;
VAL_ 154 OBJ_Bottom_Out_Of_Image_5 1 "TRUE" 0 "FALSE" ;
VAL_ 154 OBJ_Top_Out_Of_Image_V_5 1 "VALID" 0 "INVALID" ;
VAL_ 154 OBJ_Bottom_Out_Of_Image_V_5 1 "VALID" 0 "INVALID" ;
VAL_ 154 OBJ_Lane_Assignment_5 5 "RIGHT_RIGHT" 4 "RIGHT" 3 "HOST" 2 "LEFT" 1 "LEFT_LEFT" 0 "UNKNOWN" ;
VAL_ 154 OBJ_Lane_Assignment_V_5 1 "VALID" 0 "INVALID" ;
VAL_ 154 OBJ_Age_Seconds_V_5 1 "VALID" 0 "INVALID" ;
VAL_ 154 OBJ_Width_V_5 1 "VALID" 0 "INVALID" ;
VAL_ 154 OBJ_Width_STD_V_5 1 "VALID" 0 "INVALID" ;
VAL_ 154 OBJ_Length_V_5 1 "VALID" 0 "INVALID" ;
VAL_ 154 OBJ_Length_STD_V_5 1 "VALID" 0 "INVALID" ;
VAL_ 154 OBJ_Height_V_5 1 "VALID" 0 "INVALID" ;
VAL_ 154 OBJ_Height_STD_V_5 1 "VALID" 0 "INVALID" ;
VAL_ 154 OBJ_Abs_Long_Velocity_V_5 1 "VALID" 0 "INVALID" ;
VAL_ 154 OBJ_Abs_Long_Vel_STD_V_5 1 "VALID" 0 "INVALID" ;
VAL_ 154 OBJ_Abs_Lat_Velocity_V_5 1 "VALID" 0 "INVALID" ;
VAL_ 154 OBJ_Abs_Lat_Vel_STD_V_5 1 "VALID" 0 "INVALID" ;
VAL_ 154 OBJ_Abs_Long_Acc_V_5 1 "VALID" 0 "INVALID" ;
VAL_ 154 OBJ_Abs_Long_Acc_STD_V_5 1 "VALID" 0 "INVALID" ;
VAL_ 154 OBJ_Abs_Lat_Acc_V_5 1 "VALID" 0 "INVALID" ;
VAL_ 154 OBJ_Abs_Lat_Acc_STD_V_5 1 "VALID" 0 "INVALID" ;
VAL_ 154 OBJ_Abs_Acceleration_V_5 1 "VALID" 0 "INVALID" ;
VAL_ 154 OBJ_Abs_Acc_STD_V_5 1 "VALID" 0 "INVALID" ;
VAL_ 154 OBJ_Inv_TTC_V_5 1 "VALID" 0 "INVALID" ;
VAL_ 154 OBJ_Inv_TTC_STD_V_5 1 "VALID" 0 "INVALID" ;
VAL_ 154 OBJ_Relative_Long_Acc_V_5 1 "VALID" 0 "INVALID" ;
VAL_ 154 OBJ_Rel_Long_Acc_STD_V_5 1 "VALID" 0 "INVALID" ;
VAL_ 154 OBJ_Relative_Long_Velocity_V_5 1 "VALID" 0 "INVALID" ;
VAL_ 154 OBJ_Rel_Long_Vel_STD_V_5 1 "VALID" 0 "INVALID" ;
VAL_ 154 OBJ_Relative_Lat_Velocity_V_5 1 "VALID" 0 "INVALID" ;
VAL_ 154 OBJ_Rel_Lat_Vel_STD_V_5 1 "VALID" 0 "INVALID" ;
VAL_ 154 OBJ_Long_Distance_V_5 1 "VALID" 0 "INVALID" ;
VAL_ 154 OBJ_Long_Distance_STD_V_5 1 "VALID" 0 "INVALID" ;
VAL_ 154 OBJ_Lat_Distance_V_5 1 "VALID" 0 "INVALID" ;
VAL_ 154 OBJ_Lat_Distance_STD_V_5 1 "VALID" 0 "INVALID" ;
VAL_ 154 OBJ_Absolute_Speed_V_5 1 "VALID" 0 "INVALID" ;
VAL_ 154 OBJ_Absolute_Speed_STD_V_5 1 "VALID" 0 "INVALID" ;
VAL_ 154 OBJ_Heading_V_5 1 "VALID" 0 "INVALID" ;
VAL_ 154 OBJ_Heading_STD_V_5 1 "VALID" 0 "INVALID" ;
VAL_ 154 OBJ_Angle_Rate_STD_V_5 1 "VALID" 0 "INVALID" ;
VAL_ 154 OBJ_Angle_Rate_V_5 1 "VALID" 0 "INVALID" ;
VAL_ 154 OBJ_Angle_Right_V_5 1 "VALID" 0 "INVALID" ;
