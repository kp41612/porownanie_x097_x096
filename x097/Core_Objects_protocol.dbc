VERSION "15"
// BundelVersion=v4.21.5_CF1
NS_ :

BS_:

BU_: EyeQ4 MCU

BO_ 154 Core_Objects_protocol: 4820 EyeQ4
 SG_ OBJ_Absolute_Speed_STD_V_28 : 27642|1@1+ (1,0) [0|1] "bool" MCU
 SG_ Reserved_18_28 : 27643|5@1+ (1,0) [0|0] "NA" MCU
 SG_ OBJ_Heading_28 : 27648|10@1+ (0.01,-3.14) [-3.14|3.14] "rad" MCU
 SG_ OBJ_Heading_V_28 : 27658|1@1+ (1,0) [0|1] "bool" MCU
 SG_ OBJ_Heading_STD_28 : 27659|15@1+ (0.0001,0) [0|3.14] "rad" MCU
 SG_ OBJ_Heading_STD_V_28 : 27674|1@1+ (1,0) [0|1] "bool" MCU
 SG_ Reserved_19_28 : 27675|5@1+ (1,0) [0|0] "NA" MCU
 SG_ OBJ_Angle_Rate_STD_28 : 27680|15@1+ (0.0001,0) [0|2.2318] "RPS" MCU
 SG_ OBJ_Angle_Rate_STD_V_28 : 27695|1@1+ (1,0) [0|1] "bool" MCU
 SG_ OBJ_Angle_Rate_28 : 27696|12@1+ (0.002,-2.234) [-2.234|2.2318] "RPS" MCU
 SG_ OBJ_Angle_Rate_V_28 : 27708|1@1+ (1,0) [0|1] "bool" MCU
 SG_ Reserved_20_28 : 27709|3@1+ (1,0) [0|0] "NA" MCU
 SG_ OBJ_Angle_Right_28 : 27712|14@1+ (0.0002,-1.571) [-1.571|1.571] "rad" MCU
 SG_ OBJ_Angle_Right_V_28 : 27726|1@1+ (1,0) [0|1] "bool" MCU
 SG_ OBJ_Angle_Right_STD_28 : 27727|14@1+ (0.0001,0) [0|1.571] "rad" MCU
 SG_ OBJ_Angle_Right_STD_V_28 : 27741|1@1+ (1,0) [0|1] "bool" MCU
 SG_ Reserved_21_28 : 27742|2@1+ (1,0) [0|0] "NA" MCU
 SG_ OBJ_Angle_Left_28 : 27744|14@1+ (0.0002,-1.571) [-1.571|1.571] "rad" MCU
 SG_ OBJ_Angle_Left_V_28 : 27758|1@1+ (1,0) [0|1] "bool" MCU
 SG_ OBJ_Angle_Left_STD_28 : 27759|14@1+ (0.0001,0) [0|1.571] "rad" MCU
 SG_ OBJ_Angle_Left_STD_V_28 : 27773|1@1+ (1,0) [0|1] "bool" MCU
 SG_ Reserved_22_28 : 27774|2@1+ (1,0) [0|0] "NA" MCU
 SG_ OBJ_Angle_Side_28 : 27776|14@1+ (0.0002,-1.571) [-1.571|1.571] "rad" MCU
 SG_ OBJ_Angle_Side_V_28 : 27790|1@1+ (1,0) [0|1] "bool" MCU
 SG_ OBJ_Angle_Side_STD_28 : 27791|14@1+ (0.0001,0) [0|1.571] "rad" MCU
 SG_ OBJ_Angle_Side_STD_V_28 : 27805|1@1+ (1,0) [0|1] "bool" MCU
 SG_ OBJ_Angle_Mid_V_28 : 27806|1@1+ (1,0) [0|1] "bool" MCU
 SG_ Reserved_23_28 : 27807|1@1+ (1,0) [0|0] "NA" MCU
 SG_ OBJ_Angle_Mid_28 : 27808|14@1+ (0.0002,-1.571) [-1.571|1.571] "rad" MCU
 SG_ OBJ_Angle_Mid_STD_28 : 27822|14@1+ (0.0001,0) [0|1.571] "rad" MCU
 SG_ OBJ_Angle_Mid_STD_V_28 : 27836|1@1+ (1,0) [0|1] "bool" MCU
 SG_ OBJ_Angle_Bottom_V_28 : 27837|1@1+ (1,0) [0|1] "bool" MCU
 SG_ Reserved_24_28 : 27838|2@1+ (1,0) [0|0] "NA" MCU
 SG_ OBJ_Angle_Bottom_28 : 27840|14@1+ (0.0002,-1.571) [-1.571|1.571] "rad" MCU
 SG_ OBJ_Angle_Bottom_STD_28 : 27854|14@1+ (0.0001,0) [0|1.571] "rad" MCU
 SG_ OBJ_Angle_Bottom_STD_V_28 : 27868|1@1+ (1,0) [0|1] "bool" MCU
 SG_ OBJ_Visibility_Side_V_28 : 27869|1@1+ (1,0) [0|1] "bool" MCU
 SG_ OBJ_Visibility_Side_28 : 27870|2@1+ (1,0) [0|2] "ENUM" MCU
 SG_ OBJ_Is_In_Drivable_Area_28 : 27872|1@1+ (1,0) [0|1] "bool" MCU
 SG_ OBJ_Is_In_Drivable_Area_V_28 : 27873|1@1+ (1,0) [0|1] "bool" MCU
 SG_ OBJ_Is_VeryClose_V_28 : 27874|1@1+ (1,0) [0|1] "bool" MCU
 SG_ OBJ_Is_VeryClose_28 : 27875|1@1+ (1,0) [0|1] "bool" MCU
 SG_ OBJ_Buffer_C4_28 : 27876|2@1+ (1,0) [0|2] "NA" MCU
 SG_ OBJ_Buffer_C5_28 : 27878|2@1+ (1,0) [0|2] "NA" MCU
 SG_ OBJ_Buffer_C6_28 : 27880|2@1+ (1,0) [0|2] "NA" MCU
 SG_ OBJ_Buffer_C7_28 : 27882|2@1+ (1,0) [0|2] "NA" MCU
 SG_ OBJ_OverlapAngleEgoLaneR_28 : 27884|10@1+ (0.01,-3.14) [-3.14|3.14] "rad" MCU
 SG_ OBJ_OverlapAngleEgoLaneR_V_28 : 27894|1@1+ (1,0) [0|1] "bool" MCU
 SG_ Reserved_25_28 : 27895|9@1+ (1,0) [0|0] "NA" MCU
 SG_ OBJ_OverlapAngleEgoLaneL_28 : 27904|10@1+ (0.01,-3.14) [-3.14|3.14] "rad" MCU
 SG_ OBJ_OverlapAngleEgoLaneL_V_28 : 27914|1@1+ (1,0) [0|1] "bool" MCU
 SG_ OBJ_Is_EMERGENCY_VCL_28 : 27915|1@1+ (1,0) [0|1] "bool" MCU
 SG_ OBJ_EMERGENCY_LIGHT_COLOR_28 : 27916|4@1+ (1,0) [0|15] "BITWIZE" MCU
 SG_ OBJ_EMERGENCY_V_28 : 27920|1@1+ (1,0) [0|1] "bool" MCU
 SG_ OBJ_Angle_Top_28 : 27921|14@1+ (0.0002,0) [0|3.1415] "rad" MCU
 SG_ OBJ_Angle_Top_V_28 : 27935|1@1+ (1,0) [0|1] "bool" MCU
 SG_ OBJ_Angle_Top_STD_28 : 27936|15@1+ (0.0001,0) [0|3.1415] "rad" MCU
 SG_ OBJ_Angle_Top_STD_V_28 : 27951|1@1+ (1,0) [0|1] "bool" MCU
 SG_ OBJ_Open_Door_Left_28 : 27952|1@1+ (1,0) [0|1] "bool" MCU
 SG_ OBJ_Open_Door_Right_28 : 27953|1@1+ (1,0) [0|1] "bool" MCU
 SG_ OBJ_Visible_Left_or_Right_28 : 27954|2@1+ (1,0) [0|2] "ENUM" MCU
 SG_ OBJ_Visible_Left_or_Right_V_28 : 27956|1@1+ (1,0) [0|1] "bool" MCU
 SG_ OBJ_2W_Is_Motorbike_Probability_28 : 27957|8@1+ (0.01,0) [0|1] "NA" MCU
 SG_ Reserved_26_28 : 27965|3@1+ (1,0) [0|0] "NA" MCU
 SG_ OBJ_2W_Is_Bicycle_Probability_28 : 27968|8@1+ (0.01,0) [0|1] "NA" MCU
 SG_ Reserved_27_28 : 27976|24@1+ (1,0) [0|0] "NA" MCU
 SG_ OBJ_CRC_29 : 28000|32@1+ (1,0) [0|4294967295] "NA" MCU
 SG_ OBJ_ID_29 : 28032|8@1+ (1,0) [0|255] "counter" MCU
 SG_ OBJ_Existence_Probability_29 : 28040|8@1+ (0.01,0) [0|1] "NA" MCU
 SG_ OBJ_Fusion_Source_29 : 28048|16@1+ (1,0) [0|65535] "BITWIZE" MCU
 SG_ OBJ_Triggered_SDM_29 : 28064|2@1+ (1,0) [0|2] "ENUM" MCU
 SG_ OBJ_Motion_Category_29 : 28066|4@1+ (1,0) [0|13] "ENUM" MCU
 SG_ OBJ_Moving_IN_Probability_29 : 28070|7@1+ (0.01,0) [0|1] "NA" MCU
 SG_ OBJ_Object_Age_29 : 28077|11@1+ (1,0) [0|2047] "frames" MCU
 SG_ OBJ_Measuring_Status_29 : 28088|3@1+ (1,0) [0|7] "BITWIZE" MCU
 SG_ OBJ_Object_Class_29 : 28091|4@1+ (1,0) [0|9] "ENUM" MCU
 SG_ Reserved_4_29 : 28095|1@1+ (1,0) [0|0] "NA" MCU
 SG_ OBJ_Class_Probability_29 : 28096|7@1+ (0.01,0) [0|1] "NA" MCU
 SG_ OBJ_Car_Probability_29 : 28103|7@1+ (0.01,0) [0|1] "NA" MCU
 SG_ OBJ_Truck_Probability_29 : 28110|7@1+ (0.01,0) [0|1] "NA" MCU
 SG_ OBJ_Bike_Probability_29 : 28117|7@1+ (0.01,0) [0|1] "NA" MCU
 SG_ OBJ_Camera_Source_29 : 28124|4@1+ (1,0) [0|15] "ENUM" MCU
 SG_ OBJ_Motion_Status_29 : 28128|3@1+ (1,0) [0|5] "ENUM" MCU
 SG_ OBJ_Motion_Orientation_29 : 28131|4@1+ (1,0) [0|13] "ENUM" MCU
 SG_ OBJ_Has_Cut_Lane_29 : 28135|1@1+ (1,0) [0|1] "bool" MCU
 SG_ OBJ_Has_Cut_Path_29 : 28136|1@1+ (1,0) [0|1] "bool" MCU
 SG_ OBJ_Brake_Light_Validity_29 : 28137|1@1+ (1,0) [0|1] "bool" MCU
 SG_ OBJ_Brake_Light_29 : 28138|1@1+ (1,0) [0|1] "bool" MCU
 SG_ OBJ_Turn_Indicator_Right_29 : 28139|1@1+ (1,0) [0|1] "bool" MCU
 SG_ OBJ_Turn_Indicator_Left_29 : 28140|1@1+ (1,0) [0|1] "bool" MCU
 SG_ OBJ_Turn_Indicator_Validity_29 : 28141|1@1+ (1,0) [0|1] "bool" MCU
 SG_ OBJ_Right_Out_Of_Image_29 : 28142|1@1+ (1,0) [0|1] "bool" MCU
 SG_ OBJ_Left_Out_Of_Image_29 : 28143|1@1+ (1,0) [0|1] "bool" MCU
 SG_ OBJ_Right_Out_Of_Image_V_29 : 28144|1@1+ (1,0) [0|1] "bool" MCU
 SG_ OBJ_Left_Out_Of_Image_V_29 : 28145|1@1+ (1,0) [0|1] "bool" MCU
 SG_ OBJ_Top_Out_Of_Image_29 : 28146|1@1+ (1,0) [0|1] "bool" MCU
 SG_ OBJ_Bottom_Out_Of_Image_29 : 28147|1@1+ (1,0) [0|1] "bool" MCU
 SG_ OBJ_Top_Out_Of_Image_V_29 : 28148|1@1+ (1,0) [0|1] "bool" MCU
 SG_ OBJ_Bottom_Out_Of_Image_V_29 : 28149|1@1+ (1,0) [0|1] "bool" MCU
 SG_ OBJ_Lane_Assignment_29 : 28150|3@1+ (1,0) [0|5] "ENUM" MCU
 SG_ OBJ_Lane_Assignment_V_29 : 28153|1@1+ (1,0) [0|1] "bool" MCU
 SG_ Reserved_5_29 : 28154|6@1+ (1,0) [0|0] "NA" MCU
 SG_ OBJ_Age_Seconds_29 : 28160|7@1+ (1,0) [0|100] "s" MCU
 SG_ OBJ_Age_Seconds_V_29 : 28167|1@1+ (1,0) [0|1] "bool" MCU
 SG_ OBJ_Width_29 : 28168|9@1+ (0.01,0) [0.4|2.95] "m" MCU
 SG_ OBJ_Width_V_29 : 28177|1@1+ (1,0) [0|1] "bool" MCU
 SG_ OBJ_Width_STD_29 : 28178|11@1+ (0.001,0) [0|2] "m" MCU
 SG_ OBJ_Width_STD_V_29 : 28189|1@1+ (1,0) [0|1] "bool" MCU
 SG_ Reserved_6_29 : 28190|2@1+ (1,0) [0|0] "NA" MCU
 SG_ OBJ_Length_29 : 28192|9@1+ (0.05,0) [0.6|21] "m" MCU
 SG_ OBJ_Length_V_29 : 28201|1@1+ (1,0) [0|1] "bool" MCU
 SG_ OBJ_Length_STD_29 : 28202|10@1+ (0.01,0) [0|10] "m" MCU
 SG_ OBJ_Length_STD_V_29 : 28212|1@1+ (1,0) [0|1] "bool" MCU
 SG_ OBJ_Radar_ID_29 : 28213|8@1+ (1,0) [0|255] "counter" MCU
 SG_ Reserved_7_29 : 28221|3@1+ (1,0) [0|0] "NA" MCU
 SG_ OBJ_Height_29 : 28224|9@1+ (0.01,0) [0|2.95] "m" MCU
 SG_ OBJ_Height_V_29 : 28233|1@1+ (1,0) [0|1] "bool" MCU
 SG_ OBJ_Height_STD_29 : 28234|11@1+ (0.001,0) [0|2] "m" MCU
 SG_ OBJ_Height_STD_V_29 : 28245|1@1+ (1,0) [0|1] "bool" MCU
 SG_ Reserved_8_29 : 28246|10@1+ (1,0) [0|0] "NA" MCU
 SG_ OBJ_Abs_Long_Velocity_29 : 28256|12@1+ (0.05,-100) [-100|100] "m_per_s" MCU
 SG_ OBJ_Abs_Long_Velocity_V_29 : 28268|1@1+ (1,0) [0|1] "bool" MCU
 SG_ OBJ_Abs_Long_Velocity_STD_29 : 28269|13@1+ (0.01,0) [0|65] "m_per_s" MCU
 SG_ OBJ_Abs_Long_Vel_STD_V_29 : 28282|1@1+ (1,0) [0|1] "bool" MCU
 SG_ Reserved_9_29 : 28283|5@1+ (1,0) [0|0] "NA" MCU
 SG_ OBJ_Abs_Lat_Velocity_29 : 28288|11@1+ (0.05,-50) [-50|50] "m_per_s" MCU
 SG_ OBJ_Abs_Lat_Velocity_V_29 : 28299|1@1+ (1,0) [0|1] "bool" MCU
 SG_ OBJ_Abs_Lat_Velocity_STD_29 : 28300|13@1+ (0.01,0) [0|50] "m_per_s" MCU
 SG_ OBJ_Abs_Lat_Vel_STD_V_29 : 28313|1@1+ (1,0) [0|1] "bool" MCU
 SG_ Reserved_10_29 : 28314|6@1+ (1,0) [0|0] "NA" MCU
 SG_ OBJ_Abs_Long_Acc_29 : 28320|9@1+ (0.05,-10) [-10|10] "m_per_s2" MCU
 SG_ OBJ_Abs_Long_Acc_V_29 : 28329|1@1+ (1,0) [0|1] "bool" MCU
 SG_ OBJ_Abs_Long_Acc_STD_29 : 28330|10@1+ (0.01,0) [0|7.3] "m_per_s2" MCU
 SG_ OBJ_Abs_Long_Acc_STD_V_29 : 28340|1@1+ (1,0) [0|1] "bool" MCU
 SG_ OBJ_Abs_Lat_Acc_29 : 28341|9@1+ (0.05,-10) [-10|10] "m_per_s2" MCU
 SG_ OBJ_Abs_Lat_Acc_V_29 : 28350|1@1+ (1,0) [0|1] "bool" MCU
 SG_ Reserved_11_29 : 28351|1@1+ (1,0) [0|0] "NA" MCU
 SG_ OBJ_Abs_Lat_Acc_STD_29 : 28352|10@1+ (0.01,0) [0|7.3] "m_per_s2" MCU
 SG_ OBJ_Abs_Lat_Acc_STD_V_29 : 28362|1@1+ (1,0) [0|1] "bool" MCU
 SG_ OBJ_Abs_Acceleration_29 : 28363|9@1+ (0.05,-12.7) [-12.7|12.7] "m_per_s2" MCU
 SG_ OBJ_Abs_Acceleration_V_29 : 28372|1@1+ (1,0) [0|1] "bool" MCU
 SG_ OBJ_Abs_Acc_STD_29 : 28373|10@1+ (0.01,0) [0|7.3] "m_per_s2" MCU
 SG_ OBJ_Abs_Acc_STD_V_29 : 28383|1@1+ (1,0) [0|1] "bool" MCU
 SG_ OBJ_Inv_TTC_29 : 28384|11@1+ (0.01,-8) [-8|8] "INV(s)" MCU
 SG_ OBJ_Inv_TTC_V_29 : 28395|1@1+ (1,0) [0|1] "bool" MCU
 SG_ OBJ_Inv_TTC_STD_29 : 28396|12@1+ (0.001,0) [0|4] "INV(s)" MCU
 SG_ OBJ_Inv_TTC_STD_V_29 : 28408|1@1+ (1,0) [0|1] "bool" MCU
 SG_ Reserved_12_29 : 28409|7@1+ (1,0) [0|0] "NA" MCU
 SG_ OBJ_Relative_Long_Acc_29 : 28416|10@1+ (0.05,-20) [-20|20] "m_per_s2" MCU
 SG_ OBJ_Relative_Long_Acc_V_29 : 28426|1@1+ (1,0) [0|1] "bool" MCU
 SG_ OBJ_Relative_Long_Acc_STD_29 : 28427|10@1+ (0.01,0) [0|7.3] "m_per_s2" MCU
 SG_ OBJ_Rel_Long_Acc_STD_V_29 : 28437|1@1+ (1,0) [0|1] "bool" MCU
 SG_ Reserved_13_29 : 28438|10@1+ (1,0) [0|0] "NA" MCU
 SG_ OBJ_Relative_Long_Velocity_29 : 28448|13@1+ (0.05,-120) [-120|130] "m_per_s" MCU
 SG_ OBJ_Relative_Long_Velocity_V_29 : 28461|1@1+ (1,0) [0|1] "bool" MCU
 SG_ OBJ_Relative_Long_Vel_STD_29 : 28462|14@1+ (0.01,0) [0|130] "m_per_s" MCU
 SG_ OBJ_Rel_Long_Vel_STD_V_29 : 28476|1@1+ (1,0) [0|1] "bool" MCU
 SG_ Reserved_14_29 : 28477|3@1+ (1,0) [0|0] "NA" MCU
 SG_ OBJ_Relative_Lat_Velocity_29 : 28480|11@1+ (0.05,-50) [-50|50] "m_per_s" MCU
 SG_ OBJ_Relative_Lat_Velocity_V_29 : 28491|1@1+ (1,0) [0|1] "bool" MCU
 SG_ OBJ_Relative_Lat_Velocity_STD_29 : 28492|13@1+ (0.01,0) [0|50] "m_per_s" MCU
 SG_ OBJ_Rel_Lat_Vel_STD_V_29 : 28505|1@1+ (1,0) [0|1] "bool" MCU
 SG_ Reserved_15_29 : 28506|6@1+ (1,0) [0|0] "NA" MCU
 SG_ OBJ_Long_Distance_29 : 28512|14@1+ (0.05,-200) [-200|500] "m" MCU
 SG_ OBJ_Long_Distance_V_29 : 28526|1@1+ (1,0) [0|1] "bool" MCU
 SG_ OBJ_Long_Distance_STD_29 : 28527|15@1+ (0.01,0) [0|250] "m" MCU
 SG_ OBJ_Long_Distance_STD_V_29 : 28542|1@1+ (1,0) [0|1] "bool" MCU
 SG_ Reserved_16_29 : 28543|1@1+ (1,0) [0|0] "NA" MCU
 SG_ OBJ_Lat_Distance_29 : 28544|12@1+ (0.05,-100) [-100|100] "m" MCU
 SG_ OBJ_Lat_Distance_V_29 : 28556|1@1+ (1,0) [0|1] "bool" MCU
 SG_ OBJ_Lat_Distance_STD_29 : 28557|14@1+ (0.01,0) [0|100] "m" MCU
 SG_ OBJ_Lat_Distance_STD_V_29 : 28571|1@1+ (1,0) [0|1] "bool" MCU
 SG_ Reserved_17_29 : 28572|4@1+ (1,0) [0|0] "NA" MCU
 SG_ OBJ_Absolute_Speed_29 : 28576|12@1+ (0.05,-65) [-65|65] "m_per_s" MCU
 SG_ OBJ_Absolute_Speed_V_29 : 28588|1@1+ (1,0) [0|1] "bool" MCU
 SG_ OBJ_Absolute_Speed_STD_29 : 28589|13@1+ (0.01,0) [0|65] "m_per_s" MCU
 SG_ OBJ_Absolute_Speed_STD_V_29 : 28602|1@1+ (1,0) [0|1] "bool" MCU
 SG_ Reserved_18_29 : 28603|5@1+ (1,0) [0|0] "NA" MCU
 SG_ OBJ_Heading_29 : 28608|10@1+ (0.01,-3.14) [-3.14|3.14] "rad" MCU
 SG_ OBJ_Heading_V_29 : 28618|1@1+ (1,0) [0|1] "bool" MCU
 SG_ OBJ_Heading_STD_29 : 28619|15@1+ (0.0001,0) [0|3.14] "rad" MCU
 SG_ OBJ_Heading_STD_V_29 : 28634|1@1+ (1,0) [0|1] "bool" MCU
 SG_ Reserved_19_29 : 28635|5@1+ (1,0) [0|0] "NA" MCU
 SG_ OBJ_Angle_Rate_STD_29 : 28640|15@1+ (0.0001,0) [0|2.2318] "RPS" MCU
 SG_ OBJ_Angle_Rate_STD_V_29 : 28655|1@1+ (1,0) [0|1] "bool" MCU
 SG_ OBJ_Angle_Rate_29 : 28656|12@1+ (0.002,-2.234) [-2.234|2.2318] "RPS" MCU
 SG_ OBJ_Angle_Rate_V_29 : 28668|1@1+ (1,0) [0|1] "bool" MCU
 SG_ Reserved_20_29 : 28669|3@1+ (1,0) [0|0] "NA" MCU
 SG_ OBJ_Angle_Right_29 : 28672|14@1+ (0.0002,-1.571) [-1.571|1.571] "rad" MCU
 SG_ OBJ_Angle_Right_V_29 : 28686|1@1+ (1,0) [0|1] "bool" MCU
 SG_ OBJ_Angle_Right_STD_29 : 28687|14@1+ (0.0001,0) [0|1.571] "rad" MCU
 SG_ OBJ_Angle_Right_STD_V_29 : 28701|1@1+ (1,0) [0|1] "bool" MCU
 SG_ Reserved_21_29 : 28702|2@1+ (1,0) [0|0] "NA" MCU
 SG_ OBJ_Angle_Left_29 : 28704|14@1+ (0.0002,-1.571) [-1.571|1.571] "rad" MCU
 SG_ OBJ_Angle_Left_V_29 : 28718|1@1+ (1,0) [0|1] "bool" MCU
 SG_ OBJ_Angle_Left_STD_29 : 28719|14@1+ (0.0001,0) [0|1.571] "rad" MCU
 SG_ OBJ_Angle_Left_STD_V_29 : 28733|1@1+ (1,0) [0|1] "bool" MCU
 SG_ Reserved_22_29 : 28734|2@1+ (1,0) [0|0] "NA" MCU
 SG_ OBJ_Angle_Side_29 : 28736|14@1+ (0.0002,-1.571) [-1.571|1.571] "rad" MCU
 SG_ OBJ_Angle_Side_V_29 : 28750|1@1+ (1,0) [0|1] "bool" MCU
 SG_ OBJ_Angle_Side_STD_29 : 28751|14@1+ (0.0001,0) [0|1.571] "rad" MCU
 SG_ OBJ_Angle_Side_STD_V_29 : 28765|1@1+ (1,0) [0|1] "bool" MCU
 SG_ OBJ_Angle_Mid_V_29 : 28766|1@1+ (1,0) [0|1] "bool" MCU
 SG_ Reserved_23_29 : 28767|1@1+ (1,0) [0|0] "NA" MCU
 SG_ OBJ_Angle_Mid_29 : 28768|14@1+ (0.0002,-1.571) [-1.571|1.571] "rad" MCU
 SG_ OBJ_Angle_Mid_STD_29 : 28782|14@1+ (0.0001,0) [0|1.571] "rad" MCU
 SG_ OBJ_Angle_Mid_STD_V_29 : 28796|1@1+ (1,0) [0|1] "bool" MCU
 SG_ OBJ_Angle_Bottom_V_29 : 28797|1@1+ (1,0) [0|1] "bool" MCU
 SG_ Reserved_24_29 : 28798|2@1+ (1,0) [0|0] "NA" MCU
 SG_ OBJ_Angle_Bottom_29 : 28800|14@1+ (0.0002,-1.571) [-1.571|1.571] "rad" MCU
 SG_ OBJ_Angle_Bottom_STD_29 : 28814|14@1+ (0.0001,0) [0|1.571] "rad" MCU
 SG_ OBJ_Angle_Bottom_STD_V_29 : 28828|1@1+ (1,0) [0|1] "bool" MCU
 SG_ OBJ_Visibility_Side_V_29 : 28829|1@1+ (1,0) [0|1] "bool" MCU
 SG_ OBJ_Visibility_Side_29 : 28830|2@1+ (1,0) [0|2] "ENUM" MCU
 SG_ OBJ_Is_In_Drivable_Area_29 : 28832|1@1+ (1,0) [0|1] "bool" MCU
 SG_ OBJ_Is_In_Drivable_Area_V_29 : 28833|1@1+ (1,0) [0|1] "bool" MCU
 SG_ OBJ_Is_VeryClose_V_29 : 28834|1@1+ (1,0) [0|1] "bool" MCU
 SG_ OBJ_Is_VeryClose_29 : 28835|1@1+ (1,0) [0|1] "bool" MCU
 SG_ OBJ_Buffer_C4_29 : 28836|2@1+ (1,0) [0|2] "NA" MCU
 SG_ OBJ_Buffer_C5_29 : 28838|2@1+ (1,0) [0|2] "NA" MCU
 SG_ OBJ_Buffer_C6_29 : 28840|2@1+ (1,0) [0|2] "NA" MCU
 SG_ OBJ_Buffer_C7_29 : 28842|2@1+ (1,0) [0|2] "NA" MCU
 SG_ OBJ_OverlapAngleEgoLaneR_29 : 28844|10@1+ (0.01,-3.14) [-3.14|3.14] "rad" MCU
 SG_ OBJ_OverlapAngleEgoLaneR_V_29 : 28854|1@1+ (1,0) [0|1] "bool" MCU
 SG_ Reserved_25_29 : 28855|9@1+ (1,0) [0|0] "NA" MCU
 SG_ OBJ_OverlapAngleEgoLaneL_29 : 28864|10@1+ (0.01,-3.14) [-3.14|3.14] "rad" MCU
 SG_ OBJ_OverlapAngleEgoLaneL_V_29 : 28874|1@1+ (1,0) [0|1] "bool" MCU
 SG_ OBJ_Is_EMERGENCY_VCL_29 : 28875|1@1+ (1,0) [0|1] "bool" MCU
 SG_ OBJ_EMERGENCY_LIGHT_COLOR_29 : 28876|4@1+ (1,0) [0|15] "BITWIZE" MCU
 SG_ OBJ_EMERGENCY_V_29 : 28880|1@1+ (1,0) [0|1] "bool" MCU
 SG_ OBJ_Angle_Top_29 : 28881|14@1+ (0.0002,0) [0|3.1415] "rad" MCU
 SG_ OBJ_Angle_Top_V_29 : 28895|1@1+ (1,0) [0|1] "bool" MCU
 SG_ OBJ_Angle_Top_STD_29 : 28896|15@1+ (0.0001,0) [0|3.1415] "rad" MCU
 SG_ OBJ_Angle_Top_STD_V_29 : 28911|1@1+ (1,0) [0|1] "bool" MCU
 SG_ OBJ_Open_Door_Left_29 : 28912|1@1+ (1,0) [0|1] "bool" MCU
 SG_ OBJ_Open_Door_Right_29 : 28913|1@1+ (1,0) [0|1] "bool" MCU
 SG_ OBJ_Visible_Left_or_Right_29 : 28914|2@1+ (1,0) [0|2] "ENUM" MCU
 SG_ OBJ_Visible_Left_or_Right_V_29 : 28916|1@1+ (1,0) [0|1] "bool" MCU
 SG_ OBJ_2W_Is_Motorbike_Probability_29 : 28917|8@1+ (0.01,0) [0|1] "NA" MCU
 SG_ Reserved_26_29 : 28925|3@1+ (1,0) [0|0] "NA" MCU
 SG_ OBJ_2W_Is_Bicycle_Probability_29 : 28928|8@1+ (0.01,0) [0|1] "NA" MCU
 SG_ Reserved_27_29 : 28936|24@1+ (1,0) [0|0] "NA" MCU
 SG_ OBJ_CRC_30 : 28960|32@1+ (1,0) [0|4294967295] "NA" MCU
 SG_ OBJ_ID_30 : 28992|8@1+ (1,0) [0|255] "counter" MCU
 SG_ OBJ_Existence_Probability_30 : 29000|8@1+ (0.01,0) [0|1] "NA" MCU
 SG_ OBJ_Fusion_Source_30 : 29008|16@1+ (1,0) [0|65535] "BITWIZE" MCU
 SG_ OBJ_Triggered_SDM_30 : 29024|2@1+ (1,0) [0|2] "ENUM" MCU
 SG_ OBJ_Motion_Category_30 : 29026|4@1+ (1,0) [0|13] "ENUM" MCU
 SG_ OBJ_Moving_IN_Probability_30 : 29030|7@1+ (0.01,0) [0|1] "NA" MCU
 SG_ OBJ_Object_Age_30 : 29037|11@1+ (1,0) [0|2047] "frames" MCU
 SG_ OBJ_Measuring_Status_30 : 29048|3@1+ (1,0) [0|7] "BITWIZE" MCU
 SG_ OBJ_Object_Class_30 : 29051|4@1+ (1,0) [0|9] "ENUM" MCU
 SG_ Reserved_4_30 : 29055|1@1+ (1,0) [0|0] "NA" MCU
 SG_ OBJ_Class_Probability_30 : 29056|7@1+ (0.01,0) [0|1] "NA" MCU
 SG_ OBJ_Car_Probability_30 : 29063|7@1+ (0.01,0) [0|1] "NA" MCU
 SG_ OBJ_Truck_Probability_30 : 29070|7@1+ (0.01,0) [0|1] "NA" MCU
 SG_ OBJ_Bike_Probability_30 : 29077|7@1+ (0.01,0) [0|1] "NA" MCU
 SG_ OBJ_Camera_Source_30 : 29084|4@1+ (1,0) [0|15] "ENUM" MCU
 SG_ OBJ_Motion_Status_30 : 29088|3@1+ (1,0) [0|5] "ENUM" MCU
 SG_ OBJ_Motion_Orientation_30 : 29091|4@1+ (1,0) [0|13] "ENUM" MCU
 SG_ OBJ_Has_Cut_Lane_30 : 29095|1@1+ (1,0) [0|1] "bool" MCU
 SG_ OBJ_Has_Cut_Path_30 : 29096|1@1+ (1,0) [0|1] "bool" MCU
 SG_ OBJ_Brake_Light_Validity_30 : 29097|1@1+ (1,0) [0|1] "bool" MCU
 SG_ OBJ_Brake_Light_30 : 29098|1@1+ (1,0) [0|1] "bool" MCU
 SG_ OBJ_Turn_Indicator_Right_30 : 29099|1@1+ (1,0) [0|1] "bool" MCU
 SG_ OBJ_Turn_Indicator_Left_30 : 29100|1@1+ (1,0) [0|1] "bool" MCU
 SG_ OBJ_Turn_Indicator_Validity_30 : 29101|1@1+ (1,0) [0|1] "bool" MCU
 SG_ OBJ_Right_Out_Of_Image_30 : 29102|1@1+ (1,0) [0|1] "bool" MCU
 SG_ OBJ_Left_Out_Of_Image_30 : 29103|1@1+ (1,0) [0|1] "bool" MCU
 SG_ OBJ_Right_Out_Of_Image_V_30 : 29104|1@1+ (1,0) [0|1] "bool" MCU
 SG_ OBJ_Left_Out_Of_Image_V_30 : 29105|1@1+ (1,0) [0|1] "bool" MCU
 SG_ OBJ_Top_Out_Of_Image_30 : 29106|1@1+ (1,0) [0|1] "bool" MCU
 SG_ OBJ_Bottom_Out_Of_Image_30 : 29107|1@1+ (1,0) [0|1] "bool" MCU
 SG_ OBJ_Top_Out_Of_Image_V_30 : 29108|1@1+ (1,0) [0|1] "bool" MCU
 SG_ OBJ_Bottom_Out_Of_Image_V_30 : 29109|1@1+ (1,0) [0|1] "bool" MCU
 SG_ OBJ_Lane_Assignment_30 : 29110|3@1+ (1,0) [0|5] "ENUM" MCU
 SG_ OBJ_Lane_Assignment_V_30 : 29113|1@1+ (1,0) [0|1] "bool" MCU
 SG_ Reserved_5_30 : 29114|6@1+ (1,0) [0|0] "NA" MCU
 SG_ OBJ_Age_Seconds_30 : 29120|7@1+ (1,0) [0|100] "s" MCU
 SG_ OBJ_Age_Seconds_V_30 : 29127|1@1+ (1,0) [0|1] "bool" MCU
 SG_ OBJ_Width_30 : 29128|9@1+ (0.01,0) [0.4|2.95] "m" MCU
 SG_ OBJ_Width_V_30 : 29137|1@1+ (1,0) [0|1] "bool" MCU
 SG_ OBJ_Width_STD_30 : 29138|11@1+ (0.001,0) [0|2] "m" MCU
 SG_ OBJ_Width_STD_V_30 : 29149|1@1+ (1,0) [0|1] "bool" MCU
 SG_ Reserved_6_30 : 29150|2@1+ (1,0) [0|0] "NA" MCU
 SG_ OBJ_Length_30 : 29152|9@1+ (0.05,0) [0.6|21] "m" MCU
 SG_ OBJ_Length_V_30 : 29161|1@1+ (1,0) [0|1] "bool" MCU
 SG_ OBJ_Length_STD_30 : 29162|10@1+ (0.01,0) [0|10] "m" MCU
 SG_ OBJ_Length_STD_V_30 : 29172|1@1+ (1,0) [0|1] "bool" MCU
 SG_ OBJ_Radar_ID_30 : 29173|8@1+ (1,0) [0|255] "counter" MCU
 SG_ Reserved_7_30 : 29181|3@1+ (1,0) [0|0] "NA" MCU
 SG_ OBJ_Height_30 : 29184|9@1+ (0.01,0) [0|2.95] "m" MCU
 SG_ OBJ_Height_V_30 : 29193|1@1+ (1,0) [0|1] "bool" MCU
 SG_ OBJ_Height_STD_30 : 29194|11@1+ (0.001,0) [0|2] "m" MCU
 SG_ OBJ_Height_STD_V_30 : 29205|1@1+ (1,0) [0|1] "bool" MCU
 SG_ Reserved_8_30 : 29206|10@1+ (1,0) [0|0] "NA" MCU
 SG_ OBJ_Abs_Long_Velocity_30 : 29216|12@1+ (0.05,-100) [-100|100] "m_per_s" MCU
 SG_ OBJ_Abs_Long_Velocity_V_30 : 29228|1@1+ (1,0) [0|1] "bool" MCU
 SG_ OBJ_Abs_Long_Velocity_STD_30 : 29229|13@1+ (0.01,0) [0|65] "m_per_s" MCU
 SG_ OBJ_Abs_Long_Vel_STD_V_30 : 29242|1@1+ (1,0) [0|1] "bool" MCU
 SG_ Reserved_9_30 : 29243|5@1+ (1,0) [0|0] "NA" MCU
 SG_ OBJ_Abs_Lat_Velocity_30 : 29248|11@1+ (0.05,-50) [-50|50] "m_per_s" MCU
 SG_ OBJ_Abs_Lat_Velocity_V_30 : 29259|1@1+ (1,0) [0|1] "bool" MCU
 SG_ OBJ_Abs_Lat_Velocity_STD_30 : 29260|13@1+ (0.01,0) [0|50] "m_per_s" MCU
 SG_ OBJ_Abs_Lat_Vel_STD_V_30 : 29273|1@1+ (1,0) [0|1] "bool" MCU
 SG_ Reserved_10_30 : 29274|6@1+ (1,0) [0|0] "NA" MCU
 SG_ OBJ_Abs_Long_Acc_30 : 29280|9@1+ (0.05,-10) [-10|10] "m_per_s2" MCU
 SG_ OBJ_Abs_Long_Acc_V_30 : 29289|1@1+ (1,0) [0|1] "bool" MCU
 SG_ OBJ_Abs_Long_Acc_STD_30 : 29290|10@1+ (0.01,0) [0|7.3] "m_per_s2" MCU
 SG_ OBJ_Abs_Long_Acc_STD_V_30 : 29300|1@1+ (1,0) [0|1] "bool" MCU
 SG_ OBJ_Abs_Lat_Acc_30 : 29301|9@1+ (0.05,-10) [-10|10] "m_per_s2" MCU
 SG_ OBJ_Abs_Lat_Acc_V_30 : 29310|1@1+ (1,0) [0|1] "bool" MCU
 SG_ Reserved_11_30 : 29311|1@1+ (1,0) [0|0] "NA" MCU
 SG_ OBJ_Abs_Lat_Acc_STD_30 : 29312|10@1+ (0.01,0) [0|7.3] "m_per_s2" MCU
 SG_ OBJ_Abs_Lat_Acc_STD_V_30 : 29322|1@1+ (1,0) [0|1] "bool" MCU
 SG_ OBJ_Abs_Acceleration_30 : 29323|9@1+ (0.05,-12.7) [-12.7|12.7] "m_per_s2" MCU
 SG_ OBJ_Abs_Acceleration_V_30 : 29332|1@1+ (1,0) [0|1] "bool" MCU
 SG_ OBJ_Abs_Acc_STD_30 : 29333|10@1+ (0.01,0) [0|7.3] "m_per_s2" MCU
 SG_ OBJ_Abs_Acc_STD_V_30 : 29343|1@1+ (1,0) [0|1] "bool" MCU
 SG_ OBJ_Inv_TTC_30 : 29344|11@1+ (0.01,-8) [-8|8] "INV(s)" MCU
 SG_ OBJ_Inv_TTC_V_30 : 29355|1@1+ (1,0) [0|1] "bool" MCU
 SG_ OBJ_Inv_TTC_STD_30 : 29356|12@1+ (0.001,0) [0|4] "INV(s)" MCU
 SG_ OBJ_Inv_TTC_STD_V_30 : 29368|1@1+ (1,0) [0|1] "bool" MCU
 SG_ Reserved_12_30 : 29369|7@1+ (1,0) [0|0] "NA" MCU
 SG_ OBJ_Relative_Long_Acc_30 : 29376|10@1+ (0.05,-20) [-20|20] "m_per_s2" MCU
 SG_ OBJ_Relative_Long_Acc_V_30 : 29386|1@1+ (1,0) [0|1] "bool" MCU
 SG_ OBJ_Relative_Long_Acc_STD_30 : 29387|10@1+ (0.01,0) [0|7.3] "m_per_s2" MCU
 SG_ OBJ_Rel_Long_Acc_STD_V_30 : 29397|1@1+ (1,0) [0|1] "bool" MCU
 SG_ Reserved_13_30 : 29398|10@1+ (1,0) [0|0] "NA" MCU
 SG_ OBJ_Relative_Long_Velocity_30 : 29408|13@1+ (0.05,-120) [-120|130] "m_per_s" MCU
 SG_ OBJ_Relative_Long_Velocity_V_30 : 29421|1@1+ (1,0) [0|1] "bool" MCU
 SG_ OBJ_Relative_Long_Vel_STD_30 : 29422|14@1+ (0.01,0) [0|130] "m_per_s" MCU
 SG_ OBJ_Rel_Long_Vel_STD_V_30 : 29436|1@1+ (1,0) [0|1] "bool" MCU
 SG_ Reserved_14_30 : 29437|3@1+ (1,0) [0|0] "NA" MCU
 SG_ OBJ_Relative_Lat_Velocity_30 : 29440|11@1+ (0.05,-50) [-50|50] "m_per_s" MCU
 SG_ OBJ_Relative_Lat_Velocity_V_30 : 29451|1@1+ (1,0) [0|1] "bool" MCU
 SG_ OBJ_Relative_Lat_Velocity_STD_30 : 29452|13@1+ (0.01,0) [0|50] "m_per_s" MCU
 SG_ OBJ_Rel_Lat_Vel_STD_V_30 : 29465|1@1+ (1,0) [0|1] "bool" MCU
 SG_ Reserved_15_30 : 29466|6@1+ (1,0) [0|0] "NA" MCU
 SG_ OBJ_Long_Distance_30 : 29472|14@1+ (0.05,-200) [-200|500] "m" MCU
 SG_ OBJ_Long_Distance_V_30 : 29486|1@1+ (1,0) [0|1] "bool" MCU
 SG_ OBJ_Long_Distance_STD_30 : 29487|15@1+ (0.01,0) [0|250] "m" MCU
 SG_ OBJ_Long_Distance_STD_V_30 : 29502|1@1+ (1,0) [0|1] "bool" MCU
 SG_ Reserved_16_30 : 29503|1@1+ (1,0) [0|0] "NA" MCU
 SG_ OBJ_Lat_Distance_30 : 29504|12@1+ (0.05,-100) [-100|100] "m" MCU
 SG_ OBJ_Lat_Distance_V_30 : 29516|1@1+ (1,0) [0|1] "bool" MCU
 SG_ OBJ_Lat_Distance_STD_30 : 29517|14@1+ (0.01,0) [0|100] "m" MCU
 SG_ OBJ_Lat_Distance_STD_V_30 : 29531|1@1+ (1,0) [0|1] "bool" MCU
 SG_ Reserved_17_30 : 29532|4@1+ (1,0) [0|0] "NA" MCU
 SG_ OBJ_Absolute_Speed_30 : 29536|12@1+ (0.05,-65) [-65|65] "m_per_s" MCU
 SG_ OBJ_Absolute_Speed_V_30 : 29548|1@1+ (1,0) [0|1] "bool" MCU
 SG_ OBJ_Absolute_Speed_STD_30 : 29549|13@1+ (0.01,0) [0|65] "m_per_s" MCU
 SG_ OBJ_Absolute_Speed_STD_V_30 : 29562|1@1+ (1,0) [0|1] "bool" MCU
 SG_ Reserved_18_30 : 29563|5@1+ (1,0) [0|0] "NA" MCU
 SG_ OBJ_Heading_30 : 29568|10@1+ (0.01,-3.14) [-3.14|3.14] "rad" MCU
 SG_ OBJ_Heading_V_30 : 29578|1@1+ (1,0) [0|1] "bool" MCU
 SG_ OBJ_Heading_STD_30 : 29579|15@1+ (0.0001,0) [0|3.14] "rad" MCU
 SG_ OBJ_Heading_STD_V_30 : 29594|1@1+ (1,0) [0|1] "bool" MCU
 SG_ Reserved_19_30 : 29595|5@1+ (1,0) [0|0] "NA" MCU
 SG_ OBJ_Angle_Rate_STD_30 : 29600|15@1+ (0.0001,0) [0|2.2318] "RPS" MCU
 SG_ OBJ_Angle_Rate_STD_V_30 : 29615|1@1+ (1,0) [0|1] "bool" MCU
 SG_ OBJ_Angle_Rate_30 : 29616|12@1+ (0.002,-2.234) [-2.234|2.2318] "RPS" MCU
 SG_ OBJ_Angle_Rate_V_30 : 29628|1@1+ (1,0) [0|1] "bool" MCU
 SG_ Reserved_20_30 : 29629|3@1+ (1,0) [0|0] "NA" MCU
 SG_ OBJ_Angle_Right_30 : 29632|14@1+ (0.0002,-1.571) [-1.571|1.571] "rad" MCU
 SG_ OBJ_Angle_Right_V_30 : 29646|1@1+ (1,0) [0|1] "bool" MCU
 SG_ OBJ_Angle_Right_STD_30 : 29647|14@1+ (0.0001,0) [0|1.571] "rad" MCU
 SG_ OBJ_Angle_Right_STD_V_30 : 29661|1@1+ (1,0) [0|1] "bool" MCU
 SG_ Reserved_21_30 : 29662|2@1+ (1,0) [0|0] "NA" MCU
 SG_ OBJ_Angle_Left_30 : 29664|14@1+ (0.0002,-1.571) [-1.571|1.571] "rad" MCU
 SG_ OBJ_Angle_Left_V_30 : 29678|1@1+ (1,0) [0|1] "bool" MCU
 SG_ OBJ_Angle_Left_STD_30 : 29679|14@1+ (0.0001,0) [0|1.571] "rad" MCU
 SG_ OBJ_Angle_Left_STD_V_30 : 29693|1@1+ (1,0) [0|1] "bool" MCU
 SG_ Reserved_22_30 : 29694|2@1+ (1,0) [0|0] "NA" MCU
 SG_ OBJ_Angle_Side_30 : 29696|14@1+ (0.0002,-1.571) [-1.571|1.571] "rad" MCU
 SG_ OBJ_Angle_Side_V_30 : 29710|1@1+ (1,0) [0|1] "bool" MCU
 SG_ OBJ_Angle_Side_STD_30 : 29711|14@1+ (0.0001,0) [0|1.571] "rad" MCU
 SG_ OBJ_Angle_Side_STD_V_30 : 29725|1@1+ (1,0) [0|1] "bool" MCU
 SG_ OBJ_Angle_Mid_V_30 : 29726|1@1+ (1,0) [0|1] "bool" MCU
 SG_ Reserved_23_30 : 29727|1@1+ (1,0) [0|0] "NA" MCU
 SG_ OBJ_Angle_Mid_30 : 29728|14@1+ (0.0002,-1.571) [-1.571|1.571] "rad" MCU
 SG_ OBJ_Angle_Mid_STD_30 : 29742|14@1+ (0.0001,0) [0|1.571] "rad" MCU
 SG_ OBJ_Angle_Mid_STD_V_30 : 29756|1@1+ (1,0) [0|1] "bool" MCU
 SG_ OBJ_Angle_Bottom_V_30 : 29757|1@1+ (1,0) [0|1] "bool" MCU
 SG_ Reserved_24_30 : 29758|2@1+ (1,0) [0|0] "NA" MCU
 SG_ OBJ_Angle_Bottom_30 : 29760|14@1+ (0.0002,-1.571) [-1.571|1.571] "rad" MCU
 SG_ OBJ_Angle_Bottom_STD_30 : 29774|14@1+ (0.0001,0) [0|1.571] "rad" MCU
 SG_ OBJ_Angle_Bottom_STD_V_30 : 29788|1@1+ (1,0) [0|1] "bool" MCU
 SG_ OBJ_Visibility_Side_V_30 : 29789|1@1+ (1,0) [0|1] "bool" MCU
 SG_ OBJ_Visibility_Side_30 : 29790|2@1+ (1,0) [0|2] "ENUM" MCU
 SG_ OBJ_Is_In_Drivable_Area_30 : 29792|1@1+ (1,0) [0|1] "bool" MCU
 SG_ OBJ_Is_In_Drivable_Area_V_30 : 29793|1@1+ (1,0) [0|1] "bool" MCU
 SG_ OBJ_Is_VeryClose_V_30 : 29794|1@1+ (1,0) [0|1] "bool" MCU
 SG_ OBJ_Is_VeryClose_30 : 29795|1@1+ (1,0) [0|1] "bool" MCU
 SG_ OBJ_Buffer_C4_30 : 29796|2@1+ (1,0) [0|2] "NA" MCU
 SG_ OBJ_Buffer_C5_30 : 29798|2@1+ (1,0) [0|2] "NA" MCU
 SG_ OBJ_Buffer_C6_30 : 29800|2@1+ (1,0) [0|2] "NA" MCU
 SG_ OBJ_Buffer_C7_30 : 29802|2@1+ (1,0) [0|2] "NA" MCU
 SG_ OBJ_OverlapAngleEgoLaneR_30 : 29804|10@1+ (0.01,-3.14) [-3.14|3.14] "rad" MCU
 SG_ OBJ_OverlapAngleEgoLaneR_V_30 : 29814|1@1+ (1,0) [0|1] "bool" MCU
 SG_ Reserved_25_30 : 29815|9@1+ (1,0) [0|0] "NA" MCU
 SG_ OBJ_OverlapAngleEgoLaneL_30 : 29824|10@1+ (0.01,-3.14) [-3.14|3.14] "rad" MCU
 SG_ OBJ_OverlapAngleEgoLaneL_V_30 : 29834|1@1+ (1,0) [0|1] "bool" MCU
 SG_ OBJ_Is_EMERGENCY_VCL_30 : 29835|1@1+ (1,0) [0|1] "bool" MCU
 SG_ OBJ_EMERGENCY_LIGHT_COLOR_30 : 29836|4@1+ (1,0) [0|15] "BITWIZE" MCU
 SG_ OBJ_EMERGENCY_V_30 : 29840|1@1+ (1,0) [0|1] "bool" MCU
 SG_ OBJ_Angle_Top_30 : 29841|14@1+ (0.0002,0) [0|3.1415] "rad" MCU
 SG_ OBJ_Angle_Top_V_30 : 29855|1@1+ (1,0) [0|1] "bool" MCU
 SG_ OBJ_Angle_Top_STD_30 : 29856|15@1+ (0.0001,0) [0|3.1415] "rad" MCU
 SG_ OBJ_Angle_Top_STD_V_30 : 29871|1@1+ (1,0) [0|1] "bool" MCU
 SG_ OBJ_Open_Door_Left_30 : 29872|1@1+ (1,0) [0|1] "bool" MCU
 SG_ OBJ_Open_Door_Right_30 : 29873|1@1+ (1,0) [0|1] "bool" MCU
 SG_ OBJ_Visible_Left_or_Right_30 : 29874|2@1+ (1,0) [0|2] "ENUM" MCU
 SG_ OBJ_Visible_Left_or_Right_V_30 : 29876|1@1+ (1,0) [0|1] "bool" MCU
 SG_ OBJ_2W_Is_Motorbike_Probability_30 : 29877|8@1+ (0.01,0) [0|1] "NA" MCU
 SG_ Reserved_26_30 : 29885|3@1+ (1,0) [0|0] "NA" MCU
 SG_ OBJ_2W_Is_Bicycle_Probability_30 : 29888|8@1+ (0.01,0) [0|1] "NA" MCU
 SG_ Reserved_27_30 : 29896|24@1+ (1,0) [0|0] "NA" MCU
 SG_ OBJ_CRC_31 : 29920|32@1+ (1,0) [0|4294967295] "NA" MCU
 SG_ OBJ_ID_31 : 29952|8@1+ (1,0) [0|255] "counter" MCU
 SG_ OBJ_Existence_Probability_31 : 29960|8@1+ (0.01,0) [0|1] "NA" MCU
 SG_ OBJ_Fusion_Source_31 : 29968|16@1+ (1,0) [0|65535] "BITWIZE" MCU
 SG_ OBJ_Triggered_SDM_31 : 29984|2@1+ (1,0) [0|2] "ENUM" MCU
 SG_ OBJ_Motion_Category_31 : 29986|4@1+ (1,0) [0|13] "ENUM" MCU
 SG_ OBJ_Moving_IN_Probability_31 : 29990|7@1+ (0.01,0) [0|1] "NA" MCU
 SG_ OBJ_Object_Age_31 : 29997|11@1+ (1,0) [0|2047] "frames" MCU
 SG_ OBJ_Measuring_Status_31 : 30008|3@1+ (1,0) [0|7] "BITWIZE" MCU
 SG_ OBJ_Object_Class_31 : 30011|4@1+ (1,0) [0|9] "ENUM" MCU
 SG_ Reserved_4_31 : 30015|1@1+ (1,0) [0|0] "NA" MCU
 SG_ OBJ_Class_Probability_31 : 30016|7@1+ (0.01,0) [0|1] "NA" MCU
 SG_ OBJ_Car_Probability_31 : 30023|7@1+ (0.01,0) [0|1] "NA" MCU
 SG_ OBJ_Truck_Probability_31 : 30030|7@1+ (0.01,0) [0|1] "NA" MCU
 SG_ OBJ_Bike_Probability_31 : 30037|7@1+ (0.01,0) [0|1] "NA" MCU
 SG_ OBJ_Camera_Source_31 : 30044|4@1+ (1,0) [0|15] "ENUM" MCU
 SG_ OBJ_Motion_Status_31 : 30048|3@1+ (1,0) [0|5] "ENUM" MCU
 SG_ OBJ_Motion_Orientation_31 : 30051|4@1+ (1,0) [0|13] "ENUM" MCU
 SG_ OBJ_Has_Cut_Lane_31 : 30055|1@1+ (1,0) [0|1] "bool" MCU
 SG_ OBJ_Has_Cut_Path_31 : 30056|1@1+ (1,0) [0|1] "bool" MCU
 SG_ OBJ_Brake_Light_Validity_31 : 30057|1@1+ (1,0) [0|1] "bool" MCU
 SG_ OBJ_Brake_Light_31 : 30058|1@1+ (1,0) [0|1] "bool" MCU
 SG_ OBJ_Turn_Indicator_Right_31 : 30059|1@1+ (1,0) [0|1] "bool" MCU
 SG_ OBJ_Turn_Indicator_Left_31 : 30060|1@1+ (1,0) [0|1] "bool" MCU
 SG_ OBJ_Turn_Indicator_Validity_31 : 30061|1@1+ (1,0) [0|1] "bool" MCU
 SG_ OBJ_Right_Out_Of_Image_31 : 30062|1@1+ (1,0) [0|1] "bool" MCU
 SG_ OBJ_Left_Out_Of_Image_31 : 30063|1@1+ (1,0) [0|1] "bool" MCU
 SG_ OBJ_Right_Out_Of_Image_V_31 : 30064|1@1+ (1,0) [0|1] "bool" MCU
 SG_ OBJ_Left_Out_Of_Image_V_31 : 30065|1@1+ (1,0) [0|1] "bool" MCU
 SG_ OBJ_Top_Out_Of_Image_31 : 30066|1@1+ (1,0) [0|1] "bool" MCU
 SG_ OBJ_Bottom_Out_Of_Image_31 : 30067|1@1+ (1,0) [0|1] "bool" MCU
 SG_ OBJ_Top_Out_Of_Image_V_31 : 30068|1@1+ (1,0) [0|1] "bool" MCU
 SG_ OBJ_Bottom_Out_Of_Image_V_31 : 30069|1@1+ (1,0) [0|1] "bool" MCU
 SG_ OBJ_Lane_Assignment_31 : 30070|3@1+ (1,0) [0|5] "ENUM" MCU
 SG_ OBJ_Lane_Assignment_V_31 : 30073|1@1+ (1,0) [0|1] "bool" MCU
 SG_ Reserved_5_31 : 30074|6@1+ (1,0) [0|0] "NA" MCU
 SG_ OBJ_Age_Seconds_31 : 30080|7@1+ (1,0) [0|100] "s" MCU
 SG_ OBJ_Age_Seconds_V_31 : 30087|1@1+ (1,0) [0|1] "bool" MCU
 SG_ OBJ_Width_31 : 30088|9@1+ (0.01,0) [0.4|2.95] "m" MCU
 SG_ OBJ_Width_V_31 : 30097|1@1+ (1,0) [0|1] "bool" MCU
 SG_ OBJ_Width_STD_31 : 30098|11@1+ (0.001,0) [0|2] "m" MCU
 SG_ OBJ_Width_STD_V_31 : 30109|1@1+ (1,0) [0|1] "bool" MCU
 SG_ Reserved_6_31 : 30110|2@1+ (1,0) [0|0] "NA" MCU
 SG_ OBJ_Length_31 : 30112|9@1+ (0.05,0) [0.6|21] "m" MCU
 SG_ OBJ_Length_V_31 : 30121|1@1+ (1,0) [0|1] "bool" MCU
 SG_ OBJ_Length_STD_31 : 30122|10@1+ (0.01,0) [0|10] "m" MCU
 SG_ OBJ_Length_STD_V_31 : 30132|1@1+ (1,0) [0|1] "bool" MCU
 SG_ OBJ_Radar_ID_31 : 30133|8@1+ (1,0) [0|255] "counter" MCU
 SG_ Reserved_7_31 : 30141|3@1+ (1,0) [0|0] "NA" MCU
 SG_ OBJ_Height_31 : 30144|9@1+ (0.01,0) [0|2.95] "m" MCU
 SG_ OBJ_Height_V_31 : 30153|1@1+ (1,0) [0|1] "bool" MCU
 SG_ OBJ_Height_STD_31 : 30154|11@1+ (0.001,0) [0|2] "m" MCU
 SG_ OBJ_Height_STD_V_31 : 30165|1@1+ (1,0) [0|1] "bool" MCU
 SG_ Reserved_8_31 : 30166|10@1+ (1,0) [0|0] "NA" MCU
 SG_ OBJ_Abs_Long_Velocity_31 : 30176|12@1+ (0.05,-100) [-100|100] "m_per_s" MCU
 SG_ OBJ_Abs_Long_Velocity_V_31 : 30188|1@1+ (1,0) [0|1] "bool" MCU
 SG_ OBJ_Abs_Long_Velocity_STD_31 : 30189|13@1+ (0.01,0) [0|65] "m_per_s" MCU
 SG_ OBJ_Abs_Long_Vel_STD_V_31 : 30202|1@1+ (1,0) [0|1] "bool" MCU
 SG_ Reserved_9_31 : 30203|5@1+ (1,0) [0|0] "NA" MCU
 SG_ OBJ_Abs_Lat_Velocity_31 : 30208|11@1+ (0.05,-50) [-50|50] "m_per_s" MCU
 SG_ OBJ_Abs_Lat_Velocity_V_31 : 30219|1@1+ (1,0) [0|1] "bool" MCU
 SG_ OBJ_Abs_Lat_Velocity_STD_31 : 30220|13@1+ (0.01,0) [0|50] "m_per_s" MCU
 SG_ OBJ_Abs_Lat_Vel_STD_V_31 : 30233|1@1+ (1,0) [0|1] "bool" MCU
 SG_ Reserved_10_31 : 30234|6@1+ (1,0) [0|0] "NA" MCU
 SG_ OBJ_Abs_Long_Acc_31 : 30240|9@1+ (0.05,-10) [-10|10] "m_per_s2" MCU
 SG_ OBJ_Abs_Long_Acc_V_31 : 30249|1@1+ (1,0) [0|1] "bool" MCU
 SG_ OBJ_Abs_Long_Acc_STD_31 : 30250|10@1+ (0.01,0) [0|7.3] "m_per_s2" MCU
 SG_ OBJ_Abs_Long_Acc_STD_V_31 : 30260|1@1+ (1,0) [0|1] "bool" MCU
 SG_ OBJ_Abs_Lat_Acc_31 : 30261|9@1+ (0.05,-10) [-10|10] "m_per_s2" MCU
 SG_ OBJ_Abs_Lat_Acc_V_31 : 30270|1@1+ (1,0) [0|1] "bool" MCU
 SG_ Reserved_11_31 : 30271|1@1+ (1,0) [0|0] "NA" MCU
 SG_ OBJ_Abs_Lat_Acc_STD_31 : 30272|10@1+ (0.01,0) [0|7.3] "m_per_s2" MCU
 SG_ OBJ_Abs_Lat_Acc_STD_V_31 : 30282|1@1+ (1,0) [0|1] "bool" MCU
 SG_ OBJ_Abs_Acceleration_31 : 30283|9@1+ (0.05,-12.7) [-12.7|12.7] "m_per_s2" MCU
 SG_ OBJ_Abs_Acceleration_V_31 : 30292|1@1+ (1,0) [0|1] "bool" MCU
 SG_ OBJ_Abs_Acc_STD_31 : 30293|10@1+ (0.01,0) [0|7.3] "m_per_s2" MCU
 SG_ OBJ_Abs_Acc_STD_V_31 : 30303|1@1+ (1,0) [0|1] "bool" MCU
 SG_ OBJ_Inv_TTC_31 : 30304|11@1+ (0.01,-8) [-8|8] "INV(s)" MCU
 SG_ OBJ_Inv_TTC_V_31 : 30315|1@1+ (1,0) [0|1] "bool" MCU
 SG_ OBJ_Inv_TTC_STD_31 : 30316|12@1+ (0.001,0) [0|4] "INV(s)" MCU
 SG_ OBJ_Inv_TTC_STD_V_31 : 30328|1@1+ (1,0) [0|1] "bool" MCU
 SG_ Reserved_12_31 : 30329|7@1+ (1,0) [0|0] "NA" MCU
 SG_ OBJ_Relative_Long_Acc_31 : 30336|10@1+ (0.05,-20) [-20|20] "m_per_s2" MCU
 SG_ OBJ_Relative_Long_Acc_V_31 : 30346|1@1+ (1,0) [0|1] "bool" MCU
 SG_ OBJ_Relative_Long_Acc_STD_31 : 30347|10@1+ (0.01,0) [0|7.3] "m_per_s2" MCU
 SG_ OBJ_Rel_Long_Acc_STD_V_31 : 30357|1@1+ (1,0) [0|1] "bool" MCU
 SG_ Reserved_13_31 : 30358|10@1+ (1,0) [0|0] "NA" MCU
 SG_ OBJ_Relative_Long_Velocity_31 : 30368|13@1+ (0.05,-120) [-120|130] "m_per_s" MCU
 SG_ OBJ_Relative_Long_Velocity_V_31 : 30381|1@1+ (1,0) [0|1] "bool" MCU
 SG_ OBJ_Relative_Long_Vel_STD_31 : 30382|14@1+ (0.01,0) [0|130] "m_per_s" MCU
 SG_ OBJ_Rel_Long_Vel_STD_V_31 : 30396|1@1+ (1,0) [0|1] "bool" MCU
 SG_ Reserved_14_31 : 30397|3@1+ (1,0) [0|0] "NA" MCU
 SG_ OBJ_Relative_Lat_Velocity_31 : 30400|11@1+ (0.05,-50) [-50|50] "m_per_s" MCU
 SG_ OBJ_Relative_Lat_Velocity_V_31 : 30411|1@1+ (1,0) [0|1] "bool" MCU
 SG_ OBJ_Relative_Lat_Velocity_STD_31 : 30412|13@1+ (0.01,0) [0|50] "m_per_s" MCU
 SG_ OBJ_Rel_Lat_Vel_STD_V_31 : 30425|1@1+ (1,0) [0|1] "bool" MCU
 SG_ Reserved_15_31 : 30426|6@1+ (1,0) [0|0] "NA" MCU
 SG_ OBJ_Long_Distance_31 : 30432|14@1+ (0.05,-200) [-200|500] "m" MCU
 SG_ OBJ_Long_Distance_V_31 : 30446|1@1+ (1,0) [0|1] "bool" MCU
 SG_ OBJ_Long_Distance_STD_31 : 30447|15@1+ (0.01,0) [0|250] "m" MCU
 SG_ OBJ_Long_Distance_STD_V_31 : 30462|1@1+ (1,0) [0|1] "bool" MCU
 SG_ Reserved_16_31 : 30463|1@1+ (1,0) [0|0] "NA" MCU
 SG_ OBJ_Lat_Distance_31 : 30464|12@1+ (0.05,-100) [-100|100] "m" MCU
 SG_ OBJ_Lat_Distance_V_31 : 30476|1@1+ (1,0) [0|1] "bool" MCU
 SG_ OBJ_Lat_Distance_STD_31 : 30477|14@1+ (0.01,0) [0|100] "m" MCU
 SG_ OBJ_Lat_Distance_STD_V_31 : 30491|1@1+ (1,0) [0|1] "bool" MCU
 SG_ Reserved_17_31 : 30492|4@1+ (1,0) [0|0] "NA" MCU
 SG_ OBJ_Absolute_Speed_31 : 30496|12@1+ (0.05,-65) [-65|65] "m_per_s" MCU
 SG_ OBJ_Absolute_Speed_V_31 : 30508|1@1+ (1,0) [0|1] "bool" MCU
 SG_ OBJ_Absolute_Speed_STD_31 : 30509|13@1+ (0.01,0) [0|65] "m_per_s" MCU
 SG_ OBJ_Absolute_Speed_STD_V_31 : 30522|1@1+ (1,0) [0|1] "bool" MCU
 SG_ Reserved_18_31 : 30523|5@1+ (1,0) [0|0] "NA" MCU
 SG_ OBJ_Heading_31 : 30528|10@1+ (0.01,-3.14) [-3.14|3.14] "rad" MCU
 SG_ OBJ_Heading_V_31 : 30538|1@1+ (1,0) [0|1] "bool" MCU
 SG_ OBJ_Heading_STD_31 : 30539|15@1+ (0.0001,0) [0|3.14] "rad" MCU
 SG_ OBJ_Heading_STD_V_31 : 30554|1@1+ (1,0) [0|1] "bool" MCU
 SG_ Reserved_19_31 : 30555|5@1+ (1,0) [0|0] "NA" MCU
 SG_ OBJ_Angle_Rate_STD_31 : 30560|15@1+ (0.0001,0) [0|2.2318] "RPS" MCU
 SG_ OBJ_Angle_Rate_STD_V_31 : 30575|1@1+ (1,0) [0|1] "bool" MCU
 SG_ OBJ_Angle_Rate_31 : 30576|12@1+ (0.002,-2.234) [-2.234|2.2318] "RPS" MCU
 SG_ OBJ_Angle_Rate_V_31 : 30588|1@1+ (1,0) [0|1] "bool" MCU
 SG_ Reserved_20_31 : 30589|3@1+ (1,0) [0|0] "NA" MCU
 SG_ OBJ_Angle_Right_31 : 30592|14@1+ (0.0002,-1.571) [-1.571|1.571] "rad" MCU
 SG_ OBJ_Angle_Right_V_31 : 30606|1@1+ (1,0) [0|1] "bool" MCU
 SG_ OBJ_Angle_Right_STD_31 : 30607|14@1+ (0.0001,0) [0|1.571] "rad" MCU
 SG_ OBJ_Angle_Right_STD_V_31 : 30621|1@1+ (1,0) [0|1] "bool" MCU
 SG_ Reserved_21_31 : 30622|2@1+ (1,0) [0|0] "NA" MCU
 SG_ OBJ_Angle_Left_31 : 30624|14@1+ (0.0002,-1.571) [-1.571|1.571] "rad" MCU
 SG_ OBJ_Angle_Left_V_31 : 30638|1@1+ (1,0) [0|1] "bool" MCU
 SG_ OBJ_Angle_Left_STD_31 : 30639|14@1+ (0.0001,0) [0|1.571] "rad" MCU
 SG_ OBJ_Angle_Left_STD_V_31 : 30653|1@1+ (1,0) [0|1] "bool" MCU
 SG_ Reserved_22_31 : 30654|2@1+ (1,0) [0|0] "NA" MCU
 SG_ OBJ_Angle_Side_31 : 30656|14@1+ (0.0002,-1.571) [-1.571|1.571] "rad" MCU
 SG_ OBJ_Angle_Side_V_31 : 30670|1@1+ (1,0) [0|1] "bool" MCU
 SG_ OBJ_Angle_Side_STD_31 : 30671|14@1+ (0.0001,0) [0|1.571] "rad" MCU
 SG_ OBJ_Angle_Side_STD_V_31 : 30685|1@1+ (1,0) [0|1] "bool" MCU
 SG_ OBJ_Angle_Mid_V_31 : 30686|1@1+ (1,0) [0|1] "bool" MCU
 SG_ Reserved_23_31 : 30687|1@1+ (1,0) [0|0] "NA" MCU
 SG_ OBJ_Angle_Mid_31 : 30688|14@1+ (0.0002,-1.571) [-1.571|1.571] "rad" MCU
 SG_ OBJ_Angle_Mid_STD_31 : 30702|14@1+ (0.0001,0) [0|1.571] "rad" MCU
 SG_ OBJ_Angle_Mid_STD_V_31 : 30716|1@1+ (1,0) [0|1] "bool" MCU
 SG_ OBJ_Angle_Bottom_V_31 : 30717|1@1+ (1,0) [0|1] "bool" MCU
 SG_ Reserved_24_31 : 30718|2@1+ (1,0) [0|0] "NA" MCU
 SG_ OBJ_Angle_Bottom_31 : 30720|14@1+ (0.0002,-1.571) [-1.571|1.571] "rad" MCU
 SG_ OBJ_Angle_Bottom_STD_31 : 30734|14@1+ (0.0001,0) [0|1.571] "rad" MCU
 SG_ OBJ_Angle_Bottom_STD_V_31 : 30748|1@1+ (1,0) [0|1] "bool" MCU
 SG_ OBJ_Visibility_Side_V_31 : 30749|1@1+ (1,0) [0|1] "bool" MCU
 SG_ OBJ_Visibility_Side_31 : 30750|2@1+ (1,0) [0|2] "ENUM" MCU
 SG_ OBJ_Is_In_Drivable_Area_31 : 30752|1@1+ (1,0) [0|1] "bool" MCU
 SG_ OBJ_Is_In_Drivable_Area_V_31 : 30753|1@1+ (1,0) [0|1] "bool" MCU
 SG_ OBJ_Is_VeryClose_V_31 : 30754|1@1+ (1,0) [0|1] "bool" MCU
 SG_ OBJ_Is_VeryClose_31 : 30755|1@1+ (1,0) [0|1] "bool" MCU
 SG_ OBJ_Buffer_C4_31 : 30756|2@1+ (1,0) [0|2] "NA" MCU
 SG_ OBJ_Buffer_C5_31 : 30758|2@1+ (1,0) [0|2] "NA" MCU
 SG_ OBJ_Buffer_C6_31 : 30760|2@1+ (1,0) [0|2] "NA" MCU
 SG_ OBJ_Buffer_C7_31 : 30762|2@1+ (1,0) [0|2] "NA" MCU
 SG_ OBJ_OverlapAngleEgoLaneR_31 : 30764|10@1+ (0.01,-3.14) [-3.14|3.14] "rad" MCU
 SG_ OBJ_OverlapAngleEgoLaneR_V_31 : 30774|1@1+ (1,0) [0|1] "bool" MCU
 SG_ Reserved_25_31 : 30775|9@1+ (1,0) [0|0] "NA" MCU
 SG_ OBJ_OverlapAngleEgoLaneL_31 : 30784|10@1+ (0.01,-3.14) [-3.14|3.14] "rad" MCU
 SG_ OBJ_OverlapAngleEgoLaneL_V_31 : 30794|1@1+ (1,0) [0|1] "bool" MCU
 SG_ OBJ_Is_EMERGENCY_VCL_31 : 30795|1@1+ (1,0) [0|1] "bool" MCU
 SG_ OBJ_EMERGENCY_LIGHT_COLOR_31 : 30796|4@1+ (1,0) [0|15] "BITWIZE" MCU
 SG_ OBJ_EMERGENCY_V_31 : 30800|1@1+ (1,0) [0|1] "bool" MCU
 SG_ OBJ_Angle_Top_31 : 30801|14@1+ (0.0002,0) [0|3.1415] "rad" MCU
 SG_ OBJ_Angle_Top_V_31 : 30815|1@1+ (1,0) [0|1] "bool" MCU
 SG_ OBJ_Angle_Top_STD_31 : 30816|15@1+ (0.0001,0) [0|3.1415] "rad" MCU
 SG_ OBJ_Angle_Top_STD_V_31 : 30831|1@1+ (1,0) [0|1] "bool" MCU
 SG_ OBJ_Open_Door_Left_31 : 30832|1@1+ (1,0) [0|1] "bool" MCU
 SG_ OBJ_Open_Door_Right_31 : 30833|1@1+ (1,0) [0|1] "bool" MCU
 SG_ OBJ_Visible_Left_or_Right_31 : 30834|2@1+ (1,0) [0|2] "ENUM" MCU
 SG_ OBJ_Visible_Left_or_Right_V_31 : 30836|1@1+ (1,0) [0|1] "bool" MCU
 SG_ OBJ_2W_Is_Motorbike_Probability_31 : 30837|8@1+ (0.01,0) [0|1] "NA" MCU
 SG_ Reserved_26_31 : 30845|3@1+ (1,0) [0|0] "NA" MCU
 SG_ OBJ_2W_Is_Bicycle_Probability_31 : 30848|8@1+ (0.01,0) [0|1] "NA" MCU
 SG_ Reserved_27_31 : 30856|24@1+ (1,0) [0|0] "NA" MCU
 SG_ OBJ_CRC_32 : 30880|32@1+ (1,0) [0|4294967295] "NA" MCU
 SG_ OBJ_ID_32 : 30912|8@1+ (1,0) [0|255] "counter" MCU
 SG_ OBJ_Existence_Probability_32 : 30920|8@1+ (0.01,0) [0|1] "NA" MCU
 SG_ OBJ_Fusion_Source_32 : 30928|16@1+ (1,0) [0|65535] "BITWIZE" MCU
 SG_ OBJ_Triggered_SDM_32 : 30944|2@1+ (1,0) [0|2] "ENUM" MCU
 SG_ OBJ_Motion_Category_32 : 30946|4@1+ (1,0) [0|13] "ENUM" MCU
 SG_ OBJ_Moving_IN_Probability_32 : 30950|7@1+ (0.01,0) [0|1] "NA" MCU
 SG_ OBJ_Object_Age_32 : 30957|11@1+ (1,0) [0|2047] "frames" MCU
 SG_ OBJ_Measuring_Status_32 : 30968|3@1+ (1,0) [0|7] "BITWIZE" MCU
 SG_ OBJ_Object_Class_32 : 30971|4@1+ (1,0) [0|9] "ENUM" MCU
 SG_ Reserved_4_32 : 30975|1@1+ (1,0) [0|0] "NA" MCU
 SG_ OBJ_Class_Probability_32 : 30976|7@1+ (0.01,0) [0|1] "NA" MCU
 SG_ OBJ_Car_Probability_32 : 30983|7@1+ (0.01,0) [0|1] "NA" MCU
 SG_ OBJ_Truck_Probability_32 : 30990|7@1+ (0.01,0) [0|1] "NA" MCU
 SG_ OBJ_Bike_Probability_32 : 30997|7@1+ (0.01,0) [0|1] "NA" MCU
 SG_ OBJ_Camera_Source_32 : 31004|4@1+ (1,0) [0|15] "ENUM" MCU
 SG_ OBJ_Motion_Status_32 : 31008|3@1+ (1,0) [0|5] "ENUM" MCU
 SG_ OBJ_Motion_Orientation_32 : 31011|4@1+ (1,0) [0|13] "ENUM" MCU
 SG_ OBJ_Has_Cut_Lane_32 : 31015|1@1+ (1,0) [0|1] "bool" MCU
 SG_ OBJ_Has_Cut_Path_32 : 31016|1@1+ (1,0) [0|1] "bool" MCU
 SG_ OBJ_Brake_Light_Validity_32 : 31017|1@1+ (1,0) [0|1] "bool" MCU
 SG_ OBJ_Brake_Light_32 : 31018|1@1+ (1,0) [0|1] "bool" MCU
 SG_ OBJ_Turn_Indicator_Right_32 : 31019|1@1+ (1,0) [0|1] "bool" MCU
 SG_ OBJ_Turn_Indicator_Left_32 : 31020|1@1+ (1,0) [0|1] "bool" MCU
 SG_ OBJ_Turn_Indicator_Validity_32 : 31021|1@1+ (1,0) [0|1] "bool" MCU
 SG_ OBJ_Right_Out_Of_Image_32 : 31022|1@1+ (1,0) [0|1] "bool" MCU
 SG_ OBJ_Left_Out_Of_Image_32 : 31023|1@1+ (1,0) [0|1] "bool" MCU
 SG_ OBJ_Right_Out_Of_Image_V_32 : 31024|1@1+ (1,0) [0|1] "bool" MCU
 SG_ OBJ_Left_Out_Of_Image_V_32 : 31025|1@1+ (1,0) [0|1] "bool" MCU
 SG_ OBJ_Top_Out_Of_Image_32 : 31026|1@1+ (1,0) [0|1] "bool" MCU
 SG_ OBJ_Bottom_Out_Of_Image_32 : 31027|1@1+ (1,0) [0|1] "bool" MCU
 SG_ OBJ_Top_Out_Of_Image_V_32 : 31028|1@1+ (1,0) [0|1] "bool" MCU
 SG_ OBJ_Bottom_Out_Of_Image_V_32 : 31029|1@1+ (1,0) [0|1] "bool" MCU
 SG_ OBJ_Lane_Assignment_32 : 31030|3@1+ (1,0) [0|5] "ENUM" MCU
 SG_ OBJ_Lane_Assignment_V_32 : 31033|1@1+ (1,0) [0|1] "bool" MCU
 SG_ Reserved_5_32 : 31034|6@1+ (1,0) [0|0] "NA" MCU
 SG_ OBJ_Age_Seconds_32 : 31040|7@1+ (1,0) [0|100] "s" MCU
 SG_ OBJ_Age_Seconds_V_32 : 31047|1@1+ (1,0) [0|1] "bool" MCU
 SG_ OBJ_Width_32 : 31048|9@1+ (0.01,0) [0.4|2.95] "m" MCU
 SG_ OBJ_Width_V_32 : 31057|1@1+ (1,0) [0|1] "bool" MCU
 SG_ OBJ_Width_STD_32 : 31058|11@1+ (0.001,0) [0|2] "m" MCU
 SG_ OBJ_Width_STD_V_32 : 31069|1@1+ (1,0) [0|1] "bool" MCU
 SG_ Reserved_6_32 : 31070|2@1+ (1,0) [0|0] "NA" MCU
 SG_ OBJ_Length_32 : 31072|9@1+ (0.05,0) [0.6|21] "m" MCU
 SG_ OBJ_Length_V_32 : 31081|1@1+ (1,0) [0|1] "bool" MCU
 SG_ OBJ_Length_STD_32 : 31082|10@1+ (0.01,0) [0|10] "m" MCU
 SG_ OBJ_Length_STD_V_32 : 31092|1@1+ (1,0) [0|1] "bool" MCU
 SG_ OBJ_Radar_ID_32 : 31093|8@1+ (1,0) [0|255] "counter" MCU
 SG_ Reserved_7_32 : 31101|3@1+ (1,0) [0|0] "NA" MCU
 SG_ OBJ_Height_32 : 31104|9@1+ (0.01,0) [0|2.95] "m" MCU
 SG_ OBJ_Height_V_32 : 31113|1@1+ (1,0) [0|1] "bool" MCU
 SG_ OBJ_Height_STD_32 : 31114|11@1+ (0.001,0) [0|2] "m" MCU
 SG_ OBJ_Height_STD_V_32 : 31125|1@1+ (1,0) [0|1] "bool" MCU
 SG_ Reserved_8_32 : 31126|10@1+ (1,0) [0|0] "NA" MCU
 SG_ OBJ_Abs_Long_Velocity_32 : 31136|12@1+ (0.05,-100) [-100|100] "m_per_s" MCU
 SG_ OBJ_Abs_Long_Velocity_V_32 : 31148|1@1+ (1,0) [0|1] "bool" MCU
 SG_ OBJ_Abs_Long_Velocity_STD_32 : 31149|13@1+ (0.01,0) [0|65] "m_per_s" MCU
 SG_ OBJ_Abs_Long_Vel_STD_V_32 : 31162|1@1+ (1,0) [0|1] "bool" MCU
 SG_ Reserved_9_32 : 31163|5@1+ (1,0) [0|0] "NA" MCU
 SG_ OBJ_Abs_Lat_Velocity_32 : 31168|11@1+ (0.05,-50) [-50|50] "m_per_s" MCU
 SG_ OBJ_Abs_Lat_Velocity_V_32 : 31179|1@1+ (1,0) [0|1] "bool" MCU
 SG_ OBJ_Abs_Lat_Velocity_STD_32 : 31180|13@1+ (0.01,0) [0|50] "m_per_s" MCU
 SG_ OBJ_Abs_Lat_Vel_STD_V_32 : 31193|1@1+ (1,0) [0|1] "bool" MCU
 SG_ Reserved_10_32 : 31194|6@1+ (1,0) [0|0] "NA" MCU
 SG_ OBJ_Abs_Long_Acc_32 : 31200|9@1+ (0.05,-10) [-10|10] "m_per_s2" MCU
 SG_ OBJ_Abs_Long_Acc_V_32 : 31209|1@1+ (1,0) [0|1] "bool" MCU
 SG_ OBJ_Abs_Long_Acc_STD_32 : 31210|10@1+ (0.01,0) [0|7.3] "m_per_s2" MCU
 SG_ OBJ_Abs_Long_Acc_STD_V_32 : 31220|1@1+ (1,0) [0|1] "bool" MCU
 SG_ OBJ_Abs_Lat_Acc_32 : 31221|9@1+ (0.05,-10) [-10|10] "m_per_s2" MCU
 SG_ OBJ_Abs_Lat_Acc_V_32 : 31230|1@1+ (1,0) [0|1] "bool" MCU
 SG_ Reserved_11_32 : 31231|1@1+ (1,0) [0|0] "NA" MCU
 SG_ OBJ_Abs_Lat_Acc_STD_32 : 31232|10@1+ (0.01,0) [0|7.3] "m_per_s2" MCU
 SG_ OBJ_Abs_Lat_Acc_STD_V_32 : 31242|1@1+ (1,0) [0|1] "bool" MCU
 SG_ OBJ_Abs_Acceleration_32 : 31243|9@1+ (0.05,-12.7) [-12.7|12.7] "m_per_s2" MCU
 SG_ OBJ_Abs_Acceleration_V_32 : 31252|1@1+ (1,0) [0|1] "bool" MCU
 SG_ OBJ_Abs_Acc_STD_32 : 31253|10@1+ (0.01,0) [0|7.3] "m_per_s2" MCU
 SG_ OBJ_Abs_Acc_STD_V_32 : 31263|1@1+ (1,0) [0|1] "bool" MCU
 SG_ OBJ_Inv_TTC_32 : 31264|11@1+ (0.01,-8) [-8|8] "INV(s)" MCU
 SG_ OBJ_Inv_TTC_V_32 : 31275|1@1+ (1,0) [0|1] "bool" MCU
 SG_ OBJ_Inv_TTC_STD_32 : 31276|12@1+ (0.001,0) [0|4] "INV(s)" MCU
 SG_ OBJ_Inv_TTC_STD_V_32 : 31288|1@1+ (1,0) [0|1] "bool" MCU
 SG_ Reserved_12_32 : 31289|7@1+ (1,0) [0|0] "NA" MCU
 SG_ OBJ_Relative_Long_Acc_32 : 31296|10@1+ (0.05,-20) [-20|20] "m_per_s2" MCU
 SG_ OBJ_Relative_Long_Acc_V_32 : 31306|1@1+ (1,0) [0|1] "bool" MCU
 SG_ OBJ_Relative_Long_Acc_STD_32 : 31307|10@1+ (0.01,0) [0|7.3] "m_per_s2" MCU
 SG_ OBJ_Rel_Long_Acc_STD_V_32 : 31317|1@1+ (1,0) [0|1] "bool" MCU
 SG_ Reserved_13_32 : 31318|10@1+ (1,0) [0|0] "NA" MCU
 SG_ OBJ_Relative_Long_Velocity_32 : 31328|13@1+ (0.05,-120) [-120|130] "m_per_s" MCU
 SG_ OBJ_Relative_Long_Velocity_V_32 : 31341|1@1+ (1,0) [0|1] "bool" MCU
 SG_ OBJ_Relative_Long_Vel_STD_32 : 31342|14@1+ (0.01,0) [0|130] "m_per_s" MCU
 SG_ OBJ_Rel_Long_Vel_STD_V_32 : 31356|1@1+ (1,0) [0|1] "bool" MCU
 SG_ Reserved_14_32 : 31357|3@1+ (1,0) [0|0] "NA" MCU
 SG_ OBJ_Relative_Lat_Velocity_32 : 31360|11@1+ (0.05,-50) [-50|50] "m_per_s" MCU
 SG_ OBJ_Relative_Lat_Velocity_V_32 : 31371|1@1+ (1,0) [0|1] "bool" MCU
 SG_ OBJ_Relative_Lat_Velocity_STD_32 : 31372|13@1+ (0.01,0) [0|50] "m_per_s" MCU
 SG_ OBJ_Rel_Lat_Vel_STD_V_32 : 31385|1@1+ (1,0) [0|1] "bool" MCU
 SG_ Reserved_15_32 : 31386|6@1+ (1,0) [0|0] "NA" MCU
 SG_ OBJ_Long_Distance_32 : 31392|14@1+ (0.05,-200) [-200|500] "m" MCU
 SG_ OBJ_Long_Distance_V_32 : 31406|1@1+ (1,0) [0|1] "bool" MCU
 SG_ OBJ_Long_Distance_STD_32 : 31407|15@1+ (0.01,0) [0|250] "m" MCU
 SG_ OBJ_Long_Distance_STD_V_32 : 31422|1@1+ (1,0) [0|1] "bool" MCU
 SG_ Reserved_16_32 : 31423|1@1+ (1,0) [0|0] "NA" MCU
 SG_ OBJ_Lat_Distance_32 : 31424|12@1+ (0.05,-100) [-100|100] "m" MCU
 SG_ OBJ_Lat_Distance_V_32 : 31436|1@1+ (1,0) [0|1] "bool" MCU
 SG_ OBJ_Lat_Distance_STD_32 : 31437|14@1+ (0.01,0) [0|100] "m" MCU
 SG_ OBJ_Lat_Distance_STD_V_32 : 31451|1@1+ (1,0) [0|1] "bool" MCU
 SG_ Reserved_17_32 : 31452|4@1+ (1,0) [0|0] "NA" MCU
 SG_ OBJ_Absolute_Speed_32 : 31456|12@1+ (0.05,-65) [-65|65] "m_per_s" MCU
 SG_ OBJ_Absolute_Speed_V_32 : 31468|1@1+ (1,0) [0|1] "bool" MCU
 SG_ OBJ_Absolute_Speed_STD_32 : 31469|13@1+ (0.01,0) [0|65] "m_per_s" MCU
 SG_ OBJ_Absolute_Speed_STD_V_32 : 31482|1@1+ (1,0) [0|1] "bool" MCU
 SG_ Reserved_18_32 : 31483|5@1+ (1,0) [0|0] "NA" MCU
 SG_ OBJ_Heading_32 : 31488|10@1+ (0.01,-3.14) [-3.14|3.14] "rad" MCU
 SG_ OBJ_Heading_V_32 : 31498|1@1+ (1,0) [0|1] "bool" MCU
 SG_ OBJ_Heading_STD_32 : 31499|15@1+ (0.0001,0) [0|3.14] "rad" MCU
 SG_ OBJ_Heading_STD_V_32 : 31514|1@1+ (1,0) [0|1] "bool" MCU
 SG_ Reserved_19_32 : 31515|5@1+ (1,0) [0|0] "NA" MCU
 SG_ OBJ_Angle_Rate_STD_32 : 31520|15@1+ (0.0001,0) [0|2.2318] "RPS" MCU
 SG_ OBJ_Angle_Rate_STD_V_32 : 31535|1@1+ (1,0) [0|1] "bool" MCU
 SG_ OBJ_Angle_Rate_32 : 31536|12@1+ (0.002,-2.234) [-2.234|2.2318] "RPS" MCU
 SG_ OBJ_Angle_Rate_V_32 : 31548|1@1+ (1,0) [0|1] "bool" MCU
 SG_ Reserved_20_32 : 31549|3@1+ (1,0) [0|0] "NA" MCU
 SG_ OBJ_Angle_Right_32 : 31552|14@1+ (0.0002,-1.571) [-1.571|1.571] "rad" MCU
 SG_ OBJ_Angle_Right_V_32 : 31566|1@1+ (1,0) [0|1] "bool" MCU
 SG_ OBJ_Angle_Right_STD_32 : 31567|14@1+ (0.0001,0) [0|1.571] "rad" MCU
 SG_ OBJ_Angle_Right_STD_V_32 : 31581|1@1+ (1,0) [0|1] "bool" MCU
 SG_ Reserved_21_32 : 31582|2@1+ (1,0) [0|0] "NA" MCU
 SG_ OBJ_Angle_Left_32 : 31584|14@1+ (0.0002,-1.571) [-1.571|1.571] "rad" MCU
 SG_ OBJ_Angle_Left_V_32 : 31598|1@1+ (1,0) [0|1] "bool" MCU
 SG_ OBJ_Angle_Left_STD_32 : 31599|14@1+ (0.0001,0) [0|1.571] "rad" MCU
 SG_ OBJ_Angle_Left_STD_V_32 : 31613|1@1+ (1,0) [0|1] "bool" MCU
 SG_ Reserved_22_32 : 31614|2@1+ (1,0) [0|0] "NA" MCU
 SG_ OBJ_Angle_Side_32 : 31616|14@1+ (0.0002,-1.571) [-1.571|1.571] "rad" MCU
 SG_ OBJ_Angle_Side_V_32 : 31630|1@1+ (1,0) [0|1] "bool" MCU
 SG_ OBJ_Angle_Side_STD_32 : 31631|14@1+ (0.0001,0) [0|1.571] "rad" MCU
 SG_ OBJ_Angle_Side_STD_V_32 : 31645|1@1+ (1,0) [0|1] "bool" MCU
 SG_ OBJ_Angle_Mid_V_32 : 31646|1@1+ (1,0) [0|1] "bool" MCU
 SG_ Reserved_23_32 : 31647|1@1+ (1,0) [0|0] "NA" MCU
 SG_ OBJ_Angle_Mid_32 : 31648|14@1+ (0.0002,-1.571) [-1.571|1.571] "rad" MCU
 SG_ OBJ_Angle_Mid_STD_32 : 31662|14@1+ (0.0001,0) [0|1.571] "rad" MCU
 SG_ OBJ_Angle_Mid_STD_V_32 : 31676|1@1+ (1,0) [0|1] "bool" MCU
 SG_ OBJ_Angle_Bottom_V_32 : 31677|1@1+ (1,0) [0|1] "bool" MCU
 SG_ Reserved_24_32 : 31678|2@1+ (1,0) [0|0] "NA" MCU
 SG_ OBJ_Angle_Bottom_32 : 31680|14@1+ (0.0002,-1.571) [-1.571|1.571] "rad" MCU
 SG_ OBJ_Angle_Bottom_STD_32 : 31694|14@1+ (0.0001,0) [0|1.571] "rad" MCU
 SG_ OBJ_Angle_Bottom_STD_V_32 : 31708|1@1+ (1,0) [0|1] "bool" MCU
 SG_ OBJ_Visibility_Side_V_32 : 31709|1@1+ (1,0) [0|1] "bool" MCU
 SG_ OBJ_Visibility_Side_32 : 31710|2@1+ (1,0) [0|2] "ENUM" MCU
 SG_ OBJ_Is_In_Drivable_Area_32 : 31712|1@1+ (1,0) [0|1] "bool" MCU
 SG_ OBJ_Is_In_Drivable_Area_V_32 : 31713|1@1+ (1,0) [0|1] "bool" MCU
 SG_ OBJ_Is_VeryClose_V_32 : 31714|1@1+ (1,0) [0|1] "bool" MCU
 SG_ OBJ_Is_VeryClose_32 : 31715|1@1+ (1,0) [0|1] "bool" MCU
 SG_ OBJ_Buffer_C4_32 : 31716|2@1+ (1,0) [0|2] "NA" MCU
 SG_ OBJ_Buffer_C5_32 : 31718|2@1+ (1,0) [0|2] "NA" MCU
 SG_ OBJ_Buffer_C6_32 : 31720|2@1+ (1,0) [0|2] "NA" MCU
 SG_ OBJ_Buffer_C7_32 : 31722|2@1+ (1,0) [0|2] "NA" MCU
 SG_ OBJ_OverlapAngleEgoLaneR_32 : 31724|10@1+ (0.01,-3.14) [-3.14|3.14] "rad" MCU
 SG_ OBJ_OverlapAngleEgoLaneR_V_32 : 31734|1@1+ (1,0) [0|1] "bool" MCU
 SG_ Reserved_25_32 : 31735|9@1+ (1,0) [0|0] "NA" MCU
 SG_ OBJ_OverlapAngleEgoLaneL_32 : 31744|10@1+ (0.01,-3.14) [-3.14|3.14] "rad" MCU
 SG_ OBJ_OverlapAngleEgoLaneL_V_32 : 31754|1@1+ (1,0) [0|1] "bool" MCU
 SG_ OBJ_Is_EMERGENCY_VCL_32 : 31755|1@1+ (1,0) [0|1] "bool" MCU
 SG_ OBJ_EMERGENCY_LIGHT_COLOR_32 : 31756|4@1+ (1,0) [0|15] "BITWIZE" MCU
 SG_ OBJ_EMERGENCY_V_32 : 31760|1@1+ (1,0) [0|1] "bool" MCU
 SG_ OBJ_Angle_Top_32 : 31761|14@1+ (0.0002,0) [0|3.1415] "rad" MCU
 SG_ OBJ_Angle_Top_V_32 : 31775|1@1+ (1,0) [0|1] "bool" MCU
 SG_ OBJ_Angle_Top_STD_32 : 31776|15@1+ (0.0001,0) [0|3.1415] "rad" MCU
 SG_ OBJ_Angle_Top_STD_V_32 : 31791|1@1+ (1,0) [0|1] "bool" MCU
 SG_ OBJ_Open_Door_Left_32 : 31792|1@1+ (1,0) [0|1] "bool" MCU
 SG_ OBJ_Open_Door_Right_32 : 31793|1@1+ (1,0) [0|1] "bool" MCU
 SG_ OBJ_Visible_Left_or_Right_32 : 31794|2@1+ (1,0) [0|2] "ENUM" MCU
 SG_ OBJ_Visible_Left_or_Right_V_32 : 31796|1@1+ (1,0) [0|1] "bool" MCU
 SG_ OBJ_2W_Is_Motorbike_Probability_32 : 31797|8@1+ (0.01,0) [0|1] "NA" MCU
 SG_ Reserved_26_32 : 31805|3@1+ (1,0) [0|0] "NA" MCU
 SG_ OBJ_2W_Is_Bicycle_Probability_32 : 31808|8@1+ (0.01,0) [0|1] "NA" MCU
 SG_ Reserved_27_32 : 31816|24@1+ (1,0) [0|0] "NA" MCU
 SG_ OBJ_CRC_33 : 31840|32@1+ (1,0) [0|4294967295] "NA" MCU
 SG_ OBJ_ID_33 : 31872|8@1+ (1,0) [0|255] "counter" MCU
 SG_ OBJ_Existence_Probability_33 : 31880|8@1+ (0.01,0) [0|1] "NA" MCU
 SG_ OBJ_Fusion_Source_33 : 31888|16@1+ (1,0) [0|65535] "BITWIZE" MCU
 SG_ OBJ_Triggered_SDM_33 : 31904|2@1+ (1,0) [0|2] "ENUM" MCU
 SG_ OBJ_Motion_Category_33 : 31906|4@1+ (1,0) [0|13] "ENUM" MCU
 SG_ OBJ_Moving_IN_Probability_33 : 31910|7@1+ (0.01,0) [0|1] "NA" MCU
 SG_ OBJ_Object_Age_33 : 31917|11@1+ (1,0) [0|2047] "frames" MCU
 SG_ OBJ_Measuring_Status_33 : 31928|3@1+ (1,0) [0|7] "BITWIZE" MCU
 SG_ OBJ_Object_Class_33 : 31931|4@1+ (1,0) [0|9] "ENUM" MCU
 SG_ Reserved_4_33 : 31935|1@1+ (1,0) [0|0] "NA" MCU
 SG_ OBJ_Class_Probability_33 : 31936|7@1+ (0.01,0) [0|1] "NA" MCU
 SG_ OBJ_Car_Probability_33 : 31943|7@1+ (0.01,0) [0|1] "NA" MCU
 SG_ OBJ_Truck_Probability_33 : 31950|7@1+ (0.01,0) [0|1] "NA" MCU
 SG_ OBJ_Bike_Probability_33 : 31957|7@1+ (0.01,0) [0|1] "NA" MCU
 SG_ OBJ_Camera_Source_33 : 31964|4@1+ (1,0) [0|15] "ENUM" MCU
 SG_ OBJ_Motion_Status_33 : 31968|3@1+ (1,0) [0|5] "ENUM" MCU
 SG_ OBJ_Motion_Orientation_33 : 31971|4@1+ (1,0) [0|13] "ENUM" MCU
 SG_ OBJ_Has_Cut_Lane_33 : 31975|1@1+ (1,0) [0|1] "bool" MCU
 SG_ OBJ_Has_Cut_Path_33 : 31976|1@1+ (1,0) [0|1] "bool" MCU
 SG_ OBJ_Brake_Light_Validity_33 : 31977|1@1+ (1,0) [0|1] "bool" MCU
 SG_ OBJ_Brake_Light_33 : 31978|1@1+ (1,0) [0|1] "bool" MCU
 SG_ OBJ_Turn_Indicator_Right_33 : 31979|1@1+ (1,0) [0|1] "bool" MCU
 SG_ OBJ_Turn_Indicator_Left_33 : 31980|1@1+ (1,0) [0|1] "bool" MCU
 SG_ OBJ_Turn_Indicator_Validity_33 : 31981|1@1+ (1,0) [0|1] "bool" MCU
 SG_ OBJ_Right_Out_Of_Image_33 : 31982|1@1+ (1,0) [0|1] "bool" MCU
 SG_ OBJ_Left_Out_Of_Image_33 : 31983|1@1+ (1,0) [0|1] "bool" MCU
 SG_ OBJ_Right_Out_Of_Image_V_33 : 31984|1@1+ (1,0) [0|1] "bool" MCU
 SG_ OBJ_Left_Out_Of_Image_V_33 : 31985|1@1+ (1,0) [0|1] "bool" MCU
 SG_ OBJ_Top_Out_Of_Image_33 : 31986|1@1+ (1,0) [0|1] "bool" MCU
 SG_ OBJ_Bottom_Out_Of_Image_33 : 31987|1@1+ (1,0) [0|1] "bool" MCU
 SG_ OBJ_Top_Out_Of_Image_V_33 : 31988|1@1+ (1,0) [0|1] "bool" MCU
 SG_ OBJ_Bottom_Out_Of_Image_V_33 : 31989|1@1+ (1,0) [0|1] "bool" MCU
 SG_ OBJ_Lane_Assignment_33 : 31990|3@1+ (1,0) [0|5] "ENUM" MCU
 SG_ OBJ_Lane_Assignment_V_33 : 31993|1@1+ (1,0) [0|1] "bool" MCU
 SG_ Reserved_5_33 : 31994|6@1+ (1,0) [0|0] "NA" MCU
 SG_ OBJ_Age_Seconds_33 : 32000|7@1+ (1,0) [0|100] "s" MCU
 SG_ OBJ_Age_Seconds_V_33 : 32007|1@1+ (1,0) [0|1] "bool" MCU
 SG_ OBJ_Width_33 : 32008|9@1+ (0.01,0) [0.4|2.95] "m" MCU
 SG_ OBJ_Width_V_33 : 32017|1@1+ (1,0) [0|1] "bool" MCU
 SG_ OBJ_Width_STD_33 : 32018|11@1+ (0.001,0) [0|2] "m" MCU
 SG_ OBJ_Width_STD_V_33 : 32029|1@1+ (1,0) [0|1] "bool" MCU
 SG_ Reserved_6_33 : 32030|2@1+ (1,0) [0|0] "NA" MCU
 SG_ OBJ_Length_33 : 32032|9@1+ (0.05,0) [0.6|21] "m" MCU
 SG_ OBJ_Length_V_33 : 32041|1@1+ (1,0) [0|1] "bool" MCU
 SG_ OBJ_Length_STD_33 : 32042|10@1+ (0.01,0) [0|10] "m" MCU
 SG_ OBJ_Length_STD_V_33 : 32052|1@1+ (1,0) [0|1] "bool" MCU
 SG_ OBJ_Radar_ID_33 : 32053|8@1+ (1,0) [0|255] "counter" MCU
 SG_ Reserved_7_33 : 32061|3@1+ (1,0) [0|0] "NA" MCU
 SG_ OBJ_Height_33 : 32064|9@1+ (0.01,0) [0|2.95] "m" MCU
 SG_ OBJ_Height_V_33 : 32073|1@1+ (1,0) [0|1] "bool" MCU
 SG_ OBJ_Height_STD_33 : 32074|11@1+ (0.001,0) [0|2] "m" MCU
 SG_ OBJ_Height_STD_V_33 : 32085|1@1+ (1,0) [0|1] "bool" MCU
 SG_ Reserved_8_33 : 32086|10@1+ (1,0) [0|0] "NA" MCU
 SG_ OBJ_Abs_Long_Velocity_33 : 32096|12@1+ (0.05,-100) [-100|100] "m_per_s" MCU
 SG_ OBJ_Abs_Long_Velocity_V_33 : 32108|1@1+ (1,0) [0|1] "bool" MCU
 SG_ OBJ_Abs_Long_Velocity_STD_33 : 32109|13@1+ (0.01,0) [0|65] "m_per_s" MCU
 SG_ OBJ_Abs_Long_Vel_STD_V_33 : 32122|1@1+ (1,0) [0|1] "bool" MCU
 SG_ Reserved_9_33 : 32123|5@1+ (1,0) [0|0] "NA" MCU
 SG_ OBJ_Abs_Lat_Velocity_33 : 32128|11@1+ (0.05,-50) [-50|50] "m_per_s" MCU
 SG_ OBJ_Abs_Lat_Velocity_V_33 : 32139|1@1+ (1,0) [0|1] "bool" MCU
 SG_ OBJ_Abs_Lat_Velocity_STD_33 : 32140|13@1+ (0.01,0) [0|50] "m_per_s" MCU
 SG_ OBJ_Abs_Lat_Vel_STD_V_33 : 32153|1@1+ (1,0) [0|1] "bool" MCU
 SG_ Reserved_10_33 : 32154|6@1+ (1,0) [0|0] "NA" MCU
 SG_ OBJ_Abs_Long_Acc_33 : 32160|9@1+ (0.05,-10) [-10|10] "m_per_s2" MCU
 SG_ OBJ_Abs_Long_Acc_V_33 : 32169|1@1+ (1,0) [0|1] "bool" MCU
 SG_ OBJ_Abs_Long_Acc_STD_33 : 32170|10@1+ (0.01,0) [0|7.3] "m_per_s2" MCU
 SG_ OBJ_Abs_Long_Acc_STD_V_33 : 32180|1@1+ (1,0) [0|1] "bool" MCU
 SG_ OBJ_Abs_Lat_Acc_33 : 32181|9@1+ (0.05,-10) [-10|10] "m_per_s2" MCU
 SG_ OBJ_Abs_Lat_Acc_V_33 : 32190|1@1+ (1,0) [0|1] "bool" MCU
 SG_ Reserved_11_33 : 32191|1@1+ (1,0) [0|0] "NA" MCU
 SG_ OBJ_Abs_Lat_Acc_STD_33 : 32192|10@1+ (0.01,0) [0|7.3] "m_per_s2" MCU
 SG_ OBJ_Abs_Lat_Acc_STD_V_33 : 32202|1@1+ (1,0) [0|1] "bool" MCU
 SG_ OBJ_Abs_Acceleration_33 : 32203|9@1+ (0.05,-12.7) [-12.7|12.7] "m_per_s2" MCU
 SG_ OBJ_Abs_Acceleration_V_33 : 32212|1@1+ (1,0) [0|1] "bool" MCU
 SG_ OBJ_Abs_Acc_STD_33 : 32213|10@1+ (0.01,0) [0|7.3] "m_per_s2" MCU
 SG_ OBJ_Abs_Acc_STD_V_33 : 32223|1@1+ (1,0) [0|1] "bool" MCU
 SG_ OBJ_Inv_TTC_33 : 32224|11@1+ (0.01,-8) [-8|8] "INV(s)" MCU
 SG_ OBJ_Inv_TTC_V_33 : 32235|1@1+ (1,0) [0|1] "bool" MCU
 SG_ OBJ_Inv_TTC_STD_33 : 32236|12@1+ (0.001,0) [0|4] "INV(s)" MCU
 SG_ OBJ_Inv_TTC_STD_V_33 : 32248|1@1+ (1,0) [0|1] "bool" MCU
 SG_ Reserved_12_33 : 32249|7@1+ (1,0) [0|0] "NA" MCU
 SG_ OBJ_Relative_Long_Acc_33 : 32256|10@1+ (0.05,-20) [-20|20] "m_per_s2" MCU
 SG_ OBJ_Relative_Long_Acc_V_33 : 32266|1@1+ (1,0) [0|1] "bool" MCU
 SG_ OBJ_Relative_Long_Acc_STD_33 : 32267|10@1+ (0.01,0) [0|7.3] "m_per_s2" MCU
 SG_ OBJ_Rel_Long_Acc_STD_V_33 : 32277|1@1+ (1,0) [0|1] "bool" MCU
 SG_ Reserved_13_33 : 32278|10@1+ (1,0) [0|0] "NA" MCU
 SG_ OBJ_Relative_Long_Velocity_33 : 32288|13@1+ (0.05,-120) [-120|130] "m_per_s" MCU
 SG_ OBJ_Relative_Long_Velocity_V_33 : 32301|1@1+ (1,0) [0|1] "bool" MCU
 SG_ OBJ_Relative_Long_Vel_STD_33 : 32302|14@1+ (0.01,0) [0|130] "m_per_s" MCU
 SG_ OBJ_Rel_Long_Vel_STD_V_33 : 32316|1@1+ (1,0) [0|1] "bool" MCU
 SG_ Reserved_14_33 : 32317|3@1+ (1,0) [0|0] "NA" MCU
 SG_ OBJ_Relative_Lat_Velocity_33 : 32320|11@1+ (0.05,-50) [-50|50] "m_per_s" MCU
 SG_ OBJ_Relative_Lat_Velocity_V_33 : 32331|1@1+ (1,0) [0|1] "bool" MCU
 SG_ OBJ_Relative_Lat_Velocity_STD_33 : 32332|13@1+ (0.01,0) [0|50] "m_per_s" MCU
 SG_ OBJ_Rel_Lat_Vel_STD_V_33 : 32345|1@1+ (1,0) [0|1] "bool" MCU
 SG_ Reserved_15_33 : 32346|6@1+ (1,0) [0|0] "NA" MCU
 SG_ OBJ_Long_Distance_33 : 32352|14@1+ (0.05,-200) [-200|500] "m" MCU
 SG_ OBJ_Long_Distance_V_33 : 32366|1@1+ (1,0) [0|1] "bool" MCU
 SG_ OBJ_Long_Distance_STD_33 : 32367|15@1+ (0.01,0) [0|250] "m" MCU
 SG_ OBJ_Long_Distance_STD_V_33 : 32382|1@1+ (1,0) [0|1] "bool" MCU
 SG_ Reserved_16_33 : 32383|1@1+ (1,0) [0|0] "NA" MCU
 SG_ OBJ_Lat_Distance_33 : 32384|12@1+ (0.05,-100) [-100|100] "m" MCU
 SG_ OBJ_Lat_Distance_V_33 : 32396|1@1+ (1,0) [0|1] "bool" MCU
 SG_ OBJ_Lat_Distance_STD_33 : 32397|14@1+ (0.01,0) [0|100] "m" MCU
 SG_ OBJ_Lat_Distance_STD_V_33 : 32411|1@1+ (1,0) [0|1] "bool" MCU
 SG_ Reserved_17_33 : 32412|4@1+ (1,0) [0|0] "NA" MCU
 SG_ OBJ_Absolute_Speed_33 : 32416|12@1+ (0.05,-65) [-65|65] "m_per_s" MCU
 SG_ OBJ_Absolute_Speed_V_33 : 32428|1@1+ (1,0) [0|1] "bool" MCU
 SG_ OBJ_Absolute_Speed_STD_33 : 32429|13@1+ (0.01,0) [0|65] "m_per_s" MCU
 SG_ OBJ_Absolute_Speed_STD_V_33 : 32442|1@1+ (1,0) [0|1] "bool" MCU
 SG_ Reserved_18_33 : 32443|5@1+ (1,0) [0|0] "NA" MCU
 SG_ OBJ_Heading_33 : 32448|10@1+ (0.01,-3.14) [-3.14|3.14] "rad" MCU
 SG_ OBJ_Heading_V_33 : 32458|1@1+ (1,0) [0|1] "bool" MCU
 SG_ OBJ_Heading_STD_33 : 32459|15@1+ (0.0001,0) [0|3.14] "rad" MCU
 SG_ OBJ_Heading_STD_V_33 : 32474|1@1+ (1,0) [0|1] "bool" MCU
 SG_ Reserved_19_33 : 32475|5@1+ (1,0) [0|0] "NA" MCU
 SG_ OBJ_Angle_Rate_STD_33 : 32480|15@1+ (0.0001,0) [0|2.2318] "RPS" MCU
 SG_ OBJ_Angle_Rate_STD_V_33 : 32495|1@1+ (1,0) [0|1] "bool" MCU
 SG_ OBJ_Angle_Rate_33 : 32496|12@1+ (0.002,-2.234) [-2.234|2.2318] "RPS" MCU
 SG_ OBJ_Angle_Rate_V_33 : 32508|1@1+ (1,0) [0|1] "bool" MCU
 SG_ Reserved_20_33 : 32509|3@1+ (1,0) [0|0] "NA" MCU
 SG_ OBJ_Angle_Right_33 : 32512|14@1+ (0.0002,-1.571) [-1.571|1.571] "rad" MCU
 SG_ OBJ_Angle_Right_V_33 : 32526|1@1+ (1,0) [0|1] "bool" MCU
 SG_ OBJ_Angle_Right_STD_33 : 32527|14@1+ (0.0001,0) [0|1.571] "rad" MCU
 SG_ OBJ_Angle_Right_STD_V_33 : 32541|1@1+ (1,0) [0|1] "bool" MCU
 SG_ Reserved_21_33 : 32542|2@1+ (1,0) [0|0] "NA" MCU
 SG_ OBJ_Angle_Left_33 : 32544|14@1+ (0.0002,-1.571) [-1.571|1.571] "rad" MCU
 SG_ OBJ_Angle_Left_V_33 : 32558|1@1+ (1,0) [0|1] "bool" MCU
 SG_ OBJ_Angle_Left_STD_33 : 32559|14@1+ (0.0001,0) [0|1.571] "rad" MCU
 SG_ OBJ_Angle_Left_STD_V_33 : 32573|1@1+ (1,0) [0|1] "bool" MCU
 SG_ Reserved_22_33 : 32574|2@1+ (1,0) [0|0] "NA" MCU
 SG_ OBJ_Angle_Side_33 : 32576|14@1+ (0.0002,-1.571) [-1.571|1.571] "rad" MCU
 SG_ OBJ_Angle_Side_V_33 : 32590|1@1+ (1,0) [0|1] "bool" MCU
 SG_ OBJ_Angle_Side_STD_33 : 32591|14@1+ (0.0001,0) [0|1.571] "rad" MCU
 SG_ OBJ_Angle_Side_STD_V_33 : 32605|1@1+ (1,0) [0|1] "bool" MCU
 SG_ OBJ_Angle_Mid_V_33 : 32606|1@1+ (1,0) [0|1] "bool" MCU
 SG_ Reserved_23_33 : 32607|1@1+ (1,0) [0|0] "NA" MCU
 SG_ OBJ_Angle_Mid_33 : 32608|14@1+ (0.0002,-1.571) [-1.571|1.571] "rad" MCU
 SG_ OBJ_Angle_Mid_STD_33 : 32622|14@1+ (0.0001,0) [0|1.571] "rad" MCU
 SG_ OBJ_Angle_Mid_STD_V_33 : 32636|1@1+ (1,0) [0|1] "bool" MCU
 SG_ OBJ_Angle_Bottom_V_33 : 32637|1@1+ (1,0) [0|1] "bool" MCU
 SG_ Reserved_24_33 : 32638|2@1+ (1,0) [0|0] "NA" MCU
 SG_ OBJ_Angle_Bottom_33 : 32640|14@1+ (0.0002,-1.571) [-1.571|1.571] "rad" MCU
 SG_ OBJ_Angle_Bottom_STD_33 : 32654|14@1+ (0.0001,0) [0|1.571] "rad" MCU
 SG_ OBJ_Angle_Bottom_STD_V_33 : 32668|1@1+ (1,0) [0|1] "bool" MCU
 SG_ OBJ_Visibility_Side_V_33 : 32669|1@1+ (1,0) [0|1] "bool" MCU
 SG_ OBJ_Visibility_Side_33 : 32670|2@1+ (1,0) [0|2] "ENUM" MCU
 SG_ OBJ_Is_In_Drivable_Area_33 : 32672|1@1+ (1,0) [0|1] "bool" MCU
 SG_ OBJ_Is_In_Drivable_Area_V_33 : 32673|1@1+ (1,0) [0|1] "bool" MCU
 SG_ OBJ_Is_VeryClose_V_33 : 32674|1@1+ (1,0) [0|1] "bool" MCU
 SG_ OBJ_Is_VeryClose_33 : 32675|1@1+ (1,0) [0|1] "bool" MCU
 SG_ OBJ_Buffer_C4_33 : 32676|2@1+ (1,0) [0|2] "NA" MCU
 SG_ OBJ_Buffer_C5_33 : 32678|2@1+ (1,0) [0|2] "NA" MCU
 SG_ OBJ_Buffer_C6_33 : 32680|2@1+ (1,0) [0|2] "NA" MCU
 SG_ OBJ_Buffer_C7_33 : 32682|2@1+ (1,0) [0|2] "NA" MCU
 SG_ OBJ_OverlapAngleEgoLaneR_33 : 32684|10@1+ (0.01,-3.14) [-3.14|3.14] "rad" MCU
 SG_ OBJ_OverlapAngleEgoLaneR_V_33 : 32694|1@1+ (1,0) [0|1] "bool" MCU
 SG_ Reserved_25_33 : 32695|9@1+ (1,0) [0|0] "NA" MCU
 SG_ OBJ_OverlapAngleEgoLaneL_33 : 32704|10@1+ (0.01,-3.14) [-3.14|3.14] "rad" MCU
 SG_ OBJ_OverlapAngleEgoLaneL_V_33 : 32714|1@1+ (1,0) [0|1] "bool" MCU
 SG_ OBJ_Is_EMERGENCY_VCL_33 : 32715|1@1+ (1,0) [0|1] "bool" MCU
 SG_ OBJ_EMERGENCY_LIGHT_COLOR_33 : 32716|4@1+ (1,0) [0|15] "BITWIZE" MCU
 SG_ OBJ_EMERGENCY_V_33 : 32720|1@1+ (1,0) [0|1] "bool" MCU
 SG_ OBJ_Angle_Top_33 : 32721|14@1+ (0.0002,0) [0|3.1415] "rad" MCU
 SG_ OBJ_Angle_Top_V_33 : 32735|1@1+ (1,0) [0|1] "bool" MCU
 SG_ OBJ_Angle_Top_STD_33 : 32736|15@1+ (0.0001,0) [0|3.1415] "rad" MCU
 SG_ OBJ_Angle_Top_STD_V_33 : 32751|1@1+ (1,0) [0|1] "bool" MCU
 SG_ OBJ_Open_Door_Left_33 : 32752|1@1+ (1,0) [0|1] "bool" MCU
 SG_ OBJ_Open_Door_Right_33 : 32753|1@1+ (1,0) [0|1] "bool" MCU
 SG_ OBJ_Visible_Left_or_Right_33 : 32754|2@1+ (1,0) [0|2] "ENUM" MCU
 SG_ OBJ_Visible_Left_or_Right_V_33 : 32756|1@1+ (1,0) [0|1] "bool" MCU
 SG_ OBJ_2W_Is_Motorbike_Probability_33 : 32757|8@1+ (0.01,0) [0|1] "NA" MCU
 SG_ Reserved_26_33 : 32765|3@1+ (1,0) [0|0] "NA" MCU
 SG_ OBJ_2W_Is_Bicycle_Probability_33 : 32768|8@1+ (0.01,0) [0|1] "NA" MCU
 SG_ Reserved_27_33 : 32776|24@1+ (1,0) [0|0] "NA" MCU
 SG_ OBJ_CRC_34 : 32800|32@1+ (1,0) [0|4294967295] "NA" MCU
 SG_ OBJ_ID_34 : 32832|8@1+ (1,0) [0|255] "counter" MCU
 SG_ OBJ_Existence_Probability_34 : 32840|8@1+ (0.01,0) [0|1] "NA" MCU
 SG_ OBJ_Fusion_Source_34 : 32848|16@1+ (1,0) [0|65535] "BITWIZE" MCU
 SG_ OBJ_Triggered_SDM_34 : 32864|2@1+ (1,0) [0|2] "ENUM" MCU
 SG_ OBJ_Motion_Category_34 : 32866|4@1+ (1,0) [0|13] "ENUM" MCU
 SG_ OBJ_Moving_IN_Probability_34 : 32870|7@1+ (0.01,0) [0|1] "NA" MCU
 SG_ OBJ_Object_Age_34 : 32877|11@1+ (1,0) [0|2047] "frames" MCU
 SG_ OBJ_Measuring_Status_34 : 32888|3@1+ (1,0) [0|7] "BITWIZE" MCU
 SG_ OBJ_Object_Class_34 : 32891|4@1+ (1,0) [0|9] "ENUM" MCU
 SG_ Reserved_4_34 : 32895|1@1+ (1,0) [0|0] "NA" MCU
 SG_ OBJ_Class_Probability_34 : 32896|7@1+ (0.01,0) [0|1] "NA" MCU
 SG_ OBJ_Car_Probability_34 : 32903|7@1+ (0.01,0) [0|1] "NA" MCU
 SG_ OBJ_Truck_Probability_34 : 32910|7@1+ (0.01,0) [0|1] "NA" MCU
 SG_ OBJ_Bike_Probability_34 : 32917|7@1+ (0.01,0) [0|1] "NA" MCU
 SG_ OBJ_Camera_Source_34 : 32924|4@1+ (1,0) [0|15] "ENUM" MCU
 SG_ OBJ_Motion_Status_34 : 32928|3@1+ (1,0) [0|5] "ENUM" MCU
 SG_ OBJ_Motion_Orientation_34 : 32931|4@1+ (1,0) [0|13] "ENUM" MCU
 SG_ OBJ_Has_Cut_Lane_34 : 32935|1@1+ (1,0) [0|1] "bool" MCU
 SG_ OBJ_Has_Cut_Path_34 : 32936|1@1+ (1,0) [0|1] "bool" MCU
 SG_ OBJ_Brake_Light_Validity_34 : 32937|1@1+ (1,0) [0|1] "bool" MCU
 SG_ OBJ_Brake_Light_34 : 32938|1@1+ (1,0) [0|1] "bool" MCU
 SG_ OBJ_Turn_Indicator_Right_34 : 32939|1@1+ (1,0) [0|1] "bool" MCU
 SG_ OBJ_Turn_Indicator_Left_34 : 32940|1@1+ (1,0) [0|1] "bool" MCU
 SG_ OBJ_Turn_Indicator_Validity_34 : 32941|1@1+ (1,0) [0|1] "bool" MCU
 SG_ OBJ_Right_Out_Of_Image_34 : 32942|1@1+ (1,0) [0|1] "bool" MCU
 SG_ OBJ_Left_Out_Of_Image_34 : 32943|1@1+ (1,0) [0|1] "bool" MCU
 SG_ OBJ_Right_Out_Of_Image_V_34 : 32944|1@1+ (1,0) [0|1] "bool" MCU
 SG_ OBJ_Left_Out_Of_Image_V_34 : 32945|1@1+ (1,0) [0|1] "bool" MCU
 SG_ OBJ_Top_Out_Of_Image_34 : 32946|1@1+ (1,0) [0|1] "bool" MCU
 SG_ OBJ_Bottom_Out_Of_Image_34 : 32947|1@1+ (1,0) [0|1] "bool" MCU
 SG_ OBJ_Top_Out_Of_Image_V_34 : 32948|1@1+ (1,0) [0|1] "bool" MCU
 SG_ OBJ_Bottom_Out_Of_Image_V_34 : 32949|1@1+ (1,0) [0|1] "bool" MCU
 SG_ OBJ_Lane_Assignment_34 : 32950|3@1+ (1,0) [0|5] "ENUM" MCU
 SG_ OBJ_Lane_Assignment_V_34 : 32953|1@1+ (1,0) [0|1] "bool" MCU
 SG_ Reserved_5_34 : 32954|6@1+ (1,0) [0|0] "NA" MCU
 SG_ OBJ_Age_Seconds_34 : 32960|7@1+ (1,0) [0|100] "s" MCU
 SG_ OBJ_Age_Seconds_V_34 : 32967|1@1+ (1,0) [0|1] "bool" MCU
 SG_ OBJ_Width_34 : 32968|9@1+ (0.01,0) [0.4|2.95] "m" MCU
 SG_ OBJ_Width_V_34 : 32977|1@1+ (1,0) [0|1] "bool" MCU
 SG_ OBJ_Width_STD_34 : 32978|11@1+ (0.001,0) [0|2] "m" MCU
 SG_ OBJ_Width_STD_V_34 : 32989|1@1+ (1,0) [0|1] "bool" MCU
 SG_ Reserved_6_34 : 32990|2@1+ (1,0) [0|0] "NA" MCU
 SG_ OBJ_Length_34 : 32992|9@1+ (0.05,0) [0.6|21] "m" MCU
 SG_ OBJ_Length_V_34 : 33001|1@1+ (1,0) [0|1] "bool" MCU
 SG_ OBJ_Length_STD_34 : 33002|10@1+ (0.01,0) [0|10] "m" MCU
 SG_ OBJ_Length_STD_V_34 : 33012|1@1+ (1,0) [0|1] "bool" MCU
 SG_ OBJ_Radar_ID_34 : 33013|8@1+ (1,0) [0|255] "counter" MCU
 SG_ Reserved_7_34 : 33021|3@1+ (1,0) [0|0] "NA" MCU
 SG_ OBJ_Height_34 : 33024|9@1+ (0.01,0) [0|2.95] "m" MCU
 SG_ OBJ_Height_V_34 : 33033|1@1+ (1,0) [0|1] "bool" MCU
 SG_ OBJ_Height_STD_34 : 33034|11@1+ (0.001,0) [0|2] "m" MCU
 SG_ OBJ_Height_STD_V_34 : 33045|1@1+ (1,0) [0|1] "bool" MCU
 SG_ Reserved_8_34 : 33046|10@1+ (1,0) [0|0] "NA" MCU
 SG_ OBJ_Abs_Long_Velocity_34 : 33056|12@1+ (0.05,-100) [-100|100] "m_per_s" MCU
 SG_ OBJ_Abs_Long_Velocity_V_34 : 33068|1@1+ (1,0) [0|1] "bool" MCU

CM_ SG_ 154 OBJ_Absolute_Speed_STD_V_28 "Validator for the STD of the absolute ground speed.";
CM_ SG_ 154 OBJ_Heading_28 "The angle beetweenthe host longitudinal axis and target's heading (clockwise, e.g. PI/2 is a target crossing from left to right).";
CM_ SG_ 154 OBJ_Heading_V_28 "Validator for the object heading.";
CM_ SG_ 154 OBJ_Heading_STD_28 "STD of the object heading.";
CM_ SG_ 154 OBJ_Heading_STD_V_28 "Validator for the STD of the object heading.";
CM_ SG_ 154 OBJ_Angle_Rate_STD_28 "Standard deviation of the angular speed. (radians)";
CM_ SG_ 154 OBJ_Angle_Rate_STD_V_28 "Validator for the STD of the angular speed.";
CM_ SG_ 154 OBJ_Angle_Rate_28 "The momentary angular speed of the object (radians). The positive side is to the host's right.";
CM_ SG_ 154 OBJ_Angle_Rate_V_28 "Validator for the angular speed.";
CM_ SG_ 154 OBJ_Angle_Right_28 "The angle between the host longitudinal axis and the right side of the front / rear of the target (the visible one). The positive side is to the host's right.";
CM_ SG_ 154 OBJ_Angle_Right_V_28 "Validator for angleRight";
CM_ SG_ 154 OBJ_Angle_Right_STD_28 "Standard deviation of angleRight";
CM_ SG_ 154 OBJ_Angle_Right_STD_V_28 "Validator for the standard deviation of angleRight.";
CM_ SG_ 154 OBJ_Angle_Left_28 "The angle between the host longitudinal axis and the left side of the front / rear of the target (the visible one). The positive side is to the host's right.";
CM_ SG_ 154 OBJ_Angle_Left_V_28 "Validator for angleLeft.";
CM_ SG_ 154 OBJ_Angle_Left_STD_28 "Standard deviation of angleLeft.";
CM_ SG_ 154 OBJ_Angle_Left_STD_V_28 "Validator for the standard deviation of angleLeft.";
CM_ SG_ 154 OBJ_Angle_Side_28 "The angle between the host longitudinal axis and the far visible edge - the visible edge of the front / rear of the target that is not visible. Currently supported for vehicles only.";
CM_ SG_ 154 OBJ_Angle_Side_V_28 "Validator for angleSide.";
CM_ SG_ 154 OBJ_Angle_Side_STD_28 "Standard deviation of angleSide.";
CM_ SG_ 154 OBJ_Angle_Side_STD_V_28 "Validator for the STD of angleSide.";
CM_ SG_ 154 OBJ_Angle_Mid_V_28 "Validator for angleMid.";
CM_ SG_ 154 OBJ_Angle_Mid_28 "The angle between the host longitudinal axis and the middle of the front / rear of the target (the visible one). The positive side is to the host's right.";
CM_ SG_ 154 OBJ_Angle_Mid_STD_28 "Standard deviation of angleMid.";
CM_ SG_ 154 OBJ_Angle_Mid_STD_V_28 "Validator for the STD of angleMid.";
CM_ SG_ 154 OBJ_Angle_Bottom_V_28 "Validator for OBJAngle_Bottom. ";
CM_ SG_ 154 OBJ_Angle_Bottom_28 "The angle between the longitudinal axis and the Bottom of the front / rear of the target (the visible one). The positive side is to the host's bottom";
CM_ SG_ 154 OBJ_Angle_Bottom_STD_28 "STD for OBJAngle_Bottom. ";
CM_ SG_ 154 OBJ_Angle_Bottom_STD_V_28 "Validator for OBJAngle_Bottom_STD. ";
CM_ SG_ 154 OBJ_Visibility_Side_V_28 "Currently Supported for VD only";
CM_ SG_ 154 OBJ_Visibility_Side_28 "From what car  side is the object visible";
CM_ SG_ 154 OBJ_Is_In_Drivable_Area_28 "Indicates whether the target is in a driveable area.";
CM_ SG_ 154 OBJ_Is_In_Drivable_Area_V_28 "Validator for OBJ_Is_In_Drivable_Area.";
CM_ SG_ 154 OBJ_Is_VeryClose_V_28 "Validator for OBJ_Is_VeryClose. ";
CM_ SG_ 154 OBJ_Is_VeryClose_28 "Indicates whether the target is very close to the host such that it is hard to measure its distance. Currently relevant for peds only";
CM_ SG_ 154 OBJ_OverlapAngleEgoLaneR_28 "Lateral distance to the middle of the RL and RR corners.";
CM_ SG_ 154 OBJ_OverlapAngleEgoLaneR_V_28 "Validator for OBJ_OverlapAngleEgoLaneR";
CM_ SG_ 154 OBJ_OverlapAngleEgoLaneL_28 "Lateral distance to the middle of the RL and RR corners.  ";
CM_ SG_ 154 OBJ_OverlapAngleEgoLaneL_V_28 "Validator for OBJ_OverlapAngleEgoLaneL";
CM_ SG_ 154 OBJ_Is_EMERGENCY_VCL_28 "Is Object an Emergency Vehicle";
CM_ SG_ 154 OBJ_EMERGENCY_LIGHT_COLOR_28 "Emergency Color";
CM_ SG_ 154 OBJ_EMERGENCY_V_28 "Are OBJ_Is_EMERGENCY_VCL and OBJ_EMERGENCY_LIGHT_COLOR Valid";
CM_ SG_ 154 OBJ_Angle_Top_28 "From VD touching point on the ground till the roof of the car";
CM_ SG_ 154 OBJ_Angle_Top_V_28 "Validator for OBJ_Angle_Top ";
CM_ SG_ 154 OBJ_Angle_Top_STD_28 "STD for OBJ_Angle_Top";
CM_ SG_ 154 OBJ_Angle_Top_STD_V_28 "Validator for OBJ_Angle_Top_STD. ";
CM_ SG_ 154 OBJ_Open_Door_Left_28 "Indicator if left door is open";
CM_ SG_ 154 OBJ_Open_Door_Right_28 "Indicator if right door is open";
CM_ SG_ 154 OBJ_Visible_Left_or_Right_28 "This signal describes the visible Left or Right side of the Target vehicle.";
CM_ SG_ 154 OBJ_Visible_Left_or_Right_V_28 "OBJ_Visible_Left_or_Right";
CM_ SG_ 154 OBJ_2W_Is_Motorbike_Probability_28 "The probability of the Two-wheeler reported object being a Motorbike";
CM_ SG_ 154 OBJ_2W_Is_Bicycle_Probability_28 "The probability of the Two-wheeler reported object being a Bicycle";
CM_ SG_ 154 OBJ_CRC_29 "Calculated over all element signals. From the signal after the CRC until the first signal in the next elements OBJ_CRC_N+1  not including";
CM_ SG_ 154 OBJ_ID_29 "The detected object ID. Range is 1-255, while 0 indicates that the field in unfilled.";
CM_ SG_ 154 OBJ_Existence_Probability_29 "The existence probability of the reported object";
CM_ SG_ 154 OBJ_Fusion_Source_29 "sources ids used for fusion";
CM_ SG_ 154 OBJ_Triggered_SDM_29 "Indicates whether the object has trigered the SDM (Safety Diagnostic Manager) alert.";
CM_ SG_ 154 OBJ_Motion_Category_29 "Relevant for VD only. Full description of values can be found at the ACC guide.";
CM_ SG_ 154 OBJ_Moving_IN_Probability_29 "The probability the object is eventually move into ego lane. (In case that the OBJ_Motion_Category signal is set to  MOVING_IN ";
CM_ SG_ 154 OBJ_Object_Age_29 "The number of frames in which the object was recognized.";
CM_ SG_ 154 OBJ_Measuring_Status_29 "Measurment status. Old vs New marks if this is the first frame in which the object is reported. Predicted vs Measured marks if the report is raw or has been predicted forward in time using the measured dynamics and ego motion.";
CM_ SG_ 154 OBJ_Object_Class_29 "Indicates the object type. Uncertain is outputted in case the probability that a vehicle is a truck is very similar to the probability that it is a car.";
CM_ SG_ 154 OBJ_Class_Probability_29 "The probability of this type classification.";
CM_ SG_ 154 OBJ_Car_Probability_29 "The probability the object is a car";
CM_ SG_ 154 OBJ_Truck_Probability_29 "The probability the object is a Truck";
CM_ SG_ 154 OBJ_Bike_Probability_29 "The probability the object is a Bike";
CM_ SG_ 154 OBJ_Camera_Source_29 "The camera in which this object was detected (best choice).";
CM_ SG_ 154 OBJ_Motion_Status_29 "MOVING - the object is moving STATIONARY - the object was never seen moving STOPPED -  the object was moving and has stopped MOVING_SLOWLY - the object is moving very slowly";
CM_ SG_ 154 OBJ_Motion_Orientation_29 "The direction of the targets heading compared to the host. ";
CM_ SG_ 154 OBJ_Has_Cut_Lane_29 "Indicates whether the object cut the host's (right or left) lane. In case there are no lanes, indicates whether the objects is at most 1 meters away from the host.";
CM_ SG_ 154 OBJ_Has_Cut_Path_29 "Indicates whether the object is in the host's path.";
CM_ SG_ 154 OBJ_Brake_Light_Validity_29 "Validator for braking light indicator";
CM_ SG_ 154 OBJ_Brake_Light_29 "Indication for brake lights ";
CM_ SG_ 154 OBJ_Turn_Indicator_Right_29 "Indication for blinking right light.";
CM_ SG_ 154 OBJ_Turn_Indicator_Left_29 "Indication for blinking left light ";
CM_ SG_ 154 OBJ_Turn_Indicator_Validity_29 "Validator for light indicators";
CM_ SG_ 154 OBJ_Right_Out_Of_Image_29 "Indicates whether the measurment are predicted out of the right side of the image bounderies.";
CM_ SG_ 154 OBJ_Left_Out_Of_Image_29 "Indicates whether if measurment are predicted out of  the left side of the image bounderies";
CM_ SG_ 154 OBJ_Right_Out_Of_Image_V_29 "validator";
CM_ SG_ 154 OBJ_Left_Out_Of_Image_V_29 "validator";
CM_ SG_ 154 OBJ_Top_Out_Of_Image_29 "Indicates whether if measurment are predicted out of  the top of the image bounderies";
CM_ SG_ 154 OBJ_Bottom_Out_Of_Image_29 "Indicates whether if measurment are predicted out of  the bottom of the image bounderies";
CM_ SG_ 154 OBJ_Top_Out_Of_Image_V_29 "validator";
CM_ SG_ 154 OBJ_Bottom_Out_Of_Image_V_29 "validator";
CM_ SG_ 154 OBJ_Lane_Assignment_29 "The object's lane relative to the host lane.";
CM_ SG_ 154 OBJ_Lane_Assignment_V_29 "Validator for lane assignment";
CM_ SG_ 154 OBJ_Age_Seconds_29 "Time in seconds in which the object was recognized. ";
CM_ SG_ 154 OBJ_Age_Seconds_V_29 "Validator for object age";
CM_ SG_ 154 OBJ_Width_29 "The width of the target vehicle in the world (not to be mistaken with the width of the visible part of the vehicle).";
CM_ SG_ 154 OBJ_Width_V_29 "Validator for object width";
CM_ SG_ 154 OBJ_Width_STD_29 "Standard deviation for object width";
CM_ SG_ 154 OBJ_Width_STD_V_29 "Validator for the standard deviation of object width";
CM_ SG_ 154 OBJ_Length_29 "The length of the vehicle in the world. For crossing bicycles it gives the viewed length of the bicycle.";
CM_ SG_ 154 OBJ_Length_V_29 "Validator for object length.";
CM_ SG_ 154 OBJ_Length_STD_29 "Standard deviation for object length.";
CM_ SG_ 154 OBJ_Length_STD_V_29 "Validator for the standard deviation of object length.";
CM_ SG_ 154 OBJ_Radar_ID_29 "Radar Object ID of the Fused Object, Only relvant when OBJ_Fusion_Source is not Camera only";
CM_ SG_ 154 OBJ_Height_29 "The height of the object in the world. ";
CM_ SG_ 154 OBJ_Height_V_29 "Validator for object height.";
CM_ SG_ 154 OBJ_Height_STD_29 "Standard deviation for object height.";
CM_ SG_ 154 OBJ_Height_STD_V_29 "Validator for the standard deviation of object height.";
CM_ SG_ 154 OBJ_Abs_Long_Velocity_29 "Absolute longitudinal velocity.";
CM_ SG_ 154 OBJ_Abs_Long_Velocity_V_29 "Validator for absolute longitudinal velocity.";
CM_ SG_ 154 OBJ_Abs_Long_Velocity_STD_29 "Standard deviation of absolute longitudinal velocity.";
CM_ SG_ 154 OBJ_Abs_Long_Vel_STD_V_29 "Validator for the standard deviation of the absolute longitudinal velocity.";
CM_ SG_ 154 OBJ_Abs_Lat_Velocity_29 "The lateral ground speed of the object.";
CM_ SG_ 154 OBJ_Abs_Lat_Velocity_V_29 "Validator for the lateral ground speed of the object.";
CM_ SG_ 154 OBJ_Abs_Lat_Velocity_STD_29 "STD of the lateral ground speed of the object.";
CM_ SG_ 154 OBJ_Abs_Lat_Vel_STD_V_29 "Validator for the STD of the lateral ground speed of the object.";
CM_ SG_ 154 OBJ_Abs_Long_Acc_29 "The longitudinal ground acceleration of the object.";
CM_ SG_ 154 OBJ_Abs_Long_Acc_V_29 "Validator for the longitudinal ground acceleration of the object.";
CM_ SG_ 154 OBJ_Abs_Long_Acc_STD_29 "STD of the longitudinal ground acceleration of the object.";
CM_ SG_ 154 OBJ_Abs_Long_Acc_STD_V_29 "Validator for the STD of the longitudinal ground acceleration of the object.";
CM_ SG_ 154 OBJ_Abs_Lat_Acc_29 "The lateral ground acceleration of the object.";
CM_ SG_ 154 OBJ_Abs_Lat_Acc_V_29 "Validator for the lateral ground acceleration of the object.";
CM_ SG_ 154 OBJ_Abs_Lat_Acc_STD_29 "STD of the lateral ground acceleration of the object.";
CM_ SG_ 154 OBJ_Abs_Lat_Acc_STD_V_29 "Validator for the STD of the lateral ground acceleration of the object.";
CM_ SG_ 154 OBJ_Abs_Acceleration_29 "The absolute ground acceleration in the target's heading direction.";
CM_ SG_ 154 OBJ_Abs_Acceleration_V_29 "Validator for the absolute ground acceleration.";
CM_ SG_ 154 OBJ_Abs_Acc_STD_29 "STD of the absolute ground acceleration.";
CM_ SG_ 154 OBJ_Abs_Acc_STD_V_29 "Validator for the STD of the absolute ground acceleration.";
CM_ SG_ 154 OBJ_Inv_TTC_29 "Inverse TTC (time to collision).";
CM_ SG_ 154 OBJ_Inv_TTC_STD_29 "STD for inverse TTC .";
CM_ SG_ 154 OBJ_Inv_TTC_STD_V_29 "Validator for the STD for inverse TTC .";
CM_ SG_ 154 OBJ_Relative_Long_Acc_29 "The relative longitudinal ground acceleration of the object.";
CM_ SG_ 154 OBJ_Relative_Long_Acc_V_29 "Validator for the relative longitudinal ground acceleration of the object.";
CM_ SG_ 154 OBJ_Relative_Long_Acc_STD_29 "STD of the relative longitudinal ground acceleration of the object.";
CM_ SG_ 154 OBJ_Rel_Long_Acc_STD_V_29 "Validator for the STD of the relative longitudinal ground acceleration.";
CM_ SG_ 154 OBJ_Relative_Long_Velocity_29 "The relative longtitudinal speed between the target and ego vehicle. ";
CM_ SG_ 154 OBJ_Relative_Long_Velocity_V_29 "Validator for the relative longtitudinal speed.";
CM_ SG_ 154 OBJ_Relative_Long_Vel_STD_29 "STD of the relative longtitudinal speed.";
CM_ SG_ 154 OBJ_Rel_Long_Vel_STD_V_29 "Validator for the STD of the relative longtitudinal speed.";
CM_ SG_ 154 OBJ_Relative_Lat_Velocity_29 "The relative lateral speed between the target and ego vehicle. ";
CM_ SG_ 154 OBJ_Relative_Lat_Velocity_V_29 "Validator for the relative lateral speed. ";
CM_ SG_ 154 OBJ_Relative_Lat_Velocity_STD_29 "STD of the relative lateral speed. ";
CM_ SG_ 154 OBJ_Rel_Lat_Vel_STD_V_29 "Validator for the STD of the relative lateral speed. ";
CM_ SG_ 154 OBJ_Long_Distance_29 "The longitudinal distance to middle of the rear bumper (middle of the RL and RR corners) of the target.";
CM_ SG_ 154 OBJ_Long_Distance_V_29 "Validator of the longtitudinal distance field";
CM_ SG_ 154 OBJ_Long_Distance_STD_29 "STD of the  longtitudinal distance.";
CM_ SG_ 154 OBJ_Long_Distance_STD_V_29 "Validator for the STD of the  longtitudinal distance.";
CM_ SG_ 154 OBJ_Lat_Distance_29 "Lateral distance to the middle of the RL and RR corners.  ";
CM_ SG_ 154 OBJ_Lat_Distance_V_29 "Validator for the lateral distance of the object.";
CM_ SG_ 154 OBJ_Lat_Distance_STD_29 "STD of the lateral distance of the object.";
CM_ SG_ 154 OBJ_Lat_Distance_STD_V_29 "Validator for the STD of the lateral distance of the object.";
CM_ SG_ 154 OBJ_Absolute_Speed_29 "The absolute ground speed in the targets' heading direction.";
CM_ SG_ 154 OBJ_Absolute_Speed_V_29 "Validator for the absolute ground speed.";
CM_ SG_ 154 OBJ_Absolute_Speed_STD_29 "STD of the absolute ground speed.";
CM_ SG_ 154 OBJ_Absolute_Speed_STD_V_29 "Validator for the STD of the absolute ground speed.";
CM_ SG_ 154 OBJ_Heading_29 "The angle beetweenthe host longitudinal axis and target's heading (clockwise, e.g. PI/2 is a target crossing from left to right).";
CM_ SG_ 154 OBJ_Heading_V_29 "Validator for the object heading.";
CM_ SG_ 154 OBJ_Heading_STD_29 "STD of the object heading.";
CM_ SG_ 154 OBJ_Heading_STD_V_29 "Validator for the STD of the object heading.";
CM_ SG_ 154 OBJ_Angle_Rate_STD_29 "Standard deviation of the angular speed. (radians)";
CM_ SG_ 154 OBJ_Angle_Rate_STD_V_29 "Validator for the STD of the angular speed.";
CM_ SG_ 154 OBJ_Angle_Rate_29 "The momentary angular speed of the object (radians). The positive side is to the host's right.";
CM_ SG_ 154 OBJ_Angle_Rate_V_29 "Validator for the angular speed.";
CM_ SG_ 154 OBJ_Angle_Right_29 "The angle between the host longitudinal axis and the right side of the front / rear of the target (the visible one). The positive side is to the host's right.";
CM_ SG_ 154 OBJ_Angle_Right_V_29 "Validator for angleRight";
CM_ SG_ 154 OBJ_Angle_Right_STD_29 "Standard deviation of angleRight";
CM_ SG_ 154 OBJ_Angle_Right_STD_V_29 "Validator for the standard deviation of angleRight.";
CM_ SG_ 154 OBJ_Angle_Left_29 "The angle between the host longitudinal axis and the left side of the front / rear of the target (the visible one). The positive side is to the host's right.";
CM_ SG_ 154 OBJ_Angle_Left_V_29 "Validator for angleLeft.";
CM_ SG_ 154 OBJ_Angle_Left_STD_29 "Standard deviation of angleLeft.";
CM_ SG_ 154 OBJ_Angle_Left_STD_V_29 "Validator for the standard deviation of angleLeft.";
CM_ SG_ 154 OBJ_Angle_Side_29 "The angle between the host longitudinal axis and the far visible edge - the visible edge of the front / rear of the target that is not visible. Currently supported for vehicles only.";
CM_ SG_ 154 OBJ_Angle_Side_V_29 "Validator for angleSide.";
CM_ SG_ 154 OBJ_Angle_Side_STD_29 "Standard deviation of angleSide.";
CM_ SG_ 154 OBJ_Angle_Side_STD_V_29 "Validator for the STD of angleSide.";
CM_ SG_ 154 OBJ_Angle_Mid_V_29 "Validator for angleMid.";
CM_ SG_ 154 OBJ_Angle_Mid_29 "The angle between the host longitudinal axis and the middle of the front / rear of the target (the visible one). The positive side is to the host's right.";
CM_ SG_ 154 OBJ_Angle_Mid_STD_29 "Standard deviation of angleMid.";
CM_ SG_ 154 OBJ_Angle_Mid_STD_V_29 "Validator for the STD of angleMid.";
CM_ SG_ 154 OBJ_Angle_Bottom_V_29 "Validator for OBJAngle_Bottom. ";
CM_ SG_ 154 OBJ_Angle_Bottom_29 "The angle between the longitudinal axis and the Bottom of the front / rear of the target (the visible one). The positive side is to the host's bottom";
CM_ SG_ 154 OBJ_Angle_Bottom_STD_29 "STD for OBJAngle_Bottom. ";
CM_ SG_ 154 OBJ_Angle_Bottom_STD_V_29 "Validator for OBJAngle_Bottom_STD. ";
CM_ SG_ 154 OBJ_Visibility_Side_V_29 "Currently Supported for VD only";
CM_ SG_ 154 OBJ_Visibility_Side_29 "From what car  side is the object visible";
CM_ SG_ 154 OBJ_Is_In_Drivable_Area_29 "Indicates whether the target is in a driveable area.";
CM_ SG_ 154 OBJ_Is_In_Drivable_Area_V_29 "Validator for OBJ_Is_In_Drivable_Area.";
CM_ SG_ 154 OBJ_Is_VeryClose_V_29 "Validator for OBJ_Is_VeryClose. ";
CM_ SG_ 154 OBJ_Is_VeryClose_29 "Indicates whether the target is very close to the host such that it is hard to measure its distance. Currently relevant for peds only";
CM_ SG_ 154 OBJ_OverlapAngleEgoLaneR_29 "Lateral distance to the middle of the RL and RR corners.";
CM_ SG_ 154 OBJ_OverlapAngleEgoLaneR_V_29 "Validator for OBJ_OverlapAngleEgoLaneR";
CM_ SG_ 154 OBJ_OverlapAngleEgoLaneL_29 "Lateral distance to the middle of the RL and RR corners.  ";
CM_ SG_ 154 OBJ_OverlapAngleEgoLaneL_V_29 "Validator for OBJ_OverlapAngleEgoLaneL";
CM_ SG_ 154 OBJ_Is_EMERGENCY_VCL_29 "Is Object an Emergency Vehicle";
CM_ SG_ 154 OBJ_EMERGENCY_LIGHT_COLOR_29 "Emergency Color";
CM_ SG_ 154 OBJ_EMERGENCY_V_29 "Are OBJ_Is_EMERGENCY_VCL and OBJ_EMERGENCY_LIGHT_COLOR Valid";
CM_ SG_ 154 OBJ_Angle_Top_29 "From VD touching point on the ground till the roof of the car";
CM_ SG_ 154 OBJ_Angle_Top_V_29 "Validator for OBJ_Angle_Top ";
CM_ SG_ 154 OBJ_Angle_Top_STD_29 "STD for OBJ_Angle_Top";
CM_ SG_ 154 OBJ_Angle_Top_STD_V_29 "Validator for OBJ_Angle_Top_STD. ";
CM_ SG_ 154 OBJ_Open_Door_Left_29 "Indicator if left door is open";
CM_ SG_ 154 OBJ_Open_Door_Right_29 "Indicator if right door is open";
CM_ SG_ 154 OBJ_Visible_Left_or_Right_29 "This signal describes the visible Left or Right side of the Target vehicle.";
CM_ SG_ 154 OBJ_Visible_Left_or_Right_V_29 "OBJ_Visible_Left_or_Right";
CM_ SG_ 154 OBJ_2W_Is_Motorbike_Probability_29 "The probability of the Two-wheeler reported object being a Motorbike";
CM_ SG_ 154 OBJ_2W_Is_Bicycle_Probability_29 "The probability of the Two-wheeler reported object being a Bicycle";
CM_ SG_ 154 OBJ_CRC_30 "Calculated over all element signals. From the signal after the CRC until the first signal in the next elements OBJ_CRC_N+1  not including";
CM_ SG_ 154 OBJ_ID_30 "The detected object ID. Range is 1-255, while 0 indicates that the field in unfilled.";
CM_ SG_ 154 OBJ_Existence_Probability_30 "The existence probability of the reported object";
CM_ SG_ 154 OBJ_Fusion_Source_30 "sources ids used for fusion";
CM_ SG_ 154 OBJ_Triggered_SDM_30 "Indicates whether the object has trigered the SDM (Safety Diagnostic Manager) alert.";
CM_ SG_ 154 OBJ_Motion_Category_30 "Relevant for VD only. Full description of values can be found at the ACC guide.";
CM_ SG_ 154 OBJ_Moving_IN_Probability_30 "The probability the object is eventually move into ego lane. (In case that the OBJ_Motion_Category signal is set to  MOVING_IN ";
CM_ SG_ 154 OBJ_Object_Age_30 "The number of frames in which the object was recognized.";
CM_ SG_ 154 OBJ_Measuring_Status_30 "Measurment status. Old vs New marks if this is the first frame in which the object is reported. Predicted vs Measured marks if the report is raw or has been predicted forward in time using the measured dynamics and ego motion.";
CM_ SG_ 154 OBJ_Object_Class_30 "Indicates the object type. Uncertain is outputted in case the probability that a vehicle is a truck is very similar to the probability that it is a car.";
CM_ SG_ 154 OBJ_Class_Probability_30 "The probability of this type classification.";
CM_ SG_ 154 OBJ_Car_Probability_30 "The probability the object is a car";
CM_ SG_ 154 OBJ_Truck_Probability_30 "The probability the object is a Truck";
CM_ SG_ 154 OBJ_Bike_Probability_30 "The probability the object is a Bike";
CM_ SG_ 154 OBJ_Camera_Source_30 "The camera in which this object was detected (best choice).";
CM_ SG_ 154 OBJ_Motion_Status_30 "MOVING - the object is moving STATIONARY - the object was never seen moving STOPPED -  the object was moving and has stopped MOVING_SLOWLY - the object is moving very slowly";
CM_ SG_ 154 OBJ_Motion_Orientation_30 "The direction of the targets heading compared to the host. ";
CM_ SG_ 154 OBJ_Has_Cut_Lane_30 "Indicates whether the object cut the host's (right or left) lane. In case there are no lanes, indicates whether the objects is at most 1 meters away from the host.";
CM_ SG_ 154 OBJ_Has_Cut_Path_30 "Indicates whether the object is in the host's path.";
CM_ SG_ 154 OBJ_Brake_Light_Validity_30 "Validator for braking light indicator";
CM_ SG_ 154 OBJ_Brake_Light_30 "Indication for brake lights ";
CM_ SG_ 154 OBJ_Turn_Indicator_Right_30 "Indication for blinking right light.";
CM_ SG_ 154 OBJ_Turn_Indicator_Left_30 "Indication for blinking left light ";
CM_ SG_ 154 OBJ_Turn_Indicator_Validity_30 "Validator for light indicators";
CM_ SG_ 154 OBJ_Right_Out_Of_Image_30 "Indicates whether the measurment are predicted out of the right side of the image bounderies.";
CM_ SG_ 154 OBJ_Left_Out_Of_Image_30 "Indicates whether if measurment are predicted out of  the left side of the image bounderies";
CM_ SG_ 154 OBJ_Right_Out_Of_Image_V_30 "validator";
CM_ SG_ 154 OBJ_Left_Out_Of_Image_V_30 "validator";
CM_ SG_ 154 OBJ_Top_Out_Of_Image_30 "Indicates whether if measurment are predicted out of  the top of the image bounderies";
CM_ SG_ 154 OBJ_Bottom_Out_Of_Image_30 "Indicates whether if measurment are predicted out of  the bottom of the image bounderies";
CM_ SG_ 154 OBJ_Top_Out_Of_Image_V_30 "validator";
CM_ SG_ 154 OBJ_Bottom_Out_Of_Image_V_30 "validator";
CM_ SG_ 154 OBJ_Lane_Assignment_30 "The object's lane relative to the host lane.";
CM_ SG_ 154 OBJ_Lane_Assignment_V_30 "Validator for lane assignment";
CM_ SG_ 154 OBJ_Age_Seconds_30 "Time in seconds in which the object was recognized. ";
CM_ SG_ 154 OBJ_Age_Seconds_V_30 "Validator for object age";
CM_ SG_ 154 OBJ_Width_30 "The width of the target vehicle in the world (not to be mistaken with the width of the visible part of the vehicle).";
CM_ SG_ 154 OBJ_Width_V_30 "Validator for object width";
CM_ SG_ 154 OBJ_Width_STD_30 "Standard deviation for object width";
CM_ SG_ 154 OBJ_Width_STD_V_30 "Validator for the standard deviation of object width";
CM_ SG_ 154 OBJ_Length_30 "The length of the vehicle in the world. For crossing bicycles it gives the viewed length of the bicycle.";
CM_ SG_ 154 OBJ_Length_V_30 "Validator for object length.";
CM_ SG_ 154 OBJ_Length_STD_30 "Standard deviation for object length.";
CM_ SG_ 154 OBJ_Length_STD_V_30 "Validator for the standard deviation of object length.";
CM_ SG_ 154 OBJ_Radar_ID_30 "Radar Object ID of the Fused Object, Only relvant when OBJ_Fusion_Source is not Camera only";
CM_ SG_ 154 OBJ_Height_30 "The height of the object in the world. ";
CM_ SG_ 154 OBJ_Height_V_30 "Validator for object height.";
CM_ SG_ 154 OBJ_Height_STD_30 "Standard deviation for object height.";
CM_ SG_ 154 OBJ_Height_STD_V_30 "Validator for the standard deviation of object height.";
CM_ SG_ 154 OBJ_Abs_Long_Velocity_30 "Absolute longitudinal velocity.";
CM_ SG_ 154 OBJ_Abs_Long_Velocity_V_30 "Validator for absolute longitudinal velocity.";
CM_ SG_ 154 OBJ_Abs_Long_Velocity_STD_30 "Standard deviation of absolute longitudinal velocity.";
CM_ SG_ 154 OBJ_Abs_Long_Vel_STD_V_30 "Validator for the standard deviation of the absolute longitudinal velocity.";
CM_ SG_ 154 OBJ_Abs_Lat_Velocity_30 "The lateral ground speed of the object.";
CM_ SG_ 154 OBJ_Abs_Lat_Velocity_V_30 "Validator for the lateral ground speed of the object.";
CM_ SG_ 154 OBJ_Abs_Lat_Velocity_STD_30 "STD of the lateral ground speed of the object.";
CM_ SG_ 154 OBJ_Abs_Lat_Vel_STD_V_30 "Validator for the STD of the lateral ground speed of the object.";
CM_ SG_ 154 OBJ_Abs_Long_Acc_30 "The longitudinal ground acceleration of the object.";
CM_ SG_ 154 OBJ_Abs_Long_Acc_V_30 "Validator for the longitudinal ground acceleration of the object.";
CM_ SG_ 154 OBJ_Abs_Long_Acc_STD_30 "STD of the longitudinal ground acceleration of the object.";
CM_ SG_ 154 OBJ_Abs_Long_Acc_STD_V_30 "Validator for the STD of the longitudinal ground acceleration of the object.";
CM_ SG_ 154 OBJ_Abs_Lat_Acc_30 "The lateral ground acceleration of the object.";
CM_ SG_ 154 OBJ_Abs_Lat_Acc_V_30 "Validator for the lateral ground acceleration of the object.";
CM_ SG_ 154 OBJ_Abs_Lat_Acc_STD_30 "STD of the lateral ground acceleration of the object.";
CM_ SG_ 154 OBJ_Abs_Lat_Acc_STD_V_30 "Validator for the STD of the lateral ground acceleration of the object.";
CM_ SG_ 154 OBJ_Abs_Acceleration_30 "The absolute ground acceleration in the target's heading direction.";
CM_ SG_ 154 OBJ_Abs_Acceleration_V_30 "Validator for the absolute ground acceleration.";
CM_ SG_ 154 OBJ_Abs_Acc_STD_30 "STD of the absolute ground acceleration.";
CM_ SG_ 154 OBJ_Abs_Acc_STD_V_30 "Validator for the STD of the absolute ground acceleration.";
CM_ SG_ 154 OBJ_Inv_TTC_30 "Inverse TTC (time to collision).";
CM_ SG_ 154 OBJ_Inv_TTC_STD_30 "STD for inverse TTC .";
CM_ SG_ 154 OBJ_Inv_TTC_STD_V_30 "Validator for the STD for inverse TTC .";
CM_ SG_ 154 OBJ_Relative_Long_Acc_30 "The relative longitudinal ground acceleration of the object.";
CM_ SG_ 154 OBJ_Relative_Long_Acc_V_30 "Validator for the relative longitudinal ground acceleration of the object.";
CM_ SG_ 154 OBJ_Relative_Long_Acc_STD_30 "STD of the relative longitudinal ground acceleration of the object.";
CM_ SG_ 154 OBJ_Rel_Long_Acc_STD_V_30 "Validator for the STD of the relative longitudinal ground acceleration.";
CM_ SG_ 154 OBJ_Relative_Long_Velocity_30 "The relative longtitudinal speed between the target and ego vehicle. ";
CM_ SG_ 154 OBJ_Relative_Long_Velocity_V_30 "Validator for the relative longtitudinal speed.";
CM_ SG_ 154 OBJ_Relative_Long_Vel_STD_30 "STD of the relative longtitudinal speed.";
CM_ SG_ 154 OBJ_Rel_Long_Vel_STD_V_30 "Validator for the STD of the relative longtitudinal speed.";
CM_ SG_ 154 OBJ_Relative_Lat_Velocity_30 "The relative lateral speed between the target and ego vehicle. ";
CM_ SG_ 154 OBJ_Relative_Lat_Velocity_V_30 "Validator for the relative lateral speed. ";
CM_ SG_ 154 OBJ_Relative_Lat_Velocity_STD_30 "STD of the relative lateral speed. ";
CM_ SG_ 154 OBJ_Rel_Lat_Vel_STD_V_30 "Validator for the STD of the relative lateral speed. ";
CM_ SG_ 154 OBJ_Long_Distance_30 "The longitudinal distance to middle of the rear bumper (middle of the RL and RR corners) of the target.";
CM_ SG_ 154 OBJ_Long_Distance_V_30 "Validator of the longtitudinal distance field";
CM_ SG_ 154 OBJ_Long_Distance_STD_30 "STD of the  longtitudinal distance.";
CM_ SG_ 154 OBJ_Long_Distance_STD_V_30 "Validator for the STD of the  longtitudinal distance.";
CM_ SG_ 154 OBJ_Lat_Distance_30 "Lateral distance to the middle of the RL and RR corners.  ";
CM_ SG_ 154 OBJ_Lat_Distance_V_30 "Validator for the lateral distance of the object.";
CM_ SG_ 154 OBJ_Lat_Distance_STD_30 "STD of the lateral distance of the object.";
CM_ SG_ 154 OBJ_Lat_Distance_STD_V_30 "Validator for the STD of the lateral distance of the object.";
CM_ SG_ 154 OBJ_Absolute_Speed_30 "The absolute ground speed in the targets' heading direction.";
CM_ SG_ 154 OBJ_Absolute_Speed_V_30 "Validator for the absolute ground speed.";
CM_ SG_ 154 OBJ_Absolute_Speed_STD_30 "STD of the absolute ground speed.";
CM_ SG_ 154 OBJ_Absolute_Speed_STD_V_30 "Validator for the STD of the absolute ground speed.";
CM_ SG_ 154 OBJ_Heading_30 "The angle beetweenthe host longitudinal axis and target's heading (clockwise, e.g. PI/2 is a target crossing from left to right).";
CM_ SG_ 154 OBJ_Heading_V_30 "Validator for the object heading.";
CM_ SG_ 154 OBJ_Heading_STD_30 "STD of the object heading.";
CM_ SG_ 154 OBJ_Heading_STD_V_30 "Validator for the STD of the object heading.";
CM_ SG_ 154 OBJ_Angle_Rate_STD_30 "Standard deviation of the angular speed. (radians)";
CM_ SG_ 154 OBJ_Angle_Rate_STD_V_30 "Validator for the STD of the angular speed.";
CM_ SG_ 154 OBJ_Angle_Rate_30 "The momentary angular speed of the object (radians). The positive side is to the host's right.";
CM_ SG_ 154 OBJ_Angle_Rate_V_30 "Validator for the angular speed.";
CM_ SG_ 154 OBJ_Angle_Right_30 "The angle between the host longitudinal axis and the right side of the front / rear of the target (the visible one). The positive side is to the host's right.";
CM_ SG_ 154 OBJ_Angle_Right_V_30 "Validator for angleRight";
CM_ SG_ 154 OBJ_Angle_Right_STD_30 "Standard deviation of angleRight";
CM_ SG_ 154 OBJ_Angle_Right_STD_V_30 "Validator for the standard deviation of angleRight.";
CM_ SG_ 154 OBJ_Angle_Left_30 "The angle between the host longitudinal axis and the left side of the front / rear of the target (the visible one). The positive side is to the host's right.";
CM_ SG_ 154 OBJ_Angle_Left_V_30 "Validator for angleLeft.";
CM_ SG_ 154 OBJ_Angle_Left_STD_30 "Standard deviation of angleLeft.";
CM_ SG_ 154 OBJ_Angle_Left_STD_V_30 "Validator for the standard deviation of angleLeft.";
CM_ SG_ 154 OBJ_Angle_Side_30 "The angle between the host longitudinal axis and the far visible edge - the visible edge of the front / rear of the target that is not visible. Currently supported for vehicles only.";
CM_ SG_ 154 OBJ_Angle_Side_V_30 "Validator for angleSide.";
CM_ SG_ 154 OBJ_Angle_Side_STD_30 "Standard deviation of angleSide.";
CM_ SG_ 154 OBJ_Angle_Side_STD_V_30 "Validator for the STD of angleSide.";
CM_ SG_ 154 OBJ_Angle_Mid_V_30 "Validator for angleMid.";
CM_ SG_ 154 OBJ_Angle_Mid_30 "The angle between the host longitudinal axis and the middle of the front / rear of the target (the visible one). The positive side is to the host's right.";
CM_ SG_ 154 OBJ_Angle_Mid_STD_30 "Standard deviation of angleMid.";
CM_ SG_ 154 OBJ_Angle_Mid_STD_V_30 "Validator for the STD of angleMid.";
CM_ SG_ 154 OBJ_Angle_Bottom_V_30 "Validator for OBJAngle_Bottom. ";
CM_ SG_ 154 OBJ_Angle_Bottom_30 "The angle between the longitudinal axis and the Bottom of the front / rear of the target (the visible one). The positive side is to the host's bottom";
CM_ SG_ 154 OBJ_Angle_Bottom_STD_30 "STD for OBJAngle_Bottom. ";
CM_ SG_ 154 OBJ_Angle_Bottom_STD_V_30 "Validator for OBJAngle_Bottom_STD. ";
CM_ SG_ 154 OBJ_Visibility_Side_V_30 "Currently Supported for VD only";
CM_ SG_ 154 OBJ_Visibility_Side_30 "From what car  side is the object visible";
CM_ SG_ 154 OBJ_Is_In_Drivable_Area_30 "Indicates whether the target is in a driveable area.";
CM_ SG_ 154 OBJ_Is_In_Drivable_Area_V_30 "Validator for OBJ_Is_In_Drivable_Area.";
CM_ SG_ 154 OBJ_Is_VeryClose_V_30 "Validator for OBJ_Is_VeryClose. ";
CM_ SG_ 154 OBJ_Is_VeryClose_30 "Indicates whether the target is very close to the host such that it is hard to measure its distance. Currently relevant for peds only";
CM_ SG_ 154 OBJ_OverlapAngleEgoLaneR_30 "Lateral distance to the middle of the RL and RR corners.";
CM_ SG_ 154 OBJ_OverlapAngleEgoLaneR_V_30 "Validator for OBJ_OverlapAngleEgoLaneR";
CM_ SG_ 154 OBJ_OverlapAngleEgoLaneL_30 "Lateral distance to the middle of the RL and RR corners.  ";
CM_ SG_ 154 OBJ_OverlapAngleEgoLaneL_V_30 "Validator for OBJ_OverlapAngleEgoLaneL";
CM_ SG_ 154 OBJ_Is_EMERGENCY_VCL_30 "Is Object an Emergency Vehicle";
CM_ SG_ 154 OBJ_EMERGENCY_LIGHT_COLOR_30 "Emergency Color";
CM_ SG_ 154 OBJ_EMERGENCY_V_30 "Are OBJ_Is_EMERGENCY_VCL and OBJ_EMERGENCY_LIGHT_COLOR Valid";
CM_ SG_ 154 OBJ_Angle_Top_30 "From VD touching point on the ground till the roof of the car";
CM_ SG_ 154 OBJ_Angle_Top_V_30 "Validator for OBJ_Angle_Top ";
CM_ SG_ 154 OBJ_Angle_Top_STD_30 "STD for OBJ_Angle_Top";
CM_ SG_ 154 OBJ_Angle_Top_STD_V_30 "Validator for OBJ_Angle_Top_STD. ";
CM_ SG_ 154 OBJ_Open_Door_Left_30 "Indicator if left door is open";
CM_ SG_ 154 OBJ_Open_Door_Right_30 "Indicator if right door is open";
CM_ SG_ 154 OBJ_Visible_Left_or_Right_30 "This signal describes the visible Left or Right side of the Target vehicle.";
CM_ SG_ 154 OBJ_Visible_Left_or_Right_V_30 "OBJ_Visible_Left_or_Right";
CM_ SG_ 154 OBJ_2W_Is_Motorbike_Probability_30 "The probability of the Two-wheeler reported object being a Motorbike";
CM_ SG_ 154 OBJ_2W_Is_Bicycle_Probability_30 "The probability of the Two-wheeler reported object being a Bicycle";
CM_ SG_ 154 OBJ_CRC_31 "Calculated over all element signals. From the signal after the CRC until the first signal in the next elements OBJ_CRC_N+1  not including";
CM_ SG_ 154 OBJ_ID_31 "The detected object ID. Range is 1-255, while 0 indicates that the field in unfilled.";
CM_ SG_ 154 OBJ_Existence_Probability_31 "The existence probability of the reported object";
CM_ SG_ 154 OBJ_Fusion_Source_31 "sources ids used for fusion";
CM_ SG_ 154 OBJ_Triggered_SDM_31 "Indicates whether the object has trigered the SDM (Safety Diagnostic Manager) alert.";
CM_ SG_ 154 OBJ_Motion_Category_31 "Relevant for VD only. Full description of values can be found at the ACC guide.";
CM_ SG_ 154 OBJ_Moving_IN_Probability_31 "The probability the object is eventually move into ego lane. (In case that the OBJ_Motion_Category signal is set to  MOVING_IN ";
CM_ SG_ 154 OBJ_Object_Age_31 "The number of frames in which the object was recognized.";
CM_ SG_ 154 OBJ_Measuring_Status_31 "Measurment status. Old vs New marks if this is the first frame in which the object is reported. Predicted vs Measured marks if the report is raw or has been predicted forward in time using the measured dynamics and ego motion.";
CM_ SG_ 154 OBJ_Object_Class_31 "Indicates the object type. Uncertain is outputted in case the probability that a vehicle is a truck is very similar to the probability that it is a car.";
CM_ SG_ 154 OBJ_Class_Probability_31 "The probability of this type classification.";
CM_ SG_ 154 OBJ_Car_Probability_31 "The probability the object is a car";
CM_ SG_ 154 OBJ_Truck_Probability_31 "The probability the object is a Truck";
CM_ SG_ 154 OBJ_Bike_Probability_31 "The probability the object is a Bike";
CM_ SG_ 154 OBJ_Camera_Source_31 "The camera in which this object was detected (best choice).";
CM_ SG_ 154 OBJ_Motion_Status_31 "MOVING - the object is moving STATIONARY - the object was never seen moving STOPPED -  the object was moving and has stopped MOVING_SLOWLY - the object is moving very slowly";
CM_ SG_ 154 OBJ_Motion_Orientation_31 "The direction of the targets heading compared to the host. ";
CM_ SG_ 154 OBJ_Has_Cut_Lane_31 "Indicates whether the object cut the host's (right or left) lane. In case there are no lanes, indicates whether the objects is at most 1 meters away from the host.";
CM_ SG_ 154 OBJ_Has_Cut_Path_31 "Indicates whether the object is in the host's path.";
CM_ SG_ 154 OBJ_Brake_Light_Validity_31 "Validator for braking light indicator";
CM_ SG_ 154 OBJ_Brake_Light_31 "Indication for brake lights ";
CM_ SG_ 154 OBJ_Turn_Indicator_Right_31 "Indication for blinking right light.";
CM_ SG_ 154 OBJ_Turn_Indicator_Left_31 "Indication for blinking left light ";
CM_ SG_ 154 OBJ_Turn_Indicator_Validity_31 "Validator for light indicators";
CM_ SG_ 154 OBJ_Right_Out_Of_Image_31 "Indicates whether the measurment are predicted out of the right side of the image bounderies.";
CM_ SG_ 154 OBJ_Left_Out_Of_Image_31 "Indicates whether if measurment are predicted out of  the left side of the image bounderies";
CM_ SG_ 154 OBJ_Right_Out_Of_Image_V_31 "validator";
CM_ SG_ 154 OBJ_Left_Out_Of_Image_V_31 "validator";
CM_ SG_ 154 OBJ_Top_Out_Of_Image_31 "Indicates whether if measurment are predicted out of  the top of the image bounderies";
CM_ SG_ 154 OBJ_Bottom_Out_Of_Image_31 "Indicates whether if measurment are predicted out of  the bottom of the image bounderies";
CM_ SG_ 154 OBJ_Top_Out_Of_Image_V_31 "validator";
CM_ SG_ 154 OBJ_Bottom_Out_Of_Image_V_31 "validator";
CM_ SG_ 154 OBJ_Lane_Assignment_31 "The object's lane relative to the host lane.";
CM_ SG_ 154 OBJ_Lane_Assignment_V_31 "Validator for lane assignment";
CM_ SG_ 154 OBJ_Age_Seconds_31 "Time in seconds in which the object was recognized. ";
CM_ SG_ 154 OBJ_Age_Seconds_V_31 "Validator for object age";
CM_ SG_ 154 OBJ_Width_31 "The width of the target vehicle in the world (not to be mistaken with the width of the visible part of the vehicle).";
CM_ SG_ 154 OBJ_Width_V_31 "Validator for object width";
CM_ SG_ 154 OBJ_Width_STD_31 "Standard deviation for object width";
CM_ SG_ 154 OBJ_Width_STD_V_31 "Validator for the standard deviation of object width";
CM_ SG_ 154 OBJ_Length_31 "The length of the vehicle in the world. For crossing bicycles it gives the viewed length of the bicycle.";
CM_ SG_ 154 OBJ_Length_V_31 "Validator for object length.";
CM_ SG_ 154 OBJ_Length_STD_31 "Standard deviation for object length.";
CM_ SG_ 154 OBJ_Length_STD_V_31 "Validator for the standard deviation of object length.";
CM_ SG_ 154 OBJ_Radar_ID_31 "Radar Object ID of the Fused Object, Only relvant when OBJ_Fusion_Source is not Camera only";
CM_ SG_ 154 OBJ_Height_31 "The height of the object in the world. ";
CM_ SG_ 154 OBJ_Height_V_31 "Validator for object height.";
CM_ SG_ 154 OBJ_Height_STD_31 "Standard deviation for object height.";
CM_ SG_ 154 OBJ_Height_STD_V_31 "Validator for the standard deviation of object height.";
CM_ SG_ 154 OBJ_Abs_Long_Velocity_31 "Absolute longitudinal velocity.";
CM_ SG_ 154 OBJ_Abs_Long_Velocity_V_31 "Validator for absolute longitudinal velocity.";
CM_ SG_ 154 OBJ_Abs_Long_Velocity_STD_31 "Standard deviation of absolute longitudinal velocity.";
CM_ SG_ 154 OBJ_Abs_Long_Vel_STD_V_31 "Validator for the standard deviation of the absolute longitudinal velocity.";
CM_ SG_ 154 OBJ_Abs_Lat_Velocity_31 "The lateral ground speed of the object.";
CM_ SG_ 154 OBJ_Abs_Lat_Velocity_V_31 "Validator for the lateral ground speed of the object.";
CM_ SG_ 154 OBJ_Abs_Lat_Velocity_STD_31 "STD of the lateral ground speed of the object.";
CM_ SG_ 154 OBJ_Abs_Lat_Vel_STD_V_31 "Validator for the STD of the lateral ground speed of the object.";
CM_ SG_ 154 OBJ_Abs_Long_Acc_31 "The longitudinal ground acceleration of the object.";
CM_ SG_ 154 OBJ_Abs_Long_Acc_V_31 "Validator for the longitudinal ground acceleration of the object.";
CM_ SG_ 154 OBJ_Abs_Long_Acc_STD_31 "STD of the longitudinal ground acceleration of the object.";
CM_ SG_ 154 OBJ_Abs_Long_Acc_STD_V_31 "Validator for the STD of the longitudinal ground acceleration of the object.";
CM_ SG_ 154 OBJ_Abs_Lat_Acc_31 "The lateral ground acceleration of the object.";
CM_ SG_ 154 OBJ_Abs_Lat_Acc_V_31 "Validator for the lateral ground acceleration of the object.";
CM_ SG_ 154 OBJ_Abs_Lat_Acc_STD_31 "STD of the lateral ground acceleration of the object.";
CM_ SG_ 154 OBJ_Abs_Lat_Acc_STD_V_31 "Validator for the STD of the lateral ground acceleration of the object.";
CM_ SG_ 154 OBJ_Abs_Acceleration_31 "The absolute ground acceleration in the target's heading direction.";
CM_ SG_ 154 OBJ_Abs_Acceleration_V_31 "Validator for the absolute ground acceleration.";
CM_ SG_ 154 OBJ_Abs_Acc_STD_31 "STD of the absolute ground acceleration.";
CM_ SG_ 154 OBJ_Abs_Acc_STD_V_31 "Validator for the STD of the absolute ground acceleration.";
CM_ SG_ 154 OBJ_Inv_TTC_31 "Inverse TTC (time to collision).";
CM_ SG_ 154 OBJ_Inv_TTC_STD_31 "STD for inverse TTC .";
CM_ SG_ 154 OBJ_Inv_TTC_STD_V_31 "Validator for the STD for inverse TTC .";
CM_ SG_ 154 OBJ_Relative_Long_Acc_31 "The relative longitudinal ground acceleration of the object.";
CM_ SG_ 154 OBJ_Relative_Long_Acc_V_31 "Validator for the relative longitudinal ground acceleration of the object.";
CM_ SG_ 154 OBJ_Relative_Long_Acc_STD_31 "STD of the relative longitudinal ground acceleration of the object.";
CM_ SG_ 154 OBJ_Rel_Long_Acc_STD_V_31 "Validator for the STD of the relative longitudinal ground acceleration.";
CM_ SG_ 154 OBJ_Relative_Long_Velocity_31 "The relative longtitudinal speed between the target and ego vehicle. ";
CM_ SG_ 154 OBJ_Relative_Long_Velocity_V_31 "Validator for the relative longtitudinal speed.";
CM_ SG_ 154 OBJ_Relative_Long_Vel_STD_31 "STD of the relative longtitudinal speed.";
CM_ SG_ 154 OBJ_Rel_Long_Vel_STD_V_31 "Validator for the STD of the relative longtitudinal speed.";
CM_ SG_ 154 OBJ_Relative_Lat_Velocity_31 "The relative lateral speed between the target and ego vehicle. ";
CM_ SG_ 154 OBJ_Relative_Lat_Velocity_V_31 "Validator for the relative lateral speed. ";
CM_ SG_ 154 OBJ_Relative_Lat_Velocity_STD_31 "STD of the relative lateral speed. ";
CM_ SG_ 154 OBJ_Rel_Lat_Vel_STD_V_31 "Validator for the STD of the relative lateral speed. ";
CM_ SG_ 154 OBJ_Long_Distance_31 "The longitudinal distance to middle of the rear bumper (middle of the RL and RR corners) of the target.";
CM_ SG_ 154 OBJ_Long_Distance_V_31 "Validator of the longtitudinal distance field";
CM_ SG_ 154 OBJ_Long_Distance_STD_31 "STD of the  longtitudinal distance.";
CM_ SG_ 154 OBJ_Long_Distance_STD_V_31 "Validator for the STD of the  longtitudinal distance.";
CM_ SG_ 154 OBJ_Lat_Distance_31 "Lateral distance to the middle of the RL and RR corners.  ";
CM_ SG_ 154 OBJ_Lat_Distance_V_31 "Validator for the lateral distance of the object.";
CM_ SG_ 154 OBJ_Lat_Distance_STD_31 "STD of the lateral distance of the object.";
CM_ SG_ 154 OBJ_Lat_Distance_STD_V_31 "Validator for the STD of the lateral distance of the object.";
CM_ SG_ 154 OBJ_Absolute_Speed_31 "The absolute ground speed in the targets' heading direction.";
CM_ SG_ 154 OBJ_Absolute_Speed_V_31 "Validator for the absolute ground speed.";
CM_ SG_ 154 OBJ_Absolute_Speed_STD_31 "STD of the absolute ground speed.";
CM_ SG_ 154 OBJ_Absolute_Speed_STD_V_31 "Validator for the STD of the absolute ground speed.";
CM_ SG_ 154 OBJ_Heading_31 "The angle beetweenthe host longitudinal axis and target's heading (clockwise, e.g. PI/2 is a target crossing from left to right).";
CM_ SG_ 154 OBJ_Heading_V_31 "Validator for the object heading.";
CM_ SG_ 154 OBJ_Heading_STD_31 "STD of the object heading.";
CM_ SG_ 154 OBJ_Heading_STD_V_31 "Validator for the STD of the object heading.";
CM_ SG_ 154 OBJ_Angle_Rate_STD_31 "Standard deviation of the angular speed. (radians)";
CM_ SG_ 154 OBJ_Angle_Rate_STD_V_31 "Validator for the STD of the angular speed.";
CM_ SG_ 154 OBJ_Angle_Rate_31 "The momentary angular speed of the object (radians). The positive side is to the host's right.";
CM_ SG_ 154 OBJ_Angle_Rate_V_31 "Validator for the angular speed.";
CM_ SG_ 154 OBJ_Angle_Right_31 "The angle between the host longitudinal axis and the right side of the front / rear of the target (the visible one). The positive side is to the host's right.";
CM_ SG_ 154 OBJ_Angle_Right_V_31 "Validator for angleRight";
CM_ SG_ 154 OBJ_Angle_Right_STD_31 "Standard deviation of angleRight";
CM_ SG_ 154 OBJ_Angle_Right_STD_V_31 "Validator for the standard deviation of angleRight.";
CM_ SG_ 154 OBJ_Angle_Left_31 "The angle between the host longitudinal axis and the left side of the front / rear of the target (the visible one). The positive side is to the host's right.";
CM_ SG_ 154 OBJ_Angle_Left_V_31 "Validator for angleLeft.";
CM_ SG_ 154 OBJ_Angle_Left_STD_31 "Standard deviation of angleLeft.";
CM_ SG_ 154 OBJ_Angle_Left_STD_V_31 "Validator for the standard deviation of angleLeft.";
CM_ SG_ 154 OBJ_Angle_Side_31 "The angle between the host longitudinal axis and the far visible edge - the visible edge of the front / rear of the target that is not visible. Currently supported for vehicles only.";
CM_ SG_ 154 OBJ_Angle_Side_V_31 "Validator for angleSide.";
CM_ SG_ 154 OBJ_Angle_Side_STD_31 "Standard deviation of angleSide.";
CM_ SG_ 154 OBJ_Angle_Side_STD_V_31 "Validator for the STD of angleSide.";
CM_ SG_ 154 OBJ_Angle_Mid_V_31 "Validator for angleMid.";
CM_ SG_ 154 OBJ_Angle_Mid_31 "The angle between the host longitudinal axis and the middle of the front / rear of the target (the visible one). The positive side is to the host's right.";
CM_ SG_ 154 OBJ_Angle_Mid_STD_31 "Standard deviation of angleMid.";
CM_ SG_ 154 OBJ_Angle_Mid_STD_V_31 "Validator for the STD of angleMid.";
CM_ SG_ 154 OBJ_Angle_Bottom_V_31 "Validator for OBJAngle_Bottom. ";
CM_ SG_ 154 OBJ_Angle_Bottom_31 "The angle between the longitudinal axis and the Bottom of the front / rear of the target (the visible one). The positive side is to the host's bottom";
CM_ SG_ 154 OBJ_Angle_Bottom_STD_31 "STD for OBJAngle_Bottom. ";
CM_ SG_ 154 OBJ_Angle_Bottom_STD_V_31 "Validator for OBJAngle_Bottom_STD. ";
CM_ SG_ 154 OBJ_Visibility_Side_V_31 "Currently Supported for VD only";
CM_ SG_ 154 OBJ_Visibility_Side_31 "From what car  side is the object visible";
CM_ SG_ 154 OBJ_Is_In_Drivable_Area_31 "Indicates whether the target is in a driveable area.";
CM_ SG_ 154 OBJ_Is_In_Drivable_Area_V_31 "Validator for OBJ_Is_In_Drivable_Area.";
CM_ SG_ 154 OBJ_Is_VeryClose_V_31 "Validator for OBJ_Is_VeryClose. ";
CM_ SG_ 154 OBJ_Is_VeryClose_31 "Indicates whether the target is very close to the host such that it is hard to measure its distance. Currently relevant for peds only";
CM_ SG_ 154 OBJ_OverlapAngleEgoLaneR_31 "Lateral distance to the middle of the RL and RR corners.";
CM_ SG_ 154 OBJ_OverlapAngleEgoLaneR_V_31 "Validator for OBJ_OverlapAngleEgoLaneR";
CM_ SG_ 154 OBJ_OverlapAngleEgoLaneL_31 "Lateral distance to the middle of the RL and RR corners.  ";
CM_ SG_ 154 OBJ_OverlapAngleEgoLaneL_V_31 "Validator for OBJ_OverlapAngleEgoLaneL";
CM_ SG_ 154 OBJ_Is_EMERGENCY_VCL_31 "Is Object an Emergency Vehicle";
CM_ SG_ 154 OBJ_EMERGENCY_LIGHT_COLOR_31 "Emergency Color";
CM_ SG_ 154 OBJ_EMERGENCY_V_31 "Are OBJ_Is_EMERGENCY_VCL and OBJ_EMERGENCY_LIGHT_COLOR Valid";
CM_ SG_ 154 OBJ_Angle_Top_31 "From VD touching point on the ground till the roof of the car";
CM_ SG_ 154 OBJ_Angle_Top_V_31 "Validator for OBJ_Angle_Top ";
CM_ SG_ 154 OBJ_Angle_Top_STD_31 "STD for OBJ_Angle_Top";
CM_ SG_ 154 OBJ_Angle_Top_STD_V_31 "Validator for OBJ_Angle_Top_STD. ";
CM_ SG_ 154 OBJ_Open_Door_Left_31 "Indicator if left door is open";
CM_ SG_ 154 OBJ_Open_Door_Right_31 "Indicator if right door is open";
CM_ SG_ 154 OBJ_Visible_Left_or_Right_31 "This signal describes the visible Left or Right side of the Target vehicle.";
CM_ SG_ 154 OBJ_Visible_Left_or_Right_V_31 "OBJ_Visible_Left_or_Right";
CM_ SG_ 154 OBJ_2W_Is_Motorbike_Probability_31 "The probability of the Two-wheeler reported object being a Motorbike";
CM_ SG_ 154 OBJ_2W_Is_Bicycle_Probability_31 "The probability of the Two-wheeler reported object being a Bicycle";
CM_ SG_ 154 OBJ_CRC_32 "Calculated over all element signals. From the signal after the CRC until the first signal in the next elements OBJ_CRC_N+1  not including";
CM_ SG_ 154 OBJ_ID_32 "The detected object ID. Range is 1-255, while 0 indicates that the field in unfilled.";
CM_ SG_ 154 OBJ_Existence_Probability_32 "The existence probability of the reported object";
CM_ SG_ 154 OBJ_Fusion_Source_32 "sources ids used for fusion";
CM_ SG_ 154 OBJ_Triggered_SDM_32 "Indicates whether the object has trigered the SDM (Safety Diagnostic Manager) alert.";
CM_ SG_ 154 OBJ_Motion_Category_32 "Relevant for VD only. Full description of values can be found at the ACC guide.";
CM_ SG_ 154 OBJ_Moving_IN_Probability_32 "The probability the object is eventually move into ego lane. (In case that the OBJ_Motion_Category signal is set to  MOVING_IN ";
CM_ SG_ 154 OBJ_Object_Age_32 "The number of frames in which the object was recognized.";
CM_ SG_ 154 OBJ_Measuring_Status_32 "Measurment status. Old vs New marks if this is the first frame in which the object is reported. Predicted vs Measured marks if the report is raw or has been predicted forward in time using the measured dynamics and ego motion.";
CM_ SG_ 154 OBJ_Object_Class_32 "Indicates the object type. Uncertain is outputted in case the probability that a vehicle is a truck is very similar to the probability that it is a car.";
CM_ SG_ 154 OBJ_Class_Probability_32 "The probability of this type classification.";
CM_ SG_ 154 OBJ_Car_Probability_32 "The probability the object is a car";
CM_ SG_ 154 OBJ_Truck_Probability_32 "The probability the object is a Truck";
CM_ SG_ 154 OBJ_Bike_Probability_32 "The probability the object is a Bike";
CM_ SG_ 154 OBJ_Camera_Source_32 "The camera in which this object was detected (best choice).";
CM_ SG_ 154 OBJ_Motion_Status_32 "MOVING - the object is moving STATIONARY - the object was never seen moving STOPPED -  the object was moving and has stopped MOVING_SLOWLY - the object is moving very slowly";
CM_ SG_ 154 OBJ_Motion_Orientation_32 "The direction of the targets heading compared to the host. ";
CM_ SG_ 154 OBJ_Has_Cut_Lane_32 "Indicates whether the object cut the host's (right or left) lane. In case there are no lanes, indicates whether the objects is at most 1 meters away from the host.";
CM_ SG_ 154 OBJ_Has_Cut_Path_32 "Indicates whether the object is in the host's path.";
CM_ SG_ 154 OBJ_Brake_Light_Validity_32 "Validator for braking light indicator";
CM_ SG_ 154 OBJ_Brake_Light_32 "Indication for brake lights ";
CM_ SG_ 154 OBJ_Turn_Indicator_Right_32 "Indication for blinking right light.";
CM_ SG_ 154 OBJ_Turn_Indicator_Left_32 "Indication for blinking left light ";
CM_ SG_ 154 OBJ_Turn_Indicator_Validity_32 "Validator for light indicators";
CM_ SG_ 154 OBJ_Right_Out_Of_Image_32 "Indicates whether the measurment are predicted out of the right side of the image bounderies.";
CM_ SG_ 154 OBJ_Left_Out_Of_Image_32 "Indicates whether if measurment are predicted out of  the left side of the image bounderies";
CM_ SG_ 154 OBJ_Right_Out_Of_Image_V_32 "validator";
CM_ SG_ 154 OBJ_Left_Out_Of_Image_V_32 "validator";
CM_ SG_ 154 OBJ_Top_Out_Of_Image_32 "Indicates whether if measurment are predicted out of  the top of the image bounderies";
CM_ SG_ 154 OBJ_Bottom_Out_Of_Image_32 "Indicates whether if measurment are predicted out of  the bottom of the image bounderies";
CM_ SG_ 154 OBJ_Top_Out_Of_Image_V_32 "validator";
CM_ SG_ 154 OBJ_Bottom_Out_Of_Image_V_32 "validator";
CM_ SG_ 154 OBJ_Lane_Assignment_32 "The object's lane relative to the host lane.";
CM_ SG_ 154 OBJ_Lane_Assignment_V_32 "Validator for lane assignment";
CM_ SG_ 154 OBJ_Age_Seconds_32 "Time in seconds in which the object was recognized. ";
CM_ SG_ 154 OBJ_Age_Seconds_V_32 "Validator for object age";
CM_ SG_ 154 OBJ_Width_32 "The width of the target vehicle in the world (not to be mistaken with the width of the visible part of the vehicle).";
CM_ SG_ 154 OBJ_Width_V_32 "Validator for object width";
CM_ SG_ 154 OBJ_Width_STD_32 "Standard deviation for object width";
CM_ SG_ 154 OBJ_Width_STD_V_32 "Validator for the standard deviation of object width";
CM_ SG_ 154 OBJ_Length_32 "The length of the vehicle in the world. For crossing bicycles it gives the viewed length of the bicycle.";
CM_ SG_ 154 OBJ_Length_V_32 "Validator for object length.";
CM_ SG_ 154 OBJ_Length_STD_32 "Standard deviation for object length.";
CM_ SG_ 154 OBJ_Length_STD_V_32 "Validator for the standard deviation of object length.";
CM_ SG_ 154 OBJ_Radar_ID_32 "Radar Object ID of the Fused Object, Only relvant when OBJ_Fusion_Source is not Camera only";
CM_ SG_ 154 OBJ_Height_32 "The height of the object in the world. ";
CM_ SG_ 154 OBJ_Height_V_32 "Validator for object height.";
CM_ SG_ 154 OBJ_Height_STD_32 "Standard deviation for object height.";
CM_ SG_ 154 OBJ_Height_STD_V_32 "Validator for the standard deviation of object height.";
CM_ SG_ 154 OBJ_Abs_Long_Velocity_32 "Absolute longitudinal velocity.";
CM_ SG_ 154 OBJ_Abs_Long_Velocity_V_32 "Validator for absolute longitudinal velocity.";
CM_ SG_ 154 OBJ_Abs_Long_Velocity_STD_32 "Standard deviation of absolute longitudinal velocity.";
CM_ SG_ 154 OBJ_Abs_Long_Vel_STD_V_32 "Validator for the standard deviation of the absolute longitudinal velocity.";
CM_ SG_ 154 OBJ_Abs_Lat_Velocity_32 "The lateral ground speed of the object.";
CM_ SG_ 154 OBJ_Abs_Lat_Velocity_V_32 "Validator for the lateral ground speed of the object.";
CM_ SG_ 154 OBJ_Abs_Lat_Velocity_STD_32 "STD of the lateral ground speed of the object.";
CM_ SG_ 154 OBJ_Abs_Lat_Vel_STD_V_32 "Validator for the STD of the lateral ground speed of the object.";
CM_ SG_ 154 OBJ_Abs_Long_Acc_32 "The longitudinal ground acceleration of the object.";
CM_ SG_ 154 OBJ_Abs_Long_Acc_V_32 "Validator for the longitudinal ground acceleration of the object.";
CM_ SG_ 154 OBJ_Abs_Long_Acc_STD_32 "STD of the longitudinal ground acceleration of the object.";
CM_ SG_ 154 OBJ_Abs_Long_Acc_STD_V_32 "Validator for the STD of the longitudinal ground acceleration of the object.";
CM_ SG_ 154 OBJ_Abs_Lat_Acc_32 "The lateral ground acceleration of the object.";
CM_ SG_ 154 OBJ_Abs_Lat_Acc_V_32 "Validator for the lateral ground acceleration of the object.";
CM_ SG_ 154 OBJ_Abs_Lat_Acc_STD_32 "STD of the lateral ground acceleration of the object.";
CM_ SG_ 154 OBJ_Abs_Lat_Acc_STD_V_32 "Validator for the STD of the lateral ground acceleration of the object.";
CM_ SG_ 154 OBJ_Abs_Acceleration_32 "The absolute ground acceleration in the target's heading direction.";
CM_ SG_ 154 OBJ_Abs_Acceleration_V_32 "Validator for the absolute ground acceleration.";
CM_ SG_ 154 OBJ_Abs_Acc_STD_32 "STD of the absolute ground acceleration.";
CM_ SG_ 154 OBJ_Abs_Acc_STD_V_32 "Validator for the STD of the absolute ground acceleration.";
CM_ SG_ 154 OBJ_Inv_TTC_32 "Inverse TTC (time to collision).";
CM_ SG_ 154 OBJ_Inv_TTC_STD_32 "STD for inverse TTC .";
CM_ SG_ 154 OBJ_Inv_TTC_STD_V_32 "Validator for the STD for inverse TTC .";
CM_ SG_ 154 OBJ_Relative_Long_Acc_32 "The relative longitudinal ground acceleration of the object.";
CM_ SG_ 154 OBJ_Relative_Long_Acc_V_32 "Validator for the relative longitudinal ground acceleration of the object.";
CM_ SG_ 154 OBJ_Relative_Long_Acc_STD_32 "STD of the relative longitudinal ground acceleration of the object.";
CM_ SG_ 154 OBJ_Rel_Long_Acc_STD_V_32 "Validator for the STD of the relative longitudinal ground acceleration.";
CM_ SG_ 154 OBJ_Relative_Long_Velocity_32 "The relative longtitudinal speed between the target and ego vehicle. ";
CM_ SG_ 154 OBJ_Relative_Long_Velocity_V_32 "Validator for the relative longtitudinal speed.";
CM_ SG_ 154 OBJ_Relative_Long_Vel_STD_32 "STD of the relative longtitudinal speed.";
CM_ SG_ 154 OBJ_Rel_Long_Vel_STD_V_32 "Validator for the STD of the relative longtitudinal speed.";
CM_ SG_ 154 OBJ_Relative_Lat_Velocity_32 "The relative lateral speed between the target and ego vehicle. ";
CM_ SG_ 154 OBJ_Relative_Lat_Velocity_V_32 "Validator for the relative lateral speed. ";
CM_ SG_ 154 OBJ_Relative_Lat_Velocity_STD_32 "STD of the relative lateral speed. ";
CM_ SG_ 154 OBJ_Rel_Lat_Vel_STD_V_32 "Validator for the STD of the relative lateral speed. ";
CM_ SG_ 154 OBJ_Long_Distance_32 "The longitudinal distance to middle of the rear bumper (middle of the RL and RR corners) of the target.";
CM_ SG_ 154 OBJ_Long_Distance_V_32 "Validator of the longtitudinal distance field";
CM_ SG_ 154 OBJ_Long_Distance_STD_32 "STD of the  longtitudinal distance.";
CM_ SG_ 154 OBJ_Long_Distance_STD_V_32 "Validator for the STD of the  longtitudinal distance.";
CM_ SG_ 154 OBJ_Lat_Distance_32 "Lateral distance to the middle of the RL and RR corners.  ";
CM_ SG_ 154 OBJ_Lat_Distance_V_32 "Validator for the lateral distance of the object.";
CM_ SG_ 154 OBJ_Lat_Distance_STD_32 "STD of the lateral distance of the object.";
CM_ SG_ 154 OBJ_Lat_Distance_STD_V_32 "Validator for the STD of the lateral distance of the object.";
CM_ SG_ 154 OBJ_Absolute_Speed_32 "The absolute ground speed in the targets' heading direction.";
CM_ SG_ 154 OBJ_Absolute_Speed_V_32 "Validator for the absolute ground speed.";
CM_ SG_ 154 OBJ_Absolute_Speed_STD_32 "STD of the absolute ground speed.";
CM_ SG_ 154 OBJ_Absolute_Speed_STD_V_32 "Validator for the STD of the absolute ground speed.";
CM_ SG_ 154 OBJ_Heading_32 "The angle beetweenthe host longitudinal axis and target's heading (clockwise, e.g. PI/2 is a target crossing from left to right).";
CM_ SG_ 154 OBJ_Heading_V_32 "Validator for the object heading.";
CM_ SG_ 154 OBJ_Heading_STD_32 "STD of the object heading.";
CM_ SG_ 154 OBJ_Heading_STD_V_32 "Validator for the STD of the object heading.";
CM_ SG_ 154 OBJ_Angle_Rate_STD_32 "Standard deviation of the angular speed. (radians)";
CM_ SG_ 154 OBJ_Angle_Rate_STD_V_32 "Validator for the STD of the angular speed.";
CM_ SG_ 154 OBJ_Angle_Rate_32 "The momentary angular speed of the object (radians). The positive side is to the host's right.";
CM_ SG_ 154 OBJ_Angle_Rate_V_32 "Validator for the angular speed.";
CM_ SG_ 154 OBJ_Angle_Right_32 "The angle between the host longitudinal axis and the right side of the front / rear of the target (the visible one). The positive side is to the host's right.";
CM_ SG_ 154 OBJ_Angle_Right_V_32 "Validator for angleRight";
CM_ SG_ 154 OBJ_Angle_Right_STD_32 "Standard deviation of angleRight";
CM_ SG_ 154 OBJ_Angle_Right_STD_V_32 "Validator for the standard deviation of angleRight.";
CM_ SG_ 154 OBJ_Angle_Left_32 "The angle between the host longitudinal axis and the left side of the front / rear of the target (the visible one). The positive side is to the host's right.";
CM_ SG_ 154 OBJ_Angle_Left_V_32 "Validator for angleLeft.";
CM_ SG_ 154 OBJ_Angle_Left_STD_32 "Standard deviation of angleLeft.";
CM_ SG_ 154 OBJ_Angle_Left_STD_V_32 "Validator for the standard deviation of angleLeft.";
CM_ SG_ 154 OBJ_Angle_Side_32 "The angle between the host longitudinal axis and the far visible edge - the visible edge of the front / rear of the target that is not visible. Currently supported for vehicles only.";
CM_ SG_ 154 OBJ_Angle_Side_V_32 "Validator for angleSide.";
CM_ SG_ 154 OBJ_Angle_Side_STD_32 "Standard deviation of angleSide.";
CM_ SG_ 154 OBJ_Angle_Side_STD_V_32 "Validator for the STD of angleSide.";
CM_ SG_ 154 OBJ_Angle_Mid_V_32 "Validator for angleMid.";
CM_ SG_ 154 OBJ_Angle_Mid_32 "The angle between the host longitudinal axis and the middle of the front / rear of the target (the visible one). The positive side is to the host's right.";
CM_ SG_ 154 OBJ_Angle_Mid_STD_32 "Standard deviation of angleMid.";
CM_ SG_ 154 OBJ_Angle_Mid_STD_V_32 "Validator for the STD of angleMid.";
CM_ SG_ 154 OBJ_Angle_Bottom_V_32 "Validator for OBJAngle_Bottom. ";
CM_ SG_ 154 OBJ_Angle_Bottom_32 "The angle between the longitudinal axis and the Bottom of the front / rear of the target (the visible one). The positive side is to the host's bottom";
CM_ SG_ 154 OBJ_Angle_Bottom_STD_32 "STD for OBJAngle_Bottom. ";
CM_ SG_ 154 OBJ_Angle_Bottom_STD_V_32 "Validator for OBJAngle_Bottom_STD. ";
CM_ SG_ 154 OBJ_Visibility_Side_V_32 "Currently Supported for VD only";
CM_ SG_ 154 OBJ_Visibility_Side_32 "From what car  side is the object visible";
CM_ SG_ 154 OBJ_Is_In_Drivable_Area_32 "Indicates whether the target is in a driveable area.";
CM_ SG_ 154 OBJ_Is_In_Drivable_Area_V_32 "Validator for OBJ_Is_In_Drivable_Area.";
CM_ SG_ 154 OBJ_Is_VeryClose_V_32 "Validator for OBJ_Is_VeryClose. ";
CM_ SG_ 154 OBJ_Is_VeryClose_32 "Indicates whether the target is very close to the host such that it is hard to measure its distance. Currently relevant for peds only";
CM_ SG_ 154 OBJ_OverlapAngleEgoLaneR_32 "Lateral distance to the middle of the RL and RR corners.";
CM_ SG_ 154 OBJ_OverlapAngleEgoLaneR_V_32 "Validator for OBJ_OverlapAngleEgoLaneR";
CM_ SG_ 154 OBJ_OverlapAngleEgoLaneL_32 "Lateral distance to the middle of the RL and RR corners.  ";
CM_ SG_ 154 OBJ_OverlapAngleEgoLaneL_V_32 "Validator for OBJ_OverlapAngleEgoLaneL";
CM_ SG_ 154 OBJ_Is_EMERGENCY_VCL_32 "Is Object an Emergency Vehicle";
CM_ SG_ 154 OBJ_EMERGENCY_LIGHT_COLOR_32 "Emergency Color";
CM_ SG_ 154 OBJ_EMERGENCY_V_32 "Are OBJ_Is_EMERGENCY_VCL and OBJ_EMERGENCY_LIGHT_COLOR Valid";
CM_ SG_ 154 OBJ_Angle_Top_32 "From VD touching point on the ground till the roof of the car";
CM_ SG_ 154 OBJ_Angle_Top_V_32 "Validator for OBJ_Angle_Top ";
CM_ SG_ 154 OBJ_Angle_Top_STD_32 "STD for OBJ_Angle_Top";
CM_ SG_ 154 OBJ_Angle_Top_STD_V_32 "Validator for OBJ_Angle_Top_STD. ";
CM_ SG_ 154 OBJ_Open_Door_Left_32 "Indicator if left door is open";
CM_ SG_ 154 OBJ_Open_Door_Right_32 "Indicator if right door is open";
CM_ SG_ 154 OBJ_Visible_Left_or_Right_32 "This signal describes the visible Left or Right side of the Target vehicle.";
CM_ SG_ 154 OBJ_Visible_Left_or_Right_V_32 "OBJ_Visible_Left_or_Right";
CM_ SG_ 154 OBJ_2W_Is_Motorbike_Probability_32 "The probability of the Two-wheeler reported object being a Motorbike";
CM_ SG_ 154 OBJ_2W_Is_Bicycle_Probability_32 "The probability of the Two-wheeler reported object being a Bicycle";
CM_ SG_ 154 OBJ_CRC_33 "Calculated over all element signals. From the signal after the CRC until the first signal in the next elements OBJ_CRC_N+1  not including";
CM_ SG_ 154 OBJ_ID_33 "The detected object ID. Range is 1-255, while 0 indicates that the field in unfilled.";
CM_ SG_ 154 OBJ_Existence_Probability_33 "The existence probability of the reported object";
CM_ SG_ 154 OBJ_Fusion_Source_33 "sources ids used for fusion";
CM_ SG_ 154 OBJ_Triggered_SDM_33 "Indicates whether the object has trigered the SDM (Safety Diagnostic Manager) alert.";
CM_ SG_ 154 OBJ_Motion_Category_33 "Relevant for VD only. Full description of values can be found at the ACC guide.";
CM_ SG_ 154 OBJ_Moving_IN_Probability_33 "The probability the object is eventually move into ego lane. (In case that the OBJ_Motion_Category signal is set to  MOVING_IN ";
CM_ SG_ 154 OBJ_Object_Age_33 "The number of frames in which the object was recognized.";
CM_ SG_ 154 OBJ_Measuring_Status_33 "Measurment status. Old vs New marks if this is the first frame in which the object is reported. Predicted vs Measured marks if the report is raw or has been predicted forward in time using the measured dynamics and ego motion.";
CM_ SG_ 154 OBJ_Object_Class_33 "Indicates the object type. Uncertain is outputted in case the probability that a vehicle is a truck is very similar to the probability that it is a car.";
CM_ SG_ 154 OBJ_Class_Probability_33 "The probability of this type classification.";
CM_ SG_ 154 OBJ_Car_Probability_33 "The probability the object is a car";
CM_ SG_ 154 OBJ_Truck_Probability_33 "The probability the object is a Truck";
CM_ SG_ 154 OBJ_Bike_Probability_33 "The probability the object is a Bike";
CM_ SG_ 154 OBJ_Camera_Source_33 "The camera in which this object was detected (best choice).";
CM_ SG_ 154 OBJ_Motion_Status_33 "MOVING - the object is moving STATIONARY - the object was never seen moving STOPPED -  the object was moving and has stopped MOVING_SLOWLY - the object is moving very slowly";
CM_ SG_ 154 OBJ_Motion_Orientation_33 "The direction of the targets heading compared to the host. ";
CM_ SG_ 154 OBJ_Has_Cut_Lane_33 "Indicates whether the object cut the host's (right or left) lane. In case there are no lanes, indicates whether the objects is at most 1 meters away from the host.";
CM_ SG_ 154 OBJ_Has_Cut_Path_33 "Indicates whether the object is in the host's path.";
CM_ SG_ 154 OBJ_Brake_Light_Validity_33 "Validator for braking light indicator";
CM_ SG_ 154 OBJ_Brake_Light_33 "Indication for brake lights ";
CM_ SG_ 154 OBJ_Turn_Indicator_Right_33 "Indication for blinking right light.";
CM_ SG_ 154 OBJ_Turn_Indicator_Left_33 "Indication for blinking left light ";
CM_ SG_ 154 OBJ_Turn_Indicator_Validity_33 "Validator for light indicators";
CM_ SG_ 154 OBJ_Right_Out_Of_Image_33 "Indicates whether the measurment are predicted out of the right side of the image bounderies.";
CM_ SG_ 154 OBJ_Left_Out_Of_Image_33 "Indicates whether if measurment are predicted out of  the left side of the image bounderies";
CM_ SG_ 154 OBJ_Right_Out_Of_Image_V_33 "validator";
CM_ SG_ 154 OBJ_Left_Out_Of_Image_V_33 "validator";
CM_ SG_ 154 OBJ_Top_Out_Of_Image_33 "Indicates whether if measurment are predicted out of  the top of the image bounderies";
CM_ SG_ 154 OBJ_Bottom_Out_Of_Image_33 "Indicates whether if measurment are predicted out of  the bottom of the image bounderies";
CM_ SG_ 154 OBJ_Top_Out_Of_Image_V_33 "validator";
CM_ SG_ 154 OBJ_Bottom_Out_Of_Image_V_33 "validator";
CM_ SG_ 154 OBJ_Lane_Assignment_33 "The object's lane relative to the host lane.";
CM_ SG_ 154 OBJ_Lane_Assignment_V_33 "Validator for lane assignment";
CM_ SG_ 154 OBJ_Age_Seconds_33 "Time in seconds in which the object was recognized. ";
CM_ SG_ 154 OBJ_Age_Seconds_V_33 "Validator for object age";
CM_ SG_ 154 OBJ_Width_33 "The width of the target vehicle in the world (not to be mistaken with the width of the visible part of the vehicle).";
CM_ SG_ 154 OBJ_Width_V_33 "Validator for object width";
CM_ SG_ 154 OBJ_Width_STD_33 "Standard deviation for object width";
CM_ SG_ 154 OBJ_Width_STD_V_33 "Validator for the standard deviation of object width";
CM_ SG_ 154 OBJ_Length_33 "The length of the vehicle in the world. For crossing bicycles it gives the viewed length of the bicycle.";
CM_ SG_ 154 OBJ_Length_V_33 "Validator for object length.";
CM_ SG_ 154 OBJ_Length_STD_33 "Standard deviation for object length.";
CM_ SG_ 154 OBJ_Length_STD_V_33 "Validator for the standard deviation of object length.";
CM_ SG_ 154 OBJ_Radar_ID_33 "Radar Object ID of the Fused Object, Only relvant when OBJ_Fusion_Source is not Camera only";
CM_ SG_ 154 OBJ_Height_33 "The height of the object in the world. ";
CM_ SG_ 154 OBJ_Height_V_33 "Validator for object height.";
CM_ SG_ 154 OBJ_Height_STD_33 "Standard deviation for object height.";
CM_ SG_ 154 OBJ_Height_STD_V_33 "Validator for the standard deviation of object height.";
CM_ SG_ 154 OBJ_Abs_Long_Velocity_33 "Absolute longitudinal velocity.";
CM_ SG_ 154 OBJ_Abs_Long_Velocity_V_33 "Validator for absolute longitudinal velocity.";
CM_ SG_ 154 OBJ_Abs_Long_Velocity_STD_33 "Standard deviation of absolute longitudinal velocity.";
CM_ SG_ 154 OBJ_Abs_Long_Vel_STD_V_33 "Validator for the standard deviation of the absolute longitudinal velocity.";
CM_ SG_ 154 OBJ_Abs_Lat_Velocity_33 "The lateral ground speed of the object.";
CM_ SG_ 154 OBJ_Abs_Lat_Velocity_V_33 "Validator for the lateral ground speed of the object.";
CM_ SG_ 154 OBJ_Abs_Lat_Velocity_STD_33 "STD of the lateral ground speed of the object.";
CM_ SG_ 154 OBJ_Abs_Lat_Vel_STD_V_33 "Validator for the STD of the lateral ground speed of the object.";
CM_ SG_ 154 OBJ_Abs_Long_Acc_33 "The longitudinal ground acceleration of the object.";
CM_ SG_ 154 OBJ_Abs_Long_Acc_V_33 "Validator for the longitudinal ground acceleration of the object.";
CM_ SG_ 154 OBJ_Abs_Long_Acc_STD_33 "STD of the longitudinal ground acceleration of the object.";
CM_ SG_ 154 OBJ_Abs_Long_Acc_STD_V_33 "Validator for the STD of the longitudinal ground acceleration of the object.";
CM_ SG_ 154 OBJ_Abs_Lat_Acc_33 "The lateral ground acceleration of the object.";
CM_ SG_ 154 OBJ_Abs_Lat_Acc_V_33 "Validator for the lateral ground acceleration of the object.";
CM_ SG_ 154 OBJ_Abs_Lat_Acc_STD_33 "STD of the lateral ground acceleration of the object.";
CM_ SG_ 154 OBJ_Abs_Lat_Acc_STD_V_33 "Validator for the STD of the lateral ground acceleration of the object.";
CM_ SG_ 154 OBJ_Abs_Acceleration_33 "The absolute ground acceleration in the target's heading direction.";
CM_ SG_ 154 OBJ_Abs_Acceleration_V_33 "Validator for the absolute ground acceleration.";
CM_ SG_ 154 OBJ_Abs_Acc_STD_33 "STD of the absolute ground acceleration.";
CM_ SG_ 154 OBJ_Abs_Acc_STD_V_33 "Validator for the STD of the absolute ground acceleration.";
CM_ SG_ 154 OBJ_Inv_TTC_33 "Inverse TTC (time to collision).";
CM_ SG_ 154 OBJ_Inv_TTC_STD_33 "STD for inverse TTC .";
CM_ SG_ 154 OBJ_Inv_TTC_STD_V_33 "Validator for the STD for inverse TTC .";
CM_ SG_ 154 OBJ_Relative_Long_Acc_33 "The relative longitudinal ground acceleration of the object.";
CM_ SG_ 154 OBJ_Relative_Long_Acc_V_33 "Validator for the relative longitudinal ground acceleration of the object.";
CM_ SG_ 154 OBJ_Relative_Long_Acc_STD_33 "STD of the relative longitudinal ground acceleration of the object.";
CM_ SG_ 154 OBJ_Rel_Long_Acc_STD_V_33 "Validator for the STD of the relative longitudinal ground acceleration.";
CM_ SG_ 154 OBJ_Relative_Long_Velocity_33 "The relative longtitudinal speed between the target and ego vehicle. ";
CM_ SG_ 154 OBJ_Relative_Long_Velocity_V_33 "Validator for the relative longtitudinal speed.";
CM_ SG_ 154 OBJ_Relative_Long_Vel_STD_33 "STD of the relative longtitudinal speed.";
CM_ SG_ 154 OBJ_Rel_Long_Vel_STD_V_33 "Validator for the STD of the relative longtitudinal speed.";
CM_ SG_ 154 OBJ_Relative_Lat_Velocity_33 "The relative lateral speed between the target and ego vehicle. ";
CM_ SG_ 154 OBJ_Relative_Lat_Velocity_V_33 "Validator for the relative lateral speed. ";
CM_ SG_ 154 OBJ_Relative_Lat_Velocity_STD_33 "STD of the relative lateral speed. ";
CM_ SG_ 154 OBJ_Rel_Lat_Vel_STD_V_33 "Validator for the STD of the relative lateral speed. ";
CM_ SG_ 154 OBJ_Long_Distance_33 "The longitudinal distance to middle of the rear bumper (middle of the RL and RR corners) of the target.";
CM_ SG_ 154 OBJ_Long_Distance_V_33 "Validator of the longtitudinal distance field";
CM_ SG_ 154 OBJ_Long_Distance_STD_33 "STD of the  longtitudinal distance.";
CM_ SG_ 154 OBJ_Long_Distance_STD_V_33 "Validator for the STD of the  longtitudinal distance.";
CM_ SG_ 154 OBJ_Lat_Distance_33 "Lateral distance to the middle of the RL and RR corners.  ";
CM_ SG_ 154 OBJ_Lat_Distance_V_33 "Validator for the lateral distance of the object.";
CM_ SG_ 154 OBJ_Lat_Distance_STD_33 "STD of the lateral distance of the object.";
CM_ SG_ 154 OBJ_Lat_Distance_STD_V_33 "Validator for the STD of the lateral distance of the object.";
CM_ SG_ 154 OBJ_Absolute_Speed_33 "The absolute ground speed in the targets' heading direction.";
CM_ SG_ 154 OBJ_Absolute_Speed_V_33 "Validator for the absolute ground speed.";
CM_ SG_ 154 OBJ_Absolute_Speed_STD_33 "STD of the absolute ground speed.";
CM_ SG_ 154 OBJ_Absolute_Speed_STD_V_33 "Validator for the STD of the absolute ground speed.";
CM_ SG_ 154 OBJ_Heading_33 "The angle beetweenthe host longitudinal axis and target's heading (clockwise, e.g. PI/2 is a target crossing from left to right).";
CM_ SG_ 154 OBJ_Heading_V_33 "Validator for the object heading.";
CM_ SG_ 154 OBJ_Heading_STD_33 "STD of the object heading.";
CM_ SG_ 154 OBJ_Heading_STD_V_33 "Validator for the STD of the object heading.";
CM_ SG_ 154 OBJ_Angle_Rate_STD_33 "Standard deviation of the angular speed. (radians)";
CM_ SG_ 154 OBJ_Angle_Rate_STD_V_33 "Validator for the STD of the angular speed.";
CM_ SG_ 154 OBJ_Angle_Rate_33 "The momentary angular speed of the object (radians). The positive side is to the host's right.";
CM_ SG_ 154 OBJ_Angle_Rate_V_33 "Validator for the angular speed.";
CM_ SG_ 154 OBJ_Angle_Right_33 "The angle between the host longitudinal axis and the right side of the front / rear of the target (the visible one). The positive side is to the host's right.";
CM_ SG_ 154 OBJ_Angle_Right_V_33 "Validator for angleRight";
CM_ SG_ 154 OBJ_Angle_Right_STD_33 "Standard deviation of angleRight";
CM_ SG_ 154 OBJ_Angle_Right_STD_V_33 "Validator for the standard deviation of angleRight.";
CM_ SG_ 154 OBJ_Angle_Left_33 "The angle between the host longitudinal axis and the left side of the front / rear of the target (the visible one). The positive side is to the host's right.";
CM_ SG_ 154 OBJ_Angle_Left_V_33 "Validator for angleLeft.";
CM_ SG_ 154 OBJ_Angle_Left_STD_33 "Standard deviation of angleLeft.";
CM_ SG_ 154 OBJ_Angle_Left_STD_V_33 "Validator for the standard deviation of angleLeft.";
CM_ SG_ 154 OBJ_Angle_Side_33 "The angle between the host longitudinal axis and the far visible edge - the visible edge of the front / rear of the target that is not visible. Currently supported for vehicles only.";
CM_ SG_ 154 OBJ_Angle_Side_V_33 "Validator for angleSide.";
CM_ SG_ 154 OBJ_Angle_Side_STD_33 "Standard deviation of angleSide.";
CM_ SG_ 154 OBJ_Angle_Side_STD_V_33 "Validator for the STD of angleSide.";
CM_ SG_ 154 OBJ_Angle_Mid_V_33 "Validator for angleMid.";
CM_ SG_ 154 OBJ_Angle_Mid_33 "The angle between the host longitudinal axis and the middle of the front / rear of the target (the visible one). The positive side is to the host's right.";
CM_ SG_ 154 OBJ_Angle_Mid_STD_33 "Standard deviation of angleMid.";
CM_ SG_ 154 OBJ_Angle_Mid_STD_V_33 "Validator for the STD of angleMid.";
CM_ SG_ 154 OBJ_Angle_Bottom_V_33 "Validator for OBJAngle_Bottom. ";
CM_ SG_ 154 OBJ_Angle_Bottom_33 "The angle between the longitudinal axis and the Bottom of the front / rear of the target (the visible one). The positive side is to the host's bottom";
CM_ SG_ 154 OBJ_Angle_Bottom_STD_33 "STD for OBJAngle_Bottom. ";
CM_ SG_ 154 OBJ_Angle_Bottom_STD_V_33 "Validator for OBJAngle_Bottom_STD. ";
CM_ SG_ 154 OBJ_Visibility_Side_V_33 "Currently Supported for VD only";
CM_ SG_ 154 OBJ_Visibility_Side_33 "From what car  side is the object visible";
CM_ SG_ 154 OBJ_Is_In_Drivable_Area_33 "Indicates whether the target is in a driveable area.";
CM_ SG_ 154 OBJ_Is_In_Drivable_Area_V_33 "Validator for OBJ_Is_In_Drivable_Area.";
CM_ SG_ 154 OBJ_Is_VeryClose_V_33 "Validator for OBJ_Is_VeryClose. ";
CM_ SG_ 154 OBJ_Is_VeryClose_33 "Indicates whether the target is very close to the host such that it is hard to measure its distance. Currently relevant for peds only";
CM_ SG_ 154 OBJ_OverlapAngleEgoLaneR_33 "Lateral distance to the middle of the RL and RR corners.";
CM_ SG_ 154 OBJ_OverlapAngleEgoLaneR_V_33 "Validator for OBJ_OverlapAngleEgoLaneR";
CM_ SG_ 154 OBJ_OverlapAngleEgoLaneL_33 "Lateral distance to the middle of the RL and RR corners.  ";
CM_ SG_ 154 OBJ_OverlapAngleEgoLaneL_V_33 "Validator for OBJ_OverlapAngleEgoLaneL";
CM_ SG_ 154 OBJ_Is_EMERGENCY_VCL_33 "Is Object an Emergency Vehicle";
CM_ SG_ 154 OBJ_EMERGENCY_LIGHT_COLOR_33 "Emergency Color";
CM_ SG_ 154 OBJ_EMERGENCY_V_33 "Are OBJ_Is_EMERGENCY_VCL and OBJ_EMERGENCY_LIGHT_COLOR Valid";
CM_ SG_ 154 OBJ_Angle_Top_33 "From VD touching point on the ground till the roof of the car";
CM_ SG_ 154 OBJ_Angle_Top_V_33 "Validator for OBJ_Angle_Top ";
CM_ SG_ 154 OBJ_Angle_Top_STD_33 "STD for OBJ_Angle_Top";
CM_ SG_ 154 OBJ_Angle_Top_STD_V_33 "Validator for OBJ_Angle_Top_STD. ";
CM_ SG_ 154 OBJ_Open_Door_Left_33 "Indicator if left door is open";
CM_ SG_ 154 OBJ_Open_Door_Right_33 "Indicator if right door is open";
CM_ SG_ 154 OBJ_Visible_Left_or_Right_33 "This signal describes the visible Left or Right side of the Target vehicle.";
CM_ SG_ 154 OBJ_Visible_Left_or_Right_V_33 "OBJ_Visible_Left_or_Right";
CM_ SG_ 154 OBJ_2W_Is_Motorbike_Probability_33 "The probability of the Two-wheeler reported object being a Motorbike";
CM_ SG_ 154 OBJ_2W_Is_Bicycle_Probability_33 "The probability of the Two-wheeler reported object being a Bicycle";
CM_ SG_ 154 OBJ_CRC_34 "Calculated over all element signals. From the signal after the CRC until the first signal in the next elements OBJ_CRC_N+1  not including";
CM_ SG_ 154 OBJ_ID_34 "The detected object ID. Range is 1-255, while 0 indicates that the field in unfilled.";
CM_ SG_ 154 OBJ_Existence_Probability_34 "The existence probability of the reported object";
CM_ SG_ 154 OBJ_Fusion_Source_34 "sources ids used for fusion";
CM_ SG_ 154 OBJ_Triggered_SDM_34 "Indicates whether the object has trigered the SDM (Safety Diagnostic Manager) alert.";
CM_ SG_ 154 OBJ_Motion_Category_34 "Relevant for VD only. Full description of values can be found at the ACC guide.";
CM_ SG_ 154 OBJ_Moving_IN_Probability_34 "The probability the object is eventually move into ego lane. (In case that the OBJ_Motion_Category signal is set to  MOVING_IN ";
CM_ SG_ 154 OBJ_Object_Age_34 "The number of frames in which the object was recognized.";
CM_ SG_ 154 OBJ_Measuring_Status_34 "Measurment status. Old vs New marks if this is the first frame in which the object is reported. Predicted vs Measured marks if the report is raw or has been predicted forward in time using the measured dynamics and ego motion.";
CM_ SG_ 154 OBJ_Object_Class_34 "Indicates the object type. Uncertain is outputted in case the probability that a vehicle is a truck is very similar to the probability that it is a car.";
CM_ SG_ 154 OBJ_Class_Probability_34 "The probability of this type classification.";
CM_ SG_ 154 OBJ_Car_Probability_34 "The probability the object is a car";
CM_ SG_ 154 OBJ_Truck_Probability_34 "The probability the object is a Truck";
CM_ SG_ 154 OBJ_Bike_Probability_34 "The probability the object is a Bike";
CM_ SG_ 154 OBJ_Camera_Source_34 "The camera in which this object was detected (best choice).";
CM_ SG_ 154 OBJ_Motion_Status_34 "MOVING - the object is moving STATIONARY - the object was never seen moving STOPPED -  the object was moving and has stopped MOVING_SLOWLY - the object is moving very slowly";
CM_ SG_ 154 OBJ_Motion_Orientation_34 "The direction of the targets heading compared to the host. ";
CM_ SG_ 154 OBJ_Has_Cut_Lane_34 "Indicates whether the object cut the host's (right or left) lane. In case there are no lanes, indicates whether the objects is at most 1 meters away from the host.";
CM_ SG_ 154 OBJ_Has_Cut_Path_34 "Indicates whether the object is in the host's path.";
CM_ SG_ 154 OBJ_Brake_Light_Validity_34 "Validator for braking light indicator";
CM_ SG_ 154 OBJ_Brake_Light_34 "Indication for brake lights ";
CM_ SG_ 154 OBJ_Turn_Indicator_Right_34 "Indication for blinking right light.";
CM_ SG_ 154 OBJ_Turn_Indicator_Left_34 "Indication for blinking left light ";
CM_ SG_ 154 OBJ_Turn_Indicator_Validity_34 "Validator for light indicators";
CM_ SG_ 154 OBJ_Right_Out_Of_Image_34 "Indicates whether the measurment are predicted out of the right side of the image bounderies.";
CM_ SG_ 154 OBJ_Left_Out_Of_Image_34 "Indicates whether if measurment are predicted out of  the left side of the image bounderies";
CM_ SG_ 154 OBJ_Right_Out_Of_Image_V_34 "validator";
CM_ SG_ 154 OBJ_Left_Out_Of_Image_V_34 "validator";
CM_ SG_ 154 OBJ_Top_Out_Of_Image_34 "Indicates whether if measurment are predicted out of  the top of the image bounderies";
CM_ SG_ 154 OBJ_Bottom_Out_Of_Image_34 "Indicates whether if measurment are predicted out of  the bottom of the image bounderies";
CM_ SG_ 154 OBJ_Top_Out_Of_Image_V_34 "validator";
CM_ SG_ 154 OBJ_Bottom_Out_Of_Image_V_34 "validator";
CM_ SG_ 154 OBJ_Lane_Assignment_34 "The object's lane relative to the host lane.";
CM_ SG_ 154 OBJ_Lane_Assignment_V_34 "Validator for lane assignment";
CM_ SG_ 154 OBJ_Age_Seconds_34 "Time in seconds in which the object was recognized. ";
CM_ SG_ 154 OBJ_Age_Seconds_V_34 "Validator for object age";
CM_ SG_ 154 OBJ_Width_34 "The width of the target vehicle in the world (not to be mistaken with the width of the visible part of the vehicle).";
CM_ SG_ 154 OBJ_Width_V_34 "Validator for object width";
CM_ SG_ 154 OBJ_Width_STD_34 "Standard deviation for object width";
CM_ SG_ 154 OBJ_Width_STD_V_34 "Validator for the standard deviation of object width";
CM_ SG_ 154 OBJ_Length_34 "The length of the vehicle in the world. For crossing bicycles it gives the viewed length of the bicycle.";
CM_ SG_ 154 OBJ_Length_V_34 "Validator for object length.";
CM_ SG_ 154 OBJ_Length_STD_34 "Standard deviation for object length.";
CM_ SG_ 154 OBJ_Length_STD_V_34 "Validator for the standard deviation of object length.";
CM_ SG_ 154 OBJ_Radar_ID_34 "Radar Object ID of the Fused Object, Only relvant when OBJ_Fusion_Source is not Camera only";
CM_ SG_ 154 OBJ_Height_34 "The height of the object in the world. ";
CM_ SG_ 154 OBJ_Height_V_34 "Validator for object height.";
CM_ SG_ 154 OBJ_Height_STD_34 "Standard deviation for object height.";
CM_ SG_ 154 OBJ_Height_STD_V_34 "Validator for the standard deviation of object height.";
CM_ SG_ 154 OBJ_Abs_Long_Velocity_34 "Absolute longitudinal velocity.";
CM_ SG_ 154 OBJ_Abs_Long_Velocity_V_34 "Validator for absolute longitudinal velocity.";
BA_DEF_ SG_  "GenSigStartValue" INT 0 0;
BA_DEF_DEF_  "GenSigStartValue" 0;
BA_ "GenSigStartValue" SG_ 154 OBJ_Width_29 40;
BA_ "GenSigStartValue" SG_ 154 OBJ_Length_29 12;
BA_ "GenSigStartValue" SG_ 154 OBJ_Width_30 40;
BA_ "GenSigStartValue" SG_ 154 OBJ_Length_30 12;
BA_ "GenSigStartValue" SG_ 154 OBJ_Width_31 40;
BA_ "GenSigStartValue" SG_ 154 OBJ_Length_31 12;
BA_ "GenSigStartValue" SG_ 154 OBJ_Width_32 40;
BA_ "GenSigStartValue" SG_ 154 OBJ_Length_32 12;
BA_ "GenSigStartValue" SG_ 154 OBJ_Width_33 40;
BA_ "GenSigStartValue" SG_ 154 OBJ_Length_33 12;
BA_ "GenSigStartValue" SG_ 154 OBJ_Width_34 40;
BA_ "GenSigStartValue" SG_ 154 OBJ_Length_34 12;
VAL_ 154 OBJ_Absolute_Speed_STD_V_28 1 "VALID" 0 "INVALID" ;
VAL_ 154 OBJ_Heading_V_28 1 "VALID" 0 "INVALID" ;
VAL_ 154 OBJ_Heading_STD_V_28 1 "VALID" 0 "INVALID" ;
VAL_ 154 OBJ_Angle_Rate_STD_V_28 1 "VALID" 0 "INVALID" ;
VAL_ 154 OBJ_Angle_Rate_V_28 1 "VALID" 0 "INVALID" ;
VAL_ 154 OBJ_Angle_Right_V_28 1 "VALID" 0 "INVALID" ;
VAL_ 154 OBJ_Angle_Right_STD_V_28 1 "VALID" 0 "INVALID" ;
VAL_ 154 OBJ_Angle_Left_V_28 1 "VALID" 0 "INVALID" ;
VAL_ 154 OBJ_Angle_Left_STD_V_28 1 "VALID" 0 "INVALID" ;
VAL_ 154 OBJ_Angle_Side_V_28 1 "VALID" 0 "INVALID" ;
VAL_ 154 OBJ_Angle_Side_STD_V_28 1 "VALID" 0 "INVALID" ;
VAL_ 154 OBJ_Angle_Mid_V_28 1 "VALID" 0 "INVALID" ;
VAL_ 154 OBJ_Angle_Mid_STD_V_28 1 "VALID" 0 "INVALID" ;
VAL_ 154 OBJ_Angle_Bottom_V_28 1 "VALID" 0 "INVALID" ;
VAL_ 154 OBJ_Angle_Bottom_STD_V_28 1 "VALID" 0 "INVALID" ;
VAL_ 154 OBJ_Visibility_Side_V_28 1 "VALID" 0 "INVALID" ;
VAL_ 154 OBJ_Visibility_Side_28 2 "REAR" 1 "FRONT" 0 "NOT_VISIBLE" ;
VAL_ 154 OBJ_Is_In_Drivable_Area_28 1 "TRUE" 0 "FALSE" ;
VAL_ 154 OBJ_Is_In_Drivable_Area_V_28 1 "VALID" 0 "INVALID" ;
VAL_ 154 OBJ_Is_VeryClose_V_28 1 "VALID" 0 "INVALID" ;
VAL_ 154 OBJ_Is_VeryClose_28 1 "TRUE" 0 "FALSE" ;
VAL_ 154 OBJ_OverlapAngleEgoLaneR_V_28 1 "VALID" 0 "INVALID" ;
VAL_ 154 OBJ_OverlapAngleEgoLaneL_V_28 1 "VALID" 0 "INVALID" ;
VAL_ 154 OBJ_Is_EMERGENCY_VCL_28 1 "TRUE" 0 "FALSE" ;
VAL_ 154 OBJ_EMERGENCY_LIGHT_COLOR_28 3 "(1000)ORANGE" 2 "(0100)BLUE" 1 "(0010)RED" 0 "(0001)OTHER" ;
VAL_ 154 OBJ_EMERGENCY_V_28 1 "TRUE" 0 "FALSE" ;
VAL_ 154 OBJ_Angle_Top_V_28 1 "VALID" 0 "INVALID" ;
VAL_ 154 OBJ_Angle_Top_STD_V_28 1 "VALID" 0 "INVALID" ;
VAL_ 154 OBJ_Open_Door_Left_28 1 "TRUE" 0 "FALSE" ;
VAL_ 154 OBJ_Open_Door_Right_28 1 "TRUE" 0 "FALSE" ;
VAL_ 154 OBJ_Visible_Left_or_Right_28 2 "RIGHT" 1 "LEFT" 0 "NOT_VISIBLE" ;
VAL_ 154 OBJ_Visible_Left_or_Right_V_28 1 "VALID" 0 "INVALID" ;
VAL_ 154 OBJ_Fusion_Source_29 2 "(BIT_2)RADAR2" 1 "(BIT_1)RADAR1" 0 "(BIT_0)CAMERA" ;
VAL_ 154 OBJ_Triggered_SDM_29 2 "NOT_TRIGGERED" 1 "TRIGGERED" 0 "NOT_AVAILABLE" ;
VAL_ 154 OBJ_Motion_Category_29 13 "ONCOMING" 12 "PRECEEDING" 11 "MOVING" 10 "RTAP" 9 "LTAP" 8 "CROSSING" 7 "MOVING_OUT" 6 "MOVING_IN" 5 "CLOSE_CUT_IN" 4 "PASSING_OUT" 3 "PASSING_IN" 2 "PASSING" 1 "UNDEFINED" 0 "UNFILLED" ;
VAL_ 154 OBJ_Measuring_Status_29 2 "(BIT_2)NOT_VALID_OR_VALID" 1 "(BIT_1)PREDICTED_OR_MEASURED" 0 "(BIT_0)OLD_OR_NEW" ;
VAL_ 154 OBJ_Object_Class_29 9 "TWO_WHEELER" 8 "UNCERTAIN_VCL" 7 "ANIMAL" 6 "GENERAL_OBJECT" 5 "PEDESTRIAN" 4 "BICYCLE" 3 "MOTORBIKE" 2 "TRUCK" 1 "CAR" 0 "UNFILLED" ;
VAL_ 154 OBJ_Camera_Source_29 11 "PARKING_RIGHT" 10 "PARKING_LEFT" 9 "PARKING_REAR" 8 "PARKING_FRONT" 7 "FRONT_CORNER_RIGHT" 6 "FRONT_CORNER_LEFT" 5 "REAR_CORNER_RIGHT" 4 "REAR_CORNER_LEFT" 3 "REAR" 2 "FRONT_FISHEYE" 1 "FRONT_NARROW" 0 "FRONT_MAIN" ;
VAL_ 154 OBJ_Motion_Status_29 5 "MOVING_SLOWLY" 4 "STOPPED" 3 "STATIONARY" 2 "MOVING" 1 "UNKNOWN" 0 "INVALID" ;
VAL_ 154 OBJ_Motion_Orientation_29 13 "INVALID" 12 "NORTH" 11 "NORTH_WEST" 9 "WEST" 7 "SOUTH_WEST" 6 "SOUTH" 5 "SOUTH_EAST" 3 "EAST" 1 "NORTH_EAST" 0 "UNKNOWN" ;
VAL_ 154 OBJ_Has_Cut_Lane_29 1 "TRUE" 0 "FALSE" ;
VAL_ 154 OBJ_Has_Cut_Path_29 1 "TRUE" 0 "FALSE" ;
VAL_ 154 OBJ_Brake_Light_Validity_29 1 "TRUE" 0 "FALSE" ;
VAL_ 154 OBJ_Brake_Light_29 1 "TRUE" 0 "FALSE" ;
VAL_ 154 OBJ_Turn_Indicator_Right_29 1 "TRUE" 0 "FALSE" ;
VAL_ 154 OBJ_Turn_Indicator_Left_29 1 "TRUE" 0 "FALSE" ;
VAL_ 154 OBJ_Turn_Indicator_Validity_29 1 "TRUE" 0 "FALSE" ;
VAL_ 154 OBJ_Right_Out_Of_Image_29 1 "TRUE" 0 "FALSE" ;
VAL_ 154 OBJ_Left_Out_Of_Image_29 1 "TRUE" 0 "FALSE" ;
VAL_ 154 OBJ_Right_Out_Of_Image_V_29 1 "TRUE" 0 "FALSE" ;
VAL_ 154 OBJ_Left_Out_Of_Image_V_29 1 "TRUE" 0 "FALSE" ;
VAL_ 154 OBJ_Top_Out_Of_Image_29 1 "TRUE" 0 "FALSE" ;
VAL_ 154 OBJ_Bottom_Out_Of_Image_29 1 "TRUE" 0 "FALSE" ;
VAL_ 154 OBJ_Top_Out_Of_Image_V_29 1 "VALID" 0 "INVALID" ;
VAL_ 154 OBJ_Bottom_Out_Of_Image_V_29 1 "VALID" 0 "INVALID" ;
VAL_ 154 OBJ_Lane_Assignment_29 5 "RIGHT_RIGHT" 4 "RIGHT" 3 "HOST" 2 "LEFT" 1 "LEFT_LEFT" 0 "UNKNOWN" ;
VAL_ 154 OBJ_Lane_Assignment_V_29 1 "VALID" 0 "INVALID" ;
VAL_ 154 OBJ_Age_Seconds_V_29 1 "VALID" 0 "INVALID" ;
VAL_ 154 OBJ_Width_V_29 1 "VALID" 0 "INVALID" ;
VAL_ 154 OBJ_Width_STD_V_29 1 "VALID" 0 "INVALID" ;
VAL_ 154 OBJ_Length_V_29 1 "VALID" 0 "INVALID" ;
VAL_ 154 OBJ_Length_STD_V_29 1 "VALID" 0 "INVALID" ;
VAL_ 154 OBJ_Height_V_29 1 "VALID" 0 "INVALID" ;
VAL_ 154 OBJ_Height_STD_V_29 1 "VALID" 0 "INVALID" ;
VAL_ 154 OBJ_Abs_Long_Velocity_V_29 1 "VALID" 0 "INVALID" ;
VAL_ 154 OBJ_Abs_Long_Vel_STD_V_29 1 "VALID" 0 "INVALID" ;
VAL_ 154 OBJ_Abs_Lat_Velocity_V_29 1 "VALID" 0 "INVALID" ;
VAL_ 154 OBJ_Abs_Lat_Vel_STD_V_29 1 "VALID" 0 "INVALID" ;
VAL_ 154 OBJ_Abs_Long_Acc_V_29 1 "VALID" 0 "INVALID" ;
VAL_ 154 OBJ_Abs_Long_Acc_STD_V_29 1 "VALID" 0 "INVALID" ;
VAL_ 154 OBJ_Abs_Lat_Acc_V_29 1 "VALID" 0 "INVALID" ;
VAL_ 154 OBJ_Abs_Lat_Acc_STD_V_29 1 "VALID" 0 "INVALID" ;
VAL_ 154 OBJ_Abs_Acceleration_V_29 1 "VALID" 0 "INVALID" ;
VAL_ 154 OBJ_Abs_Acc_STD_V_29 1 "VALID" 0 "INVALID" ;
VAL_ 154 OBJ_Inv_TTC_V_29 1 "VALID" 0 "INVALID" ;
VAL_ 154 OBJ_Inv_TTC_STD_V_29 1 "VALID" 0 "INVALID" ;
VAL_ 154 OBJ_Relative_Long_Acc_V_29 1 "VALID" 0 "INVALID" ;
VAL_ 154 OBJ_Rel_Long_Acc_STD_V_29 1 "VALID" 0 "INVALID" ;
VAL_ 154 OBJ_Relative_Long_Velocity_V_29 1 "VALID" 0 "INVALID" ;
VAL_ 154 OBJ_Rel_Long_Vel_STD_V_29 1 "VALID" 0 "INVALID" ;
VAL_ 154 OBJ_Relative_Lat_Velocity_V_29 1 "VALID" 0 "INVALID" ;
VAL_ 154 OBJ_Rel_Lat_Vel_STD_V_29 1 "VALID" 0 "INVALID" ;
VAL_ 154 OBJ_Long_Distance_V_29 1 "VALID" 0 "INVALID" ;
VAL_ 154 OBJ_Long_Distance_STD_V_29 1 "VALID" 0 "INVALID" ;
VAL_ 154 OBJ_Lat_Distance_V_29 1 "VALID" 0 "INVALID" ;
VAL_ 154 OBJ_Lat_Distance_STD_V_29 1 "VALID" 0 "INVALID" ;
VAL_ 154 OBJ_Absolute_Speed_V_29 1 "VALID" 0 "INVALID" ;
VAL_ 154 OBJ_Absolute_Speed_STD_V_29 1 "VALID" 0 "INVALID" ;
VAL_ 154 OBJ_Heading_V_29 1 "VALID" 0 "INVALID" ;
VAL_ 154 OBJ_Heading_STD_V_29 1 "VALID" 0 "INVALID" ;
VAL_ 154 OBJ_Angle_Rate_STD_V_29 1 "VALID" 0 "INVALID" ;
VAL_ 154 OBJ_Angle_Rate_V_29 1 "VALID" 0 "INVALID" ;
VAL_ 154 OBJ_Angle_Right_V_29 1 "VALID" 0 "INVALID" ;
VAL_ 154 OBJ_Angle_Right_STD_V_29 1 "VALID" 0 "INVALID" ;
VAL_ 154 OBJ_Angle_Left_V_29 1 "VALID" 0 "INVALID" ;
VAL_ 154 OBJ_Angle_Left_STD_V_29 1 "VALID" 0 "INVALID" ;
VAL_ 154 OBJ_Angle_Side_V_29 1 "VALID" 0 "INVALID" ;
VAL_ 154 OBJ_Angle_Side_STD_V_29 1 "VALID" 0 "INVALID" ;
VAL_ 154 OBJ_Angle_Mid_V_29 1 "VALID" 0 "INVALID" ;
VAL_ 154 OBJ_Angle_Mid_STD_V_29 1 "VALID" 0 "INVALID" ;
VAL_ 154 OBJ_Angle_Bottom_V_29 1 "VALID" 0 "INVALID" ;
VAL_ 154 OBJ_Angle_Bottom_STD_V_29 1 "VALID" 0 "INVALID" ;
VAL_ 154 OBJ_Visibility_Side_V_29 1 "VALID" 0 "INVALID" ;
VAL_ 154 OBJ_Visibility_Side_29 2 "REAR" 1 "FRONT" 0 "NOT_VISIBLE" ;
VAL_ 154 OBJ_Is_In_Drivable_Area_29 1 "TRUE" 0 "FALSE" ;
VAL_ 154 OBJ_Is_In_Drivable_Area_V_29 1 "VALID" 0 "INVALID" ;
VAL_ 154 OBJ_Is_VeryClose_V_29 1 "VALID" 0 "INVALID" ;
VAL_ 154 OBJ_Is_VeryClose_29 1 "TRUE" 0 "FALSE" ;
VAL_ 154 OBJ_OverlapAngleEgoLaneR_V_29 1 "VALID" 0 "INVALID" ;
VAL_ 154 OBJ_OverlapAngleEgoLaneL_V_29 1 "VALID" 0 "INVALID" ;
VAL_ 154 OBJ_Is_EMERGENCY_VCL_29 1 "TRUE" 0 "FALSE" ;
VAL_ 154 OBJ_EMERGENCY_LIGHT_COLOR_29 3 "(1000)ORANGE" 2 "(0100)BLUE" 1 "(0010)RED" 0 "(0001)OTHER" ;
VAL_ 154 OBJ_EMERGENCY_V_29 1 "TRUE" 0 "FALSE" ;
VAL_ 154 OBJ_Angle_Top_V_29 1 "VALID" 0 "INVALID" ;
VAL_ 154 OBJ_Angle_Top_STD_V_29 1 "VALID" 0 "INVALID" ;
VAL_ 154 OBJ_Open_Door_Left_29 1 "TRUE" 0 "FALSE" ;
VAL_ 154 OBJ_Open_Door_Right_29 1 "TRUE" 0 "FALSE" ;
VAL_ 154 OBJ_Visible_Left_or_Right_29 2 "RIGHT" 1 "LEFT" 0 "NOT_VISIBLE" ;
VAL_ 154 OBJ_Visible_Left_or_Right_V_29 1 "VALID" 0 "INVALID" ;
VAL_ 154 OBJ_Fusion_Source_30 2 "(BIT_2)RADAR2" 1 "(BIT_1)RADAR1" 0 "(BIT_0)CAMERA" ;
VAL_ 154 OBJ_Triggered_SDM_30 2 "NOT_TRIGGERED" 1 "TRIGGERED" 0 "NOT_AVAILABLE" ;
VAL_ 154 OBJ_Motion_Category_30 13 "ONCOMING" 12 "PRECEEDING" 11 "MOVING" 10 "RTAP" 9 "LTAP" 8 "CROSSING" 7 "MOVING_OUT" 6 "MOVING_IN" 5 "CLOSE_CUT_IN" 4 "PASSING_OUT" 3 "PASSING_IN" 2 "PASSING" 1 "UNDEFINED" 0 "UNFILLED" ;
VAL_ 154 OBJ_Measuring_Status_30 2 "(BIT_2)NOT_VALID_OR_VALID" 1 "(BIT_1)PREDICTED_OR_MEASURED" 0 "(BIT_0)OLD_OR_NEW" ;
VAL_ 154 OBJ_Object_Class_30 9 "TWO_WHEELER" 8 "UNCERTAIN_VCL" 7 "ANIMAL" 6 "GENERAL_OBJECT" 5 "PEDESTRIAN" 4 "BICYCLE" 3 "MOTORBIKE" 2 "TRUCK" 1 "CAR" 0 "UNFILLED" ;
VAL_ 154 OBJ_Camera_Source_30 11 "PARKING_RIGHT" 10 "PARKING_LEFT" 9 "PARKING_REAR" 8 "PARKING_FRONT" 7 "FRONT_CORNER_RIGHT" 6 "FRONT_CORNER_LEFT" 5 "REAR_CORNER_RIGHT" 4 "REAR_CORNER_LEFT" 3 "REAR" 2 "FRONT_FISHEYE" 1 "FRONT_NARROW" 0 "FRONT_MAIN" ;
VAL_ 154 OBJ_Motion_Status_30 5 "MOVING_SLOWLY" 4 "STOPPED" 3 "STATIONARY" 2 "MOVING" 1 "UNKNOWN" 0 "INVALID" ;
VAL_ 154 OBJ_Motion_Orientation_30 13 "INVALID" 12 "NORTH" 11 "NORTH_WEST" 9 "WEST" 7 "SOUTH_WEST" 6 "SOUTH" 5 "SOUTH_EAST" 3 "EAST" 1 "NORTH_EAST" 0 "UNKNOWN" ;
VAL_ 154 OBJ_Has_Cut_Lane_30 1 "TRUE" 0 "FALSE" ;
VAL_ 154 OBJ_Has_Cut_Path_30 1 "TRUE" 0 "FALSE" ;
VAL_ 154 OBJ_Brake_Light_Validity_30 1 "TRUE" 0 "FALSE" ;
VAL_ 154 OBJ_Brake_Light_30 1 "TRUE" 0 "FALSE" ;
VAL_ 154 OBJ_Turn_Indicator_Right_30 1 "TRUE" 0 "FALSE" ;
VAL_ 154 OBJ_Turn_Indicator_Left_30 1 "TRUE" 0 "FALSE" ;
VAL_ 154 OBJ_Turn_Indicator_Validity_30 1 "TRUE" 0 "FALSE" ;
VAL_ 154 OBJ_Right_Out_Of_Image_30 1 "TRUE" 0 "FALSE" ;
VAL_ 154 OBJ_Left_Out_Of_Image_30 1 "TRUE" 0 "FALSE" ;
VAL_ 154 OBJ_Right_Out_Of_Image_V_30 1 "TRUE" 0 "FALSE" ;
VAL_ 154 OBJ_Left_Out_Of_Image_V_30 1 "TRUE" 0 "FALSE" ;
VAL_ 154 OBJ_Top_Out_Of_Image_30 1 "TRUE" 0 "FALSE" ;
VAL_ 154 OBJ_Bottom_Out_Of_Image_30 1 "TRUE" 0 "FALSE" ;
VAL_ 154 OBJ_Top_Out_Of_Image_V_30 1 "VALID" 0 "INVALID" ;
VAL_ 154 OBJ_Bottom_Out_Of_Image_V_30 1 "VALID" 0 "INVALID" ;
VAL_ 154 OBJ_Lane_Assignment_30 5 "RIGHT_RIGHT" 4 "RIGHT" 3 "HOST" 2 "LEFT" 1 "LEFT_LEFT" 0 "UNKNOWN" ;
VAL_ 154 OBJ_Lane_Assignment_V_30 1 "VALID" 0 "INVALID" ;
VAL_ 154 OBJ_Age_Seconds_V_30 1 "VALID" 0 "INVALID" ;
VAL_ 154 OBJ_Width_V_30 1 "VALID" 0 "INVALID" ;
VAL_ 154 OBJ_Width_STD_V_30 1 "VALID" 0 "INVALID" ;
VAL_ 154 OBJ_Length_V_30 1 "VALID" 0 "INVALID" ;
VAL_ 154 OBJ_Length_STD_V_30 1 "VALID" 0 "INVALID" ;
VAL_ 154 OBJ_Height_V_30 1 "VALID" 0 "INVALID" ;
VAL_ 154 OBJ_Height_STD_V_30 1 "VALID" 0 "INVALID" ;
VAL_ 154 OBJ_Abs_Long_Velocity_V_30 1 "VALID" 0 "INVALID" ;
VAL_ 154 OBJ_Abs_Long_Vel_STD_V_30 1 "VALID" 0 "INVALID" ;
VAL_ 154 OBJ_Abs_Lat_Velocity_V_30 1 "VALID" 0 "INVALID" ;
VAL_ 154 OBJ_Abs_Lat_Vel_STD_V_30 1 "VALID" 0 "INVALID" ;
VAL_ 154 OBJ_Abs_Long_Acc_V_30 1 "VALID" 0 "INVALID" ;
VAL_ 154 OBJ_Abs_Long_Acc_STD_V_30 1 "VALID" 0 "INVALID" ;
VAL_ 154 OBJ_Abs_Lat_Acc_V_30 1 "VALID" 0 "INVALID" ;
VAL_ 154 OBJ_Abs_Lat_Acc_STD_V_30 1 "VALID" 0 "INVALID" ;
VAL_ 154 OBJ_Abs_Acceleration_V_30 1 "VALID" 0 "INVALID" ;
VAL_ 154 OBJ_Abs_Acc_STD_V_30 1 "VALID" 0 "INVALID" ;
VAL_ 154 OBJ_Inv_TTC_V_30 1 "VALID" 0 "INVALID" ;
VAL_ 154 OBJ_Inv_TTC_STD_V_30 1 "VALID" 0 "INVALID" ;
VAL_ 154 OBJ_Relative_Long_Acc_V_30 1 "VALID" 0 "INVALID" ;
VAL_ 154 OBJ_Rel_Long_Acc_STD_V_30 1 "VALID" 0 "INVALID" ;
VAL_ 154 OBJ_Relative_Long_Velocity_V_30 1 "VALID" 0 "INVALID" ;
VAL_ 154 OBJ_Rel_Long_Vel_STD_V_30 1 "VALID" 0 "INVALID" ;
VAL_ 154 OBJ_Relative_Lat_Velocity_V_30 1 "VALID" 0 "INVALID" ;
VAL_ 154 OBJ_Rel_Lat_Vel_STD_V_30 1 "VALID" 0 "INVALID" ;
VAL_ 154 OBJ_Long_Distance_V_30 1 "VALID" 0 "INVALID" ;
VAL_ 154 OBJ_Long_Distance_STD_V_30 1 "VALID" 0 "INVALID" ;
VAL_ 154 OBJ_Lat_Distance_V_30 1 "VALID" 0 "INVALID" ;
VAL_ 154 OBJ_Lat_Distance_STD_V_30 1 "VALID" 0 "INVALID" ;
VAL_ 154 OBJ_Absolute_Speed_V_30 1 "VALID" 0 "INVALID" ;
VAL_ 154 OBJ_Absolute_Speed_STD_V_30 1 "VALID" 0 "INVALID" ;
VAL_ 154 OBJ_Heading_V_30 1 "VALID" 0 "INVALID" ;
VAL_ 154 OBJ_Heading_STD_V_30 1 "VALID" 0 "INVALID" ;
VAL_ 154 OBJ_Angle_Rate_STD_V_30 1 "VALID" 0 "INVALID" ;
VAL_ 154 OBJ_Angle_Rate_V_30 1 "VALID" 0 "INVALID" ;
VAL_ 154 OBJ_Angle_Right_V_30 1 "VALID" 0 "INVALID" ;
VAL_ 154 OBJ_Angle_Right_STD_V_30 1 "VALID" 0 "INVALID" ;
VAL_ 154 OBJ_Angle_Left_V_30 1 "VALID" 0 "INVALID" ;
VAL_ 154 OBJ_Angle_Left_STD_V_30 1 "VALID" 0 "INVALID" ;
VAL_ 154 OBJ_Angle_Side_V_30 1 "VALID" 0 "INVALID" ;
VAL_ 154 OBJ_Angle_Side_STD_V_30 1 "VALID" 0 "INVALID" ;
VAL_ 154 OBJ_Angle_Mid_V_30 1 "VALID" 0 "INVALID" ;
VAL_ 154 OBJ_Angle_Mid_STD_V_30 1 "VALID" 0 "INVALID" ;
VAL_ 154 OBJ_Angle_Bottom_V_30 1 "VALID" 0 "INVALID" ;
VAL_ 154 OBJ_Angle_Bottom_STD_V_30 1 "VALID" 0 "INVALID" ;
VAL_ 154 OBJ_Visibility_Side_V_30 1 "VALID" 0 "INVALID" ;
VAL_ 154 OBJ_Visibility_Side_30 2 "REAR" 1 "FRONT" 0 "NOT_VISIBLE" ;
VAL_ 154 OBJ_Is_In_Drivable_Area_30 1 "TRUE" 0 "FALSE" ;
VAL_ 154 OBJ_Is_In_Drivable_Area_V_30 1 "VALID" 0 "INVALID" ;
VAL_ 154 OBJ_Is_VeryClose_V_30 1 "VALID" 0 "INVALID" ;
VAL_ 154 OBJ_Is_VeryClose_30 1 "TRUE" 0 "FALSE" ;
VAL_ 154 OBJ_OverlapAngleEgoLaneR_V_30 1 "VALID" 0 "INVALID" ;
VAL_ 154 OBJ_OverlapAngleEgoLaneL_V_30 1 "VALID" 0 "INVALID" ;
VAL_ 154 OBJ_Is_EMERGENCY_VCL_30 1 "TRUE" 0 "FALSE" ;
VAL_ 154 OBJ_EMERGENCY_LIGHT_COLOR_30 3 "(1000)ORANGE" 2 "(0100)BLUE" 1 "(0010)RED" 0 "(0001)OTHER" ;
VAL_ 154 OBJ_EMERGENCY_V_30 1 "TRUE" 0 "FALSE" ;
VAL_ 154 OBJ_Angle_Top_V_30 1 "VALID" 0 "INVALID" ;
VAL_ 154 OBJ_Angle_Top_STD_V_30 1 "VALID" 0 "INVALID" ;
VAL_ 154 OBJ_Open_Door_Left_30 1 "TRUE" 0 "FALSE" ;
VAL_ 154 OBJ_Open_Door_Right_30 1 "TRUE" 0 "FALSE" ;
VAL_ 154 OBJ_Visible_Left_or_Right_30 2 "RIGHT" 1 "LEFT" 0 "NOT_VISIBLE" ;
VAL_ 154 OBJ_Visible_Left_or_Right_V_30 1 "VALID" 0 "INVALID" ;
VAL_ 154 OBJ_Fusion_Source_31 2 "(BIT_2)RADAR2" 1 "(BIT_1)RADAR1" 0 "(BIT_0)CAMERA" ;
VAL_ 154 OBJ_Triggered_SDM_31 2 "NOT_TRIGGERED" 1 "TRIGGERED" 0 "NOT_AVAILABLE" ;
VAL_ 154 OBJ_Motion_Category_31 13 "ONCOMING" 12 "PRECEEDING" 11 "MOVING" 10 "RTAP" 9 "LTAP" 8 "CROSSING" 7 "MOVING_OUT" 6 "MOVING_IN" 5 "CLOSE_CUT_IN" 4 "PASSING_OUT" 3 "PASSING_IN" 2 "PASSING" 1 "UNDEFINED" 0 "UNFILLED" ;
VAL_ 154 OBJ_Measuring_Status_31 2 "(BIT_2)NOT_VALID_OR_VALID" 1 "(BIT_1)PREDICTED_OR_MEASURED" 0 "(BIT_0)OLD_OR_NEW" ;
VAL_ 154 OBJ_Object_Class_31 9 "TWO_WHEELER" 8 "UNCERTAIN_VCL" 7 "ANIMAL" 6 "GENERAL_OBJECT" 5 "PEDESTRIAN" 4 "BICYCLE" 3 "MOTORBIKE" 2 "TRUCK" 1 "CAR" 0 "UNFILLED" ;
VAL_ 154 OBJ_Camera_Source_31 11 "PARKING_RIGHT" 10 "PARKING_LEFT" 9 "PARKING_REAR" 8 "PARKING_FRONT" 7 "FRONT_CORNER_RIGHT" 6 "FRONT_CORNER_LEFT" 5 "REAR_CORNER_RIGHT" 4 "REAR_CORNER_LEFT" 3 "REAR" 2 "FRONT_FISHEYE" 1 "FRONT_NARROW" 0 "FRONT_MAIN" ;
VAL_ 154 OBJ_Motion_Status_31 5 "MOVING_SLOWLY" 4 "STOPPED" 3 "STATIONARY" 2 "MOVING" 1 "UNKNOWN" 0 "INVALID" ;
VAL_ 154 OBJ_Motion_Orientation_31 13 "INVALID" 12 "NORTH" 11 "NORTH_WEST" 9 "WEST" 7 "SOUTH_WEST" 6 "SOUTH" 5 "SOUTH_EAST" 3 "EAST" 1 "NORTH_EAST" 0 "UNKNOWN" ;
VAL_ 154 OBJ_Has_Cut_Lane_31 1 "TRUE" 0 "FALSE" ;
VAL_ 154 OBJ_Has_Cut_Path_31 1 "TRUE" 0 "FALSE" ;
VAL_ 154 OBJ_Brake_Light_Validity_31 1 "TRUE" 0 "FALSE" ;
VAL_ 154 OBJ_Brake_Light_31 1 "TRUE" 0 "FALSE" ;
VAL_ 154 OBJ_Turn_Indicator_Right_31 1 "TRUE" 0 "FALSE" ;
VAL_ 154 OBJ_Turn_Indicator_Left_31 1 "TRUE" 0 "FALSE" ;
VAL_ 154 OBJ_Turn_Indicator_Validity_31 1 "TRUE" 0 "FALSE" ;
VAL_ 154 OBJ_Right_Out_Of_Image_31 1 "TRUE" 0 "FALSE" ;
VAL_ 154 OBJ_Left_Out_Of_Image_31 1 "TRUE" 0 "FALSE" ;
VAL_ 154 OBJ_Right_Out_Of_Image_V_31 1 "TRUE" 0 "FALSE" ;
VAL_ 154 OBJ_Left_Out_Of_Image_V_31 1 "TRUE" 0 "FALSE" ;
VAL_ 154 OBJ_Top_Out_Of_Image_31 1 "TRUE" 0 "FALSE" ;
VAL_ 154 OBJ_Bottom_Out_Of_Image_31 1 "TRUE" 0 "FALSE" ;
VAL_ 154 OBJ_Top_Out_Of_Image_V_31 1 "VALID" 0 "INVALID" ;
VAL_ 154 OBJ_Bottom_Out_Of_Image_V_31 1 "VALID" 0 "INVALID" ;
VAL_ 154 OBJ_Lane_Assignment_31 5 "RIGHT_RIGHT" 4 "RIGHT" 3 "HOST" 2 "LEFT" 1 "LEFT_LEFT" 0 "UNKNOWN" ;
VAL_ 154 OBJ_Lane_Assignment_V_31 1 "VALID" 0 "INVALID" ;
VAL_ 154 OBJ_Age_Seconds_V_31 1 "VALID" 0 "INVALID" ;
VAL_ 154 OBJ_Width_V_31 1 "VALID" 0 "INVALID" ;
VAL_ 154 OBJ_Width_STD_V_31 1 "VALID" 0 "INVALID" ;
VAL_ 154 OBJ_Length_V_31 1 "VALID" 0 "INVALID" ;
VAL_ 154 OBJ_Length_STD_V_31 1 "VALID" 0 "INVALID" ;
VAL_ 154 OBJ_Height_V_31 1 "VALID" 0 "INVALID" ;
VAL_ 154 OBJ_Height_STD_V_31 1 "VALID" 0 "INVALID" ;
VAL_ 154 OBJ_Abs_Long_Velocity_V_31 1 "VALID" 0 "INVALID" ;
VAL_ 154 OBJ_Abs_Long_Vel_STD_V_31 1 "VALID" 0 "INVALID" ;
VAL_ 154 OBJ_Abs_Lat_Velocity_V_31 1 "VALID" 0 "INVALID" ;
VAL_ 154 OBJ_Abs_Lat_Vel_STD_V_31 1 "VALID" 0 "INVALID" ;
VAL_ 154 OBJ_Abs_Long_Acc_V_31 1 "VALID" 0 "INVALID" ;
VAL_ 154 OBJ_Abs_Long_Acc_STD_V_31 1 "VALID" 0 "INVALID" ;
VAL_ 154 OBJ_Abs_Lat_Acc_V_31 1 "VALID" 0 "INVALID" ;
VAL_ 154 OBJ_Abs_Lat_Acc_STD_V_31 1 "VALID" 0 "INVALID" ;
VAL_ 154 OBJ_Abs_Acceleration_V_31 1 "VALID" 0 "INVALID" ;
VAL_ 154 OBJ_Abs_Acc_STD_V_31 1 "VALID" 0 "INVALID" ;
VAL_ 154 OBJ_Inv_TTC_V_31 1 "VALID" 0 "INVALID" ;
VAL_ 154 OBJ_Inv_TTC_STD_V_31 1 "VALID" 0 "INVALID" ;
VAL_ 154 OBJ_Relative_Long_Acc_V_31 1 "VALID" 0 "INVALID" ;
VAL_ 154 OBJ_Rel_Long_Acc_STD_V_31 1 "VALID" 0 "INVALID" ;
VAL_ 154 OBJ_Relative_Long_Velocity_V_31 1 "VALID" 0 "INVALID" ;
VAL_ 154 OBJ_Rel_Long_Vel_STD_V_31 1 "VALID" 0 "INVALID" ;
VAL_ 154 OBJ_Relative_Lat_Velocity_V_31 1 "VALID" 0 "INVALID" ;
VAL_ 154 OBJ_Rel_Lat_Vel_STD_V_31 1 "VALID" 0 "INVALID" ;
VAL_ 154 OBJ_Long_Distance_V_31 1 "VALID" 0 "INVALID" ;
VAL_ 154 OBJ_Long_Distance_STD_V_31 1 "VALID" 0 "INVALID" ;
VAL_ 154 OBJ_Lat_Distance_V_31 1 "VALID" 0 "INVALID" ;
VAL_ 154 OBJ_Lat_Distance_STD_V_31 1 "VALID" 0 "INVALID" ;
VAL_ 154 OBJ_Absolute_Speed_V_31 1 "VALID" 0 "INVALID" ;
VAL_ 154 OBJ_Absolute_Speed_STD_V_31 1 "VALID" 0 "INVALID" ;
VAL_ 154 OBJ_Heading_V_31 1 "VALID" 0 "INVALID" ;
VAL_ 154 OBJ_Heading_STD_V_31 1 "VALID" 0 "INVALID" ;
VAL_ 154 OBJ_Angle_Rate_STD_V_31 1 "VALID" 0 "INVALID" ;
VAL_ 154 OBJ_Angle_Rate_V_31 1 "VALID" 0 "INVALID" ;
VAL_ 154 OBJ_Angle_Right_V_31 1 "VALID" 0 "INVALID" ;
VAL_ 154 OBJ_Angle_Right_STD_V_31 1 "VALID" 0 "INVALID" ;
VAL_ 154 OBJ_Angle_Left_V_31 1 "VALID" 0 "INVALID" ;
VAL_ 154 OBJ_Angle_Left_STD_V_31 1 "VALID" 0 "INVALID" ;
VAL_ 154 OBJ_Angle_Side_V_31 1 "VALID" 0 "INVALID" ;
VAL_ 154 OBJ_Angle_Side_STD_V_31 1 "VALID" 0 "INVALID" ;
VAL_ 154 OBJ_Angle_Mid_V_31 1 "VALID" 0 "INVALID" ;
VAL_ 154 OBJ_Angle_Mid_STD_V_31 1 "VALID" 0 "INVALID" ;
VAL_ 154 OBJ_Angle_Bottom_V_31 1 "VALID" 0 "INVALID" ;
VAL_ 154 OBJ_Angle_Bottom_STD_V_31 1 "VALID" 0 "INVALID" ;
VAL_ 154 OBJ_Visibility_Side_V_31 1 "VALID" 0 "INVALID" ;
VAL_ 154 OBJ_Visibility_Side_31 2 "REAR" 1 "FRONT" 0 "NOT_VISIBLE" ;
VAL_ 154 OBJ_Is_In_Drivable_Area_31 1 "TRUE" 0 "FALSE" ;
VAL_ 154 OBJ_Is_In_Drivable_Area_V_31 1 "VALID" 0 "INVALID" ;
VAL_ 154 OBJ_Is_VeryClose_V_31 1 "VALID" 0 "INVALID" ;
VAL_ 154 OBJ_Is_VeryClose_31 1 "TRUE" 0 "FALSE" ;
VAL_ 154 OBJ_OverlapAngleEgoLaneR_V_31 1 "VALID" 0 "INVALID" ;
VAL_ 154 OBJ_OverlapAngleEgoLaneL_V_31 1 "VALID" 0 "INVALID" ;
VAL_ 154 OBJ_Is_EMERGENCY_VCL_31 1 "TRUE" 0 "FALSE" ;
VAL_ 154 OBJ_EMERGENCY_LIGHT_COLOR_31 3 "(1000)ORANGE" 2 "(0100)BLUE" 1 "(0010)RED" 0 "(0001)OTHER" ;
VAL_ 154 OBJ_EMERGENCY_V_31 1 "TRUE" 0 "FALSE" ;
VAL_ 154 OBJ_Angle_Top_V_31 1 "VALID" 0 "INVALID" ;
VAL_ 154 OBJ_Angle_Top_STD_V_31 1 "VALID" 0 "INVALID" ;
VAL_ 154 OBJ_Open_Door_Left_31 1 "TRUE" 0 "FALSE" ;
VAL_ 154 OBJ_Open_Door_Right_31 1 "TRUE" 0 "FALSE" ;
VAL_ 154 OBJ_Visible_Left_or_Right_31 2 "RIGHT" 1 "LEFT" 0 "NOT_VISIBLE" ;
VAL_ 154 OBJ_Visible_Left_or_Right_V_31 1 "VALID" 0 "INVALID" ;
VAL_ 154 OBJ_Fusion_Source_32 2 "(BIT_2)RADAR2" 1 "(BIT_1)RADAR1" 0 "(BIT_0)CAMERA" ;
VAL_ 154 OBJ_Triggered_SDM_32 2 "NOT_TRIGGERED" 1 "TRIGGERED" 0 "NOT_AVAILABLE" ;
VAL_ 154 OBJ_Motion_Category_32 13 "ONCOMING" 12 "PRECEEDING" 11 "MOVING" 10 "RTAP" 9 "LTAP" 8 "CROSSING" 7 "MOVING_OUT" 6 "MOVING_IN" 5 "CLOSE_CUT_IN" 4 "PASSING_OUT" 3 "PASSING_IN" 2 "PASSING" 1 "UNDEFINED" 0 "UNFILLED" ;
VAL_ 154 OBJ_Measuring_Status_32 2 "(BIT_2)NOT_VALID_OR_VALID" 1 "(BIT_1)PREDICTED_OR_MEASURED" 0 "(BIT_0)OLD_OR_NEW" ;
VAL_ 154 OBJ_Object_Class_32 9 "TWO_WHEELER" 8 "UNCERTAIN_VCL" 7 "ANIMAL" 6 "GENERAL_OBJECT" 5 "PEDESTRIAN" 4 "BICYCLE" 3 "MOTORBIKE" 2 "TRUCK" 1 "CAR" 0 "UNFILLED" ;
VAL_ 154 OBJ_Camera_Source_32 11 "PARKING_RIGHT" 10 "PARKING_LEFT" 9 "PARKING_REAR" 8 "PARKING_FRONT" 7 "FRONT_CORNER_RIGHT" 6 "FRONT_CORNER_LEFT" 5 "REAR_CORNER_RIGHT" 4 "REAR_CORNER_LEFT" 3 "REAR" 2 "FRONT_FISHEYE" 1 "FRONT_NARROW" 0 "FRONT_MAIN" ;
VAL_ 154 OBJ_Motion_Status_32 5 "MOVING_SLOWLY" 4 "STOPPED" 3 "STATIONARY" 2 "MOVING" 1 "UNKNOWN" 0 "INVALID" ;
VAL_ 154 OBJ_Motion_Orientation_32 13 "INVALID" 12 "NORTH" 11 "NORTH_WEST" 9 "WEST" 7 "SOUTH_WEST" 6 "SOUTH" 5 "SOUTH_EAST" 3 "EAST" 1 "NORTH_EAST" 0 "UNKNOWN" ;
VAL_ 154 OBJ_Has_Cut_Lane_32 1 "TRUE" 0 "FALSE" ;
VAL_ 154 OBJ_Has_Cut_Path_32 1 "TRUE" 0 "FALSE" ;
VAL_ 154 OBJ_Brake_Light_Validity_32 1 "TRUE" 0 "FALSE" ;
VAL_ 154 OBJ_Brake_Light_32 1 "TRUE" 0 "FALSE" ;
VAL_ 154 OBJ_Turn_Indicator_Right_32 1 "TRUE" 0 "FALSE" ;
VAL_ 154 OBJ_Turn_Indicator_Left_32 1 "TRUE" 0 "FALSE" ;
VAL_ 154 OBJ_Turn_Indicator_Validity_32 1 "TRUE" 0 "FALSE" ;
VAL_ 154 OBJ_Right_Out_Of_Image_32 1 "TRUE" 0 "FALSE" ;
VAL_ 154 OBJ_Left_Out_Of_Image_32 1 "TRUE" 0 "FALSE" ;
VAL_ 154 OBJ_Right_Out_Of_Image_V_32 1 "TRUE" 0 "FALSE" ;
VAL_ 154 OBJ_Left_Out_Of_Image_V_32 1 "TRUE" 0 "FALSE" ;
VAL_ 154 OBJ_Top_Out_Of_Image_32 1 "TRUE" 0 "FALSE" ;
VAL_ 154 OBJ_Bottom_Out_Of_Image_32 1 "TRUE" 0 "FALSE" ;
VAL_ 154 OBJ_Top_Out_Of_Image_V_32 1 "VALID" 0 "INVALID" ;
VAL_ 154 OBJ_Bottom_Out_Of_Image_V_32 1 "VALID" 0 "INVALID" ;
VAL_ 154 OBJ_Lane_Assignment_32 5 "RIGHT_RIGHT" 4 "RIGHT" 3 "HOST" 2 "LEFT" 1 "LEFT_LEFT" 0 "UNKNOWN" ;
VAL_ 154 OBJ_Lane_Assignment_V_32 1 "VALID" 0 "INVALID" ;
VAL_ 154 OBJ_Age_Seconds_V_32 1 "VALID" 0 "INVALID" ;
VAL_ 154 OBJ_Width_V_32 1 "VALID" 0 "INVALID" ;
VAL_ 154 OBJ_Width_STD_V_32 1 "VALID" 0 "INVALID" ;
VAL_ 154 OBJ_Length_V_32 1 "VALID" 0 "INVALID" ;
VAL_ 154 OBJ_Length_STD_V_32 1 "VALID" 0 "INVALID" ;
VAL_ 154 OBJ_Height_V_32 1 "VALID" 0 "INVALID" ;
VAL_ 154 OBJ_Height_STD_V_32 1 "VALID" 0 "INVALID" ;
VAL_ 154 OBJ_Abs_Long_Velocity_V_32 1 "VALID" 0 "INVALID" ;
VAL_ 154 OBJ_Abs_Long_Vel_STD_V_32 1 "VALID" 0 "INVALID" ;
VAL_ 154 OBJ_Abs_Lat_Velocity_V_32 1 "VALID" 0 "INVALID" ;
VAL_ 154 OBJ_Abs_Lat_Vel_STD_V_32 1 "VALID" 0 "INVALID" ;
VAL_ 154 OBJ_Abs_Long_Acc_V_32 1 "VALID" 0 "INVALID" ;
VAL_ 154 OBJ_Abs_Long_Acc_STD_V_32 1 "VALID" 0 "INVALID" ;
VAL_ 154 OBJ_Abs_Lat_Acc_V_32 1 "VALID" 0 "INVALID" ;
VAL_ 154 OBJ_Abs_Lat_Acc_STD_V_32 1 "VALID" 0 "INVALID" ;
VAL_ 154 OBJ_Abs_Acceleration_V_32 1 "VALID" 0 "INVALID" ;
VAL_ 154 OBJ_Abs_Acc_STD_V_32 1 "VALID" 0 "INVALID" ;
VAL_ 154 OBJ_Inv_TTC_V_32 1 "VALID" 0 "INVALID" ;
VAL_ 154 OBJ_Inv_TTC_STD_V_32 1 "VALID" 0 "INVALID" ;
VAL_ 154 OBJ_Relative_Long_Acc_V_32 1 "VALID" 0 "INVALID" ;
VAL_ 154 OBJ_Rel_Long_Acc_STD_V_32 1 "VALID" 0 "INVALID" ;
VAL_ 154 OBJ_Relative_Long_Velocity_V_32 1 "VALID" 0 "INVALID" ;
VAL_ 154 OBJ_Rel_Long_Vel_STD_V_32 1 "VALID" 0 "INVALID" ;
VAL_ 154 OBJ_Relative_Lat_Velocity_V_32 1 "VALID" 0 "INVALID" ;
VAL_ 154 OBJ_Rel_Lat_Vel_STD_V_32 1 "VALID" 0 "INVALID" ;
VAL_ 154 OBJ_Long_Distance_V_32 1 "VALID" 0 "INVALID" ;
VAL_ 154 OBJ_Long_Distance_STD_V_32 1 "VALID" 0 "INVALID" ;
VAL_ 154 OBJ_Lat_Distance_V_32 1 "VALID" 0 "INVALID" ;
VAL_ 154 OBJ_Lat_Distance_STD_V_32 1 "VALID" 0 "INVALID" ;
VAL_ 154 OBJ_Absolute_Speed_V_32 1 "VALID" 0 "INVALID" ;
VAL_ 154 OBJ_Absolute_Speed_STD_V_32 1 "VALID" 0 "INVALID" ;
VAL_ 154 OBJ_Heading_V_32 1 "VALID" 0 "INVALID" ;
VAL_ 154 OBJ_Heading_STD_V_32 1 "VALID" 0 "INVALID" ;
VAL_ 154 OBJ_Angle_Rate_STD_V_32 1 "VALID" 0 "INVALID" ;
VAL_ 154 OBJ_Angle_Rate_V_32 1 "VALID" 0 "INVALID" ;
VAL_ 154 OBJ_Angle_Right_V_32 1 "VALID" 0 "INVALID" ;
VAL_ 154 OBJ_Angle_Right_STD_V_32 1 "VALID" 0 "INVALID" ;
VAL_ 154 OBJ_Angle_Left_V_32 1 "VALID" 0 "INVALID" ;
VAL_ 154 OBJ_Angle_Left_STD_V_32 1 "VALID" 0 "INVALID" ;
VAL_ 154 OBJ_Angle_Side_V_32 1 "VALID" 0 "INVALID" ;
VAL_ 154 OBJ_Angle_Side_STD_V_32 1 "VALID" 0 "INVALID" ;
VAL_ 154 OBJ_Angle_Mid_V_32 1 "VALID" 0 "INVALID" ;
VAL_ 154 OBJ_Angle_Mid_STD_V_32 1 "VALID" 0 "INVALID" ;
VAL_ 154 OBJ_Angle_Bottom_V_32 1 "VALID" 0 "INVALID" ;
VAL_ 154 OBJ_Angle_Bottom_STD_V_32 1 "VALID" 0 "INVALID" ;
VAL_ 154 OBJ_Visibility_Side_V_32 1 "VALID" 0 "INVALID" ;
VAL_ 154 OBJ_Visibility_Side_32 2 "REAR" 1 "FRONT" 0 "NOT_VISIBLE" ;
VAL_ 154 OBJ_Is_In_Drivable_Area_32 1 "TRUE" 0 "FALSE" ;
VAL_ 154 OBJ_Is_In_Drivable_Area_V_32 1 "VALID" 0 "INVALID" ;
VAL_ 154 OBJ_Is_VeryClose_V_32 1 "VALID" 0 "INVALID" ;
VAL_ 154 OBJ_Is_VeryClose_32 1 "TRUE" 0 "FALSE" ;
VAL_ 154 OBJ_OverlapAngleEgoLaneR_V_32 1 "VALID" 0 "INVALID" ;
VAL_ 154 OBJ_OverlapAngleEgoLaneL_V_32 1 "VALID" 0 "INVALID" ;
VAL_ 154 OBJ_Is_EMERGENCY_VCL_32 1 "TRUE" 0 "FALSE" ;
VAL_ 154 OBJ_EMERGENCY_LIGHT_COLOR_32 3 "(1000)ORANGE" 2 "(0100)BLUE" 1 "(0010)RED" 0 "(0001)OTHER" ;
VAL_ 154 OBJ_EMERGENCY_V_32 1 "TRUE" 0 "FALSE" ;
VAL_ 154 OBJ_Angle_Top_V_32 1 "VALID" 0 "INVALID" ;
VAL_ 154 OBJ_Angle_Top_STD_V_32 1 "VALID" 0 "INVALID" ;
VAL_ 154 OBJ_Open_Door_Left_32 1 "TRUE" 0 "FALSE" ;
VAL_ 154 OBJ_Open_Door_Right_32 1 "TRUE" 0 "FALSE" ;
VAL_ 154 OBJ_Visible_Left_or_Right_32 2 "RIGHT" 1 "LEFT" 0 "NOT_VISIBLE" ;
VAL_ 154 OBJ_Visible_Left_or_Right_V_32 1 "VALID" 0 "INVALID" ;
VAL_ 154 OBJ_Fusion_Source_33 2 "(BIT_2)RADAR2" 1 "(BIT_1)RADAR1" 0 "(BIT_0)CAMERA" ;
VAL_ 154 OBJ_Triggered_SDM_33 2 "NOT_TRIGGERED" 1 "TRIGGERED" 0 "NOT_AVAILABLE" ;
VAL_ 154 OBJ_Motion_Category_33 13 "ONCOMING" 12 "PRECEEDING" 11 "MOVING" 10 "RTAP" 9 "LTAP" 8 "CROSSING" 7 "MOVING_OUT" 6 "MOVING_IN" 5 "CLOSE_CUT_IN" 4 "PASSING_OUT" 3 "PASSING_IN" 2 "PASSING" 1 "UNDEFINED" 0 "UNFILLED" ;
VAL_ 154 OBJ_Measuring_Status_33 2 "(BIT_2)NOT_VALID_OR_VALID" 1 "(BIT_1)PREDICTED_OR_MEASURED" 0 "(BIT_0)OLD_OR_NEW" ;
VAL_ 154 OBJ_Object_Class_33 9 "TWO_WHEELER" 8 "UNCERTAIN_VCL" 7 "ANIMAL" 6 "GENERAL_OBJECT" 5 "PEDESTRIAN" 4 "BICYCLE" 3 "MOTORBIKE" 2 "TRUCK" 1 "CAR" 0 "UNFILLED" ;
VAL_ 154 OBJ_Camera_Source_33 11 "PARKING_RIGHT" 10 "PARKING_LEFT" 9 "PARKING_REAR" 8 "PARKING_FRONT" 7 "FRONT_CORNER_RIGHT" 6 "FRONT_CORNER_LEFT" 5 "REAR_CORNER_RIGHT" 4 "REAR_CORNER_LEFT" 3 "REAR" 2 "FRONT_FISHEYE" 1 "FRONT_NARROW" 0 "FRONT_MAIN" ;
VAL_ 154 OBJ_Motion_Status_33 5 "MOVING_SLOWLY" 4 "STOPPED" 3 "STATIONARY" 2 "MOVING" 1 "UNKNOWN" 0 "INVALID" ;
VAL_ 154 OBJ_Motion_Orientation_33 13 "INVALID" 12 "NORTH" 11 "NORTH_WEST" 9 "WEST" 7 "SOUTH_WEST" 6 "SOUTH" 5 "SOUTH_EAST" 3 "EAST" 1 "NORTH_EAST" 0 "UNKNOWN" ;
VAL_ 154 OBJ_Has_Cut_Lane_33 1 "TRUE" 0 "FALSE" ;
VAL_ 154 OBJ_Has_Cut_Path_33 1 "TRUE" 0 "FALSE" ;
VAL_ 154 OBJ_Brake_Light_Validity_33 1 "TRUE" 0 "FALSE" ;
VAL_ 154 OBJ_Brake_Light_33 1 "TRUE" 0 "FALSE" ;
VAL_ 154 OBJ_Turn_Indicator_Right_33 1 "TRUE" 0 "FALSE" ;
VAL_ 154 OBJ_Turn_Indicator_Left_33 1 "TRUE" 0 "FALSE" ;
VAL_ 154 OBJ_Turn_Indicator_Validity_33 1 "TRUE" 0 "FALSE" ;
VAL_ 154 OBJ_Right_Out_Of_Image_33 1 "TRUE" 0 "FALSE" ;
VAL_ 154 OBJ_Left_Out_Of_Image_33 1 "TRUE" 0 "FALSE" ;
VAL_ 154 OBJ_Right_Out_Of_Image_V_33 1 "TRUE" 0 "FALSE" ;
VAL_ 154 OBJ_Left_Out_Of_Image_V_33 1 "TRUE" 0 "FALSE" ;
VAL_ 154 OBJ_Top_Out_Of_Image_33 1 "TRUE" 0 "FALSE" ;
VAL_ 154 OBJ_Bottom_Out_Of_Image_33 1 "TRUE" 0 "FALSE" ;
VAL_ 154 OBJ_Top_Out_Of_Image_V_33 1 "VALID" 0 "INVALID" ;
VAL_ 154 OBJ_Bottom_Out_Of_Image_V_33 1 "VALID" 0 "INVALID" ;
VAL_ 154 OBJ_Lane_Assignment_33 5 "RIGHT_RIGHT" 4 "RIGHT" 3 "HOST" 2 "LEFT" 1 "LEFT_LEFT" 0 "UNKNOWN" ;
VAL_ 154 OBJ_Lane_Assignment_V_33 1 "VALID" 0 "INVALID" ;
VAL_ 154 OBJ_Age_Seconds_V_33 1 "VALID" 0 "INVALID" ;
VAL_ 154 OBJ_Width_V_33 1 "VALID" 0 "INVALID" ;
VAL_ 154 OBJ_Width_STD_V_33 1 "VALID" 0 "INVALID" ;
VAL_ 154 OBJ_Length_V_33 1 "VALID" 0 "INVALID" ;
VAL_ 154 OBJ_Length_STD_V_33 1 "VALID" 0 "INVALID" ;
VAL_ 154 OBJ_Height_V_33 1 "VALID" 0 "INVALID" ;
VAL_ 154 OBJ_Height_STD_V_33 1 "VALID" 0 "INVALID" ;
VAL_ 154 OBJ_Abs_Long_Velocity_V_33 1 "VALID" 0 "INVALID" ;
VAL_ 154 OBJ_Abs_Long_Vel_STD_V_33 1 "VALID" 0 "INVALID" ;
VAL_ 154 OBJ_Abs_Lat_Velocity_V_33 1 "VALID" 0 "INVALID" ;
VAL_ 154 OBJ_Abs_Lat_Vel_STD_V_33 1 "VALID" 0 "INVALID" ;
VAL_ 154 OBJ_Abs_Long_Acc_V_33 1 "VALID" 0 "INVALID" ;
VAL_ 154 OBJ_Abs_Long_Acc_STD_V_33 1 "VALID" 0 "INVALID" ;
VAL_ 154 OBJ_Abs_Lat_Acc_V_33 1 "VALID" 0 "INVALID" ;
VAL_ 154 OBJ_Abs_Lat_Acc_STD_V_33 1 "VALID" 0 "INVALID" ;
VAL_ 154 OBJ_Abs_Acceleration_V_33 1 "VALID" 0 "INVALID" ;
VAL_ 154 OBJ_Abs_Acc_STD_V_33 1 "VALID" 0 "INVALID" ;
VAL_ 154 OBJ_Inv_TTC_V_33 1 "VALID" 0 "INVALID" ;
VAL_ 154 OBJ_Inv_TTC_STD_V_33 1 "VALID" 0 "INVALID" ;
VAL_ 154 OBJ_Relative_Long_Acc_V_33 1 "VALID" 0 "INVALID" ;
VAL_ 154 OBJ_Rel_Long_Acc_STD_V_33 1 "VALID" 0 "INVALID" ;
VAL_ 154 OBJ_Relative_Long_Velocity_V_33 1 "VALID" 0 "INVALID" ;
VAL_ 154 OBJ_Rel_Long_Vel_STD_V_33 1 "VALID" 0 "INVALID" ;
VAL_ 154 OBJ_Relative_Lat_Velocity_V_33 1 "VALID" 0 "INVALID" ;
VAL_ 154 OBJ_Rel_Lat_Vel_STD_V_33 1 "VALID" 0 "INVALID" ;
VAL_ 154 OBJ_Long_Distance_V_33 1 "VALID" 0 "INVALID" ;
VAL_ 154 OBJ_Long_Distance_STD_V_33 1 "VALID" 0 "INVALID" ;
VAL_ 154 OBJ_Lat_Distance_V_33 1 "VALID" 0 "INVALID" ;
VAL_ 154 OBJ_Lat_Distance_STD_V_33 1 "VALID" 0 "INVALID" ;
VAL_ 154 OBJ_Absolute_Speed_V_33 1 "VALID" 0 "INVALID" ;
VAL_ 154 OBJ_Absolute_Speed_STD_V_33 1 "VALID" 0 "INVALID" ;
VAL_ 154 OBJ_Heading_V_33 1 "VALID" 0 "INVALID" ;
VAL_ 154 OBJ_Heading_STD_V_33 1 "VALID" 0 "INVALID" ;
VAL_ 154 OBJ_Angle_Rate_STD_V_33 1 "VALID" 0 "INVALID" ;
VAL_ 154 OBJ_Angle_Rate_V_33 1 "VALID" 0 "INVALID" ;
VAL_ 154 OBJ_Angle_Right_V_33 1 "VALID" 0 "INVALID" ;
VAL_ 154 OBJ_Angle_Right_STD_V_33 1 "VALID" 0 "INVALID" ;
VAL_ 154 OBJ_Angle_Left_V_33 1 "VALID" 0 "INVALID" ;
VAL_ 154 OBJ_Angle_Left_STD_V_33 1 "VALID" 0 "INVALID" ;
VAL_ 154 OBJ_Angle_Side_V_33 1 "VALID" 0 "INVALID" ;
VAL_ 154 OBJ_Angle_Side_STD_V_33 1 "VALID" 0 "INVALID" ;
VAL_ 154 OBJ_Angle_Mid_V_33 1 "VALID" 0 "INVALID" ;
VAL_ 154 OBJ_Angle_Mid_STD_V_33 1 "VALID" 0 "INVALID" ;
VAL_ 154 OBJ_Angle_Bottom_V_33 1 "VALID" 0 "INVALID" ;
VAL_ 154 OBJ_Angle_Bottom_STD_V_33 1 "VALID" 0 "INVALID" ;
VAL_ 154 OBJ_Visibility_Side_V_33 1 "VALID" 0 "INVALID" ;
VAL_ 154 OBJ_Visibility_Side_33 2 "REAR" 1 "FRONT" 0 "NOT_VISIBLE" ;
VAL_ 154 OBJ_Is_In_Drivable_Area_33 1 "TRUE" 0 "FALSE" ;
VAL_ 154 OBJ_Is_In_Drivable_Area_V_33 1 "VALID" 0 "INVALID" ;
VAL_ 154 OBJ_Is_VeryClose_V_33 1 "VALID" 0 "INVALID" ;
VAL_ 154 OBJ_Is_VeryClose_33 1 "TRUE" 0 "FALSE" ;
VAL_ 154 OBJ_OverlapAngleEgoLaneR_V_33 1 "VALID" 0 "INVALID" ;
VAL_ 154 OBJ_OverlapAngleEgoLaneL_V_33 1 "VALID" 0 "INVALID" ;
VAL_ 154 OBJ_Is_EMERGENCY_VCL_33 1 "TRUE" 0 "FALSE" ;
VAL_ 154 OBJ_EMERGENCY_LIGHT_COLOR_33 3 "(1000)ORANGE" 2 "(0100)BLUE" 1 "(0010)RED" 0 "(0001)OTHER" ;
VAL_ 154 OBJ_EMERGENCY_V_33 1 "TRUE" 0 "FALSE" ;
VAL_ 154 OBJ_Angle_Top_V_33 1 "VALID" 0 "INVALID" ;
VAL_ 154 OBJ_Angle_Top_STD_V_33 1 "VALID" 0 "INVALID" ;
VAL_ 154 OBJ_Open_Door_Left_33 1 "TRUE" 0 "FALSE" ;
VAL_ 154 OBJ_Open_Door_Right_33 1 "TRUE" 0 "FALSE" ;
VAL_ 154 OBJ_Visible_Left_or_Right_33 2 "RIGHT" 1 "LEFT" 0 "NOT_VISIBLE" ;
VAL_ 154 OBJ_Visible_Left_or_Right_V_33 1 "VALID" 0 "INVALID" ;
VAL_ 154 OBJ_Fusion_Source_34 2 "(BIT_2)RADAR2" 1 "(BIT_1)RADAR1" 0 "(BIT_0)CAMERA" ;
VAL_ 154 OBJ_Triggered_SDM_34 2 "NOT_TRIGGERED" 1 "TRIGGERED" 0 "NOT_AVAILABLE" ;
VAL_ 154 OBJ_Motion_Category_34 13 "ONCOMING" 12 "PRECEEDING" 11 "MOVING" 10 "RTAP" 9 "LTAP" 8 "CROSSING" 7 "MOVING_OUT" 6 "MOVING_IN" 5 "CLOSE_CUT_IN" 4 "PASSING_OUT" 3 "PASSING_IN" 2 "PASSING" 1 "UNDEFINED" 0 "UNFILLED" ;
VAL_ 154 OBJ_Measuring_Status_34 2 "(BIT_2)NOT_VALID_OR_VALID" 1 "(BIT_1)PREDICTED_OR_MEASURED" 0 "(BIT_0)OLD_OR_NEW" ;
VAL_ 154 OBJ_Object_Class_34 9 "TWO_WHEELER" 8 "UNCERTAIN_VCL" 7 "ANIMAL" 6 "GENERAL_OBJECT" 5 "PEDESTRIAN" 4 "BICYCLE" 3 "MOTORBIKE" 2 "TRUCK" 1 "CAR" 0 "UNFILLED" ;
VAL_ 154 OBJ_Camera_Source_34 11 "PARKING_RIGHT" 10 "PARKING_LEFT" 9 "PARKING_REAR" 8 "PARKING_FRONT" 7 "FRONT_CORNER_RIGHT" 6 "FRONT_CORNER_LEFT" 5 "REAR_CORNER_RIGHT" 4 "REAR_CORNER_LEFT" 3 "REAR" 2 "FRONT_FISHEYE" 1 "FRONT_NARROW" 0 "FRONT_MAIN" ;
VAL_ 154 OBJ_Motion_Status_34 5 "MOVING_SLOWLY" 4 "STOPPED" 3 "STATIONARY" 2 "MOVING" 1 "UNKNOWN" 0 "INVALID" ;
VAL_ 154 OBJ_Motion_Orientation_34 13 "INVALID" 12 "NORTH" 11 "NORTH_WEST" 9 "WEST" 7 "SOUTH_WEST" 6 "SOUTH" 5 "SOUTH_EAST" 3 "EAST" 1 "NORTH_EAST" 0 "UNKNOWN" ;
VAL_ 154 OBJ_Has_Cut_Lane_34 1 "TRUE" 0 "FALSE" ;
VAL_ 154 OBJ_Has_Cut_Path_34 1 "TRUE" 0 "FALSE" ;
VAL_ 154 OBJ_Brake_Light_Validity_34 1 "TRUE" 0 "FALSE" ;
VAL_ 154 OBJ_Brake_Light_34 1 "TRUE" 0 "FALSE" ;
VAL_ 154 OBJ_Turn_Indicator_Right_34 1 "TRUE" 0 "FALSE" ;
VAL_ 154 OBJ_Turn_Indicator_Left_34 1 "TRUE" 0 "FALSE" ;
VAL_ 154 OBJ_Turn_Indicator_Validity_34 1 "TRUE" 0 "FALSE" ;
VAL_ 154 OBJ_Right_Out_Of_Image_34 1 "TRUE" 0 "FALSE" ;
VAL_ 154 OBJ_Left_Out_Of_Image_34 1 "TRUE" 0 "FALSE" ;
VAL_ 154 OBJ_Right_Out_Of_Image_V_34 1 "TRUE" 0 "FALSE" ;
VAL_ 154 OBJ_Left_Out_Of_Image_V_34 1 "TRUE" 0 "FALSE" ;
VAL_ 154 OBJ_Top_Out_Of_Image_34 1 "TRUE" 0 "FALSE" ;
VAL_ 154 OBJ_Bottom_Out_Of_Image_34 1 "TRUE" 0 "FALSE" ;
VAL_ 154 OBJ_Top_Out_Of_Image_V_34 1 "VALID" 0 "INVALID" ;
VAL_ 154 OBJ_Bottom_Out_Of_Image_V_34 1 "VALID" 0 "INVALID" ;
VAL_ 154 OBJ_Lane_Assignment_34 5 "RIGHT_RIGHT" 4 "RIGHT" 3 "HOST" 2 "LEFT" 1 "LEFT_LEFT" 0 "UNKNOWN" ;
VAL_ 154 OBJ_Lane_Assignment_V_34 1 "VALID" 0 "INVALID" ;
VAL_ 154 OBJ_Age_Seconds_V_34 1 "VALID" 0 "INVALID" ;
VAL_ 154 OBJ_Width_V_34 1 "VALID" 0 "INVALID" ;
VAL_ 154 OBJ_Width_STD_V_34 1 "VALID" 0 "INVALID" ;
VAL_ 154 OBJ_Length_V_34 1 "VALID" 0 "INVALID" ;
VAL_ 154 OBJ_Length_STD_V_34 1 "VALID" 0 "INVALID" ;
VAL_ 154 OBJ_Height_V_34 1 "VALID" 0 "INVALID" ;
VAL_ 154 OBJ_Height_STD_V_34 1 "VALID" 0 "INVALID" ;
VAL_ 154 OBJ_Abs_Long_Velocity_V_34 1 "VALID" 0 "INVALID" ;
