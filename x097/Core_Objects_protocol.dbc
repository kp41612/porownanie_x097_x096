VERSION "15"
// BundelVersion=v4.21.5_CF1
NS_ :

BS_:

BU_: EyeQ4 MCU

BO_ 154 Core_Objects_protocol: 4820 EyeQ4
 SG_ OBJ_Abs_Long_Velocity_STD_34 : 33069|13@1+ (0.01,0) [0|65] "m_per_s" MCU
 SG_ OBJ_Abs_Long_Vel_STD_V_34 : 33082|1@1+ (1,0) [0|1] "bool" MCU
 SG_ Reserved_9_34 : 33083|5@1+ (1,0) [0|0] "NA" MCU
 SG_ OBJ_Abs_Lat_Velocity_34 : 33088|11@1+ (0.05,-50) [-50|50] "m_per_s" MCU
 SG_ OBJ_Abs_Lat_Velocity_V_34 : 33099|1@1+ (1,0) [0|1] "bool" MCU
 SG_ OBJ_Abs_Lat_Velocity_STD_34 : 33100|13@1+ (0.01,0) [0|50] "m_per_s" MCU
 SG_ OBJ_Abs_Lat_Vel_STD_V_34 : 33113|1@1+ (1,0) [0|1] "bool" MCU
 SG_ Reserved_10_34 : 33114|6@1+ (1,0) [0|0] "NA" MCU
 SG_ OBJ_Abs_Long_Acc_34 : 33120|9@1+ (0.05,-10) [-10|10] "m_per_s2" MCU
 SG_ OBJ_Abs_Long_Acc_V_34 : 33129|1@1+ (1,0) [0|1] "bool" MCU
 SG_ OBJ_Abs_Long_Acc_STD_34 : 33130|10@1+ (0.01,0) [0|7.3] "m_per_s2" MCU
 SG_ OBJ_Abs_Long_Acc_STD_V_34 : 33140|1@1+ (1,0) [0|1] "bool" MCU
 SG_ OBJ_Abs_Lat_Acc_34 : 33141|9@1+ (0.05,-10) [-10|10] "m_per_s2" MCU
 SG_ OBJ_Abs_Lat_Acc_V_34 : 33150|1@1+ (1,0) [0|1] "bool" MCU
 SG_ Reserved_11_34 : 33151|1@1+ (1,0) [0|0] "NA" MCU
 SG_ OBJ_Abs_Lat_Acc_STD_34 : 33152|10@1+ (0.01,0) [0|7.3] "m_per_s2" MCU
 SG_ OBJ_Abs_Lat_Acc_STD_V_34 : 33162|1@1+ (1,0) [0|1] "bool" MCU
 SG_ OBJ_Abs_Acceleration_34 : 33163|9@1+ (0.05,-12.7) [-12.7|12.7] "m_per_s2" MCU
 SG_ OBJ_Abs_Acceleration_V_34 : 33172|1@1+ (1,0) [0|1] "bool" MCU
 SG_ OBJ_Abs_Acc_STD_34 : 33173|10@1+ (0.01,0) [0|7.3] "m_per_s2" MCU
 SG_ OBJ_Abs_Acc_STD_V_34 : 33183|1@1+ (1,0) [0|1] "bool" MCU
 SG_ OBJ_Inv_TTC_34 : 33184|11@1+ (0.01,-8) [-8|8] "INV(s)" MCU
 SG_ OBJ_Inv_TTC_V_34 : 33195|1@1+ (1,0) [0|1] "bool" MCU
 SG_ OBJ_Inv_TTC_STD_34 : 33196|12@1+ (0.001,0) [0|4] "INV(s)" MCU
 SG_ OBJ_Inv_TTC_STD_V_34 : 33208|1@1+ (1,0) [0|1] "bool" MCU
 SG_ Reserved_12_34 : 33209|7@1+ (1,0) [0|0] "NA" MCU
 SG_ OBJ_Relative_Long_Acc_34 : 33216|10@1+ (0.05,-20) [-20|20] "m_per_s2" MCU
 SG_ OBJ_Relative_Long_Acc_V_34 : 33226|1@1+ (1,0) [0|1] "bool" MCU
 SG_ OBJ_Relative_Long_Acc_STD_34 : 33227|10@1+ (0.01,0) [0|7.3] "m_per_s2" MCU
 SG_ OBJ_Rel_Long_Acc_STD_V_34 : 33237|1@1+ (1,0) [0|1] "bool" MCU
 SG_ Reserved_13_34 : 33238|10@1+ (1,0) [0|0] "NA" MCU
 SG_ OBJ_Relative_Long_Velocity_34 : 33248|13@1+ (0.05,-120) [-120|130] "m_per_s" MCU
 SG_ OBJ_Relative_Long_Velocity_V_34 : 33261|1@1+ (1,0) [0|1] "bool" MCU
 SG_ OBJ_Relative_Long_Vel_STD_34 : 33262|14@1+ (0.01,0) [0|130] "m_per_s" MCU
 SG_ OBJ_Rel_Long_Vel_STD_V_34 : 33276|1@1+ (1,0) [0|1] "bool" MCU
 SG_ Reserved_14_34 : 33277|3@1+ (1,0) [0|0] "NA" MCU
 SG_ OBJ_Relative_Lat_Velocity_34 : 33280|11@1+ (0.05,-50) [-50|50] "m_per_s" MCU
 SG_ OBJ_Relative_Lat_Velocity_V_34 : 33291|1@1+ (1,0) [0|1] "bool" MCU
 SG_ OBJ_Relative_Lat_Velocity_STD_34 : 33292|13@1+ (0.01,0) [0|50] "m_per_s" MCU
 SG_ OBJ_Rel_Lat_Vel_STD_V_34 : 33305|1@1+ (1,0) [0|1] "bool" MCU
 SG_ Reserved_15_34 : 33306|6@1+ (1,0) [0|0] "NA" MCU
 SG_ OBJ_Long_Distance_34 : 33312|14@1+ (0.05,-200) [-200|500] "m" MCU
 SG_ OBJ_Long_Distance_V_34 : 33326|1@1+ (1,0) [0|1] "bool" MCU
 SG_ OBJ_Long_Distance_STD_34 : 33327|15@1+ (0.01,0) [0|250] "m" MCU
 SG_ OBJ_Long_Distance_STD_V_34 : 33342|1@1+ (1,0) [0|1] "bool" MCU
 SG_ Reserved_16_34 : 33343|1@1+ (1,0) [0|0] "NA" MCU
 SG_ OBJ_Lat_Distance_34 : 33344|12@1+ (0.05,-100) [-100|100] "m" MCU
 SG_ OBJ_Lat_Distance_V_34 : 33356|1@1+ (1,0) [0|1] "bool" MCU
 SG_ OBJ_Lat_Distance_STD_34 : 33357|14@1+ (0.01,0) [0|100] "m" MCU
 SG_ OBJ_Lat_Distance_STD_V_34 : 33371|1@1+ (1,0) [0|1] "bool" MCU
 SG_ Reserved_17_34 : 33372|4@1+ (1,0) [0|0] "NA" MCU
 SG_ OBJ_Absolute_Speed_34 : 33376|12@1+ (0.05,-65) [-65|65] "m_per_s" MCU
 SG_ OBJ_Absolute_Speed_V_34 : 33388|1@1+ (1,0) [0|1] "bool" MCU
 SG_ OBJ_Absolute_Speed_STD_34 : 33389|13@1+ (0.01,0) [0|65] "m_per_s" MCU
 SG_ OBJ_Absolute_Speed_STD_V_34 : 33402|1@1+ (1,0) [0|1] "bool" MCU
 SG_ Reserved_18_34 : 33403|5@1+ (1,0) [0|0] "NA" MCU
 SG_ OBJ_Heading_34 : 33408|10@1+ (0.01,-3.14) [-3.14|3.14] "rad" MCU
 SG_ OBJ_Heading_V_34 : 33418|1@1+ (1,0) [0|1] "bool" MCU
 SG_ OBJ_Heading_STD_34 : 33419|15@1+ (0.0001,0) [0|3.14] "rad" MCU
 SG_ OBJ_Heading_STD_V_34 : 33434|1@1+ (1,0) [0|1] "bool" MCU
 SG_ Reserved_19_34 : 33435|5@1+ (1,0) [0|0] "NA" MCU
 SG_ OBJ_Angle_Rate_STD_34 : 33440|15@1+ (0.0001,0) [0|2.2318] "RPS" MCU
 SG_ OBJ_Angle_Rate_STD_V_34 : 33455|1@1+ (1,0) [0|1] "bool" MCU
 SG_ OBJ_Angle_Rate_34 : 33456|12@1+ (0.002,-2.234) [-2.234|2.2318] "RPS" MCU
 SG_ OBJ_Angle_Rate_V_34 : 33468|1@1+ (1,0) [0|1] "bool" MCU
 SG_ Reserved_20_34 : 33469|3@1+ (1,0) [0|0] "NA" MCU
 SG_ OBJ_Angle_Right_34 : 33472|14@1+ (0.0002,-1.571) [-1.571|1.571] "rad" MCU
 SG_ OBJ_Angle_Right_V_34 : 33486|1@1+ (1,0) [0|1] "bool" MCU
 SG_ OBJ_Angle_Right_STD_34 : 33487|14@1+ (0.0001,0) [0|1.571] "rad" MCU
 SG_ OBJ_Angle_Right_STD_V_34 : 33501|1@1+ (1,0) [0|1] "bool" MCU
 SG_ Reserved_21_34 : 33502|2@1+ (1,0) [0|0] "NA" MCU
 SG_ OBJ_Angle_Left_34 : 33504|14@1+ (0.0002,-1.571) [-1.571|1.571] "rad" MCU
 SG_ OBJ_Angle_Left_V_34 : 33518|1@1+ (1,0) [0|1] "bool" MCU
 SG_ OBJ_Angle_Left_STD_34 : 33519|14@1+ (0.0001,0) [0|1.571] "rad" MCU
 SG_ OBJ_Angle_Left_STD_V_34 : 33533|1@1+ (1,0) [0|1] "bool" MCU
 SG_ Reserved_22_34 : 33534|2@1+ (1,0) [0|0] "NA" MCU
 SG_ OBJ_Angle_Side_34 : 33536|14@1+ (0.0002,-1.571) [-1.571|1.571] "rad" MCU
 SG_ OBJ_Angle_Side_V_34 : 33550|1@1+ (1,0) [0|1] "bool" MCU
 SG_ OBJ_Angle_Side_STD_34 : 33551|14@1+ (0.0001,0) [0|1.571] "rad" MCU
 SG_ OBJ_Angle_Side_STD_V_34 : 33565|1@1+ (1,0) [0|1] "bool" MCU
 SG_ OBJ_Angle_Mid_V_34 : 33566|1@1+ (1,0) [0|1] "bool" MCU
 SG_ Reserved_23_34 : 33567|1@1+ (1,0) [0|0] "NA" MCU
 SG_ OBJ_Angle_Mid_34 : 33568|14@1+ (0.0002,-1.571) [-1.571|1.571] "rad" MCU
 SG_ OBJ_Angle_Mid_STD_34 : 33582|14@1+ (0.0001,0) [0|1.571] "rad" MCU
 SG_ OBJ_Angle_Mid_STD_V_34 : 33596|1@1+ (1,0) [0|1] "bool" MCU
 SG_ OBJ_Angle_Bottom_V_34 : 33597|1@1+ (1,0) [0|1] "bool" MCU
 SG_ Reserved_24_34 : 33598|2@1+ (1,0) [0|0] "NA" MCU
 SG_ OBJ_Angle_Bottom_34 : 33600|14@1+ (0.0002,-1.571) [-1.571|1.571] "rad" MCU
 SG_ OBJ_Angle_Bottom_STD_34 : 33614|14@1+ (0.0001,0) [0|1.571] "rad" MCU
 SG_ OBJ_Angle_Bottom_STD_V_34 : 33628|1@1+ (1,0) [0|1] "bool" MCU
 SG_ OBJ_Visibility_Side_V_34 : 33629|1@1+ (1,0) [0|1] "bool" MCU
 SG_ OBJ_Visibility_Side_34 : 33630|2@1+ (1,0) [0|2] "ENUM" MCU
 SG_ OBJ_Is_In_Drivable_Area_34 : 33632|1@1+ (1,0) [0|1] "bool" MCU
 SG_ OBJ_Is_In_Drivable_Area_V_34 : 33633|1@1+ (1,0) [0|1] "bool" MCU
 SG_ OBJ_Is_VeryClose_V_34 : 33634|1@1+ (1,0) [0|1] "bool" MCU
 SG_ OBJ_Is_VeryClose_34 : 33635|1@1+ (1,0) [0|1] "bool" MCU
 SG_ OBJ_Buffer_C4_34 : 33636|2@1+ (1,0) [0|2] "NA" MCU
 SG_ OBJ_Buffer_C5_34 : 33638|2@1+ (1,0) [0|2] "NA" MCU
 SG_ OBJ_Buffer_C6_34 : 33640|2@1+ (1,0) [0|2] "NA" MCU
 SG_ OBJ_Buffer_C7_34 : 33642|2@1+ (1,0) [0|2] "NA" MCU
 SG_ OBJ_OverlapAngleEgoLaneR_34 : 33644|10@1+ (0.01,-3.14) [-3.14|3.14] "rad" MCU
 SG_ OBJ_OverlapAngleEgoLaneR_V_34 : 33654|1@1+ (1,0) [0|1] "bool" MCU
 SG_ Reserved_25_34 : 33655|9@1+ (1,0) [0|0] "NA" MCU
 SG_ OBJ_OverlapAngleEgoLaneL_34 : 33664|10@1+ (0.01,-3.14) [-3.14|3.14] "rad" MCU
 SG_ OBJ_OverlapAngleEgoLaneL_V_34 : 33674|1@1+ (1,0) [0|1] "bool" MCU
 SG_ OBJ_Is_EMERGENCY_VCL_34 : 33675|1@1+ (1,0) [0|1] "bool" MCU
 SG_ OBJ_EMERGENCY_LIGHT_COLOR_34 : 33676|4@1+ (1,0) [0|15] "BITWIZE" MCU
 SG_ OBJ_EMERGENCY_V_34 : 33680|1@1+ (1,0) [0|1] "bool" MCU
 SG_ OBJ_Angle_Top_34 : 33681|14@1+ (0.0002,0) [0|3.1415] "rad" MCU
 SG_ OBJ_Angle_Top_V_34 : 33695|1@1+ (1,0) [0|1] "bool" MCU
 SG_ OBJ_Angle_Top_STD_34 : 33696|15@1+ (0.0001,0) [0|3.1415] "rad" MCU
 SG_ OBJ_Angle_Top_STD_V_34 : 33711|1@1+ (1,0) [0|1] "bool" MCU
 SG_ OBJ_Open_Door_Left_34 : 33712|1@1+ (1,0) [0|1] "bool" MCU
 SG_ OBJ_Open_Door_Right_34 : 33713|1@1+ (1,0) [0|1] "bool" MCU
 SG_ OBJ_Visible_Left_or_Right_34 : 33714|2@1+ (1,0) [0|2] "ENUM" MCU
 SG_ OBJ_Visible_Left_or_Right_V_34 : 33716|1@1+ (1,0) [0|1] "bool" MCU
 SG_ OBJ_2W_Is_Motorbike_Probability_34 : 33717|8@1+ (0.01,0) [0|1] "NA" MCU
 SG_ Reserved_26_34 : 33725|3@1+ (1,0) [0|0] "NA" MCU
 SG_ OBJ_2W_Is_Bicycle_Probability_34 : 33728|8@1+ (0.01,0) [0|1] "NA" MCU
 SG_ Reserved_27_34 : 33736|24@1+ (1,0) [0|0] "NA" MCU
 SG_ OBJ_CRC_35 : 33760|32@1+ (1,0) [0|4294967295] "NA" MCU
 SG_ OBJ_ID_35 : 33792|8@1+ (1,0) [0|255] "counter" MCU
 SG_ OBJ_Existence_Probability_35 : 33800|8@1+ (0.01,0) [0|1] "NA" MCU
 SG_ OBJ_Fusion_Source_35 : 33808|16@1+ (1,0) [0|65535] "BITWIZE" MCU
 SG_ OBJ_Triggered_SDM_35 : 33824|2@1+ (1,0) [0|2] "ENUM" MCU
 SG_ OBJ_Motion_Category_35 : 33826|4@1+ (1,0) [0|13] "ENUM" MCU
 SG_ OBJ_Moving_IN_Probability_35 : 33830|7@1+ (0.01,0) [0|1] "NA" MCU
 SG_ OBJ_Object_Age_35 : 33837|11@1+ (1,0) [0|2047] "frames" MCU
 SG_ OBJ_Measuring_Status_35 : 33848|3@1+ (1,0) [0|7] "BITWIZE" MCU
 SG_ OBJ_Object_Class_35 : 33851|4@1+ (1,0) [0|9] "ENUM" MCU
 SG_ Reserved_4_35 : 33855|1@1+ (1,0) [0|0] "NA" MCU
 SG_ OBJ_Class_Probability_35 : 33856|7@1+ (0.01,0) [0|1] "NA" MCU
 SG_ OBJ_Car_Probability_35 : 33863|7@1+ (0.01,0) [0|1] "NA" MCU
 SG_ OBJ_Truck_Probability_35 : 33870|7@1+ (0.01,0) [0|1] "NA" MCU
 SG_ OBJ_Bike_Probability_35 : 33877|7@1+ (0.01,0) [0|1] "NA" MCU
 SG_ OBJ_Camera_Source_35 : 33884|4@1+ (1,0) [0|15] "ENUM" MCU
 SG_ OBJ_Motion_Status_35 : 33888|3@1+ (1,0) [0|5] "ENUM" MCU
 SG_ OBJ_Motion_Orientation_35 : 33891|4@1+ (1,0) [0|13] "ENUM" MCU
 SG_ OBJ_Has_Cut_Lane_35 : 33895|1@1+ (1,0) [0|1] "bool" MCU
 SG_ OBJ_Has_Cut_Path_35 : 33896|1@1+ (1,0) [0|1] "bool" MCU
 SG_ OBJ_Brake_Light_Validity_35 : 33897|1@1+ (1,0) [0|1] "bool" MCU
 SG_ OBJ_Brake_Light_35 : 33898|1@1+ (1,0) [0|1] "bool" MCU
 SG_ OBJ_Turn_Indicator_Right_35 : 33899|1@1+ (1,0) [0|1] "bool" MCU
 SG_ OBJ_Turn_Indicator_Left_35 : 33900|1@1+ (1,0) [0|1] "bool" MCU
 SG_ OBJ_Turn_Indicator_Validity_35 : 33901|1@1+ (1,0) [0|1] "bool" MCU
 SG_ OBJ_Right_Out_Of_Image_35 : 33902|1@1+ (1,0) [0|1] "bool" MCU
 SG_ OBJ_Left_Out_Of_Image_35 : 33903|1@1+ (1,0) [0|1] "bool" MCU
 SG_ OBJ_Right_Out_Of_Image_V_35 : 33904|1@1+ (1,0) [0|1] "bool" MCU
 SG_ OBJ_Left_Out_Of_Image_V_35 : 33905|1@1+ (1,0) [0|1] "bool" MCU
 SG_ OBJ_Top_Out_Of_Image_35 : 33906|1@1+ (1,0) [0|1] "bool" MCU
 SG_ OBJ_Bottom_Out_Of_Image_35 : 33907|1@1+ (1,0) [0|1] "bool" MCU
 SG_ OBJ_Top_Out_Of_Image_V_35 : 33908|1@1+ (1,0) [0|1] "bool" MCU
 SG_ OBJ_Bottom_Out_Of_Image_V_35 : 33909|1@1+ (1,0) [0|1] "bool" MCU
 SG_ OBJ_Lane_Assignment_35 : 33910|3@1+ (1,0) [0|5] "ENUM" MCU
 SG_ OBJ_Lane_Assignment_V_35 : 33913|1@1+ (1,0) [0|1] "bool" MCU
 SG_ Reserved_5_35 : 33914|6@1+ (1,0) [0|0] "NA" MCU
 SG_ OBJ_Age_Seconds_35 : 33920|7@1+ (1,0) [0|100] "s" MCU
 SG_ OBJ_Age_Seconds_V_35 : 33927|1@1+ (1,0) [0|1] "bool" MCU
 SG_ OBJ_Width_35 : 33928|9@1+ (0.01,0) [0.4|2.95] "m" MCU
 SG_ OBJ_Width_V_35 : 33937|1@1+ (1,0) [0|1] "bool" MCU
 SG_ OBJ_Width_STD_35 : 33938|11@1+ (0.001,0) [0|2] "m" MCU
 SG_ OBJ_Width_STD_V_35 : 33949|1@1+ (1,0) [0|1] "bool" MCU
 SG_ Reserved_6_35 : 33950|2@1+ (1,0) [0|0] "NA" MCU
 SG_ OBJ_Length_35 : 33952|9@1+ (0.05,0) [0.6|21] "m" MCU
 SG_ OBJ_Length_V_35 : 33961|1@1+ (1,0) [0|1] "bool" MCU
 SG_ OBJ_Length_STD_35 : 33962|10@1+ (0.01,0) [0|10] "m" MCU
 SG_ OBJ_Length_STD_V_35 : 33972|1@1+ (1,0) [0|1] "bool" MCU
 SG_ OBJ_Radar_ID_35 : 33973|8@1+ (1,0) [0|255] "counter" MCU
 SG_ Reserved_7_35 : 33981|3@1+ (1,0) [0|0] "NA" MCU
 SG_ OBJ_Height_35 : 33984|9@1+ (0.01,0) [0|2.95] "m" MCU
 SG_ OBJ_Height_V_35 : 33993|1@1+ (1,0) [0|1] "bool" MCU
 SG_ OBJ_Height_STD_35 : 33994|11@1+ (0.001,0) [0|2] "m" MCU
 SG_ OBJ_Height_STD_V_35 : 34005|1@1+ (1,0) [0|1] "bool" MCU
 SG_ Reserved_8_35 : 34006|10@1+ (1,0) [0|0] "NA" MCU
 SG_ OBJ_Abs_Long_Velocity_35 : 34016|12@1+ (0.05,-100) [-100|100] "m_per_s" MCU
 SG_ OBJ_Abs_Long_Velocity_V_35 : 34028|1@1+ (1,0) [0|1] "bool" MCU
 SG_ OBJ_Abs_Long_Velocity_STD_35 : 34029|13@1+ (0.01,0) [0|65] "m_per_s" MCU
 SG_ OBJ_Abs_Long_Vel_STD_V_35 : 34042|1@1+ (1,0) [0|1] "bool" MCU
 SG_ Reserved_9_35 : 34043|5@1+ (1,0) [0|0] "NA" MCU
 SG_ OBJ_Abs_Lat_Velocity_35 : 34048|11@1+ (0.05,-50) [-50|50] "m_per_s" MCU
 SG_ OBJ_Abs_Lat_Velocity_V_35 : 34059|1@1+ (1,0) [0|1] "bool" MCU
 SG_ OBJ_Abs_Lat_Velocity_STD_35 : 34060|13@1+ (0.01,0) [0|50] "m_per_s" MCU
 SG_ OBJ_Abs_Lat_Vel_STD_V_35 : 34073|1@1+ (1,0) [0|1] "bool" MCU
 SG_ Reserved_10_35 : 34074|6@1+ (1,0) [0|0] "NA" MCU
 SG_ OBJ_Abs_Long_Acc_35 : 34080|9@1+ (0.05,-10) [-10|10] "m_per_s2" MCU
 SG_ OBJ_Abs_Long_Acc_V_35 : 34089|1@1+ (1,0) [0|1] "bool" MCU
 SG_ OBJ_Abs_Long_Acc_STD_35 : 34090|10@1+ (0.01,0) [0|7.3] "m_per_s2" MCU
 SG_ OBJ_Abs_Long_Acc_STD_V_35 : 34100|1@1+ (1,0) [0|1] "bool" MCU
 SG_ OBJ_Abs_Lat_Acc_35 : 34101|9@1+ (0.05,-10) [-10|10] "m_per_s2" MCU
 SG_ OBJ_Abs_Lat_Acc_V_35 : 34110|1@1+ (1,0) [0|1] "bool" MCU
 SG_ Reserved_11_35 : 34111|1@1+ (1,0) [0|0] "NA" MCU
 SG_ OBJ_Abs_Lat_Acc_STD_35 : 34112|10@1+ (0.01,0) [0|7.3] "m_per_s2" MCU
 SG_ OBJ_Abs_Lat_Acc_STD_V_35 : 34122|1@1+ (1,0) [0|1] "bool" MCU
 SG_ OBJ_Abs_Acceleration_35 : 34123|9@1+ (0.05,-12.7) [-12.7|12.7] "m_per_s2" MCU
 SG_ OBJ_Abs_Acceleration_V_35 : 34132|1@1+ (1,0) [0|1] "bool" MCU
 SG_ OBJ_Abs_Acc_STD_35 : 34133|10@1+ (0.01,0) [0|7.3] "m_per_s2" MCU
 SG_ OBJ_Abs_Acc_STD_V_35 : 34143|1@1+ (1,0) [0|1] "bool" MCU
 SG_ OBJ_Inv_TTC_35 : 34144|11@1+ (0.01,-8) [-8|8] "INV(s)" MCU
 SG_ OBJ_Inv_TTC_V_35 : 34155|1@1+ (1,0) [0|1] "bool" MCU
 SG_ OBJ_Inv_TTC_STD_35 : 34156|12@1+ (0.001,0) [0|4] "INV(s)" MCU
 SG_ OBJ_Inv_TTC_STD_V_35 : 34168|1@1+ (1,0) [0|1] "bool" MCU
 SG_ Reserved_12_35 : 34169|7@1+ (1,0) [0|0] "NA" MCU
 SG_ OBJ_Relative_Long_Acc_35 : 34176|10@1+ (0.05,-20) [-20|20] "m_per_s2" MCU
 SG_ OBJ_Relative_Long_Acc_V_35 : 34186|1@1+ (1,0) [0|1] "bool" MCU
 SG_ OBJ_Relative_Long_Acc_STD_35 : 34187|10@1+ (0.01,0) [0|7.3] "m_per_s2" MCU
 SG_ OBJ_Rel_Long_Acc_STD_V_35 : 34197|1@1+ (1,0) [0|1] "bool" MCU
 SG_ Reserved_13_35 : 34198|10@1+ (1,0) [0|0] "NA" MCU
 SG_ OBJ_Relative_Long_Velocity_35 : 34208|13@1+ (0.05,-120) [-120|130] "m_per_s" MCU
 SG_ OBJ_Relative_Long_Velocity_V_35 : 34221|1@1+ (1,0) [0|1] "bool" MCU
 SG_ OBJ_Relative_Long_Vel_STD_35 : 34222|14@1+ (0.01,0) [0|130] "m_per_s" MCU
 SG_ OBJ_Rel_Long_Vel_STD_V_35 : 34236|1@1+ (1,0) [0|1] "bool" MCU
 SG_ Reserved_14_35 : 34237|3@1+ (1,0) [0|0] "NA" MCU
 SG_ OBJ_Relative_Lat_Velocity_35 : 34240|11@1+ (0.05,-50) [-50|50] "m_per_s" MCU
 SG_ OBJ_Relative_Lat_Velocity_V_35 : 34251|1@1+ (1,0) [0|1] "bool" MCU
 SG_ OBJ_Relative_Lat_Velocity_STD_35 : 34252|13@1+ (0.01,0) [0|50] "m_per_s" MCU
 SG_ OBJ_Rel_Lat_Vel_STD_V_35 : 34265|1@1+ (1,0) [0|1] "bool" MCU
 SG_ Reserved_15_35 : 34266|6@1+ (1,0) [0|0] "NA" MCU
 SG_ OBJ_Long_Distance_35 : 34272|14@1+ (0.05,-200) [-200|500] "m" MCU
 SG_ OBJ_Long_Distance_V_35 : 34286|1@1+ (1,0) [0|1] "bool" MCU
 SG_ OBJ_Long_Distance_STD_35 : 34287|15@1+ (0.01,0) [0|250] "m" MCU
 SG_ OBJ_Long_Distance_STD_V_35 : 34302|1@1+ (1,0) [0|1] "bool" MCU
 SG_ Reserved_16_35 : 34303|1@1+ (1,0) [0|0] "NA" MCU
 SG_ OBJ_Lat_Distance_35 : 34304|12@1+ (0.05,-100) [-100|100] "m" MCU
 SG_ OBJ_Lat_Distance_V_35 : 34316|1@1+ (1,0) [0|1] "bool" MCU
 SG_ OBJ_Lat_Distance_STD_35 : 34317|14@1+ (0.01,0) [0|100] "m" MCU
 SG_ OBJ_Lat_Distance_STD_V_35 : 34331|1@1+ (1,0) [0|1] "bool" MCU
 SG_ Reserved_17_35 : 34332|4@1+ (1,0) [0|0] "NA" MCU
 SG_ OBJ_Absolute_Speed_35 : 34336|12@1+ (0.05,-65) [-65|65] "m_per_s" MCU
 SG_ OBJ_Absolute_Speed_V_35 : 34348|1@1+ (1,0) [0|1] "bool" MCU
 SG_ OBJ_Absolute_Speed_STD_35 : 34349|13@1+ (0.01,0) [0|65] "m_per_s" MCU
 SG_ OBJ_Absolute_Speed_STD_V_35 : 34362|1@1+ (1,0) [0|1] "bool" MCU
 SG_ Reserved_18_35 : 34363|5@1+ (1,0) [0|0] "NA" MCU
 SG_ OBJ_Heading_35 : 34368|10@1+ (0.01,-3.14) [-3.14|3.14] "rad" MCU
 SG_ OBJ_Heading_V_35 : 34378|1@1+ (1,0) [0|1] "bool" MCU
 SG_ OBJ_Heading_STD_35 : 34379|15@1+ (0.0001,0) [0|3.14] "rad" MCU
 SG_ OBJ_Heading_STD_V_35 : 34394|1@1+ (1,0) [0|1] "bool" MCU
 SG_ Reserved_19_35 : 34395|5@1+ (1,0) [0|0] "NA" MCU
 SG_ OBJ_Angle_Rate_STD_35 : 34400|15@1+ (0.0001,0) [0|2.2318] "RPS" MCU
 SG_ OBJ_Angle_Rate_STD_V_35 : 34415|1@1+ (1,0) [0|1] "bool" MCU
 SG_ OBJ_Angle_Rate_35 : 34416|12@1+ (0.002,-2.234) [-2.234|2.2318] "RPS" MCU
 SG_ OBJ_Angle_Rate_V_35 : 34428|1@1+ (1,0) [0|1] "bool" MCU
 SG_ Reserved_20_35 : 34429|3@1+ (1,0) [0|0] "NA" MCU
 SG_ OBJ_Angle_Right_35 : 34432|14@1+ (0.0002,-1.571) [-1.571|1.571] "rad" MCU
 SG_ OBJ_Angle_Right_V_35 : 34446|1@1+ (1,0) [0|1] "bool" MCU
 SG_ OBJ_Angle_Right_STD_35 : 34447|14@1+ (0.0001,0) [0|1.571] "rad" MCU
 SG_ OBJ_Angle_Right_STD_V_35 : 34461|1@1+ (1,0) [0|1] "bool" MCU
 SG_ Reserved_21_35 : 34462|2@1+ (1,0) [0|0] "NA" MCU
 SG_ OBJ_Angle_Left_35 : 34464|14@1+ (0.0002,-1.571) [-1.571|1.571] "rad" MCU
 SG_ OBJ_Angle_Left_V_35 : 34478|1@1+ (1,0) [0|1] "bool" MCU
 SG_ OBJ_Angle_Left_STD_35 : 34479|14@1+ (0.0001,0) [0|1.571] "rad" MCU
 SG_ OBJ_Angle_Left_STD_V_35 : 34493|1@1+ (1,0) [0|1] "bool" MCU
 SG_ Reserved_22_35 : 34494|2@1+ (1,0) [0|0] "NA" MCU
 SG_ OBJ_Angle_Side_35 : 34496|14@1+ (0.0002,-1.571) [-1.571|1.571] "rad" MCU
 SG_ OBJ_Angle_Side_V_35 : 34510|1@1+ (1,0) [0|1] "bool" MCU
 SG_ OBJ_Angle_Side_STD_35 : 34511|14@1+ (0.0001,0) [0|1.571] "rad" MCU
 SG_ OBJ_Angle_Side_STD_V_35 : 34525|1@1+ (1,0) [0|1] "bool" MCU
 SG_ OBJ_Angle_Mid_V_35 : 34526|1@1+ (1,0) [0|1] "bool" MCU
 SG_ Reserved_23_35 : 34527|1@1+ (1,0) [0|0] "NA" MCU
 SG_ OBJ_Angle_Mid_35 : 34528|14@1+ (0.0002,-1.571) [-1.571|1.571] "rad" MCU
 SG_ OBJ_Angle_Mid_STD_35 : 34542|14@1+ (0.0001,0) [0|1.571] "rad" MCU
 SG_ OBJ_Angle_Mid_STD_V_35 : 34556|1@1+ (1,0) [0|1] "bool" MCU
 SG_ OBJ_Angle_Bottom_V_35 : 34557|1@1+ (1,0) [0|1] "bool" MCU
 SG_ Reserved_24_35 : 34558|2@1+ (1,0) [0|0] "NA" MCU
 SG_ OBJ_Angle_Bottom_35 : 34560|14@1+ (0.0002,-1.571) [-1.571|1.571] "rad" MCU
 SG_ OBJ_Angle_Bottom_STD_35 : 34574|14@1+ (0.0001,0) [0|1.571] "rad" MCU
 SG_ OBJ_Angle_Bottom_STD_V_35 : 34588|1@1+ (1,0) [0|1] "bool" MCU
 SG_ OBJ_Visibility_Side_V_35 : 34589|1@1+ (1,0) [0|1] "bool" MCU
 SG_ OBJ_Visibility_Side_35 : 34590|2@1+ (1,0) [0|2] "ENUM" MCU
 SG_ OBJ_Is_In_Drivable_Area_35 : 34592|1@1+ (1,0) [0|1] "bool" MCU
 SG_ OBJ_Is_In_Drivable_Area_V_35 : 34593|1@1+ (1,0) [0|1] "bool" MCU
 SG_ OBJ_Is_VeryClose_V_35 : 34594|1@1+ (1,0) [0|1] "bool" MCU
 SG_ OBJ_Is_VeryClose_35 : 34595|1@1+ (1,0) [0|1] "bool" MCU
 SG_ OBJ_Buffer_C4_35 : 34596|2@1+ (1,0) [0|2] "NA" MCU
 SG_ OBJ_Buffer_C5_35 : 34598|2@1+ (1,0) [0|2] "NA" MCU
 SG_ OBJ_Buffer_C6_35 : 34600|2@1+ (1,0) [0|2] "NA" MCU
 SG_ OBJ_Buffer_C7_35 : 34602|2@1+ (1,0) [0|2] "NA" MCU
 SG_ OBJ_OverlapAngleEgoLaneR_35 : 34604|10@1+ (0.01,-3.14) [-3.14|3.14] "rad" MCU
 SG_ OBJ_OverlapAngleEgoLaneR_V_35 : 34614|1@1+ (1,0) [0|1] "bool" MCU
 SG_ Reserved_25_35 : 34615|9@1+ (1,0) [0|0] "NA" MCU
 SG_ OBJ_OverlapAngleEgoLaneL_35 : 34624|10@1+ (0.01,-3.14) [-3.14|3.14] "rad" MCU
 SG_ OBJ_OverlapAngleEgoLaneL_V_35 : 34634|1@1+ (1,0) [0|1] "bool" MCU
 SG_ OBJ_Is_EMERGENCY_VCL_35 : 34635|1@1+ (1,0) [0|1] "bool" MCU
 SG_ OBJ_EMERGENCY_LIGHT_COLOR_35 : 34636|4@1+ (1,0) [0|15] "BITWIZE" MCU
 SG_ OBJ_EMERGENCY_V_35 : 34640|1@1+ (1,0) [0|1] "bool" MCU
 SG_ OBJ_Angle_Top_35 : 34641|14@1+ (0.0002,0) [0|3.1415] "rad" MCU
 SG_ OBJ_Angle_Top_V_35 : 34655|1@1+ (1,0) [0|1] "bool" MCU
 SG_ OBJ_Angle_Top_STD_35 : 34656|15@1+ (0.0001,0) [0|3.1415] "rad" MCU
 SG_ OBJ_Angle_Top_STD_V_35 : 34671|1@1+ (1,0) [0|1] "bool" MCU
 SG_ OBJ_Open_Door_Left_35 : 34672|1@1+ (1,0) [0|1] "bool" MCU
 SG_ OBJ_Open_Door_Right_35 : 34673|1@1+ (1,0) [0|1] "bool" MCU
 SG_ OBJ_Visible_Left_or_Right_35 : 34674|2@1+ (1,0) [0|2] "ENUM" MCU
 SG_ OBJ_Visible_Left_or_Right_V_35 : 34676|1@1+ (1,0) [0|1] "bool" MCU
 SG_ OBJ_2W_Is_Motorbike_Probability_35 : 34677|8@1+ (0.01,0) [0|1] "NA" MCU
 SG_ Reserved_26_35 : 34685|3@1+ (1,0) [0|0] "NA" MCU
 SG_ OBJ_2W_Is_Bicycle_Probability_35 : 34688|8@1+ (0.01,0) [0|1] "NA" MCU
 SG_ Reserved_27_35 : 34696|24@1+ (1,0) [0|0] "NA" MCU
 SG_ OBJ_CRC_36 : 34720|32@1+ (1,0) [0|4294967295] "NA" MCU
 SG_ OBJ_ID_36 : 34752|8@1+ (1,0) [0|255] "counter" MCU
 SG_ OBJ_Existence_Probability_36 : 34760|8@1+ (0.01,0) [0|1] "NA" MCU
 SG_ OBJ_Fusion_Source_36 : 34768|16@1+ (1,0) [0|65535] "BITWIZE" MCU
 SG_ OBJ_Triggered_SDM_36 : 34784|2@1+ (1,0) [0|2] "ENUM" MCU
 SG_ OBJ_Motion_Category_36 : 34786|4@1+ (1,0) [0|13] "ENUM" MCU
 SG_ OBJ_Moving_IN_Probability_36 : 34790|7@1+ (0.01,0) [0|1] "NA" MCU
 SG_ OBJ_Object_Age_36 : 34797|11@1+ (1,0) [0|2047] "frames" MCU
 SG_ OBJ_Measuring_Status_36 : 34808|3@1+ (1,0) [0|7] "BITWIZE" MCU
 SG_ OBJ_Object_Class_36 : 34811|4@1+ (1,0) [0|9] "ENUM" MCU
 SG_ Reserved_4_36 : 34815|1@1+ (1,0) [0|0] "NA" MCU
 SG_ OBJ_Class_Probability_36 : 34816|7@1+ (0.01,0) [0|1] "NA" MCU
 SG_ OBJ_Car_Probability_36 : 34823|7@1+ (0.01,0) [0|1] "NA" MCU
 SG_ OBJ_Truck_Probability_36 : 34830|7@1+ (0.01,0) [0|1] "NA" MCU
 SG_ OBJ_Bike_Probability_36 : 34837|7@1+ (0.01,0) [0|1] "NA" MCU
 SG_ OBJ_Camera_Source_36 : 34844|4@1+ (1,0) [0|15] "ENUM" MCU
 SG_ OBJ_Motion_Status_36 : 34848|3@1+ (1,0) [0|5] "ENUM" MCU
 SG_ OBJ_Motion_Orientation_36 : 34851|4@1+ (1,0) [0|13] "ENUM" MCU
 SG_ OBJ_Has_Cut_Lane_36 : 34855|1@1+ (1,0) [0|1] "bool" MCU
 SG_ OBJ_Has_Cut_Path_36 : 34856|1@1+ (1,0) [0|1] "bool" MCU
 SG_ OBJ_Brake_Light_Validity_36 : 34857|1@1+ (1,0) [0|1] "bool" MCU
 SG_ OBJ_Brake_Light_36 : 34858|1@1+ (1,0) [0|1] "bool" MCU
 SG_ OBJ_Turn_Indicator_Right_36 : 34859|1@1+ (1,0) [0|1] "bool" MCU
 SG_ OBJ_Turn_Indicator_Left_36 : 34860|1@1+ (1,0) [0|1] "bool" MCU
 SG_ OBJ_Turn_Indicator_Validity_36 : 34861|1@1+ (1,0) [0|1] "bool" MCU
 SG_ OBJ_Right_Out_Of_Image_36 : 34862|1@1+ (1,0) [0|1] "bool" MCU
 SG_ OBJ_Left_Out_Of_Image_36 : 34863|1@1+ (1,0) [0|1] "bool" MCU
 SG_ OBJ_Right_Out_Of_Image_V_36 : 34864|1@1+ (1,0) [0|1] "bool" MCU
 SG_ OBJ_Left_Out_Of_Image_V_36 : 34865|1@1+ (1,0) [0|1] "bool" MCU
 SG_ OBJ_Top_Out_Of_Image_36 : 34866|1@1+ (1,0) [0|1] "bool" MCU
 SG_ OBJ_Bottom_Out_Of_Image_36 : 34867|1@1+ (1,0) [0|1] "bool" MCU
 SG_ OBJ_Top_Out_Of_Image_V_36 : 34868|1@1+ (1,0) [0|1] "bool" MCU
 SG_ OBJ_Bottom_Out_Of_Image_V_36 : 34869|1@1+ (1,0) [0|1] "bool" MCU
 SG_ OBJ_Lane_Assignment_36 : 34870|3@1+ (1,0) [0|5] "ENUM" MCU
 SG_ OBJ_Lane_Assignment_V_36 : 34873|1@1+ (1,0) [0|1] "bool" MCU
 SG_ Reserved_5_36 : 34874|6@1+ (1,0) [0|0] "NA" MCU
 SG_ OBJ_Age_Seconds_36 : 34880|7@1+ (1,0) [0|100] "s" MCU
 SG_ OBJ_Age_Seconds_V_36 : 34887|1@1+ (1,0) [0|1] "bool" MCU
 SG_ OBJ_Width_36 : 34888|9@1+ (0.01,0) [0.4|2.95] "m" MCU
 SG_ OBJ_Width_V_36 : 34897|1@1+ (1,0) [0|1] "bool" MCU
 SG_ OBJ_Width_STD_36 : 34898|11@1+ (0.001,0) [0|2] "m" MCU
 SG_ OBJ_Width_STD_V_36 : 34909|1@1+ (1,0) [0|1] "bool" MCU
 SG_ Reserved_6_36 : 34910|2@1+ (1,0) [0|0] "NA" MCU
 SG_ OBJ_Length_36 : 34912|9@1+ (0.05,0) [0.6|21] "m" MCU
 SG_ OBJ_Length_V_36 : 34921|1@1+ (1,0) [0|1] "bool" MCU
 SG_ OBJ_Length_STD_36 : 34922|10@1+ (0.01,0) [0|10] "m" MCU
 SG_ OBJ_Length_STD_V_36 : 34932|1@1+ (1,0) [0|1] "bool" MCU
 SG_ OBJ_Radar_ID_36 : 34933|8@1+ (1,0) [0|255] "counter" MCU
 SG_ Reserved_7_36 : 34941|3@1+ (1,0) [0|0] "NA" MCU
 SG_ OBJ_Height_36 : 34944|9@1+ (0.01,0) [0|2.95] "m" MCU
 SG_ OBJ_Height_V_36 : 34953|1@1+ (1,0) [0|1] "bool" MCU
 SG_ OBJ_Height_STD_36 : 34954|11@1+ (0.001,0) [0|2] "m" MCU
 SG_ OBJ_Height_STD_V_36 : 34965|1@1+ (1,0) [0|1] "bool" MCU
 SG_ Reserved_8_36 : 34966|10@1+ (1,0) [0|0] "NA" MCU
 SG_ OBJ_Abs_Long_Velocity_36 : 34976|12@1+ (0.05,-100) [-100|100] "m_per_s" MCU
 SG_ OBJ_Abs_Long_Velocity_V_36 : 34988|1@1+ (1,0) [0|1] "bool" MCU
 SG_ OBJ_Abs_Long_Velocity_STD_36 : 34989|13@1+ (0.01,0) [0|65] "m_per_s" MCU
 SG_ OBJ_Abs_Long_Vel_STD_V_36 : 35002|1@1+ (1,0) [0|1] "bool" MCU
 SG_ Reserved_9_36 : 35003|5@1+ (1,0) [0|0] "NA" MCU
 SG_ OBJ_Abs_Lat_Velocity_36 : 35008|11@1+ (0.05,-50) [-50|50] "m_per_s" MCU
 SG_ OBJ_Abs_Lat_Velocity_V_36 : 35019|1@1+ (1,0) [0|1] "bool" MCU
 SG_ OBJ_Abs_Lat_Velocity_STD_36 : 35020|13@1+ (0.01,0) [0|50] "m_per_s" MCU
 SG_ OBJ_Abs_Lat_Vel_STD_V_36 : 35033|1@1+ (1,0) [0|1] "bool" MCU
 SG_ Reserved_10_36 : 35034|6@1+ (1,0) [0|0] "NA" MCU
 SG_ OBJ_Abs_Long_Acc_36 : 35040|9@1+ (0.05,-10) [-10|10] "m_per_s2" MCU
 SG_ OBJ_Abs_Long_Acc_V_36 : 35049|1@1+ (1,0) [0|1] "bool" MCU
 SG_ OBJ_Abs_Long_Acc_STD_36 : 35050|10@1+ (0.01,0) [0|7.3] "m_per_s2" MCU
 SG_ OBJ_Abs_Long_Acc_STD_V_36 : 35060|1@1+ (1,0) [0|1] "bool" MCU
 SG_ OBJ_Abs_Lat_Acc_36 : 35061|9@1+ (0.05,-10) [-10|10] "m_per_s2" MCU
 SG_ OBJ_Abs_Lat_Acc_V_36 : 35070|1@1+ (1,0) [0|1] "bool" MCU
 SG_ Reserved_11_36 : 35071|1@1+ (1,0) [0|0] "NA" MCU
 SG_ OBJ_Abs_Lat_Acc_STD_36 : 35072|10@1+ (0.01,0) [0|7.3] "m_per_s2" MCU
 SG_ OBJ_Abs_Lat_Acc_STD_V_36 : 35082|1@1+ (1,0) [0|1] "bool" MCU
 SG_ OBJ_Abs_Acceleration_36 : 35083|9@1+ (0.05,-12.7) [-12.7|12.7] "m_per_s2" MCU
 SG_ OBJ_Abs_Acceleration_V_36 : 35092|1@1+ (1,0) [0|1] "bool" MCU
 SG_ OBJ_Abs_Acc_STD_36 : 35093|10@1+ (0.01,0) [0|7.3] "m_per_s2" MCU
 SG_ OBJ_Abs_Acc_STD_V_36 : 35103|1@1+ (1,0) [0|1] "bool" MCU
 SG_ OBJ_Inv_TTC_36 : 35104|11@1+ (0.01,-8) [-8|8] "INV(s)" MCU
 SG_ OBJ_Inv_TTC_V_36 : 35115|1@1+ (1,0) [0|1] "bool" MCU
 SG_ OBJ_Inv_TTC_STD_36 : 35116|12@1+ (0.001,0) [0|4] "INV(s)" MCU
 SG_ OBJ_Inv_TTC_STD_V_36 : 35128|1@1+ (1,0) [0|1] "bool" MCU
 SG_ Reserved_12_36 : 35129|7@1+ (1,0) [0|0] "NA" MCU
 SG_ OBJ_Relative_Long_Acc_36 : 35136|10@1+ (0.05,-20) [-20|20] "m_per_s2" MCU
 SG_ OBJ_Relative_Long_Acc_V_36 : 35146|1@1+ (1,0) [0|1] "bool" MCU
 SG_ OBJ_Relative_Long_Acc_STD_36 : 35147|10@1+ (0.01,0) [0|7.3] "m_per_s2" MCU
 SG_ OBJ_Rel_Long_Acc_STD_V_36 : 35157|1@1+ (1,0) [0|1] "bool" MCU
 SG_ Reserved_13_36 : 35158|10@1+ (1,0) [0|0] "NA" MCU
 SG_ OBJ_Relative_Long_Velocity_36 : 35168|13@1+ (0.05,-120) [-120|130] "m_per_s" MCU
 SG_ OBJ_Relative_Long_Velocity_V_36 : 35181|1@1+ (1,0) [0|1] "bool" MCU
 SG_ OBJ_Relative_Long_Vel_STD_36 : 35182|14@1+ (0.01,0) [0|130] "m_per_s" MCU
 SG_ OBJ_Rel_Long_Vel_STD_V_36 : 35196|1@1+ (1,0) [0|1] "bool" MCU
 SG_ Reserved_14_36 : 35197|3@1+ (1,0) [0|0] "NA" MCU
 SG_ OBJ_Relative_Lat_Velocity_36 : 35200|11@1+ (0.05,-50) [-50|50] "m_per_s" MCU
 SG_ OBJ_Relative_Lat_Velocity_V_36 : 35211|1@1+ (1,0) [0|1] "bool" MCU
 SG_ OBJ_Relative_Lat_Velocity_STD_36 : 35212|13@1+ (0.01,0) [0|50] "m_per_s" MCU
 SG_ OBJ_Rel_Lat_Vel_STD_V_36 : 35225|1@1+ (1,0) [0|1] "bool" MCU
 SG_ Reserved_15_36 : 35226|6@1+ (1,0) [0|0] "NA" MCU
 SG_ OBJ_Long_Distance_36 : 35232|14@1+ (0.05,-200) [-200|500] "m" MCU
 SG_ OBJ_Long_Distance_V_36 : 35246|1@1+ (1,0) [0|1] "bool" MCU
 SG_ OBJ_Long_Distance_STD_36 : 35247|15@1+ (0.01,0) [0|250] "m" MCU
 SG_ OBJ_Long_Distance_STD_V_36 : 35262|1@1+ (1,0) [0|1] "bool" MCU
 SG_ Reserved_16_36 : 35263|1@1+ (1,0) [0|0] "NA" MCU
 SG_ OBJ_Lat_Distance_36 : 35264|12@1+ (0.05,-100) [-100|100] "m" MCU
 SG_ OBJ_Lat_Distance_V_36 : 35276|1@1+ (1,0) [0|1] "bool" MCU
 SG_ OBJ_Lat_Distance_STD_36 : 35277|14@1+ (0.01,0) [0|100] "m" MCU
 SG_ OBJ_Lat_Distance_STD_V_36 : 35291|1@1+ (1,0) [0|1] "bool" MCU
 SG_ Reserved_17_36 : 35292|4@1+ (1,0) [0|0] "NA" MCU
 SG_ OBJ_Absolute_Speed_36 : 35296|12@1+ (0.05,-65) [-65|65] "m_per_s" MCU
 SG_ OBJ_Absolute_Speed_V_36 : 35308|1@1+ (1,0) [0|1] "bool" MCU
 SG_ OBJ_Absolute_Speed_STD_36 : 35309|13@1+ (0.01,0) [0|65] "m_per_s" MCU
 SG_ OBJ_Absolute_Speed_STD_V_36 : 35322|1@1+ (1,0) [0|1] "bool" MCU
 SG_ Reserved_18_36 : 35323|5@1+ (1,0) [0|0] "NA" MCU
 SG_ OBJ_Heading_36 : 35328|10@1+ (0.01,-3.14) [-3.14|3.14] "rad" MCU
 SG_ OBJ_Heading_V_36 : 35338|1@1+ (1,0) [0|1] "bool" MCU
 SG_ OBJ_Heading_STD_36 : 35339|15@1+ (0.0001,0) [0|3.14] "rad" MCU
 SG_ OBJ_Heading_STD_V_36 : 35354|1@1+ (1,0) [0|1] "bool" MCU
 SG_ Reserved_19_36 : 35355|5@1+ (1,0) [0|0] "NA" MCU
 SG_ OBJ_Angle_Rate_STD_36 : 35360|15@1+ (0.0001,0) [0|2.2318] "RPS" MCU
 SG_ OBJ_Angle_Rate_STD_V_36 : 35375|1@1+ (1,0) [0|1] "bool" MCU
 SG_ OBJ_Angle_Rate_36 : 35376|12@1+ (0.002,-2.234) [-2.234|2.2318] "RPS" MCU
 SG_ OBJ_Angle_Rate_V_36 : 35388|1@1+ (1,0) [0|1] "bool" MCU
 SG_ Reserved_20_36 : 35389|3@1+ (1,0) [0|0] "NA" MCU
 SG_ OBJ_Angle_Right_36 : 35392|14@1+ (0.0002,-1.571) [-1.571|1.571] "rad" MCU
 SG_ OBJ_Angle_Right_V_36 : 35406|1@1+ (1,0) [0|1] "bool" MCU
 SG_ OBJ_Angle_Right_STD_36 : 35407|14@1+ (0.0001,0) [0|1.571] "rad" MCU
 SG_ OBJ_Angle_Right_STD_V_36 : 35421|1@1+ (1,0) [0|1] "bool" MCU
 SG_ Reserved_21_36 : 35422|2@1+ (1,0) [0|0] "NA" MCU
 SG_ OBJ_Angle_Left_36 : 35424|14@1+ (0.0002,-1.571) [-1.571|1.571] "rad" MCU
 SG_ OBJ_Angle_Left_V_36 : 35438|1@1+ (1,0) [0|1] "bool" MCU
 SG_ OBJ_Angle_Left_STD_36 : 35439|14@1+ (0.0001,0) [0|1.571] "rad" MCU
 SG_ OBJ_Angle_Left_STD_V_36 : 35453|1@1+ (1,0) [0|1] "bool" MCU
 SG_ Reserved_22_36 : 35454|2@1+ (1,0) [0|0] "NA" MCU
 SG_ OBJ_Angle_Side_36 : 35456|14@1+ (0.0002,-1.571) [-1.571|1.571] "rad" MCU
 SG_ OBJ_Angle_Side_V_36 : 35470|1@1+ (1,0) [0|1] "bool" MCU
 SG_ OBJ_Angle_Side_STD_36 : 35471|14@1+ (0.0001,0) [0|1.571] "rad" MCU
 SG_ OBJ_Angle_Side_STD_V_36 : 35485|1@1+ (1,0) [0|1] "bool" MCU
 SG_ OBJ_Angle_Mid_V_36 : 35486|1@1+ (1,0) [0|1] "bool" MCU
 SG_ Reserved_23_36 : 35487|1@1+ (1,0) [0|0] "NA" MCU
 SG_ OBJ_Angle_Mid_36 : 35488|14@1+ (0.0002,-1.571) [-1.571|1.571] "rad" MCU
 SG_ OBJ_Angle_Mid_STD_36 : 35502|14@1+ (0.0001,0) [0|1.571] "rad" MCU
 SG_ OBJ_Angle_Mid_STD_V_36 : 35516|1@1+ (1,0) [0|1] "bool" MCU
 SG_ OBJ_Angle_Bottom_V_36 : 35517|1@1+ (1,0) [0|1] "bool" MCU
 SG_ Reserved_24_36 : 35518|2@1+ (1,0) [0|0] "NA" MCU
 SG_ OBJ_Angle_Bottom_36 : 35520|14@1+ (0.0002,-1.571) [-1.571|1.571] "rad" MCU
 SG_ OBJ_Angle_Bottom_STD_36 : 35534|14@1+ (0.0001,0) [0|1.571] "rad" MCU
 SG_ OBJ_Angle_Bottom_STD_V_36 : 35548|1@1+ (1,0) [0|1] "bool" MCU
 SG_ OBJ_Visibility_Side_V_36 : 35549|1@1+ (1,0) [0|1] "bool" MCU
 SG_ OBJ_Visibility_Side_36 : 35550|2@1+ (1,0) [0|2] "ENUM" MCU
 SG_ OBJ_Is_In_Drivable_Area_36 : 35552|1@1+ (1,0) [0|1] "bool" MCU
 SG_ OBJ_Is_In_Drivable_Area_V_36 : 35553|1@1+ (1,0) [0|1] "bool" MCU
 SG_ OBJ_Is_VeryClose_V_36 : 35554|1@1+ (1,0) [0|1] "bool" MCU
 SG_ OBJ_Is_VeryClose_36 : 35555|1@1+ (1,0) [0|1] "bool" MCU
 SG_ OBJ_Buffer_C4_36 : 35556|2@1+ (1,0) [0|2] "NA" MCU
 SG_ OBJ_Buffer_C5_36 : 35558|2@1+ (1,0) [0|2] "NA" MCU
 SG_ OBJ_Buffer_C6_36 : 35560|2@1+ (1,0) [0|2] "NA" MCU
 SG_ OBJ_Buffer_C7_36 : 35562|2@1+ (1,0) [0|2] "NA" MCU
 SG_ OBJ_OverlapAngleEgoLaneR_36 : 35564|10@1+ (0.01,-3.14) [-3.14|3.14] "rad" MCU
 SG_ OBJ_OverlapAngleEgoLaneR_V_36 : 35574|1@1+ (1,0) [0|1] "bool" MCU
 SG_ Reserved_25_36 : 35575|9@1+ (1,0) [0|0] "NA" MCU
 SG_ OBJ_OverlapAngleEgoLaneL_36 : 35584|10@1+ (0.01,-3.14) [-3.14|3.14] "rad" MCU
 SG_ OBJ_OverlapAngleEgoLaneL_V_36 : 35594|1@1+ (1,0) [0|1] "bool" MCU
 SG_ OBJ_Is_EMERGENCY_VCL_36 : 35595|1@1+ (1,0) [0|1] "bool" MCU
 SG_ OBJ_EMERGENCY_LIGHT_COLOR_36 : 35596|4@1+ (1,0) [0|15] "BITWIZE" MCU
 SG_ OBJ_EMERGENCY_V_36 : 35600|1@1+ (1,0) [0|1] "bool" MCU
 SG_ OBJ_Angle_Top_36 : 35601|14@1+ (0.0002,0) [0|3.1415] "rad" MCU
 SG_ OBJ_Angle_Top_V_36 : 35615|1@1+ (1,0) [0|1] "bool" MCU
 SG_ OBJ_Angle_Top_STD_36 : 35616|15@1+ (0.0001,0) [0|3.1415] "rad" MCU
 SG_ OBJ_Angle_Top_STD_V_36 : 35631|1@1+ (1,0) [0|1] "bool" MCU
 SG_ OBJ_Open_Door_Left_36 : 35632|1@1+ (1,0) [0|1] "bool" MCU
 SG_ OBJ_Open_Door_Right_36 : 35633|1@1+ (1,0) [0|1] "bool" MCU
 SG_ OBJ_Visible_Left_or_Right_36 : 35634|2@1+ (1,0) [0|2] "ENUM" MCU
 SG_ OBJ_Visible_Left_or_Right_V_36 : 35636|1@1+ (1,0) [0|1] "bool" MCU
 SG_ OBJ_2W_Is_Motorbike_Probability_36 : 35637|8@1+ (0.01,0) [0|1] "NA" MCU
 SG_ Reserved_26_36 : 35645|3@1+ (1,0) [0|0] "NA" MCU
 SG_ OBJ_2W_Is_Bicycle_Probability_36 : 35648|8@1+ (0.01,0) [0|1] "NA" MCU
 SG_ Reserved_27_36 : 35656|24@1+ (1,0) [0|0] "NA" MCU
 SG_ OBJ_CRC_37 : 35680|32@1+ (1,0) [0|4294967295] "NA" MCU
 SG_ OBJ_ID_37 : 35712|8@1+ (1,0) [0|255] "counter" MCU
 SG_ OBJ_Existence_Probability_37 : 35720|8@1+ (0.01,0) [0|1] "NA" MCU
 SG_ OBJ_Fusion_Source_37 : 35728|16@1+ (1,0) [0|65535] "BITWIZE" MCU
 SG_ OBJ_Triggered_SDM_37 : 35744|2@1+ (1,0) [0|2] "ENUM" MCU
 SG_ OBJ_Motion_Category_37 : 35746|4@1+ (1,0) [0|13] "ENUM" MCU
 SG_ OBJ_Moving_IN_Probability_37 : 35750|7@1+ (0.01,0) [0|1] "NA" MCU
 SG_ OBJ_Object_Age_37 : 35757|11@1+ (1,0) [0|2047] "frames" MCU
 SG_ OBJ_Measuring_Status_37 : 35768|3@1+ (1,0) [0|7] "BITWIZE" MCU
 SG_ OBJ_Object_Class_37 : 35771|4@1+ (1,0) [0|9] "ENUM" MCU
 SG_ Reserved_4_37 : 35775|1@1+ (1,0) [0|0] "NA" MCU
 SG_ OBJ_Class_Probability_37 : 35776|7@1+ (0.01,0) [0|1] "NA" MCU
 SG_ OBJ_Car_Probability_37 : 35783|7@1+ (0.01,0) [0|1] "NA" MCU
 SG_ OBJ_Truck_Probability_37 : 35790|7@1+ (0.01,0) [0|1] "NA" MCU
 SG_ OBJ_Bike_Probability_37 : 35797|7@1+ (0.01,0) [0|1] "NA" MCU
 SG_ OBJ_Camera_Source_37 : 35804|4@1+ (1,0) [0|15] "ENUM" MCU
 SG_ OBJ_Motion_Status_37 : 35808|3@1+ (1,0) [0|5] "ENUM" MCU
 SG_ OBJ_Motion_Orientation_37 : 35811|4@1+ (1,0) [0|13] "ENUM" MCU
 SG_ OBJ_Has_Cut_Lane_37 : 35815|1@1+ (1,0) [0|1] "bool" MCU
 SG_ OBJ_Has_Cut_Path_37 : 35816|1@1+ (1,0) [0|1] "bool" MCU
 SG_ OBJ_Brake_Light_Validity_37 : 35817|1@1+ (1,0) [0|1] "bool" MCU
 SG_ OBJ_Brake_Light_37 : 35818|1@1+ (1,0) [0|1] "bool" MCU
 SG_ OBJ_Turn_Indicator_Right_37 : 35819|1@1+ (1,0) [0|1] "bool" MCU
 SG_ OBJ_Turn_Indicator_Left_37 : 35820|1@1+ (1,0) [0|1] "bool" MCU
 SG_ OBJ_Turn_Indicator_Validity_37 : 35821|1@1+ (1,0) [0|1] "bool" MCU
 SG_ OBJ_Right_Out_Of_Image_37 : 35822|1@1+ (1,0) [0|1] "bool" MCU
 SG_ OBJ_Left_Out_Of_Image_37 : 35823|1@1+ (1,0) [0|1] "bool" MCU
 SG_ OBJ_Right_Out_Of_Image_V_37 : 35824|1@1+ (1,0) [0|1] "bool" MCU
 SG_ OBJ_Left_Out_Of_Image_V_37 : 35825|1@1+ (1,0) [0|1] "bool" MCU
 SG_ OBJ_Top_Out_Of_Image_37 : 35826|1@1+ (1,0) [0|1] "bool" MCU
 SG_ OBJ_Bottom_Out_Of_Image_37 : 35827|1@1+ (1,0) [0|1] "bool" MCU
 SG_ OBJ_Top_Out_Of_Image_V_37 : 35828|1@1+ (1,0) [0|1] "bool" MCU
 SG_ OBJ_Bottom_Out_Of_Image_V_37 : 35829|1@1+ (1,0) [0|1] "bool" MCU
 SG_ OBJ_Lane_Assignment_37 : 35830|3@1+ (1,0) [0|5] "ENUM" MCU
 SG_ OBJ_Lane_Assignment_V_37 : 35833|1@1+ (1,0) [0|1] "bool" MCU
 SG_ Reserved_5_37 : 35834|6@1+ (1,0) [0|0] "NA" MCU
 SG_ OBJ_Age_Seconds_37 : 35840|7@1+ (1,0) [0|100] "s" MCU
 SG_ OBJ_Age_Seconds_V_37 : 35847|1@1+ (1,0) [0|1] "bool" MCU
 SG_ OBJ_Width_37 : 35848|9@1+ (0.01,0) [0.4|2.95] "m" MCU
 SG_ OBJ_Width_V_37 : 35857|1@1+ (1,0) [0|1] "bool" MCU
 SG_ OBJ_Width_STD_37 : 35858|11@1+ (0.001,0) [0|2] "m" MCU
 SG_ OBJ_Width_STD_V_37 : 35869|1@1+ (1,0) [0|1] "bool" MCU
 SG_ Reserved_6_37 : 35870|2@1+ (1,0) [0|0] "NA" MCU
 SG_ OBJ_Length_37 : 35872|9@1+ (0.05,0) [0.6|21] "m" MCU
 SG_ OBJ_Length_V_37 : 35881|1@1+ (1,0) [0|1] "bool" MCU
 SG_ OBJ_Length_STD_37 : 35882|10@1+ (0.01,0) [0|10] "m" MCU
 SG_ OBJ_Length_STD_V_37 : 35892|1@1+ (1,0) [0|1] "bool" MCU
 SG_ OBJ_Radar_ID_37 : 35893|8@1+ (1,0) [0|255] "counter" MCU
 SG_ Reserved_7_37 : 35901|3@1+ (1,0) [0|0] "NA" MCU
 SG_ OBJ_Height_37 : 35904|9@1+ (0.01,0) [0|2.95] "m" MCU
 SG_ OBJ_Height_V_37 : 35913|1@1+ (1,0) [0|1] "bool" MCU
 SG_ OBJ_Height_STD_37 : 35914|11@1+ (0.001,0) [0|2] "m" MCU
 SG_ OBJ_Height_STD_V_37 : 35925|1@1+ (1,0) [0|1] "bool" MCU
 SG_ Reserved_8_37 : 35926|10@1+ (1,0) [0|0] "NA" MCU
 SG_ OBJ_Abs_Long_Velocity_37 : 35936|12@1+ (0.05,-100) [-100|100] "m_per_s" MCU
 SG_ OBJ_Abs_Long_Velocity_V_37 : 35948|1@1+ (1,0) [0|1] "bool" MCU
 SG_ OBJ_Abs_Long_Velocity_STD_37 : 35949|13@1+ (0.01,0) [0|65] "m_per_s" MCU
 SG_ OBJ_Abs_Long_Vel_STD_V_37 : 35962|1@1+ (1,0) [0|1] "bool" MCU
 SG_ Reserved_9_37 : 35963|5@1+ (1,0) [0|0] "NA" MCU
 SG_ OBJ_Abs_Lat_Velocity_37 : 35968|11@1+ (0.05,-50) [-50|50] "m_per_s" MCU
 SG_ OBJ_Abs_Lat_Velocity_V_37 : 35979|1@1+ (1,0) [0|1] "bool" MCU
 SG_ OBJ_Abs_Lat_Velocity_STD_37 : 35980|13@1+ (0.01,0) [0|50] "m_per_s" MCU
 SG_ OBJ_Abs_Lat_Vel_STD_V_37 : 35993|1@1+ (1,0) [0|1] "bool" MCU
 SG_ Reserved_10_37 : 35994|6@1+ (1,0) [0|0] "NA" MCU
 SG_ OBJ_Abs_Long_Acc_37 : 36000|9@1+ (0.05,-10) [-10|10] "m_per_s2" MCU
 SG_ OBJ_Abs_Long_Acc_V_37 : 36009|1@1+ (1,0) [0|1] "bool" MCU
 SG_ OBJ_Abs_Long_Acc_STD_37 : 36010|10@1+ (0.01,0) [0|7.3] "m_per_s2" MCU
 SG_ OBJ_Abs_Long_Acc_STD_V_37 : 36020|1@1+ (1,0) [0|1] "bool" MCU
 SG_ OBJ_Abs_Lat_Acc_37 : 36021|9@1+ (0.05,-10) [-10|10] "m_per_s2" MCU
 SG_ OBJ_Abs_Lat_Acc_V_37 : 36030|1@1+ (1,0) [0|1] "bool" MCU
 SG_ Reserved_11_37 : 36031|1@1+ (1,0) [0|0] "NA" MCU
 SG_ OBJ_Abs_Lat_Acc_STD_37 : 36032|10@1+ (0.01,0) [0|7.3] "m_per_s2" MCU
 SG_ OBJ_Abs_Lat_Acc_STD_V_37 : 36042|1@1+ (1,0) [0|1] "bool" MCU
 SG_ OBJ_Abs_Acceleration_37 : 36043|9@1+ (0.05,-12.7) [-12.7|12.7] "m_per_s2" MCU
 SG_ OBJ_Abs_Acceleration_V_37 : 36052|1@1+ (1,0) [0|1] "bool" MCU
 SG_ OBJ_Abs_Acc_STD_37 : 36053|10@1+ (0.01,0) [0|7.3] "m_per_s2" MCU
 SG_ OBJ_Abs_Acc_STD_V_37 : 36063|1@1+ (1,0) [0|1] "bool" MCU
 SG_ OBJ_Inv_TTC_37 : 36064|11@1+ (0.01,-8) [-8|8] "INV(s)" MCU
 SG_ OBJ_Inv_TTC_V_37 : 36075|1@1+ (1,0) [0|1] "bool" MCU
 SG_ OBJ_Inv_TTC_STD_37 : 36076|12@1+ (0.001,0) [0|4] "INV(s)" MCU
 SG_ OBJ_Inv_TTC_STD_V_37 : 36088|1@1+ (1,0) [0|1] "bool" MCU
 SG_ Reserved_12_37 : 36089|7@1+ (1,0) [0|0] "NA" MCU
 SG_ OBJ_Relative_Long_Acc_37 : 36096|10@1+ (0.05,-20) [-20|20] "m_per_s2" MCU
 SG_ OBJ_Relative_Long_Acc_V_37 : 36106|1@1+ (1,0) [0|1] "bool" MCU
 SG_ OBJ_Relative_Long_Acc_STD_37 : 36107|10@1+ (0.01,0) [0|7.3] "m_per_s2" MCU
 SG_ OBJ_Rel_Long_Acc_STD_V_37 : 36117|1@1+ (1,0) [0|1] "bool" MCU
 SG_ Reserved_13_37 : 36118|10@1+ (1,0) [0|0] "NA" MCU
 SG_ OBJ_Relative_Long_Velocity_37 : 36128|13@1+ (0.05,-120) [-120|130] "m_per_s" MCU
 SG_ OBJ_Relative_Long_Velocity_V_37 : 36141|1@1+ (1,0) [0|1] "bool" MCU
 SG_ OBJ_Relative_Long_Vel_STD_37 : 36142|14@1+ (0.01,0) [0|130] "m_per_s" MCU
 SG_ OBJ_Rel_Long_Vel_STD_V_37 : 36156|1@1+ (1,0) [0|1] "bool" MCU
 SG_ Reserved_14_37 : 36157|3@1+ (1,0) [0|0] "NA" MCU
 SG_ OBJ_Relative_Lat_Velocity_37 : 36160|11@1+ (0.05,-50) [-50|50] "m_per_s" MCU
 SG_ OBJ_Relative_Lat_Velocity_V_37 : 36171|1@1+ (1,0) [0|1] "bool" MCU
 SG_ OBJ_Relative_Lat_Velocity_STD_37 : 36172|13@1+ (0.01,0) [0|50] "m_per_s" MCU
 SG_ OBJ_Rel_Lat_Vel_STD_V_37 : 36185|1@1+ (1,0) [0|1] "bool" MCU
 SG_ Reserved_15_37 : 36186|6@1+ (1,0) [0|0] "NA" MCU
 SG_ OBJ_Long_Distance_37 : 36192|14@1+ (0.05,-200) [-200|500] "m" MCU
 SG_ OBJ_Long_Distance_V_37 : 36206|1@1+ (1,0) [0|1] "bool" MCU
 SG_ OBJ_Long_Distance_STD_37 : 36207|15@1+ (0.01,0) [0|250] "m" MCU
 SG_ OBJ_Long_Distance_STD_V_37 : 36222|1@1+ (1,0) [0|1] "bool" MCU
 SG_ Reserved_16_37 : 36223|1@1+ (1,0) [0|0] "NA" MCU
 SG_ OBJ_Lat_Distance_37 : 36224|12@1+ (0.05,-100) [-100|100] "m" MCU
 SG_ OBJ_Lat_Distance_V_37 : 36236|1@1+ (1,0) [0|1] "bool" MCU
 SG_ OBJ_Lat_Distance_STD_37 : 36237|14@1+ (0.01,0) [0|100] "m" MCU
 SG_ OBJ_Lat_Distance_STD_V_37 : 36251|1@1+ (1,0) [0|1] "bool" MCU
 SG_ Reserved_17_37 : 36252|4@1+ (1,0) [0|0] "NA" MCU
 SG_ OBJ_Absolute_Speed_37 : 36256|12@1+ (0.05,-65) [-65|65] "m_per_s" MCU
 SG_ OBJ_Absolute_Speed_V_37 : 36268|1@1+ (1,0) [0|1] "bool" MCU
 SG_ OBJ_Absolute_Speed_STD_37 : 36269|13@1+ (0.01,0) [0|65] "m_per_s" MCU
 SG_ OBJ_Absolute_Speed_STD_V_37 : 36282|1@1+ (1,0) [0|1] "bool" MCU
 SG_ Reserved_18_37 : 36283|5@1+ (1,0) [0|0] "NA" MCU
 SG_ OBJ_Heading_37 : 36288|10@1+ (0.01,-3.14) [-3.14|3.14] "rad" MCU
 SG_ OBJ_Heading_V_37 : 36298|1@1+ (1,0) [0|1] "bool" MCU
 SG_ OBJ_Heading_STD_37 : 36299|15@1+ (0.0001,0) [0|3.14] "rad" MCU
 SG_ OBJ_Heading_STD_V_37 : 36314|1@1+ (1,0) [0|1] "bool" MCU
 SG_ Reserved_19_37 : 36315|5@1+ (1,0) [0|0] "NA" MCU
 SG_ OBJ_Angle_Rate_STD_37 : 36320|15@1+ (0.0001,0) [0|2.2318] "RPS" MCU
 SG_ OBJ_Angle_Rate_STD_V_37 : 36335|1@1+ (1,0) [0|1] "bool" MCU
 SG_ OBJ_Angle_Rate_37 : 36336|12@1+ (0.002,-2.234) [-2.234|2.2318] "RPS" MCU
 SG_ OBJ_Angle_Rate_V_37 : 36348|1@1+ (1,0) [0|1] "bool" MCU
 SG_ Reserved_20_37 : 36349|3@1+ (1,0) [0|0] "NA" MCU
 SG_ OBJ_Angle_Right_37 : 36352|14@1+ (0.0002,-1.571) [-1.571|1.571] "rad" MCU
 SG_ OBJ_Angle_Right_V_37 : 36366|1@1+ (1,0) [0|1] "bool" MCU
 SG_ OBJ_Angle_Right_STD_37 : 36367|14@1+ (0.0001,0) [0|1.571] "rad" MCU
 SG_ OBJ_Angle_Right_STD_V_37 : 36381|1@1+ (1,0) [0|1] "bool" MCU
 SG_ Reserved_21_37 : 36382|2@1+ (1,0) [0|0] "NA" MCU
 SG_ OBJ_Angle_Left_37 : 36384|14@1+ (0.0002,-1.571) [-1.571|1.571] "rad" MCU
 SG_ OBJ_Angle_Left_V_37 : 36398|1@1+ (1,0) [0|1] "bool" MCU
 SG_ OBJ_Angle_Left_STD_37 : 36399|14@1+ (0.0001,0) [0|1.571] "rad" MCU
 SG_ OBJ_Angle_Left_STD_V_37 : 36413|1@1+ (1,0) [0|1] "bool" MCU
 SG_ Reserved_22_37 : 36414|2@1+ (1,0) [0|0] "NA" MCU
 SG_ OBJ_Angle_Side_37 : 36416|14@1+ (0.0002,-1.571) [-1.571|1.571] "rad" MCU
 SG_ OBJ_Angle_Side_V_37 : 36430|1@1+ (1,0) [0|1] "bool" MCU
 SG_ OBJ_Angle_Side_STD_37 : 36431|14@1+ (0.0001,0) [0|1.571] "rad" MCU
 SG_ OBJ_Angle_Side_STD_V_37 : 36445|1@1+ (1,0) [0|1] "bool" MCU
 SG_ OBJ_Angle_Mid_V_37 : 36446|1@1+ (1,0) [0|1] "bool" MCU
 SG_ Reserved_23_37 : 36447|1@1+ (1,0) [0|0] "NA" MCU
 SG_ OBJ_Angle_Mid_37 : 36448|14@1+ (0.0002,-1.571) [-1.571|1.571] "rad" MCU
 SG_ OBJ_Angle_Mid_STD_37 : 36462|14@1+ (0.0001,0) [0|1.571] "rad" MCU
 SG_ OBJ_Angle_Mid_STD_V_37 : 36476|1@1+ (1,0) [0|1] "bool" MCU
 SG_ OBJ_Angle_Bottom_V_37 : 36477|1@1+ (1,0) [0|1] "bool" MCU
 SG_ Reserved_24_37 : 36478|2@1+ (1,0) [0|0] "NA" MCU
 SG_ OBJ_Angle_Bottom_37 : 36480|14@1+ (0.0002,-1.571) [-1.571|1.571] "rad" MCU
 SG_ OBJ_Angle_Bottom_STD_37 : 36494|14@1+ (0.0001,0) [0|1.571] "rad" MCU
 SG_ OBJ_Angle_Bottom_STD_V_37 : 36508|1@1+ (1,0) [0|1] "bool" MCU
 SG_ OBJ_Visibility_Side_V_37 : 36509|1@1+ (1,0) [0|1] "bool" MCU
 SG_ OBJ_Visibility_Side_37 : 36510|2@1+ (1,0) [0|2] "ENUM" MCU
 SG_ OBJ_Is_In_Drivable_Area_37 : 36512|1@1+ (1,0) [0|1] "bool" MCU
 SG_ OBJ_Is_In_Drivable_Area_V_37 : 36513|1@1+ (1,0) [0|1] "bool" MCU
 SG_ OBJ_Is_VeryClose_V_37 : 36514|1@1+ (1,0) [0|1] "bool" MCU
 SG_ OBJ_Is_VeryClose_37 : 36515|1@1+ (1,0) [0|1] "bool" MCU
 SG_ OBJ_Buffer_C4_37 : 36516|2@1+ (1,0) [0|2] "NA" MCU
 SG_ OBJ_Buffer_C5_37 : 36518|2@1+ (1,0) [0|2] "NA" MCU
 SG_ OBJ_Buffer_C6_37 : 36520|2@1+ (1,0) [0|2] "NA" MCU
 SG_ OBJ_Buffer_C7_37 : 36522|2@1+ (1,0) [0|2] "NA" MCU
 SG_ OBJ_OverlapAngleEgoLaneR_37 : 36524|10@1+ (0.01,-3.14) [-3.14|3.14] "rad" MCU
 SG_ OBJ_OverlapAngleEgoLaneR_V_37 : 36534|1@1+ (1,0) [0|1] "bool" MCU
 SG_ Reserved_25_37 : 36535|9@1+ (1,0) [0|0] "NA" MCU
 SG_ OBJ_OverlapAngleEgoLaneL_37 : 36544|10@1+ (0.01,-3.14) [-3.14|3.14] "rad" MCU
 SG_ OBJ_OverlapAngleEgoLaneL_V_37 : 36554|1@1+ (1,0) [0|1] "bool" MCU
 SG_ OBJ_Is_EMERGENCY_VCL_37 : 36555|1@1+ (1,0) [0|1] "bool" MCU
 SG_ OBJ_EMERGENCY_LIGHT_COLOR_37 : 36556|4@1+ (1,0) [0|15] "BITWIZE" MCU
 SG_ OBJ_EMERGENCY_V_37 : 36560|1@1+ (1,0) [0|1] "bool" MCU
 SG_ OBJ_Angle_Top_37 : 36561|14@1+ (0.0002,0) [0|3.1415] "rad" MCU
 SG_ OBJ_Angle_Top_V_37 : 36575|1@1+ (1,0) [0|1] "bool" MCU
 SG_ OBJ_Angle_Top_STD_37 : 36576|15@1+ (0.0001,0) [0|3.1415] "rad" MCU
 SG_ OBJ_Angle_Top_STD_V_37 : 36591|1@1+ (1,0) [0|1] "bool" MCU
 SG_ OBJ_Open_Door_Left_37 : 36592|1@1+ (1,0) [0|1] "bool" MCU
 SG_ OBJ_Open_Door_Right_37 : 36593|1@1+ (1,0) [0|1] "bool" MCU
 SG_ OBJ_Visible_Left_or_Right_37 : 36594|2@1+ (1,0) [0|2] "ENUM" MCU
 SG_ OBJ_Visible_Left_or_Right_V_37 : 36596|1@1+ (1,0) [0|1] "bool" MCU
 SG_ OBJ_2W_Is_Motorbike_Probability_37 : 36597|8@1+ (0.01,0) [0|1] "NA" MCU
 SG_ Reserved_26_37 : 36605|3@1+ (1,0) [0|0] "NA" MCU
 SG_ OBJ_2W_Is_Bicycle_Probability_37 : 36608|8@1+ (0.01,0) [0|1] "NA" MCU
 SG_ Reserved_27_37 : 36616|24@1+ (1,0) [0|0] "NA" MCU
 SG_ OBJ_CRC_38 : 36640|32@1+ (1,0) [0|4294967295] "NA" MCU
 SG_ OBJ_ID_38 : 36672|8@1+ (1,0) [0|255] "counter" MCU
 SG_ OBJ_Existence_Probability_38 : 36680|8@1+ (0.01,0) [0|1] "NA" MCU
 SG_ OBJ_Fusion_Source_38 : 36688|16@1+ (1,0) [0|65535] "BITWIZE" MCU
 SG_ OBJ_Triggered_SDM_38 : 36704|2@1+ (1,0) [0|2] "ENUM" MCU
 SG_ OBJ_Motion_Category_38 : 36706|4@1+ (1,0) [0|13] "ENUM" MCU
 SG_ OBJ_Moving_IN_Probability_38 : 36710|7@1+ (0.01,0) [0|1] "NA" MCU
 SG_ OBJ_Object_Age_38 : 36717|11@1+ (1,0) [0|2047] "frames" MCU
 SG_ OBJ_Measuring_Status_38 : 36728|3@1+ (1,0) [0|7] "BITWIZE" MCU
 SG_ OBJ_Object_Class_38 : 36731|4@1+ (1,0) [0|9] "ENUM" MCU
 SG_ Reserved_4_38 : 36735|1@1+ (1,0) [0|0] "NA" MCU
 SG_ OBJ_Class_Probability_38 : 36736|7@1+ (0.01,0) [0|1] "NA" MCU
 SG_ OBJ_Car_Probability_38 : 36743|7@1+ (0.01,0) [0|1] "NA" MCU
 SG_ OBJ_Truck_Probability_38 : 36750|7@1+ (0.01,0) [0|1] "NA" MCU
 SG_ OBJ_Bike_Probability_38 : 36757|7@1+ (0.01,0) [0|1] "NA" MCU
 SG_ OBJ_Camera_Source_38 : 36764|4@1+ (1,0) [0|15] "ENUM" MCU
 SG_ OBJ_Motion_Status_38 : 36768|3@1+ (1,0) [0|5] "ENUM" MCU
 SG_ OBJ_Motion_Orientation_38 : 36771|4@1+ (1,0) [0|13] "ENUM" MCU
 SG_ OBJ_Has_Cut_Lane_38 : 36775|1@1+ (1,0) [0|1] "bool" MCU
 SG_ OBJ_Has_Cut_Path_38 : 36776|1@1+ (1,0) [0|1] "bool" MCU
 SG_ OBJ_Brake_Light_Validity_38 : 36777|1@1+ (1,0) [0|1] "bool" MCU
 SG_ OBJ_Brake_Light_38 : 36778|1@1+ (1,0) [0|1] "bool" MCU
 SG_ OBJ_Turn_Indicator_Right_38 : 36779|1@1+ (1,0) [0|1] "bool" MCU
 SG_ OBJ_Turn_Indicator_Left_38 : 36780|1@1+ (1,0) [0|1] "bool" MCU
 SG_ OBJ_Turn_Indicator_Validity_38 : 36781|1@1+ (1,0) [0|1] "bool" MCU
 SG_ OBJ_Right_Out_Of_Image_38 : 36782|1@1+ (1,0) [0|1] "bool" MCU
 SG_ OBJ_Left_Out_Of_Image_38 : 36783|1@1+ (1,0) [0|1] "bool" MCU
 SG_ OBJ_Right_Out_Of_Image_V_38 : 36784|1@1+ (1,0) [0|1] "bool" MCU
 SG_ OBJ_Left_Out_Of_Image_V_38 : 36785|1@1+ (1,0) [0|1] "bool" MCU
 SG_ OBJ_Top_Out_Of_Image_38 : 36786|1@1+ (1,0) [0|1] "bool" MCU
 SG_ OBJ_Bottom_Out_Of_Image_38 : 36787|1@1+ (1,0) [0|1] "bool" MCU
 SG_ OBJ_Top_Out_Of_Image_V_38 : 36788|1@1+ (1,0) [0|1] "bool" MCU
 SG_ OBJ_Bottom_Out_Of_Image_V_38 : 36789|1@1+ (1,0) [0|1] "bool" MCU
 SG_ OBJ_Lane_Assignment_38 : 36790|3@1+ (1,0) [0|5] "ENUM" MCU
 SG_ OBJ_Lane_Assignment_V_38 : 36793|1@1+ (1,0) [0|1] "bool" MCU
 SG_ Reserved_5_38 : 36794|6@1+ (1,0) [0|0] "NA" MCU
 SG_ OBJ_Age_Seconds_38 : 36800|7@1+ (1,0) [0|100] "s" MCU
 SG_ OBJ_Age_Seconds_V_38 : 36807|1@1+ (1,0) [0|1] "bool" MCU
 SG_ OBJ_Width_38 : 36808|9@1+ (0.01,0) [0.4|2.95] "m" MCU
 SG_ OBJ_Width_V_38 : 36817|1@1+ (1,0) [0|1] "bool" MCU
 SG_ OBJ_Width_STD_38 : 36818|11@1+ (0.001,0) [0|2] "m" MCU
 SG_ OBJ_Width_STD_V_38 : 36829|1@1+ (1,0) [0|1] "bool" MCU
 SG_ Reserved_6_38 : 36830|2@1+ (1,0) [0|0] "NA" MCU
 SG_ OBJ_Length_38 : 36832|9@1+ (0.05,0) [0.6|21] "m" MCU
 SG_ OBJ_Length_V_38 : 36841|1@1+ (1,0) [0|1] "bool" MCU
 SG_ OBJ_Length_STD_38 : 36842|10@1+ (0.01,0) [0|10] "m" MCU
 SG_ OBJ_Length_STD_V_38 : 36852|1@1+ (1,0) [0|1] "bool" MCU
 SG_ OBJ_Radar_ID_38 : 36853|8@1+ (1,0) [0|255] "counter" MCU
 SG_ Reserved_7_38 : 36861|3@1+ (1,0) [0|0] "NA" MCU
 SG_ OBJ_Height_38 : 36864|9@1+ (0.01,0) [0|2.95] "m" MCU
 SG_ OBJ_Height_V_38 : 36873|1@1+ (1,0) [0|1] "bool" MCU
 SG_ OBJ_Height_STD_38 : 36874|11@1+ (0.001,0) [0|2] "m" MCU
 SG_ OBJ_Height_STD_V_38 : 36885|1@1+ (1,0) [0|1] "bool" MCU
 SG_ Reserved_8_38 : 36886|10@1+ (1,0) [0|0] "NA" MCU
 SG_ OBJ_Abs_Long_Velocity_38 : 36896|12@1+ (0.05,-100) [-100|100] "m_per_s" MCU
 SG_ OBJ_Abs_Long_Velocity_V_38 : 36908|1@1+ (1,0) [0|1] "bool" MCU
 SG_ OBJ_Abs_Long_Velocity_STD_38 : 36909|13@1+ (0.01,0) [0|65] "m_per_s" MCU
 SG_ OBJ_Abs_Long_Vel_STD_V_38 : 36922|1@1+ (1,0) [0|1] "bool" MCU
 SG_ Reserved_9_38 : 36923|5@1+ (1,0) [0|0] "NA" MCU
 SG_ OBJ_Abs_Lat_Velocity_38 : 36928|11@1+ (0.05,-50) [-50|50] "m_per_s" MCU
 SG_ OBJ_Abs_Lat_Velocity_V_38 : 36939|1@1+ (1,0) [0|1] "bool" MCU
 SG_ OBJ_Abs_Lat_Velocity_STD_38 : 36940|13@1+ (0.01,0) [0|50] "m_per_s" MCU
 SG_ OBJ_Abs_Lat_Vel_STD_V_38 : 36953|1@1+ (1,0) [0|1] "bool" MCU
 SG_ Reserved_10_38 : 36954|6@1+ (1,0) [0|0] "NA" MCU
 SG_ OBJ_Abs_Long_Acc_38 : 36960|9@1+ (0.05,-10) [-10|10] "m_per_s2" MCU
 SG_ OBJ_Abs_Long_Acc_V_38 : 36969|1@1+ (1,0) [0|1] "bool" MCU
 SG_ OBJ_Abs_Long_Acc_STD_38 : 36970|10@1+ (0.01,0) [0|7.3] "m_per_s2" MCU
 SG_ OBJ_Abs_Long_Acc_STD_V_38 : 36980|1@1+ (1,0) [0|1] "bool" MCU
 SG_ OBJ_Abs_Lat_Acc_38 : 36981|9@1+ (0.05,-10) [-10|10] "m_per_s2" MCU
 SG_ OBJ_Abs_Lat_Acc_V_38 : 36990|1@1+ (1,0) [0|1] "bool" MCU
 SG_ Reserved_11_38 : 36991|1@1+ (1,0) [0|0] "NA" MCU
 SG_ OBJ_Abs_Lat_Acc_STD_38 : 36992|10@1+ (0.01,0) [0|7.3] "m_per_s2" MCU
 SG_ OBJ_Abs_Lat_Acc_STD_V_38 : 37002|1@1+ (1,0) [0|1] "bool" MCU
 SG_ OBJ_Abs_Acceleration_38 : 37003|9@1+ (0.05,-12.7) [-12.7|12.7] "m_per_s2" MCU
 SG_ OBJ_Abs_Acceleration_V_38 : 37012|1@1+ (1,0) [0|1] "bool" MCU
 SG_ OBJ_Abs_Acc_STD_38 : 37013|10@1+ (0.01,0) [0|7.3] "m_per_s2" MCU
 SG_ OBJ_Abs_Acc_STD_V_38 : 37023|1@1+ (1,0) [0|1] "bool" MCU
 SG_ OBJ_Inv_TTC_38 : 37024|11@1+ (0.01,-8) [-8|8] "INV(s)" MCU
 SG_ OBJ_Inv_TTC_V_38 : 37035|1@1+ (1,0) [0|1] "bool" MCU
 SG_ OBJ_Inv_TTC_STD_38 : 37036|12@1+ (0.001,0) [0|4] "INV(s)" MCU
 SG_ OBJ_Inv_TTC_STD_V_38 : 37048|1@1+ (1,0) [0|1] "bool" MCU
 SG_ Reserved_12_38 : 37049|7@1+ (1,0) [0|0] "NA" MCU
 SG_ OBJ_Relative_Long_Acc_38 : 37056|10@1+ (0.05,-20) [-20|20] "m_per_s2" MCU
 SG_ OBJ_Relative_Long_Acc_V_38 : 37066|1@1+ (1,0) [0|1] "bool" MCU
 SG_ OBJ_Relative_Long_Acc_STD_38 : 37067|10@1+ (0.01,0) [0|7.3] "m_per_s2" MCU
 SG_ OBJ_Rel_Long_Acc_STD_V_38 : 37077|1@1+ (1,0) [0|1] "bool" MCU
 SG_ Reserved_13_38 : 37078|10@1+ (1,0) [0|0] "NA" MCU
 SG_ OBJ_Relative_Long_Velocity_38 : 37088|13@1+ (0.05,-120) [-120|130] "m_per_s" MCU
 SG_ OBJ_Relative_Long_Velocity_V_38 : 37101|1@1+ (1,0) [0|1] "bool" MCU
 SG_ OBJ_Relative_Long_Vel_STD_38 : 37102|14@1+ (0.01,0) [0|130] "m_per_s" MCU
 SG_ OBJ_Rel_Long_Vel_STD_V_38 : 37116|1@1+ (1,0) [0|1] "bool" MCU
 SG_ Reserved_14_38 : 37117|3@1+ (1,0) [0|0] "NA" MCU
 SG_ OBJ_Relative_Lat_Velocity_38 : 37120|11@1+ (0.05,-50) [-50|50] "m_per_s" MCU
 SG_ OBJ_Relative_Lat_Velocity_V_38 : 37131|1@1+ (1,0) [0|1] "bool" MCU
 SG_ OBJ_Relative_Lat_Velocity_STD_38 : 37132|13@1+ (0.01,0) [0|50] "m_per_s" MCU
 SG_ OBJ_Rel_Lat_Vel_STD_V_38 : 37145|1@1+ (1,0) [0|1] "bool" MCU
 SG_ Reserved_15_38 : 37146|6@1+ (1,0) [0|0] "NA" MCU
 SG_ OBJ_Long_Distance_38 : 37152|14@1+ (0.05,-200) [-200|500] "m" MCU
 SG_ OBJ_Long_Distance_V_38 : 37166|1@1+ (1,0) [0|1] "bool" MCU
 SG_ OBJ_Long_Distance_STD_38 : 37167|15@1+ (0.01,0) [0|250] "m" MCU
 SG_ OBJ_Long_Distance_STD_V_38 : 37182|1@1+ (1,0) [0|1] "bool" MCU
 SG_ Reserved_16_38 : 37183|1@1+ (1,0) [0|0] "NA" MCU
 SG_ OBJ_Lat_Distance_38 : 37184|12@1+ (0.05,-100) [-100|100] "m" MCU
 SG_ OBJ_Lat_Distance_V_38 : 37196|1@1+ (1,0) [0|1] "bool" MCU
 SG_ OBJ_Lat_Distance_STD_38 : 37197|14@1+ (0.01,0) [0|100] "m" MCU
 SG_ OBJ_Lat_Distance_STD_V_38 : 37211|1@1+ (1,0) [0|1] "bool" MCU
 SG_ Reserved_17_38 : 37212|4@1+ (1,0) [0|0] "NA" MCU
 SG_ OBJ_Absolute_Speed_38 : 37216|12@1+ (0.05,-65) [-65|65] "m_per_s" MCU
 SG_ OBJ_Absolute_Speed_V_38 : 37228|1@1+ (1,0) [0|1] "bool" MCU
 SG_ OBJ_Absolute_Speed_STD_38 : 37229|13@1+ (0.01,0) [0|65] "m_per_s" MCU
 SG_ OBJ_Absolute_Speed_STD_V_38 : 37242|1@1+ (1,0) [0|1] "bool" MCU
 SG_ Reserved_18_38 : 37243|5@1+ (1,0) [0|0] "NA" MCU
 SG_ OBJ_Heading_38 : 37248|10@1+ (0.01,-3.14) [-3.14|3.14] "rad" MCU
 SG_ OBJ_Heading_V_38 : 37258|1@1+ (1,0) [0|1] "bool" MCU
 SG_ OBJ_Heading_STD_38 : 37259|15@1+ (0.0001,0) [0|3.14] "rad" MCU
 SG_ OBJ_Heading_STD_V_38 : 37274|1@1+ (1,0) [0|1] "bool" MCU
 SG_ Reserved_19_38 : 37275|5@1+ (1,0) [0|0] "NA" MCU
 SG_ OBJ_Angle_Rate_STD_38 : 37280|15@1+ (0.0001,0) [0|2.2318] "RPS" MCU
 SG_ OBJ_Angle_Rate_STD_V_38 : 37295|1@1+ (1,0) [0|1] "bool" MCU
 SG_ OBJ_Angle_Rate_38 : 37296|12@1+ (0.002,-2.234) [-2.234|2.2318] "RPS" MCU
 SG_ OBJ_Angle_Rate_V_38 : 37308|1@1+ (1,0) [0|1] "bool" MCU
 SG_ Reserved_20_38 : 37309|3@1+ (1,0) [0|0] "NA" MCU
 SG_ OBJ_Angle_Right_38 : 37312|14@1+ (0.0002,-1.571) [-1.571|1.571] "rad" MCU
 SG_ OBJ_Angle_Right_V_38 : 37326|1@1+ (1,0) [0|1] "bool" MCU
 SG_ OBJ_Angle_Right_STD_38 : 37327|14@1+ (0.0001,0) [0|1.571] "rad" MCU
 SG_ OBJ_Angle_Right_STD_V_38 : 37341|1@1+ (1,0) [0|1] "bool" MCU
 SG_ Reserved_21_38 : 37342|2@1+ (1,0) [0|0] "NA" MCU
 SG_ OBJ_Angle_Left_38 : 37344|14@1+ (0.0002,-1.571) [-1.571|1.571] "rad" MCU
 SG_ OBJ_Angle_Left_V_38 : 37358|1@1+ (1,0) [0|1] "bool" MCU
 SG_ OBJ_Angle_Left_STD_38 : 37359|14@1+ (0.0001,0) [0|1.571] "rad" MCU
 SG_ OBJ_Angle_Left_STD_V_38 : 37373|1@1+ (1,0) [0|1] "bool" MCU
 SG_ Reserved_22_38 : 37374|2@1+ (1,0) [0|0] "NA" MCU
 SG_ OBJ_Angle_Side_38 : 37376|14@1+ (0.0002,-1.571) [-1.571|1.571] "rad" MCU
 SG_ OBJ_Angle_Side_V_38 : 37390|1@1+ (1,0) [0|1] "bool" MCU
 SG_ OBJ_Angle_Side_STD_38 : 37391|14@1+ (0.0001,0) [0|1.571] "rad" MCU
 SG_ OBJ_Angle_Side_STD_V_38 : 37405|1@1+ (1,0) [0|1] "bool" MCU
 SG_ OBJ_Angle_Mid_V_38 : 37406|1@1+ (1,0) [0|1] "bool" MCU
 SG_ Reserved_23_38 : 37407|1@1+ (1,0) [0|0] "NA" MCU
 SG_ OBJ_Angle_Mid_38 : 37408|14@1+ (0.0002,-1.571) [-1.571|1.571] "rad" MCU
 SG_ OBJ_Angle_Mid_STD_38 : 37422|14@1+ (0.0001,0) [0|1.571] "rad" MCU
 SG_ OBJ_Angle_Mid_STD_V_38 : 37436|1@1+ (1,0) [0|1] "bool" MCU
 SG_ OBJ_Angle_Bottom_V_38 : 37437|1@1+ (1,0) [0|1] "bool" MCU
 SG_ Reserved_24_38 : 37438|2@1+ (1,0) [0|0] "NA" MCU
 SG_ OBJ_Angle_Bottom_38 : 37440|14@1+ (0.0002,-1.571) [-1.571|1.571] "rad" MCU
 SG_ OBJ_Angle_Bottom_STD_38 : 37454|14@1+ (0.0001,0) [0|1.571] "rad" MCU
 SG_ OBJ_Angle_Bottom_STD_V_38 : 37468|1@1+ (1,0) [0|1] "bool" MCU
 SG_ OBJ_Visibility_Side_V_38 : 37469|1@1+ (1,0) [0|1] "bool" MCU
 SG_ OBJ_Visibility_Side_38 : 37470|2@1+ (1,0) [0|2] "ENUM" MCU
 SG_ OBJ_Is_In_Drivable_Area_38 : 37472|1@1+ (1,0) [0|1] "bool" MCU
 SG_ OBJ_Is_In_Drivable_Area_V_38 : 37473|1@1+ (1,0) [0|1] "bool" MCU
 SG_ OBJ_Is_VeryClose_V_38 : 37474|1@1+ (1,0) [0|1] "bool" MCU
 SG_ OBJ_Is_VeryClose_38 : 37475|1@1+ (1,0) [0|1] "bool" MCU
 SG_ OBJ_Buffer_C4_38 : 37476|2@1+ (1,0) [0|2] "NA" MCU
 SG_ OBJ_Buffer_C5_38 : 37478|2@1+ (1,0) [0|2] "NA" MCU
 SG_ OBJ_Buffer_C6_38 : 37480|2@1+ (1,0) [0|2] "NA" MCU
 SG_ OBJ_Buffer_C7_38 : 37482|2@1+ (1,0) [0|2] "NA" MCU
 SG_ OBJ_OverlapAngleEgoLaneR_38 : 37484|10@1+ (0.01,-3.14) [-3.14|3.14] "rad" MCU
 SG_ OBJ_OverlapAngleEgoLaneR_V_38 : 37494|1@1+ (1,0) [0|1] "bool" MCU
 SG_ Reserved_25_38 : 37495|9@1+ (1,0) [0|0] "NA" MCU
 SG_ OBJ_OverlapAngleEgoLaneL_38 : 37504|10@1+ (0.01,-3.14) [-3.14|3.14] "rad" MCU
 SG_ OBJ_OverlapAngleEgoLaneL_V_38 : 37514|1@1+ (1,0) [0|1] "bool" MCU
 SG_ OBJ_Is_EMERGENCY_VCL_38 : 37515|1@1+ (1,0) [0|1] "bool" MCU
 SG_ OBJ_EMERGENCY_LIGHT_COLOR_38 : 37516|4@1+ (1,0) [0|15] "BITWIZE" MCU
 SG_ OBJ_EMERGENCY_V_38 : 37520|1@1+ (1,0) [0|1] "bool" MCU
 SG_ OBJ_Angle_Top_38 : 37521|14@1+ (0.0002,0) [0|3.1415] "rad" MCU
 SG_ OBJ_Angle_Top_V_38 : 37535|1@1+ (1,0) [0|1] "bool" MCU
 SG_ OBJ_Angle_Top_STD_38 : 37536|15@1+ (0.0001,0) [0|3.1415] "rad" MCU
 SG_ OBJ_Angle_Top_STD_V_38 : 37551|1@1+ (1,0) [0|1] "bool" MCU
 SG_ OBJ_Open_Door_Left_38 : 37552|1@1+ (1,0) [0|1] "bool" MCU
 SG_ OBJ_Open_Door_Right_38 : 37553|1@1+ (1,0) [0|1] "bool" MCU
 SG_ OBJ_Visible_Left_or_Right_38 : 37554|2@1+ (1,0) [0|2] "ENUM" MCU
 SG_ OBJ_Visible_Left_or_Right_V_38 : 37556|1@1+ (1,0) [0|1] "bool" MCU
 SG_ OBJ_2W_Is_Motorbike_Probability_38 : 37557|8@1+ (0.01,0) [0|1] "NA" MCU
 SG_ Reserved_26_38 : 37565|3@1+ (1,0) [0|0] "NA" MCU
 SG_ OBJ_2W_Is_Bicycle_Probability_38 : 37568|8@1+ (0.01,0) [0|1] "NA" MCU
 SG_ Reserved_27_38 : 37576|24@1+ (1,0) [0|0] "NA" MCU
 SG_ OBJ_CRC_39 : 37600|32@1+ (1,0) [0|4294967295] "NA" MCU
 SG_ OBJ_ID_39 : 37632|8@1+ (1,0) [0|255] "counter" MCU
 SG_ OBJ_Existence_Probability_39 : 37640|8@1+ (0.01,0) [0|1] "NA" MCU
 SG_ OBJ_Fusion_Source_39 : 37648|16@1+ (1,0) [0|65535] "BITWIZE" MCU
 SG_ OBJ_Triggered_SDM_39 : 37664|2@1+ (1,0) [0|2] "ENUM" MCU
 SG_ OBJ_Motion_Category_39 : 37666|4@1+ (1,0) [0|13] "ENUM" MCU
 SG_ OBJ_Moving_IN_Probability_39 : 37670|7@1+ (0.01,0) [0|1] "NA" MCU
 SG_ OBJ_Object_Age_39 : 37677|11@1+ (1,0) [0|2047] "frames" MCU
 SG_ OBJ_Measuring_Status_39 : 37688|3@1+ (1,0) [0|7] "BITWIZE" MCU
 SG_ OBJ_Object_Class_39 : 37691|4@1+ (1,0) [0|9] "ENUM" MCU
 SG_ Reserved_4_39 : 37695|1@1+ (1,0) [0|0] "NA" MCU
 SG_ OBJ_Class_Probability_39 : 37696|7@1+ (0.01,0) [0|1] "NA" MCU
 SG_ OBJ_Car_Probability_39 : 37703|7@1+ (0.01,0) [0|1] "NA" MCU
 SG_ OBJ_Truck_Probability_39 : 37710|7@1+ (0.01,0) [0|1] "NA" MCU
 SG_ OBJ_Bike_Probability_39 : 37717|7@1+ (0.01,0) [0|1] "NA" MCU
 SG_ OBJ_Camera_Source_39 : 37724|4@1+ (1,0) [0|15] "ENUM" MCU
 SG_ OBJ_Motion_Status_39 : 37728|3@1+ (1,0) [0|5] "ENUM" MCU
 SG_ OBJ_Motion_Orientation_39 : 37731|4@1+ (1,0) [0|13] "ENUM" MCU
 SG_ OBJ_Has_Cut_Lane_39 : 37735|1@1+ (1,0) [0|1] "bool" MCU
 SG_ OBJ_Has_Cut_Path_39 : 37736|1@1+ (1,0) [0|1] "bool" MCU
 SG_ OBJ_Brake_Light_Validity_39 : 37737|1@1+ (1,0) [0|1] "bool" MCU
 SG_ OBJ_Brake_Light_39 : 37738|1@1+ (1,0) [0|1] "bool" MCU
 SG_ OBJ_Turn_Indicator_Right_39 : 37739|1@1+ (1,0) [0|1] "bool" MCU
 SG_ OBJ_Turn_Indicator_Left_39 : 37740|1@1+ (1,0) [0|1] "bool" MCU
 SG_ OBJ_Turn_Indicator_Validity_39 : 37741|1@1+ (1,0) [0|1] "bool" MCU
 SG_ OBJ_Right_Out_Of_Image_39 : 37742|1@1+ (1,0) [0|1] "bool" MCU
 SG_ OBJ_Left_Out_Of_Image_39 : 37743|1@1+ (1,0) [0|1] "bool" MCU
 SG_ OBJ_Right_Out_Of_Image_V_39 : 37744|1@1+ (1,0) [0|1] "bool" MCU
 SG_ OBJ_Left_Out_Of_Image_V_39 : 37745|1@1+ (1,0) [0|1] "bool" MCU
 SG_ OBJ_Top_Out_Of_Image_39 : 37746|1@1+ (1,0) [0|1] "bool" MCU
 SG_ OBJ_Bottom_Out_Of_Image_39 : 37747|1@1+ (1,0) [0|1] "bool" MCU
 SG_ OBJ_Top_Out_Of_Image_V_39 : 37748|1@1+ (1,0) [0|1] "bool" MCU
 SG_ OBJ_Bottom_Out_Of_Image_V_39 : 37749|1@1+ (1,0) [0|1] "bool" MCU
 SG_ OBJ_Lane_Assignment_39 : 37750|3@1+ (1,0) [0|5] "ENUM" MCU
 SG_ OBJ_Lane_Assignment_V_39 : 37753|1@1+ (1,0) [0|1] "bool" MCU
 SG_ Reserved_5_39 : 37754|6@1+ (1,0) [0|0] "NA" MCU
 SG_ OBJ_Age_Seconds_39 : 37760|7@1+ (1,0) [0|100] "s" MCU
 SG_ OBJ_Age_Seconds_V_39 : 37767|1@1+ (1,0) [0|1] "bool" MCU
 SG_ OBJ_Width_39 : 37768|9@1+ (0.01,0) [0.4|2.95] "m" MCU
 SG_ OBJ_Width_V_39 : 37777|1@1+ (1,0) [0|1] "bool" MCU
 SG_ OBJ_Width_STD_39 : 37778|11@1+ (0.001,0) [0|2] "m" MCU
 SG_ OBJ_Width_STD_V_39 : 37789|1@1+ (1,0) [0|1] "bool" MCU
 SG_ Reserved_6_39 : 37790|2@1+ (1,0) [0|0] "NA" MCU
 SG_ OBJ_Length_39 : 37792|9@1+ (0.05,0) [0.6|21] "m" MCU
 SG_ OBJ_Length_V_39 : 37801|1@1+ (1,0) [0|1] "bool" MCU
 SG_ OBJ_Length_STD_39 : 37802|10@1+ (0.01,0) [0|10] "m" MCU
 SG_ OBJ_Length_STD_V_39 : 37812|1@1+ (1,0) [0|1] "bool" MCU
 SG_ OBJ_Radar_ID_39 : 37813|8@1+ (1,0) [0|255] "counter" MCU
 SG_ Reserved_7_39 : 37821|3@1+ (1,0) [0|0] "NA" MCU
 SG_ OBJ_Height_39 : 37824|9@1+ (0.01,0) [0|2.95] "m" MCU
 SG_ OBJ_Height_V_39 : 37833|1@1+ (1,0) [0|1] "bool" MCU
 SG_ OBJ_Height_STD_39 : 37834|11@1+ (0.001,0) [0|2] "m" MCU
 SG_ OBJ_Height_STD_V_39 : 37845|1@1+ (1,0) [0|1] "bool" MCU
 SG_ Reserved_8_39 : 37846|10@1+ (1,0) [0|0] "NA" MCU
 SG_ OBJ_Abs_Long_Velocity_39 : 37856|12@1+ (0.05,-100) [-100|100] "m_per_s" MCU
 SG_ OBJ_Abs_Long_Velocity_V_39 : 37868|1@1+ (1,0) [0|1] "bool" MCU
 SG_ OBJ_Abs_Long_Velocity_STD_39 : 37869|13@1+ (0.01,0) [0|65] "m_per_s" MCU
 SG_ OBJ_Abs_Long_Vel_STD_V_39 : 37882|1@1+ (1,0) [0|1] "bool" MCU
 SG_ Reserved_9_39 : 37883|5@1+ (1,0) [0|0] "NA" MCU
 SG_ OBJ_Abs_Lat_Velocity_39 : 37888|11@1+ (0.05,-50) [-50|50] "m_per_s" MCU
 SG_ OBJ_Abs_Lat_Velocity_V_39 : 37899|1@1+ (1,0) [0|1] "bool" MCU
 SG_ OBJ_Abs_Lat_Velocity_STD_39 : 37900|13@1+ (0.01,0) [0|50] "m_per_s" MCU
 SG_ OBJ_Abs_Lat_Vel_STD_V_39 : 37913|1@1+ (1,0) [0|1] "bool" MCU
 SG_ Reserved_10_39 : 37914|6@1+ (1,0) [0|0] "NA" MCU
 SG_ OBJ_Abs_Long_Acc_39 : 37920|9@1+ (0.05,-10) [-10|10] "m_per_s2" MCU
 SG_ OBJ_Abs_Long_Acc_V_39 : 37929|1@1+ (1,0) [0|1] "bool" MCU
 SG_ OBJ_Abs_Long_Acc_STD_39 : 37930|10@1+ (0.01,0) [0|7.3] "m_per_s2" MCU
 SG_ OBJ_Abs_Long_Acc_STD_V_39 : 37940|1@1+ (1,0) [0|1] "bool" MCU
 SG_ OBJ_Abs_Lat_Acc_39 : 37941|9@1+ (0.05,-10) [-10|10] "m_per_s2" MCU
 SG_ OBJ_Abs_Lat_Acc_V_39 : 37950|1@1+ (1,0) [0|1] "bool" MCU
 SG_ Reserved_11_39 : 37951|1@1+ (1,0) [0|0] "NA" MCU
 SG_ OBJ_Abs_Lat_Acc_STD_39 : 37952|10@1+ (0.01,0) [0|7.3] "m_per_s2" MCU
 SG_ OBJ_Abs_Lat_Acc_STD_V_39 : 37962|1@1+ (1,0) [0|1] "bool" MCU
 SG_ OBJ_Abs_Acceleration_39 : 37963|9@1+ (0.05,-12.7) [-12.7|12.7] "m_per_s2" MCU
 SG_ OBJ_Abs_Acceleration_V_39 : 37972|1@1+ (1,0) [0|1] "bool" MCU
 SG_ OBJ_Abs_Acc_STD_39 : 37973|10@1+ (0.01,0) [0|7.3] "m_per_s2" MCU
 SG_ OBJ_Abs_Acc_STD_V_39 : 37983|1@1+ (1,0) [0|1] "bool" MCU
 SG_ OBJ_Inv_TTC_39 : 37984|11@1+ (0.01,-8) [-8|8] "INV(s)" MCU
 SG_ OBJ_Inv_TTC_V_39 : 37995|1@1+ (1,0) [0|1] "bool" MCU
 SG_ OBJ_Inv_TTC_STD_39 : 37996|12@1+ (0.001,0) [0|4] "INV(s)" MCU
 SG_ OBJ_Inv_TTC_STD_V_39 : 38008|1@1+ (1,0) [0|1] "bool" MCU
 SG_ Reserved_12_39 : 38009|7@1+ (1,0) [0|0] "NA" MCU
 SG_ OBJ_Relative_Long_Acc_39 : 38016|10@1+ (0.05,-20) [-20|20] "m_per_s2" MCU
 SG_ OBJ_Relative_Long_Acc_V_39 : 38026|1@1+ (1,0) [0|1] "bool" MCU
 SG_ OBJ_Relative_Long_Acc_STD_39 : 38027|10@1+ (0.01,0) [0|7.3] "m_per_s2" MCU
 SG_ OBJ_Rel_Long_Acc_STD_V_39 : 38037|1@1+ (1,0) [0|1] "bool" MCU
 SG_ Reserved_13_39 : 38038|10@1+ (1,0) [0|0] "NA" MCU
 SG_ OBJ_Relative_Long_Velocity_39 : 38048|13@1+ (0.05,-120) [-120|130] "m_per_s" MCU
 SG_ OBJ_Relative_Long_Velocity_V_39 : 38061|1@1+ (1,0) [0|1] "bool" MCU
 SG_ OBJ_Relative_Long_Vel_STD_39 : 38062|14@1+ (0.01,0) [0|130] "m_per_s" MCU
 SG_ OBJ_Rel_Long_Vel_STD_V_39 : 38076|1@1+ (1,0) [0|1] "bool" MCU
 SG_ Reserved_14_39 : 38077|3@1+ (1,0) [0|0] "NA" MCU
 SG_ OBJ_Relative_Lat_Velocity_39 : 38080|11@1+ (0.05,-50) [-50|50] "m_per_s" MCU
 SG_ OBJ_Relative_Lat_Velocity_V_39 : 38091|1@1+ (1,0) [0|1] "bool" MCU
 SG_ OBJ_Relative_Lat_Velocity_STD_39 : 38092|13@1+ (0.01,0) [0|50] "m_per_s" MCU
 SG_ OBJ_Rel_Lat_Vel_STD_V_39 : 38105|1@1+ (1,0) [0|1] "bool" MCU
 SG_ Reserved_15_39 : 38106|6@1+ (1,0) [0|0] "NA" MCU
 SG_ OBJ_Long_Distance_39 : 38112|14@1+ (0.05,-200) [-200|500] "m" MCU
 SG_ OBJ_Long_Distance_V_39 : 38126|1@1+ (1,0) [0|1] "bool" MCU
 SG_ OBJ_Long_Distance_STD_39 : 38127|15@1+ (0.01,0) [0|250] "m" MCU
 SG_ OBJ_Long_Distance_STD_V_39 : 38142|1@1+ (1,0) [0|1] "bool" MCU
 SG_ Reserved_16_39 : 38143|1@1+ (1,0) [0|0] "NA" MCU
 SG_ OBJ_Lat_Distance_39 : 38144|12@1+ (0.05,-100) [-100|100] "m" MCU
 SG_ OBJ_Lat_Distance_V_39 : 38156|1@1+ (1,0) [0|1] "bool" MCU
 SG_ OBJ_Lat_Distance_STD_39 : 38157|14@1+ (0.01,0) [0|100] "m" MCU
 SG_ OBJ_Lat_Distance_STD_V_39 : 38171|1@1+ (1,0) [0|1] "bool" MCU
 SG_ Reserved_17_39 : 38172|4@1+ (1,0) [0|0] "NA" MCU
 SG_ OBJ_Absolute_Speed_39 : 38176|12@1+ (0.05,-65) [-65|65] "m_per_s" MCU
 SG_ OBJ_Absolute_Speed_V_39 : 38188|1@1+ (1,0) [0|1] "bool" MCU
 SG_ OBJ_Absolute_Speed_STD_39 : 38189|13@1+ (0.01,0) [0|65] "m_per_s" MCU
 SG_ OBJ_Absolute_Speed_STD_V_39 : 38202|1@1+ (1,0) [0|1] "bool" MCU
 SG_ Reserved_18_39 : 38203|5@1+ (1,0) [0|0] "NA" MCU
 SG_ OBJ_Heading_39 : 38208|10@1+ (0.01,-3.14) [-3.14|3.14] "rad" MCU
 SG_ OBJ_Heading_V_39 : 38218|1@1+ (1,0) [0|1] "bool" MCU
 SG_ OBJ_Heading_STD_39 : 38219|15@1+ (0.0001,0) [0|3.14] "rad" MCU
 SG_ OBJ_Heading_STD_V_39 : 38234|1@1+ (1,0) [0|1] "bool" MCU
 SG_ Reserved_19_39 : 38235|5@1+ (1,0) [0|0] "NA" MCU
 SG_ OBJ_Angle_Rate_STD_39 : 38240|15@1+ (0.0001,0) [0|2.2318] "RPS" MCU
 SG_ OBJ_Angle_Rate_STD_V_39 : 38255|1@1+ (1,0) [0|1] "bool" MCU
 SG_ OBJ_Angle_Rate_39 : 38256|12@1+ (0.002,-2.234) [-2.234|2.2318] "RPS" MCU
 SG_ OBJ_Angle_Rate_V_39 : 38268|1@1+ (1,0) [0|1] "bool" MCU
 SG_ Reserved_20_39 : 38269|3@1+ (1,0) [0|0] "NA" MCU
 SG_ OBJ_Angle_Right_39 : 38272|14@1+ (0.0002,-1.571) [-1.571|1.571] "rad" MCU
 SG_ OBJ_Angle_Right_V_39 : 38286|1@1+ (1,0) [0|1] "bool" MCU
 SG_ OBJ_Angle_Right_STD_39 : 38287|14@1+ (0.0001,0) [0|1.571] "rad" MCU
 SG_ OBJ_Angle_Right_STD_V_39 : 38301|1@1+ (1,0) [0|1] "bool" MCU
 SG_ Reserved_21_39 : 38302|2@1+ (1,0) [0|0] "NA" MCU
 SG_ OBJ_Angle_Left_39 : 38304|14@1+ (0.0002,-1.571) [-1.571|1.571] "rad" MCU
 SG_ OBJ_Angle_Left_V_39 : 38318|1@1+ (1,0) [0|1] "bool" MCU
 SG_ OBJ_Angle_Left_STD_39 : 38319|14@1+ (0.0001,0) [0|1.571] "rad" MCU
 SG_ OBJ_Angle_Left_STD_V_39 : 38333|1@1+ (1,0) [0|1] "bool" MCU
 SG_ Reserved_22_39 : 38334|2@1+ (1,0) [0|0] "NA" MCU
 SG_ OBJ_Angle_Side_39 : 38336|14@1+ (0.0002,-1.571) [-1.571|1.571] "rad" MCU
 SG_ OBJ_Angle_Side_V_39 : 38350|1@1+ (1,0) [0|1] "bool" MCU
 SG_ OBJ_Angle_Side_STD_39 : 38351|14@1+ (0.0001,0) [0|1.571] "rad" MCU
 SG_ OBJ_Angle_Side_STD_V_39 : 38365|1@1+ (1,0) [0|1] "bool" MCU
 SG_ OBJ_Angle_Mid_V_39 : 38366|1@1+ (1,0) [0|1] "bool" MCU
 SG_ Reserved_23_39 : 38367|1@1+ (1,0) [0|0] "NA" MCU
 SG_ OBJ_Angle_Mid_39 : 38368|14@1+ (0.0002,-1.571) [-1.571|1.571] "rad" MCU
 SG_ OBJ_Angle_Mid_STD_39 : 38382|14@1+ (0.0001,0) [0|1.571] "rad" MCU
 SG_ OBJ_Angle_Mid_STD_V_39 : 38396|1@1+ (1,0) [0|1] "bool" MCU
 SG_ OBJ_Angle_Bottom_V_39 : 38397|1@1+ (1,0) [0|1] "bool" MCU
 SG_ Reserved_24_39 : 38398|2@1+ (1,0) [0|0] "NA" MCU
 SG_ OBJ_Angle_Bottom_39 : 38400|14@1+ (0.0002,-1.571) [-1.571|1.571] "rad" MCU
 SG_ OBJ_Angle_Bottom_STD_39 : 38414|14@1+ (0.0001,0) [0|1.571] "rad" MCU
 SG_ OBJ_Angle_Bottom_STD_V_39 : 38428|1@1+ (1,0) [0|1] "bool" MCU
 SG_ OBJ_Visibility_Side_V_39 : 38429|1@1+ (1,0) [0|1] "bool" MCU
 SG_ OBJ_Visibility_Side_39 : 38430|2@1+ (1,0) [0|2] "ENUM" MCU
 SG_ OBJ_Is_In_Drivable_Area_39 : 38432|1@1+ (1,0) [0|1] "bool" MCU
 SG_ OBJ_Is_In_Drivable_Area_V_39 : 38433|1@1+ (1,0) [0|1] "bool" MCU
 SG_ OBJ_Is_VeryClose_V_39 : 38434|1@1+ (1,0) [0|1] "bool" MCU
 SG_ OBJ_Is_VeryClose_39 : 38435|1@1+ (1,0) [0|1] "bool" MCU
 SG_ OBJ_Buffer_C4_39 : 38436|2@1+ (1,0) [0|2] "NA" MCU
 SG_ OBJ_Buffer_C5_39 : 38438|2@1+ (1,0) [0|2] "NA" MCU
 SG_ OBJ_Buffer_C6_39 : 38440|2@1+ (1,0) [0|2] "NA" MCU
 SG_ OBJ_Buffer_C7_39 : 38442|2@1+ (1,0) [0|2] "NA" MCU
 SG_ OBJ_OverlapAngleEgoLaneR_39 : 38444|10@1+ (0.01,-3.14) [-3.14|3.14] "rad" MCU
 SG_ OBJ_OverlapAngleEgoLaneR_V_39 : 38454|1@1+ (1,0) [0|1] "bool" MCU
 SG_ Reserved_25_39 : 38455|9@1+ (1,0) [0|0] "NA" MCU
 SG_ OBJ_OverlapAngleEgoLaneL_39 : 38464|10@1+ (0.01,-3.14) [-3.14|3.14] "rad" MCU
 SG_ OBJ_OverlapAngleEgoLaneL_V_39 : 38474|1@1+ (1,0) [0|1] "bool" MCU
 SG_ OBJ_Is_EMERGENCY_VCL_39 : 38475|1@1+ (1,0) [0|1] "bool" MCU
 SG_ OBJ_EMERGENCY_LIGHT_COLOR_39 : 38476|4@1+ (1,0) [0|15] "BITWIZE" MCU
 SG_ OBJ_EMERGENCY_V_39 : 38480|1@1+ (1,0) [0|1] "bool" MCU
 SG_ OBJ_Angle_Top_39 : 38481|14@1+ (0.0002,0) [0|3.1415] "rad" MCU
 SG_ OBJ_Angle_Top_V_39 : 38495|1@1+ (1,0) [0|1] "bool" MCU
 SG_ OBJ_Angle_Top_STD_39 : 38496|15@1+ (0.0001,0) [0|3.1415] "rad" MCU
 SG_ OBJ_Angle_Top_STD_V_39 : 38511|1@1+ (1,0) [0|1] "bool" MCU
 SG_ OBJ_Open_Door_Left_39 : 38512|1@1+ (1,0) [0|1] "bool" MCU
 SG_ OBJ_Open_Door_Right_39 : 38513|1@1+ (1,0) [0|1] "bool" MCU
 SG_ OBJ_Visible_Left_or_Right_39 : 38514|2@1+ (1,0) [0|2] "ENUM" MCU
 SG_ OBJ_Visible_Left_or_Right_V_39 : 38516|1@1+ (1,0) [0|1] "bool" MCU
 SG_ OBJ_2W_Is_Motorbike_Probability_39 : 38517|8@1+ (0.01,0) [0|1] "NA" MCU
 SG_ Reserved_26_39 : 38525|3@1+ (1,0) [0|0] "NA" MCU
 SG_ OBJ_2W_Is_Bicycle_Probability_39 : 38528|8@1+ (0.01,0) [0|1] "NA" MCU
 SG_ Reserved_27_39 : 38536|24@1+ (1,0) [0|0] "NA" MCU

CM_ SG_ 154 OBJ_Abs_Long_Velocity_STD_34 "Standard deviation of absolute longitudinal velocity.";
CM_ SG_ 154 OBJ_Abs_Long_Vel_STD_V_34 "Validator for the standard deviation of the absolute longitudinal velocity.";
CM_ SG_ 154 OBJ_Abs_Lat_Velocity_34 "The lateral ground speed of the object.";
CM_ SG_ 154 OBJ_Abs_Lat_Velocity_V_34 "Validator for the lateral ground speed of the object.";
CM_ SG_ 154 OBJ_Abs_Lat_Velocity_STD_34 "STD of the lateral ground speed of the object.";
CM_ SG_ 154 OBJ_Abs_Lat_Vel_STD_V_34 "Validator for the STD of the lateral ground speed of the object.";
CM_ SG_ 154 OBJ_Abs_Long_Acc_34 "The longitudinal ground acceleration of the object.";
CM_ SG_ 154 OBJ_Abs_Long_Acc_V_34 "Validator for the longitudinal ground acceleration of the object.";
CM_ SG_ 154 OBJ_Abs_Long_Acc_STD_34 "STD of the longitudinal ground acceleration of the object.";
CM_ SG_ 154 OBJ_Abs_Long_Acc_STD_V_34 "Validator for the STD of the longitudinal ground acceleration of the object.";
CM_ SG_ 154 OBJ_Abs_Lat_Acc_34 "The lateral ground acceleration of the object.";
CM_ SG_ 154 OBJ_Abs_Lat_Acc_V_34 "Validator for the lateral ground acceleration of the object.";
CM_ SG_ 154 OBJ_Abs_Lat_Acc_STD_34 "STD of the lateral ground acceleration of the object.";
CM_ SG_ 154 OBJ_Abs_Lat_Acc_STD_V_34 "Validator for the STD of the lateral ground acceleration of the object.";
CM_ SG_ 154 OBJ_Abs_Acceleration_34 "The absolute ground acceleration in the target's heading direction.";
CM_ SG_ 154 OBJ_Abs_Acceleration_V_34 "Validator for the absolute ground acceleration.";
CM_ SG_ 154 OBJ_Abs_Acc_STD_34 "STD of the absolute ground acceleration.";
CM_ SG_ 154 OBJ_Abs_Acc_STD_V_34 "Validator for the STD of the absolute ground acceleration.";
CM_ SG_ 154 OBJ_Inv_TTC_34 "Inverse TTC (time to collision).";
CM_ SG_ 154 OBJ_Inv_TTC_STD_34 "STD for inverse TTC .";
CM_ SG_ 154 OBJ_Inv_TTC_STD_V_34 "Validator for the STD for inverse TTC .";
CM_ SG_ 154 OBJ_Relative_Long_Acc_34 "The relative longitudinal ground acceleration of the object.";
CM_ SG_ 154 OBJ_Relative_Long_Acc_V_34 "Validator for the relative longitudinal ground acceleration of the object.";
CM_ SG_ 154 OBJ_Relative_Long_Acc_STD_34 "STD of the relative longitudinal ground acceleration of the object.";
CM_ SG_ 154 OBJ_Rel_Long_Acc_STD_V_34 "Validator for the STD of the relative longitudinal ground acceleration.";
CM_ SG_ 154 OBJ_Relative_Long_Velocity_34 "The relative longtitudinal speed between the target and ego vehicle. ";
CM_ SG_ 154 OBJ_Relative_Long_Velocity_V_34 "Validator for the relative longtitudinal speed.";
CM_ SG_ 154 OBJ_Relative_Long_Vel_STD_34 "STD of the relative longtitudinal speed.";
CM_ SG_ 154 OBJ_Rel_Long_Vel_STD_V_34 "Validator for the STD of the relative longtitudinal speed.";
CM_ SG_ 154 OBJ_Relative_Lat_Velocity_34 "The relative lateral speed between the target and ego vehicle. ";
CM_ SG_ 154 OBJ_Relative_Lat_Velocity_V_34 "Validator for the relative lateral speed. ";
CM_ SG_ 154 OBJ_Relative_Lat_Velocity_STD_34 "STD of the relative lateral speed. ";
CM_ SG_ 154 OBJ_Rel_Lat_Vel_STD_V_34 "Validator for the STD of the relative lateral speed. ";
CM_ SG_ 154 OBJ_Long_Distance_34 "The longitudinal distance to middle of the rear bumper (middle of the RL and RR corners) of the target.";
CM_ SG_ 154 OBJ_Long_Distance_V_34 "Validator of the longtitudinal distance field";
CM_ SG_ 154 OBJ_Long_Distance_STD_34 "STD of the  longtitudinal distance.";
CM_ SG_ 154 OBJ_Long_Distance_STD_V_34 "Validator for the STD of the  longtitudinal distance.";
CM_ SG_ 154 OBJ_Lat_Distance_34 "Lateral distance to the middle of the RL and RR corners.  ";
CM_ SG_ 154 OBJ_Lat_Distance_V_34 "Validator for the lateral distance of the object.";
CM_ SG_ 154 OBJ_Lat_Distance_STD_34 "STD of the lateral distance of the object.";
CM_ SG_ 154 OBJ_Lat_Distance_STD_V_34 "Validator for the STD of the lateral distance of the object.";
CM_ SG_ 154 OBJ_Absolute_Speed_34 "The absolute ground speed in the targets' heading direction.";
CM_ SG_ 154 OBJ_Absolute_Speed_V_34 "Validator for the absolute ground speed.";
CM_ SG_ 154 OBJ_Absolute_Speed_STD_34 "STD of the absolute ground speed.";
CM_ SG_ 154 OBJ_Absolute_Speed_STD_V_34 "Validator for the STD of the absolute ground speed.";
CM_ SG_ 154 OBJ_Heading_34 "The angle beetweenthe host longitudinal axis and target's heading (clockwise, e.g. PI/2 is a target crossing from left to right).";
CM_ SG_ 154 OBJ_Heading_V_34 "Validator for the object heading.";
CM_ SG_ 154 OBJ_Heading_STD_34 "STD of the object heading.";
CM_ SG_ 154 OBJ_Heading_STD_V_34 "Validator for the STD of the object heading.";
CM_ SG_ 154 OBJ_Angle_Rate_STD_34 "Standard deviation of the angular speed. (radians)";
CM_ SG_ 154 OBJ_Angle_Rate_STD_V_34 "Validator for the STD of the angular speed.";
CM_ SG_ 154 OBJ_Angle_Rate_34 "The momentary angular speed of the object (radians). The positive side is to the host's right.";
CM_ SG_ 154 OBJ_Angle_Rate_V_34 "Validator for the angular speed.";
CM_ SG_ 154 OBJ_Angle_Right_34 "The angle between the host longitudinal axis and the right side of the front / rear of the target (the visible one). The positive side is to the host's right.";
CM_ SG_ 154 OBJ_Angle_Right_V_34 "Validator for angleRight";
CM_ SG_ 154 OBJ_Angle_Right_STD_34 "Standard deviation of angleRight";
CM_ SG_ 154 OBJ_Angle_Right_STD_V_34 "Validator for the standard deviation of angleRight.";
CM_ SG_ 154 OBJ_Angle_Left_34 "The angle between the host longitudinal axis and the left side of the front / rear of the target (the visible one). The positive side is to the host's right.";
CM_ SG_ 154 OBJ_Angle_Left_V_34 "Validator for angleLeft.";
CM_ SG_ 154 OBJ_Angle_Left_STD_34 "Standard deviation of angleLeft.";
CM_ SG_ 154 OBJ_Angle_Left_STD_V_34 "Validator for the standard deviation of angleLeft.";
CM_ SG_ 154 OBJ_Angle_Side_34 "The angle between the host longitudinal axis and the far visible edge - the visible edge of the front / rear of the target that is not visible. Currently supported for vehicles only.";
CM_ SG_ 154 OBJ_Angle_Side_V_34 "Validator for angleSide.";
CM_ SG_ 154 OBJ_Angle_Side_STD_34 "Standard deviation of angleSide.";
CM_ SG_ 154 OBJ_Angle_Side_STD_V_34 "Validator for the STD of angleSide.";
CM_ SG_ 154 OBJ_Angle_Mid_V_34 "Validator for angleMid.";
CM_ SG_ 154 OBJ_Angle_Mid_34 "The angle between the host longitudinal axis and the middle of the front / rear of the target (the visible one). The positive side is to the host's right.";
CM_ SG_ 154 OBJ_Angle_Mid_STD_34 "Standard deviation of angleMid.";
CM_ SG_ 154 OBJ_Angle_Mid_STD_V_34 "Validator for the STD of angleMid.";
CM_ SG_ 154 OBJ_Angle_Bottom_V_34 "Validator for OBJAngle_Bottom. ";
CM_ SG_ 154 OBJ_Angle_Bottom_34 "The angle between the longitudinal axis and the Bottom of the front / rear of the target (the visible one). The positive side is to the host's bottom";
CM_ SG_ 154 OBJ_Angle_Bottom_STD_34 "STD for OBJAngle_Bottom. ";
CM_ SG_ 154 OBJ_Angle_Bottom_STD_V_34 "Validator for OBJAngle_Bottom_STD. ";
CM_ SG_ 154 OBJ_Visibility_Side_V_34 "Currently Supported for VD only";
CM_ SG_ 154 OBJ_Visibility_Side_34 "From what car  side is the object visible";
CM_ SG_ 154 OBJ_Is_In_Drivable_Area_34 "Indicates whether the target is in a driveable area.";
CM_ SG_ 154 OBJ_Is_In_Drivable_Area_V_34 "Validator for OBJ_Is_In_Drivable_Area.";
CM_ SG_ 154 OBJ_Is_VeryClose_V_34 "Validator for OBJ_Is_VeryClose. ";
CM_ SG_ 154 OBJ_Is_VeryClose_34 "Indicates whether the target is very close to the host such that it is hard to measure its distance. Currently relevant for peds only";
CM_ SG_ 154 OBJ_OverlapAngleEgoLaneR_34 "Lateral distance to the middle of the RL and RR corners.";
CM_ SG_ 154 OBJ_OverlapAngleEgoLaneR_V_34 "Validator for OBJ_OverlapAngleEgoLaneR";
CM_ SG_ 154 OBJ_OverlapAngleEgoLaneL_34 "Lateral distance to the middle of the RL and RR corners.  ";
CM_ SG_ 154 OBJ_OverlapAngleEgoLaneL_V_34 "Validator for OBJ_OverlapAngleEgoLaneL";
CM_ SG_ 154 OBJ_Is_EMERGENCY_VCL_34 "Is Object an Emergency Vehicle";
CM_ SG_ 154 OBJ_EMERGENCY_LIGHT_COLOR_34 "Emergency Color";
CM_ SG_ 154 OBJ_EMERGENCY_V_34 "Are OBJ_Is_EMERGENCY_VCL and OBJ_EMERGENCY_LIGHT_COLOR Valid";
CM_ SG_ 154 OBJ_Angle_Top_34 "From VD touching point on the ground till the roof of the car";
CM_ SG_ 154 OBJ_Angle_Top_V_34 "Validator for OBJ_Angle_Top ";
CM_ SG_ 154 OBJ_Angle_Top_STD_34 "STD for OBJ_Angle_Top";
CM_ SG_ 154 OBJ_Angle_Top_STD_V_34 "Validator for OBJ_Angle_Top_STD. ";
CM_ SG_ 154 OBJ_Open_Door_Left_34 "Indicator if left door is open";
CM_ SG_ 154 OBJ_Open_Door_Right_34 "Indicator if right door is open";
CM_ SG_ 154 OBJ_Visible_Left_or_Right_34 "This signal describes the visible Left or Right side of the Target vehicle.";
CM_ SG_ 154 OBJ_Visible_Left_or_Right_V_34 "OBJ_Visible_Left_or_Right";
CM_ SG_ 154 OBJ_2W_Is_Motorbike_Probability_34 "The probability of the Two-wheeler reported object being a Motorbike";
CM_ SG_ 154 OBJ_2W_Is_Bicycle_Probability_34 "The probability of the Two-wheeler reported object being a Bicycle";
CM_ SG_ 154 OBJ_CRC_35 "Calculated over all element signals. From the signal after the CRC until the first signal in the next elements OBJ_CRC_N+1  not including";
CM_ SG_ 154 OBJ_ID_35 "The detected object ID. Range is 1-255, while 0 indicates that the field in unfilled.";
CM_ SG_ 154 OBJ_Existence_Probability_35 "The existence probability of the reported object";
CM_ SG_ 154 OBJ_Fusion_Source_35 "sources ids used for fusion";
CM_ SG_ 154 OBJ_Triggered_SDM_35 "Indicates whether the object has trigered the SDM (Safety Diagnostic Manager) alert.";
CM_ SG_ 154 OBJ_Motion_Category_35 "Relevant for VD only. Full description of values can be found at the ACC guide.";
CM_ SG_ 154 OBJ_Moving_IN_Probability_35 "The probability the object is eventually move into ego lane. (In case that the OBJ_Motion_Category signal is set to  MOVING_IN ";
CM_ SG_ 154 OBJ_Object_Age_35 "The number of frames in which the object was recognized.";
CM_ SG_ 154 OBJ_Measuring_Status_35 "Measurment status. Old vs New marks if this is the first frame in which the object is reported. Predicted vs Measured marks if the report is raw or has been predicted forward in time using the measured dynamics and ego motion.";
CM_ SG_ 154 OBJ_Object_Class_35 "Indicates the object type. Uncertain is outputted in case the probability that a vehicle is a truck is very similar to the probability that it is a car.";
CM_ SG_ 154 OBJ_Class_Probability_35 "The probability of this type classification.";
CM_ SG_ 154 OBJ_Car_Probability_35 "The probability the object is a car";
CM_ SG_ 154 OBJ_Truck_Probability_35 "The probability the object is a Truck";
CM_ SG_ 154 OBJ_Bike_Probability_35 "The probability the object is a Bike";
CM_ SG_ 154 OBJ_Camera_Source_35 "The camera in which this object was detected (best choice).";
CM_ SG_ 154 OBJ_Motion_Status_35 "MOVING - the object is moving STATIONARY - the object was never seen moving STOPPED -  the object was moving and has stopped MOVING_SLOWLY - the object is moving very slowly";
CM_ SG_ 154 OBJ_Motion_Orientation_35 "The direction of the targets heading compared to the host. ";
CM_ SG_ 154 OBJ_Has_Cut_Lane_35 "Indicates whether the object cut the host's (right or left) lane. In case there are no lanes, indicates whether the objects is at most 1 meters away from the host.";
CM_ SG_ 154 OBJ_Has_Cut_Path_35 "Indicates whether the object is in the host's path.";
CM_ SG_ 154 OBJ_Brake_Light_Validity_35 "Validator for braking light indicator";
CM_ SG_ 154 OBJ_Brake_Light_35 "Indication for brake lights ";
CM_ SG_ 154 OBJ_Turn_Indicator_Right_35 "Indication for blinking right light.";
CM_ SG_ 154 OBJ_Turn_Indicator_Left_35 "Indication for blinking left light ";
CM_ SG_ 154 OBJ_Turn_Indicator_Validity_35 "Validator for light indicators";
CM_ SG_ 154 OBJ_Right_Out_Of_Image_35 "Indicates whether the measurment are predicted out of the right side of the image bounderies.";
CM_ SG_ 154 OBJ_Left_Out_Of_Image_35 "Indicates whether if measurment are predicted out of  the left side of the image bounderies";
CM_ SG_ 154 OBJ_Right_Out_Of_Image_V_35 "validator";
CM_ SG_ 154 OBJ_Left_Out_Of_Image_V_35 "validator";
CM_ SG_ 154 OBJ_Top_Out_Of_Image_35 "Indicates whether if measurment are predicted out of  the top of the image bounderies";
CM_ SG_ 154 OBJ_Bottom_Out_Of_Image_35 "Indicates whether if measurment are predicted out of  the bottom of the image bounderies";
CM_ SG_ 154 OBJ_Top_Out_Of_Image_V_35 "validator";
CM_ SG_ 154 OBJ_Bottom_Out_Of_Image_V_35 "validator";
CM_ SG_ 154 OBJ_Lane_Assignment_35 "The object's lane relative to the host lane.";
CM_ SG_ 154 OBJ_Lane_Assignment_V_35 "Validator for lane assignment";
CM_ SG_ 154 OBJ_Age_Seconds_35 "Time in seconds in which the object was recognized. ";
CM_ SG_ 154 OBJ_Age_Seconds_V_35 "Validator for object age";
CM_ SG_ 154 OBJ_Width_35 "The width of the target vehicle in the world (not to be mistaken with the width of the visible part of the vehicle).";
CM_ SG_ 154 OBJ_Width_V_35 "Validator for object width";
CM_ SG_ 154 OBJ_Width_STD_35 "Standard deviation for object width";
CM_ SG_ 154 OBJ_Width_STD_V_35 "Validator for the standard deviation of object width";
CM_ SG_ 154 OBJ_Length_35 "The length of the vehicle in the world. For crossing bicycles it gives the viewed length of the bicycle.";
CM_ SG_ 154 OBJ_Length_V_35 "Validator for object length.";
CM_ SG_ 154 OBJ_Length_STD_35 "Standard deviation for object length.";
CM_ SG_ 154 OBJ_Length_STD_V_35 "Validator for the standard deviation of object length.";
CM_ SG_ 154 OBJ_Radar_ID_35 "Radar Object ID of the Fused Object, Only relvant when OBJ_Fusion_Source is not Camera only";
CM_ SG_ 154 OBJ_Height_35 "The height of the object in the world. ";
CM_ SG_ 154 OBJ_Height_V_35 "Validator for object height.";
CM_ SG_ 154 OBJ_Height_STD_35 "Standard deviation for object height.";
CM_ SG_ 154 OBJ_Height_STD_V_35 "Validator for the standard deviation of object height.";
CM_ SG_ 154 OBJ_Abs_Long_Velocity_35 "Absolute longitudinal velocity.";
CM_ SG_ 154 OBJ_Abs_Long_Velocity_V_35 "Validator for absolute longitudinal velocity.";
CM_ SG_ 154 OBJ_Abs_Long_Velocity_STD_35 "Standard deviation of absolute longitudinal velocity.";
CM_ SG_ 154 OBJ_Abs_Long_Vel_STD_V_35 "Validator for the standard deviation of the absolute longitudinal velocity.";
CM_ SG_ 154 OBJ_Abs_Lat_Velocity_35 "The lateral ground speed of the object.";
CM_ SG_ 154 OBJ_Abs_Lat_Velocity_V_35 "Validator for the lateral ground speed of the object.";
CM_ SG_ 154 OBJ_Abs_Lat_Velocity_STD_35 "STD of the lateral ground speed of the object.";
CM_ SG_ 154 OBJ_Abs_Lat_Vel_STD_V_35 "Validator for the STD of the lateral ground speed of the object.";
CM_ SG_ 154 OBJ_Abs_Long_Acc_35 "The longitudinal ground acceleration of the object.";
CM_ SG_ 154 OBJ_Abs_Long_Acc_V_35 "Validator for the longitudinal ground acceleration of the object.";
CM_ SG_ 154 OBJ_Abs_Long_Acc_STD_35 "STD of the longitudinal ground acceleration of the object.";
CM_ SG_ 154 OBJ_Abs_Long_Acc_STD_V_35 "Validator for the STD of the longitudinal ground acceleration of the object.";
CM_ SG_ 154 OBJ_Abs_Lat_Acc_35 "The lateral ground acceleration of the object.";
CM_ SG_ 154 OBJ_Abs_Lat_Acc_V_35 "Validator for the lateral ground acceleration of the object.";
CM_ SG_ 154 OBJ_Abs_Lat_Acc_STD_35 "STD of the lateral ground acceleration of the object.";
CM_ SG_ 154 OBJ_Abs_Lat_Acc_STD_V_35 "Validator for the STD of the lateral ground acceleration of the object.";
CM_ SG_ 154 OBJ_Abs_Acceleration_35 "The absolute ground acceleration in the target's heading direction.";
CM_ SG_ 154 OBJ_Abs_Acceleration_V_35 "Validator for the absolute ground acceleration.";
CM_ SG_ 154 OBJ_Abs_Acc_STD_35 "STD of the absolute ground acceleration.";
CM_ SG_ 154 OBJ_Abs_Acc_STD_V_35 "Validator for the STD of the absolute ground acceleration.";
CM_ SG_ 154 OBJ_Inv_TTC_35 "Inverse TTC (time to collision).";
CM_ SG_ 154 OBJ_Inv_TTC_STD_35 "STD for inverse TTC .";
CM_ SG_ 154 OBJ_Inv_TTC_STD_V_35 "Validator for the STD for inverse TTC .";
CM_ SG_ 154 OBJ_Relative_Long_Acc_35 "The relative longitudinal ground acceleration of the object.";
CM_ SG_ 154 OBJ_Relative_Long_Acc_V_35 "Validator for the relative longitudinal ground acceleration of the object.";
CM_ SG_ 154 OBJ_Relative_Long_Acc_STD_35 "STD of the relative longitudinal ground acceleration of the object.";
CM_ SG_ 154 OBJ_Rel_Long_Acc_STD_V_35 "Validator for the STD of the relative longitudinal ground acceleration.";
CM_ SG_ 154 OBJ_Relative_Long_Velocity_35 "The relative longtitudinal speed between the target and ego vehicle. ";
CM_ SG_ 154 OBJ_Relative_Long_Velocity_V_35 "Validator for the relative longtitudinal speed.";
CM_ SG_ 154 OBJ_Relative_Long_Vel_STD_35 "STD of the relative longtitudinal speed.";
CM_ SG_ 154 OBJ_Rel_Long_Vel_STD_V_35 "Validator for the STD of the relative longtitudinal speed.";
CM_ SG_ 154 OBJ_Relative_Lat_Velocity_35 "The relative lateral speed between the target and ego vehicle. ";
CM_ SG_ 154 OBJ_Relative_Lat_Velocity_V_35 "Validator for the relative lateral speed. ";
CM_ SG_ 154 OBJ_Relative_Lat_Velocity_STD_35 "STD of the relative lateral speed. ";
CM_ SG_ 154 OBJ_Rel_Lat_Vel_STD_V_35 "Validator for the STD of the relative lateral speed. ";
CM_ SG_ 154 OBJ_Long_Distance_35 "The longitudinal distance to middle of the rear bumper (middle of the RL and RR corners) of the target.";
CM_ SG_ 154 OBJ_Long_Distance_V_35 "Validator of the longtitudinal distance field";
CM_ SG_ 154 OBJ_Long_Distance_STD_35 "STD of the  longtitudinal distance.";
CM_ SG_ 154 OBJ_Long_Distance_STD_V_35 "Validator for the STD of the  longtitudinal distance.";
CM_ SG_ 154 OBJ_Lat_Distance_35 "Lateral distance to the middle of the RL and RR corners.  ";
CM_ SG_ 154 OBJ_Lat_Distance_V_35 "Validator for the lateral distance of the object.";
CM_ SG_ 154 OBJ_Lat_Distance_STD_35 "STD of the lateral distance of the object.";
CM_ SG_ 154 OBJ_Lat_Distance_STD_V_35 "Validator for the STD of the lateral distance of the object.";
CM_ SG_ 154 OBJ_Absolute_Speed_35 "The absolute ground speed in the targets' heading direction.";
CM_ SG_ 154 OBJ_Absolute_Speed_V_35 "Validator for the absolute ground speed.";
CM_ SG_ 154 OBJ_Absolute_Speed_STD_35 "STD of the absolute ground speed.";
CM_ SG_ 154 OBJ_Absolute_Speed_STD_V_35 "Validator for the STD of the absolute ground speed.";
CM_ SG_ 154 OBJ_Heading_35 "The angle beetweenthe host longitudinal axis and target's heading (clockwise, e.g. PI/2 is a target crossing from left to right).";
CM_ SG_ 154 OBJ_Heading_V_35 "Validator for the object heading.";
CM_ SG_ 154 OBJ_Heading_STD_35 "STD of the object heading.";
CM_ SG_ 154 OBJ_Heading_STD_V_35 "Validator for the STD of the object heading.";
CM_ SG_ 154 OBJ_Angle_Rate_STD_35 "Standard deviation of the angular speed. (radians)";
CM_ SG_ 154 OBJ_Angle_Rate_STD_V_35 "Validator for the STD of the angular speed.";
CM_ SG_ 154 OBJ_Angle_Rate_35 "The momentary angular speed of the object (radians). The positive side is to the host's right.";
CM_ SG_ 154 OBJ_Angle_Rate_V_35 "Validator for the angular speed.";
CM_ SG_ 154 OBJ_Angle_Right_35 "The angle between the host longitudinal axis and the right side of the front / rear of the target (the visible one). The positive side is to the host's right.";
CM_ SG_ 154 OBJ_Angle_Right_V_35 "Validator for angleRight";
CM_ SG_ 154 OBJ_Angle_Right_STD_35 "Standard deviation of angleRight";
CM_ SG_ 154 OBJ_Angle_Right_STD_V_35 "Validator for the standard deviation of angleRight.";
CM_ SG_ 154 OBJ_Angle_Left_35 "The angle between the host longitudinal axis and the left side of the front / rear of the target (the visible one). The positive side is to the host's right.";
CM_ SG_ 154 OBJ_Angle_Left_V_35 "Validator for angleLeft.";
CM_ SG_ 154 OBJ_Angle_Left_STD_35 "Standard deviation of angleLeft.";
CM_ SG_ 154 OBJ_Angle_Left_STD_V_35 "Validator for the standard deviation of angleLeft.";
CM_ SG_ 154 OBJ_Angle_Side_35 "The angle between the host longitudinal axis and the far visible edge - the visible edge of the front / rear of the target that is not visible. Currently supported for vehicles only.";
CM_ SG_ 154 OBJ_Angle_Side_V_35 "Validator for angleSide.";
CM_ SG_ 154 OBJ_Angle_Side_STD_35 "Standard deviation of angleSide.";
CM_ SG_ 154 OBJ_Angle_Side_STD_V_35 "Validator for the STD of angleSide.";
CM_ SG_ 154 OBJ_Angle_Mid_V_35 "Validator for angleMid.";
CM_ SG_ 154 OBJ_Angle_Mid_35 "The angle between the host longitudinal axis and the middle of the front / rear of the target (the visible one). The positive side is to the host's right.";
CM_ SG_ 154 OBJ_Angle_Mid_STD_35 "Standard deviation of angleMid.";
CM_ SG_ 154 OBJ_Angle_Mid_STD_V_35 "Validator for the STD of angleMid.";
CM_ SG_ 154 OBJ_Angle_Bottom_V_35 "Validator for OBJAngle_Bottom. ";
CM_ SG_ 154 OBJ_Angle_Bottom_35 "The angle between the longitudinal axis and the Bottom of the front / rear of the target (the visible one). The positive side is to the host's bottom";
CM_ SG_ 154 OBJ_Angle_Bottom_STD_35 "STD for OBJAngle_Bottom. ";
CM_ SG_ 154 OBJ_Angle_Bottom_STD_V_35 "Validator for OBJAngle_Bottom_STD. ";
CM_ SG_ 154 OBJ_Visibility_Side_V_35 "Currently Supported for VD only";
CM_ SG_ 154 OBJ_Visibility_Side_35 "From what car  side is the object visible";
CM_ SG_ 154 OBJ_Is_In_Drivable_Area_35 "Indicates whether the target is in a driveable area.";
CM_ SG_ 154 OBJ_Is_In_Drivable_Area_V_35 "Validator for OBJ_Is_In_Drivable_Area.";
CM_ SG_ 154 OBJ_Is_VeryClose_V_35 "Validator for OBJ_Is_VeryClose. ";
CM_ SG_ 154 OBJ_Is_VeryClose_35 "Indicates whether the target is very close to the host such that it is hard to measure its distance. Currently relevant for peds only";
CM_ SG_ 154 OBJ_OverlapAngleEgoLaneR_35 "Lateral distance to the middle of the RL and RR corners.";
CM_ SG_ 154 OBJ_OverlapAngleEgoLaneR_V_35 "Validator for OBJ_OverlapAngleEgoLaneR";
CM_ SG_ 154 OBJ_OverlapAngleEgoLaneL_35 "Lateral distance to the middle of the RL and RR corners.  ";
CM_ SG_ 154 OBJ_OverlapAngleEgoLaneL_V_35 "Validator for OBJ_OverlapAngleEgoLaneL";
CM_ SG_ 154 OBJ_Is_EMERGENCY_VCL_35 "Is Object an Emergency Vehicle";
CM_ SG_ 154 OBJ_EMERGENCY_LIGHT_COLOR_35 "Emergency Color";
CM_ SG_ 154 OBJ_EMERGENCY_V_35 "Are OBJ_Is_EMERGENCY_VCL and OBJ_EMERGENCY_LIGHT_COLOR Valid";
CM_ SG_ 154 OBJ_Angle_Top_35 "From VD touching point on the ground till the roof of the car";
CM_ SG_ 154 OBJ_Angle_Top_V_35 "Validator for OBJ_Angle_Top ";
CM_ SG_ 154 OBJ_Angle_Top_STD_35 "STD for OBJ_Angle_Top";
CM_ SG_ 154 OBJ_Angle_Top_STD_V_35 "Validator for OBJ_Angle_Top_STD. ";
CM_ SG_ 154 OBJ_Open_Door_Left_35 "Indicator if left door is open";
CM_ SG_ 154 OBJ_Open_Door_Right_35 "Indicator if right door is open";
CM_ SG_ 154 OBJ_Visible_Left_or_Right_35 "This signal describes the visible Left or Right side of the Target vehicle.";
CM_ SG_ 154 OBJ_Visible_Left_or_Right_V_35 "OBJ_Visible_Left_or_Right";
CM_ SG_ 154 OBJ_2W_Is_Motorbike_Probability_35 "The probability of the Two-wheeler reported object being a Motorbike";
CM_ SG_ 154 OBJ_2W_Is_Bicycle_Probability_35 "The probability of the Two-wheeler reported object being a Bicycle";
CM_ SG_ 154 OBJ_CRC_36 "Calculated over all element signals. From the signal after the CRC until the first signal in the next elements OBJ_CRC_N+1  not including";
CM_ SG_ 154 OBJ_ID_36 "The detected object ID. Range is 1-255, while 0 indicates that the field in unfilled.";
CM_ SG_ 154 OBJ_Existence_Probability_36 "The existence probability of the reported object";
CM_ SG_ 154 OBJ_Fusion_Source_36 "sources ids used for fusion";
CM_ SG_ 154 OBJ_Triggered_SDM_36 "Indicates whether the object has trigered the SDM (Safety Diagnostic Manager) alert.";
CM_ SG_ 154 OBJ_Motion_Category_36 "Relevant for VD only. Full description of values can be found at the ACC guide.";
CM_ SG_ 154 OBJ_Moving_IN_Probability_36 "The probability the object is eventually move into ego lane. (In case that the OBJ_Motion_Category signal is set to  MOVING_IN ";
CM_ SG_ 154 OBJ_Object_Age_36 "The number of frames in which the object was recognized.";
CM_ SG_ 154 OBJ_Measuring_Status_36 "Measurment status. Old vs New marks if this is the first frame in which the object is reported. Predicted vs Measured marks if the report is raw or has been predicted forward in time using the measured dynamics and ego motion.";
CM_ SG_ 154 OBJ_Object_Class_36 "Indicates the object type. Uncertain is outputted in case the probability that a vehicle is a truck is very similar to the probability that it is a car.";
CM_ SG_ 154 OBJ_Class_Probability_36 "The probability of this type classification.";
CM_ SG_ 154 OBJ_Car_Probability_36 "The probability the object is a car";
CM_ SG_ 154 OBJ_Truck_Probability_36 "The probability the object is a Truck";
CM_ SG_ 154 OBJ_Bike_Probability_36 "The probability the object is a Bike";
CM_ SG_ 154 OBJ_Camera_Source_36 "The camera in which this object was detected (best choice).";
CM_ SG_ 154 OBJ_Motion_Status_36 "MOVING - the object is moving STATIONARY - the object was never seen moving STOPPED -  the object was moving and has stopped MOVING_SLOWLY - the object is moving very slowly";
CM_ SG_ 154 OBJ_Motion_Orientation_36 "The direction of the targets heading compared to the host. ";
CM_ SG_ 154 OBJ_Has_Cut_Lane_36 "Indicates whether the object cut the host's (right or left) lane. In case there are no lanes, indicates whether the objects is at most 1 meters away from the host.";
CM_ SG_ 154 OBJ_Has_Cut_Path_36 "Indicates whether the object is in the host's path.";
CM_ SG_ 154 OBJ_Brake_Light_Validity_36 "Validator for braking light indicator";
CM_ SG_ 154 OBJ_Brake_Light_36 "Indication for brake lights ";
CM_ SG_ 154 OBJ_Turn_Indicator_Right_36 "Indication for blinking right light.";
CM_ SG_ 154 OBJ_Turn_Indicator_Left_36 "Indication for blinking left light ";
CM_ SG_ 154 OBJ_Turn_Indicator_Validity_36 "Validator for light indicators";
CM_ SG_ 154 OBJ_Right_Out_Of_Image_36 "Indicates whether the measurment are predicted out of the right side of the image bounderies.";
CM_ SG_ 154 OBJ_Left_Out_Of_Image_36 "Indicates whether if measurment are predicted out of  the left side of the image bounderies";
CM_ SG_ 154 OBJ_Right_Out_Of_Image_V_36 "validator";
CM_ SG_ 154 OBJ_Left_Out_Of_Image_V_36 "validator";
CM_ SG_ 154 OBJ_Top_Out_Of_Image_36 "Indicates whether if measurment are predicted out of  the top of the image bounderies";
CM_ SG_ 154 OBJ_Bottom_Out_Of_Image_36 "Indicates whether if measurment are predicted out of  the bottom of the image bounderies";
CM_ SG_ 154 OBJ_Top_Out_Of_Image_V_36 "validator";
CM_ SG_ 154 OBJ_Bottom_Out_Of_Image_V_36 "validator";
CM_ SG_ 154 OBJ_Lane_Assignment_36 "The object's lane relative to the host lane.";
CM_ SG_ 154 OBJ_Lane_Assignment_V_36 "Validator for lane assignment";
CM_ SG_ 154 OBJ_Age_Seconds_36 "Time in seconds in which the object was recognized. ";
CM_ SG_ 154 OBJ_Age_Seconds_V_36 "Validator for object age";
CM_ SG_ 154 OBJ_Width_36 "The width of the target vehicle in the world (not to be mistaken with the width of the visible part of the vehicle).";
CM_ SG_ 154 OBJ_Width_V_36 "Validator for object width";
CM_ SG_ 154 OBJ_Width_STD_36 "Standard deviation for object width";
CM_ SG_ 154 OBJ_Width_STD_V_36 "Validator for the standard deviation of object width";
CM_ SG_ 154 OBJ_Length_36 "The length of the vehicle in the world. For crossing bicycles it gives the viewed length of the bicycle.";
CM_ SG_ 154 OBJ_Length_V_36 "Validator for object length.";
CM_ SG_ 154 OBJ_Length_STD_36 "Standard deviation for object length.";
CM_ SG_ 154 OBJ_Length_STD_V_36 "Validator for the standard deviation of object length.";
CM_ SG_ 154 OBJ_Radar_ID_36 "Radar Object ID of the Fused Object, Only relvant when OBJ_Fusion_Source is not Camera only";
CM_ SG_ 154 OBJ_Height_36 "The height of the object in the world. ";
CM_ SG_ 154 OBJ_Height_V_36 "Validator for object height.";
CM_ SG_ 154 OBJ_Height_STD_36 "Standard deviation for object height.";
CM_ SG_ 154 OBJ_Height_STD_V_36 "Validator for the standard deviation of object height.";
CM_ SG_ 154 OBJ_Abs_Long_Velocity_36 "Absolute longitudinal velocity.";
CM_ SG_ 154 OBJ_Abs_Long_Velocity_V_36 "Validator for absolute longitudinal velocity.";
CM_ SG_ 154 OBJ_Abs_Long_Velocity_STD_36 "Standard deviation of absolute longitudinal velocity.";
CM_ SG_ 154 OBJ_Abs_Long_Vel_STD_V_36 "Validator for the standard deviation of the absolute longitudinal velocity.";
CM_ SG_ 154 OBJ_Abs_Lat_Velocity_36 "The lateral ground speed of the object.";
CM_ SG_ 154 OBJ_Abs_Lat_Velocity_V_36 "Validator for the lateral ground speed of the object.";
CM_ SG_ 154 OBJ_Abs_Lat_Velocity_STD_36 "STD of the lateral ground speed of the object.";
CM_ SG_ 154 OBJ_Abs_Lat_Vel_STD_V_36 "Validator for the STD of the lateral ground speed of the object.";
CM_ SG_ 154 OBJ_Abs_Long_Acc_36 "The longitudinal ground acceleration of the object.";
CM_ SG_ 154 OBJ_Abs_Long_Acc_V_36 "Validator for the longitudinal ground acceleration of the object.";
CM_ SG_ 154 OBJ_Abs_Long_Acc_STD_36 "STD of the longitudinal ground acceleration of the object.";
CM_ SG_ 154 OBJ_Abs_Long_Acc_STD_V_36 "Validator for the STD of the longitudinal ground acceleration of the object.";
CM_ SG_ 154 OBJ_Abs_Lat_Acc_36 "The lateral ground acceleration of the object.";
CM_ SG_ 154 OBJ_Abs_Lat_Acc_V_36 "Validator for the lateral ground acceleration of the object.";
CM_ SG_ 154 OBJ_Abs_Lat_Acc_STD_36 "STD of the lateral ground acceleration of the object.";
CM_ SG_ 154 OBJ_Abs_Lat_Acc_STD_V_36 "Validator for the STD of the lateral ground acceleration of the object.";
CM_ SG_ 154 OBJ_Abs_Acceleration_36 "The absolute ground acceleration in the target's heading direction.";
CM_ SG_ 154 OBJ_Abs_Acceleration_V_36 "Validator for the absolute ground acceleration.";
CM_ SG_ 154 OBJ_Abs_Acc_STD_36 "STD of the absolute ground acceleration.";
CM_ SG_ 154 OBJ_Abs_Acc_STD_V_36 "Validator for the STD of the absolute ground acceleration.";
CM_ SG_ 154 OBJ_Inv_TTC_36 "Inverse TTC (time to collision).";
CM_ SG_ 154 OBJ_Inv_TTC_STD_36 "STD for inverse TTC .";
CM_ SG_ 154 OBJ_Inv_TTC_STD_V_36 "Validator for the STD for inverse TTC .";
CM_ SG_ 154 OBJ_Relative_Long_Acc_36 "The relative longitudinal ground acceleration of the object.";
CM_ SG_ 154 OBJ_Relative_Long_Acc_V_36 "Validator for the relative longitudinal ground acceleration of the object.";
CM_ SG_ 154 OBJ_Relative_Long_Acc_STD_36 "STD of the relative longitudinal ground acceleration of the object.";
CM_ SG_ 154 OBJ_Rel_Long_Acc_STD_V_36 "Validator for the STD of the relative longitudinal ground acceleration.";
CM_ SG_ 154 OBJ_Relative_Long_Velocity_36 "The relative longtitudinal speed between the target and ego vehicle. ";
CM_ SG_ 154 OBJ_Relative_Long_Velocity_V_36 "Validator for the relative longtitudinal speed.";
CM_ SG_ 154 OBJ_Relative_Long_Vel_STD_36 "STD of the relative longtitudinal speed.";
CM_ SG_ 154 OBJ_Rel_Long_Vel_STD_V_36 "Validator for the STD of the relative longtitudinal speed.";
CM_ SG_ 154 OBJ_Relative_Lat_Velocity_36 "The relative lateral speed between the target and ego vehicle. ";
CM_ SG_ 154 OBJ_Relative_Lat_Velocity_V_36 "Validator for the relative lateral speed. ";
CM_ SG_ 154 OBJ_Relative_Lat_Velocity_STD_36 "STD of the relative lateral speed. ";
CM_ SG_ 154 OBJ_Rel_Lat_Vel_STD_V_36 "Validator for the STD of the relative lateral speed. ";
CM_ SG_ 154 OBJ_Long_Distance_36 "The longitudinal distance to middle of the rear bumper (middle of the RL and RR corners) of the target.";
CM_ SG_ 154 OBJ_Long_Distance_V_36 "Validator of the longtitudinal distance field";
CM_ SG_ 154 OBJ_Long_Distance_STD_36 "STD of the  longtitudinal distance.";
CM_ SG_ 154 OBJ_Long_Distance_STD_V_36 "Validator for the STD of the  longtitudinal distance.";
CM_ SG_ 154 OBJ_Lat_Distance_36 "Lateral distance to the middle of the RL and RR corners.  ";
CM_ SG_ 154 OBJ_Lat_Distance_V_36 "Validator for the lateral distance of the object.";
CM_ SG_ 154 OBJ_Lat_Distance_STD_36 "STD of the lateral distance of the object.";
CM_ SG_ 154 OBJ_Lat_Distance_STD_V_36 "Validator for the STD of the lateral distance of the object.";
CM_ SG_ 154 OBJ_Absolute_Speed_36 "The absolute ground speed in the targets' heading direction.";
CM_ SG_ 154 OBJ_Absolute_Speed_V_36 "Validator for the absolute ground speed.";
CM_ SG_ 154 OBJ_Absolute_Speed_STD_36 "STD of the absolute ground speed.";
CM_ SG_ 154 OBJ_Absolute_Speed_STD_V_36 "Validator for the STD of the absolute ground speed.";
CM_ SG_ 154 OBJ_Heading_36 "The angle beetweenthe host longitudinal axis and target's heading (clockwise, e.g. PI/2 is a target crossing from left to right).";
CM_ SG_ 154 OBJ_Heading_V_36 "Validator for the object heading.";
CM_ SG_ 154 OBJ_Heading_STD_36 "STD of the object heading.";
CM_ SG_ 154 OBJ_Heading_STD_V_36 "Validator for the STD of the object heading.";
CM_ SG_ 154 OBJ_Angle_Rate_STD_36 "Standard deviation of the angular speed. (radians)";
CM_ SG_ 154 OBJ_Angle_Rate_STD_V_36 "Validator for the STD of the angular speed.";
CM_ SG_ 154 OBJ_Angle_Rate_36 "The momentary angular speed of the object (radians). The positive side is to the host's right.";
CM_ SG_ 154 OBJ_Angle_Rate_V_36 "Validator for the angular speed.";
CM_ SG_ 154 OBJ_Angle_Right_36 "The angle between the host longitudinal axis and the right side of the front / rear of the target (the visible one). The positive side is to the host's right.";
CM_ SG_ 154 OBJ_Angle_Right_V_36 "Validator for angleRight";
CM_ SG_ 154 OBJ_Angle_Right_STD_36 "Standard deviation of angleRight";
CM_ SG_ 154 OBJ_Angle_Right_STD_V_36 "Validator for the standard deviation of angleRight.";
CM_ SG_ 154 OBJ_Angle_Left_36 "The angle between the host longitudinal axis and the left side of the front / rear of the target (the visible one). The positive side is to the host's right.";
CM_ SG_ 154 OBJ_Angle_Left_V_36 "Validator for angleLeft.";
CM_ SG_ 154 OBJ_Angle_Left_STD_36 "Standard deviation of angleLeft.";
CM_ SG_ 154 OBJ_Angle_Left_STD_V_36 "Validator for the standard deviation of angleLeft.";
CM_ SG_ 154 OBJ_Angle_Side_36 "The angle between the host longitudinal axis and the far visible edge - the visible edge of the front / rear of the target that is not visible. Currently supported for vehicles only.";
CM_ SG_ 154 OBJ_Angle_Side_V_36 "Validator for angleSide.";
CM_ SG_ 154 OBJ_Angle_Side_STD_36 "Standard deviation of angleSide.";
CM_ SG_ 154 OBJ_Angle_Side_STD_V_36 "Validator for the STD of angleSide.";
CM_ SG_ 154 OBJ_Angle_Mid_V_36 "Validator for angleMid.";
CM_ SG_ 154 OBJ_Angle_Mid_36 "The angle between the host longitudinal axis and the middle of the front / rear of the target (the visible one). The positive side is to the host's right.";
CM_ SG_ 154 OBJ_Angle_Mid_STD_36 "Standard deviation of angleMid.";
CM_ SG_ 154 OBJ_Angle_Mid_STD_V_36 "Validator for the STD of angleMid.";
CM_ SG_ 154 OBJ_Angle_Bottom_V_36 "Validator for OBJAngle_Bottom. ";
CM_ SG_ 154 OBJ_Angle_Bottom_36 "The angle between the longitudinal axis and the Bottom of the front / rear of the target (the visible one). The positive side is to the host's bottom";
CM_ SG_ 154 OBJ_Angle_Bottom_STD_36 "STD for OBJAngle_Bottom. ";
CM_ SG_ 154 OBJ_Angle_Bottom_STD_V_36 "Validator for OBJAngle_Bottom_STD. ";
CM_ SG_ 154 OBJ_Visibility_Side_V_36 "Currently Supported for VD only";
CM_ SG_ 154 OBJ_Visibility_Side_36 "From what car  side is the object visible";
CM_ SG_ 154 OBJ_Is_In_Drivable_Area_36 "Indicates whether the target is in a driveable area.";
CM_ SG_ 154 OBJ_Is_In_Drivable_Area_V_36 "Validator for OBJ_Is_In_Drivable_Area.";
CM_ SG_ 154 OBJ_Is_VeryClose_V_36 "Validator for OBJ_Is_VeryClose. ";
CM_ SG_ 154 OBJ_Is_VeryClose_36 "Indicates whether the target is very close to the host such that it is hard to measure its distance. Currently relevant for peds only";
CM_ SG_ 154 OBJ_OverlapAngleEgoLaneR_36 "Lateral distance to the middle of the RL and RR corners.";
CM_ SG_ 154 OBJ_OverlapAngleEgoLaneR_V_36 "Validator for OBJ_OverlapAngleEgoLaneR";
CM_ SG_ 154 OBJ_OverlapAngleEgoLaneL_36 "Lateral distance to the middle of the RL and RR corners.  ";
CM_ SG_ 154 OBJ_OverlapAngleEgoLaneL_V_36 "Validator for OBJ_OverlapAngleEgoLaneL";
CM_ SG_ 154 OBJ_Is_EMERGENCY_VCL_36 "Is Object an Emergency Vehicle";
CM_ SG_ 154 OBJ_EMERGENCY_LIGHT_COLOR_36 "Emergency Color";
CM_ SG_ 154 OBJ_EMERGENCY_V_36 "Are OBJ_Is_EMERGENCY_VCL and OBJ_EMERGENCY_LIGHT_COLOR Valid";
CM_ SG_ 154 OBJ_Angle_Top_36 "From VD touching point on the ground till the roof of the car";
CM_ SG_ 154 OBJ_Angle_Top_V_36 "Validator for OBJ_Angle_Top ";
CM_ SG_ 154 OBJ_Angle_Top_STD_36 "STD for OBJ_Angle_Top";
CM_ SG_ 154 OBJ_Angle_Top_STD_V_36 "Validator for OBJ_Angle_Top_STD. ";
CM_ SG_ 154 OBJ_Open_Door_Left_36 "Indicator if left door is open";
CM_ SG_ 154 OBJ_Open_Door_Right_36 "Indicator if right door is open";
CM_ SG_ 154 OBJ_Visible_Left_or_Right_36 "This signal describes the visible Left or Right side of the Target vehicle.";
CM_ SG_ 154 OBJ_Visible_Left_or_Right_V_36 "OBJ_Visible_Left_or_Right";
CM_ SG_ 154 OBJ_2W_Is_Motorbike_Probability_36 "The probability of the Two-wheeler reported object being a Motorbike";
CM_ SG_ 154 OBJ_2W_Is_Bicycle_Probability_36 "The probability of the Two-wheeler reported object being a Bicycle";
CM_ SG_ 154 OBJ_CRC_37 "Calculated over all element signals. From the signal after the CRC until the first signal in the next elements OBJ_CRC_N+1  not including";
CM_ SG_ 154 OBJ_ID_37 "The detected object ID. Range is 1-255, while 0 indicates that the field in unfilled.";
CM_ SG_ 154 OBJ_Existence_Probability_37 "The existence probability of the reported object";
CM_ SG_ 154 OBJ_Fusion_Source_37 "sources ids used for fusion";
CM_ SG_ 154 OBJ_Triggered_SDM_37 "Indicates whether the object has trigered the SDM (Safety Diagnostic Manager) alert.";
CM_ SG_ 154 OBJ_Motion_Category_37 "Relevant for VD only. Full description of values can be found at the ACC guide.";
CM_ SG_ 154 OBJ_Moving_IN_Probability_37 "The probability the object is eventually move into ego lane. (In case that the OBJ_Motion_Category signal is set to  MOVING_IN ";
CM_ SG_ 154 OBJ_Object_Age_37 "The number of frames in which the object was recognized.";
CM_ SG_ 154 OBJ_Measuring_Status_37 "Measurment status. Old vs New marks if this is the first frame in which the object is reported. Predicted vs Measured marks if the report is raw or has been predicted forward in time using the measured dynamics and ego motion.";
CM_ SG_ 154 OBJ_Object_Class_37 "Indicates the object type. Uncertain is outputted in case the probability that a vehicle is a truck is very similar to the probability that it is a car.";
CM_ SG_ 154 OBJ_Class_Probability_37 "The probability of this type classification.";
CM_ SG_ 154 OBJ_Car_Probability_37 "The probability the object is a car";
CM_ SG_ 154 OBJ_Truck_Probability_37 "The probability the object is a Truck";
CM_ SG_ 154 OBJ_Bike_Probability_37 "The probability the object is a Bike";
CM_ SG_ 154 OBJ_Camera_Source_37 "The camera in which this object was detected (best choice).";
CM_ SG_ 154 OBJ_Motion_Status_37 "MOVING - the object is moving STATIONARY - the object was never seen moving STOPPED -  the object was moving and has stopped MOVING_SLOWLY - the object is moving very slowly";
CM_ SG_ 154 OBJ_Motion_Orientation_37 "The direction of the targets heading compared to the host. ";
CM_ SG_ 154 OBJ_Has_Cut_Lane_37 "Indicates whether the object cut the host's (right or left) lane. In case there are no lanes, indicates whether the objects is at most 1 meters away from the host.";
CM_ SG_ 154 OBJ_Has_Cut_Path_37 "Indicates whether the object is in the host's path.";
CM_ SG_ 154 OBJ_Brake_Light_Validity_37 "Validator for braking light indicator";
CM_ SG_ 154 OBJ_Brake_Light_37 "Indication for brake lights ";
CM_ SG_ 154 OBJ_Turn_Indicator_Right_37 "Indication for blinking right light.";
CM_ SG_ 154 OBJ_Turn_Indicator_Left_37 "Indication for blinking left light ";
CM_ SG_ 154 OBJ_Turn_Indicator_Validity_37 "Validator for light indicators";
CM_ SG_ 154 OBJ_Right_Out_Of_Image_37 "Indicates whether the measurment are predicted out of the right side of the image bounderies.";
CM_ SG_ 154 OBJ_Left_Out_Of_Image_37 "Indicates whether if measurment are predicted out of  the left side of the image bounderies";
CM_ SG_ 154 OBJ_Right_Out_Of_Image_V_37 "validator";
CM_ SG_ 154 OBJ_Left_Out_Of_Image_V_37 "validator";
CM_ SG_ 154 OBJ_Top_Out_Of_Image_37 "Indicates whether if measurment are predicted out of  the top of the image bounderies";
CM_ SG_ 154 OBJ_Bottom_Out_Of_Image_37 "Indicates whether if measurment are predicted out of  the bottom of the image bounderies";
CM_ SG_ 154 OBJ_Top_Out_Of_Image_V_37 "validator";
CM_ SG_ 154 OBJ_Bottom_Out_Of_Image_V_37 "validator";
CM_ SG_ 154 OBJ_Lane_Assignment_37 "The object's lane relative to the host lane.";
CM_ SG_ 154 OBJ_Lane_Assignment_V_37 "Validator for lane assignment";
CM_ SG_ 154 OBJ_Age_Seconds_37 "Time in seconds in which the object was recognized. ";
CM_ SG_ 154 OBJ_Age_Seconds_V_37 "Validator for object age";
CM_ SG_ 154 OBJ_Width_37 "The width of the target vehicle in the world (not to be mistaken with the width of the visible part of the vehicle).";
CM_ SG_ 154 OBJ_Width_V_37 "Validator for object width";
CM_ SG_ 154 OBJ_Width_STD_37 "Standard deviation for object width";
CM_ SG_ 154 OBJ_Width_STD_V_37 "Validator for the standard deviation of object width";
CM_ SG_ 154 OBJ_Length_37 "The length of the vehicle in the world. For crossing bicycles it gives the viewed length of the bicycle.";
CM_ SG_ 154 OBJ_Length_V_37 "Validator for object length.";
CM_ SG_ 154 OBJ_Length_STD_37 "Standard deviation for object length.";
CM_ SG_ 154 OBJ_Length_STD_V_37 "Validator for the standard deviation of object length.";
CM_ SG_ 154 OBJ_Radar_ID_37 "Radar Object ID of the Fused Object, Only relvant when OBJ_Fusion_Source is not Camera only";
CM_ SG_ 154 OBJ_Height_37 "The height of the object in the world. ";
CM_ SG_ 154 OBJ_Height_V_37 "Validator for object height.";
CM_ SG_ 154 OBJ_Height_STD_37 "Standard deviation for object height.";
CM_ SG_ 154 OBJ_Height_STD_V_37 "Validator for the standard deviation of object height.";
CM_ SG_ 154 OBJ_Abs_Long_Velocity_37 "Absolute longitudinal velocity.";
CM_ SG_ 154 OBJ_Abs_Long_Velocity_V_37 "Validator for absolute longitudinal velocity.";
CM_ SG_ 154 OBJ_Abs_Long_Velocity_STD_37 "Standard deviation of absolute longitudinal velocity.";
CM_ SG_ 154 OBJ_Abs_Long_Vel_STD_V_37 "Validator for the standard deviation of the absolute longitudinal velocity.";
CM_ SG_ 154 OBJ_Abs_Lat_Velocity_37 "The lateral ground speed of the object.";
CM_ SG_ 154 OBJ_Abs_Lat_Velocity_V_37 "Validator for the lateral ground speed of the object.";
CM_ SG_ 154 OBJ_Abs_Lat_Velocity_STD_37 "STD of the lateral ground speed of the object.";
CM_ SG_ 154 OBJ_Abs_Lat_Vel_STD_V_37 "Validator for the STD of the lateral ground speed of the object.";
CM_ SG_ 154 OBJ_Abs_Long_Acc_37 "The longitudinal ground acceleration of the object.";
CM_ SG_ 154 OBJ_Abs_Long_Acc_V_37 "Validator for the longitudinal ground acceleration of the object.";
CM_ SG_ 154 OBJ_Abs_Long_Acc_STD_37 "STD of the longitudinal ground acceleration of the object.";
CM_ SG_ 154 OBJ_Abs_Long_Acc_STD_V_37 "Validator for the STD of the longitudinal ground acceleration of the object.";
CM_ SG_ 154 OBJ_Abs_Lat_Acc_37 "The lateral ground acceleration of the object.";
CM_ SG_ 154 OBJ_Abs_Lat_Acc_V_37 "Validator for the lateral ground acceleration of the object.";
CM_ SG_ 154 OBJ_Abs_Lat_Acc_STD_37 "STD of the lateral ground acceleration of the object.";
CM_ SG_ 154 OBJ_Abs_Lat_Acc_STD_V_37 "Validator for the STD of the lateral ground acceleration of the object.";
CM_ SG_ 154 OBJ_Abs_Acceleration_37 "The absolute ground acceleration in the target's heading direction.";
CM_ SG_ 154 OBJ_Abs_Acceleration_V_37 "Validator for the absolute ground acceleration.";
CM_ SG_ 154 OBJ_Abs_Acc_STD_37 "STD of the absolute ground acceleration.";
CM_ SG_ 154 OBJ_Abs_Acc_STD_V_37 "Validator for the STD of the absolute ground acceleration.";
CM_ SG_ 154 OBJ_Inv_TTC_37 "Inverse TTC (time to collision).";
CM_ SG_ 154 OBJ_Inv_TTC_STD_37 "STD for inverse TTC .";
CM_ SG_ 154 OBJ_Inv_TTC_STD_V_37 "Validator for the STD for inverse TTC .";
CM_ SG_ 154 OBJ_Relative_Long_Acc_37 "The relative longitudinal ground acceleration of the object.";
CM_ SG_ 154 OBJ_Relative_Long_Acc_V_37 "Validator for the relative longitudinal ground acceleration of the object.";
CM_ SG_ 154 OBJ_Relative_Long_Acc_STD_37 "STD of the relative longitudinal ground acceleration of the object.";
CM_ SG_ 154 OBJ_Rel_Long_Acc_STD_V_37 "Validator for the STD of the relative longitudinal ground acceleration.";
CM_ SG_ 154 OBJ_Relative_Long_Velocity_37 "The relative longtitudinal speed between the target and ego vehicle. ";
CM_ SG_ 154 OBJ_Relative_Long_Velocity_V_37 "Validator for the relative longtitudinal speed.";
CM_ SG_ 154 OBJ_Relative_Long_Vel_STD_37 "STD of the relative longtitudinal speed.";
CM_ SG_ 154 OBJ_Rel_Long_Vel_STD_V_37 "Validator for the STD of the relative longtitudinal speed.";
CM_ SG_ 154 OBJ_Relative_Lat_Velocity_37 "The relative lateral speed between the target and ego vehicle. ";
CM_ SG_ 154 OBJ_Relative_Lat_Velocity_V_37 "Validator for the relative lateral speed. ";
CM_ SG_ 154 OBJ_Relative_Lat_Velocity_STD_37 "STD of the relative lateral speed. ";
CM_ SG_ 154 OBJ_Rel_Lat_Vel_STD_V_37 "Validator for the STD of the relative lateral speed. ";
CM_ SG_ 154 OBJ_Long_Distance_37 "The longitudinal distance to middle of the rear bumper (middle of the RL and RR corners) of the target.";
CM_ SG_ 154 OBJ_Long_Distance_V_37 "Validator of the longtitudinal distance field";
CM_ SG_ 154 OBJ_Long_Distance_STD_37 "STD of the  longtitudinal distance.";
CM_ SG_ 154 OBJ_Long_Distance_STD_V_37 "Validator for the STD of the  longtitudinal distance.";
CM_ SG_ 154 OBJ_Lat_Distance_37 "Lateral distance to the middle of the RL and RR corners.  ";
CM_ SG_ 154 OBJ_Lat_Distance_V_37 "Validator for the lateral distance of the object.";
CM_ SG_ 154 OBJ_Lat_Distance_STD_37 "STD of the lateral distance of the object.";
CM_ SG_ 154 OBJ_Lat_Distance_STD_V_37 "Validator for the STD of the lateral distance of the object.";
CM_ SG_ 154 OBJ_Absolute_Speed_37 "The absolute ground speed in the targets' heading direction.";
CM_ SG_ 154 OBJ_Absolute_Speed_V_37 "Validator for the absolute ground speed.";
CM_ SG_ 154 OBJ_Absolute_Speed_STD_37 "STD of the absolute ground speed.";
CM_ SG_ 154 OBJ_Absolute_Speed_STD_V_37 "Validator for the STD of the absolute ground speed.";
CM_ SG_ 154 OBJ_Heading_37 "The angle beetweenthe host longitudinal axis and target's heading (clockwise, e.g. PI/2 is a target crossing from left to right).";
CM_ SG_ 154 OBJ_Heading_V_37 "Validator for the object heading.";
CM_ SG_ 154 OBJ_Heading_STD_37 "STD of the object heading.";
CM_ SG_ 154 OBJ_Heading_STD_V_37 "Validator for the STD of the object heading.";
CM_ SG_ 154 OBJ_Angle_Rate_STD_37 "Standard deviation of the angular speed. (radians)";
CM_ SG_ 154 OBJ_Angle_Rate_STD_V_37 "Validator for the STD of the angular speed.";
CM_ SG_ 154 OBJ_Angle_Rate_37 "The momentary angular speed of the object (radians). The positive side is to the host's right.";
CM_ SG_ 154 OBJ_Angle_Rate_V_37 "Validator for the angular speed.";
CM_ SG_ 154 OBJ_Angle_Right_37 "The angle between the host longitudinal axis and the right side of the front / rear of the target (the visible one). The positive side is to the host's right.";
CM_ SG_ 154 OBJ_Angle_Right_V_37 "Validator for angleRight";
CM_ SG_ 154 OBJ_Angle_Right_STD_37 "Standard deviation of angleRight";
CM_ SG_ 154 OBJ_Angle_Right_STD_V_37 "Validator for the standard deviation of angleRight.";
CM_ SG_ 154 OBJ_Angle_Left_37 "The angle between the host longitudinal axis and the left side of the front / rear of the target (the visible one). The positive side is to the host's right.";
CM_ SG_ 154 OBJ_Angle_Left_V_37 "Validator for angleLeft.";
CM_ SG_ 154 OBJ_Angle_Left_STD_37 "Standard deviation of angleLeft.";
CM_ SG_ 154 OBJ_Angle_Left_STD_V_37 "Validator for the standard deviation of angleLeft.";
CM_ SG_ 154 OBJ_Angle_Side_37 "The angle between the host longitudinal axis and the far visible edge - the visible edge of the front / rear of the target that is not visible. Currently supported for vehicles only.";
CM_ SG_ 154 OBJ_Angle_Side_V_37 "Validator for angleSide.";
CM_ SG_ 154 OBJ_Angle_Side_STD_37 "Standard deviation of angleSide.";
CM_ SG_ 154 OBJ_Angle_Side_STD_V_37 "Validator for the STD of angleSide.";
CM_ SG_ 154 OBJ_Angle_Mid_V_37 "Validator for angleMid.";
CM_ SG_ 154 OBJ_Angle_Mid_37 "The angle between the host longitudinal axis and the middle of the front / rear of the target (the visible one). The positive side is to the host's right.";
CM_ SG_ 154 OBJ_Angle_Mid_STD_37 "Standard deviation of angleMid.";
CM_ SG_ 154 OBJ_Angle_Mid_STD_V_37 "Validator for the STD of angleMid.";
CM_ SG_ 154 OBJ_Angle_Bottom_V_37 "Validator for OBJAngle_Bottom. ";
CM_ SG_ 154 OBJ_Angle_Bottom_37 "The angle between the longitudinal axis and the Bottom of the front / rear of the target (the visible one). The positive side is to the host's bottom";
CM_ SG_ 154 OBJ_Angle_Bottom_STD_37 "STD for OBJAngle_Bottom. ";
CM_ SG_ 154 OBJ_Angle_Bottom_STD_V_37 "Validator for OBJAngle_Bottom_STD. ";
CM_ SG_ 154 OBJ_Visibility_Side_V_37 "Currently Supported for VD only";
CM_ SG_ 154 OBJ_Visibility_Side_37 "From what car  side is the object visible";
CM_ SG_ 154 OBJ_Is_In_Drivable_Area_37 "Indicates whether the target is in a driveable area.";
CM_ SG_ 154 OBJ_Is_In_Drivable_Area_V_37 "Validator for OBJ_Is_In_Drivable_Area.";
CM_ SG_ 154 OBJ_Is_VeryClose_V_37 "Validator for OBJ_Is_VeryClose. ";
CM_ SG_ 154 OBJ_Is_VeryClose_37 "Indicates whether the target is very close to the host such that it is hard to measure its distance. Currently relevant for peds only";
CM_ SG_ 154 OBJ_OverlapAngleEgoLaneR_37 "Lateral distance to the middle of the RL and RR corners.";
CM_ SG_ 154 OBJ_OverlapAngleEgoLaneR_V_37 "Validator for OBJ_OverlapAngleEgoLaneR";
CM_ SG_ 154 OBJ_OverlapAngleEgoLaneL_37 "Lateral distance to the middle of the RL and RR corners.  ";
CM_ SG_ 154 OBJ_OverlapAngleEgoLaneL_V_37 "Validator for OBJ_OverlapAngleEgoLaneL";
CM_ SG_ 154 OBJ_Is_EMERGENCY_VCL_37 "Is Object an Emergency Vehicle";
CM_ SG_ 154 OBJ_EMERGENCY_LIGHT_COLOR_37 "Emergency Color";
CM_ SG_ 154 OBJ_EMERGENCY_V_37 "Are OBJ_Is_EMERGENCY_VCL and OBJ_EMERGENCY_LIGHT_COLOR Valid";
CM_ SG_ 154 OBJ_Angle_Top_37 "From VD touching point on the ground till the roof of the car";
CM_ SG_ 154 OBJ_Angle_Top_V_37 "Validator for OBJ_Angle_Top ";
CM_ SG_ 154 OBJ_Angle_Top_STD_37 "STD for OBJ_Angle_Top";
CM_ SG_ 154 OBJ_Angle_Top_STD_V_37 "Validator for OBJ_Angle_Top_STD. ";
CM_ SG_ 154 OBJ_Open_Door_Left_37 "Indicator if left door is open";
CM_ SG_ 154 OBJ_Open_Door_Right_37 "Indicator if right door is open";
CM_ SG_ 154 OBJ_Visible_Left_or_Right_37 "This signal describes the visible Left or Right side of the Target vehicle.";
CM_ SG_ 154 OBJ_Visible_Left_or_Right_V_37 "OBJ_Visible_Left_or_Right";
CM_ SG_ 154 OBJ_2W_Is_Motorbike_Probability_37 "The probability of the Two-wheeler reported object being a Motorbike";
CM_ SG_ 154 OBJ_2W_Is_Bicycle_Probability_37 "The probability of the Two-wheeler reported object being a Bicycle";
CM_ SG_ 154 OBJ_CRC_38 "Calculated over all element signals. From the signal after the CRC until the first signal in the next elements OBJ_CRC_N+1  not including";
CM_ SG_ 154 OBJ_ID_38 "The detected object ID. Range is 1-255, while 0 indicates that the field in unfilled.";
CM_ SG_ 154 OBJ_Existence_Probability_38 "The existence probability of the reported object";
CM_ SG_ 154 OBJ_Fusion_Source_38 "sources ids used for fusion";
CM_ SG_ 154 OBJ_Triggered_SDM_38 "Indicates whether the object has trigered the SDM (Safety Diagnostic Manager) alert.";
CM_ SG_ 154 OBJ_Motion_Category_38 "Relevant for VD only. Full description of values can be found at the ACC guide.";
CM_ SG_ 154 OBJ_Moving_IN_Probability_38 "The probability the object is eventually move into ego lane. (In case that the OBJ_Motion_Category signal is set to  MOVING_IN ";
CM_ SG_ 154 OBJ_Object_Age_38 "The number of frames in which the object was recognized.";
CM_ SG_ 154 OBJ_Measuring_Status_38 "Measurment status. Old vs New marks if this is the first frame in which the object is reported. Predicted vs Measured marks if the report is raw or has been predicted forward in time using the measured dynamics and ego motion.";
CM_ SG_ 154 OBJ_Object_Class_38 "Indicates the object type. Uncertain is outputted in case the probability that a vehicle is a truck is very similar to the probability that it is a car.";
CM_ SG_ 154 OBJ_Class_Probability_38 "The probability of this type classification.";
CM_ SG_ 154 OBJ_Car_Probability_38 "The probability the object is a car";
CM_ SG_ 154 OBJ_Truck_Probability_38 "The probability the object is a Truck";
CM_ SG_ 154 OBJ_Bike_Probability_38 "The probability the object is a Bike";
CM_ SG_ 154 OBJ_Camera_Source_38 "The camera in which this object was detected (best choice).";
CM_ SG_ 154 OBJ_Motion_Status_38 "MOVING - the object is moving STATIONARY - the object was never seen moving STOPPED -  the object was moving and has stopped MOVING_SLOWLY - the object is moving very slowly";
CM_ SG_ 154 OBJ_Motion_Orientation_38 "The direction of the targets heading compared to the host. ";
CM_ SG_ 154 OBJ_Has_Cut_Lane_38 "Indicates whether the object cut the host's (right or left) lane. In case there are no lanes, indicates whether the objects is at most 1 meters away from the host.";
CM_ SG_ 154 OBJ_Has_Cut_Path_38 "Indicates whether the object is in the host's path.";
CM_ SG_ 154 OBJ_Brake_Light_Validity_38 "Validator for braking light indicator";
CM_ SG_ 154 OBJ_Brake_Light_38 "Indication for brake lights ";
CM_ SG_ 154 OBJ_Turn_Indicator_Right_38 "Indication for blinking right light.";
CM_ SG_ 154 OBJ_Turn_Indicator_Left_38 "Indication for blinking left light ";
CM_ SG_ 154 OBJ_Turn_Indicator_Validity_38 "Validator for light indicators";
CM_ SG_ 154 OBJ_Right_Out_Of_Image_38 "Indicates whether the measurment are predicted out of the right side of the image bounderies.";
CM_ SG_ 154 OBJ_Left_Out_Of_Image_38 "Indicates whether if measurment are predicted out of  the left side of the image bounderies";
CM_ SG_ 154 OBJ_Right_Out_Of_Image_V_38 "validator";
CM_ SG_ 154 OBJ_Left_Out_Of_Image_V_38 "validator";
CM_ SG_ 154 OBJ_Top_Out_Of_Image_38 "Indicates whether if measurment are predicted out of  the top of the image bounderies";
CM_ SG_ 154 OBJ_Bottom_Out_Of_Image_38 "Indicates whether if measurment are predicted out of  the bottom of the image bounderies";
CM_ SG_ 154 OBJ_Top_Out_Of_Image_V_38 "validator";
CM_ SG_ 154 OBJ_Bottom_Out_Of_Image_V_38 "validator";
CM_ SG_ 154 OBJ_Lane_Assignment_38 "The object's lane relative to the host lane.";
CM_ SG_ 154 OBJ_Lane_Assignment_V_38 "Validator for lane assignment";
CM_ SG_ 154 OBJ_Age_Seconds_38 "Time in seconds in which the object was recognized. ";
CM_ SG_ 154 OBJ_Age_Seconds_V_38 "Validator for object age";
CM_ SG_ 154 OBJ_Width_38 "The width of the target vehicle in the world (not to be mistaken with the width of the visible part of the vehicle).";
CM_ SG_ 154 OBJ_Width_V_38 "Validator for object width";
CM_ SG_ 154 OBJ_Width_STD_38 "Standard deviation for object width";
CM_ SG_ 154 OBJ_Width_STD_V_38 "Validator for the standard deviation of object width";
CM_ SG_ 154 OBJ_Length_38 "The length of the vehicle in the world. For crossing bicycles it gives the viewed length of the bicycle.";
CM_ SG_ 154 OBJ_Length_V_38 "Validator for object length.";
CM_ SG_ 154 OBJ_Length_STD_38 "Standard deviation for object length.";
CM_ SG_ 154 OBJ_Length_STD_V_38 "Validator for the standard deviation of object length.";
CM_ SG_ 154 OBJ_Radar_ID_38 "Radar Object ID of the Fused Object, Only relvant when OBJ_Fusion_Source is not Camera only";
CM_ SG_ 154 OBJ_Height_38 "The height of the object in the world. ";
CM_ SG_ 154 OBJ_Height_V_38 "Validator for object height.";
CM_ SG_ 154 OBJ_Height_STD_38 "Standard deviation for object height.";
CM_ SG_ 154 OBJ_Height_STD_V_38 "Validator for the standard deviation of object height.";
CM_ SG_ 154 OBJ_Abs_Long_Velocity_38 "Absolute longitudinal velocity.";
CM_ SG_ 154 OBJ_Abs_Long_Velocity_V_38 "Validator for absolute longitudinal velocity.";
CM_ SG_ 154 OBJ_Abs_Long_Velocity_STD_38 "Standard deviation of absolute longitudinal velocity.";
CM_ SG_ 154 OBJ_Abs_Long_Vel_STD_V_38 "Validator for the standard deviation of the absolute longitudinal velocity.";
CM_ SG_ 154 OBJ_Abs_Lat_Velocity_38 "The lateral ground speed of the object.";
CM_ SG_ 154 OBJ_Abs_Lat_Velocity_V_38 "Validator for the lateral ground speed of the object.";
CM_ SG_ 154 OBJ_Abs_Lat_Velocity_STD_38 "STD of the lateral ground speed of the object.";
CM_ SG_ 154 OBJ_Abs_Lat_Vel_STD_V_38 "Validator for the STD of the lateral ground speed of the object.";
CM_ SG_ 154 OBJ_Abs_Long_Acc_38 "The longitudinal ground acceleration of the object.";
CM_ SG_ 154 OBJ_Abs_Long_Acc_V_38 "Validator for the longitudinal ground acceleration of the object.";
CM_ SG_ 154 OBJ_Abs_Long_Acc_STD_38 "STD of the longitudinal ground acceleration of the object.";
CM_ SG_ 154 OBJ_Abs_Long_Acc_STD_V_38 "Validator for the STD of the longitudinal ground acceleration of the object.";
CM_ SG_ 154 OBJ_Abs_Lat_Acc_38 "The lateral ground acceleration of the object.";
CM_ SG_ 154 OBJ_Abs_Lat_Acc_V_38 "Validator for the lateral ground acceleration of the object.";
CM_ SG_ 154 OBJ_Abs_Lat_Acc_STD_38 "STD of the lateral ground acceleration of the object.";
CM_ SG_ 154 OBJ_Abs_Lat_Acc_STD_V_38 "Validator for the STD of the lateral ground acceleration of the object.";
CM_ SG_ 154 OBJ_Abs_Acceleration_38 "The absolute ground acceleration in the target's heading direction.";
CM_ SG_ 154 OBJ_Abs_Acceleration_V_38 "Validator for the absolute ground acceleration.";
CM_ SG_ 154 OBJ_Abs_Acc_STD_38 "STD of the absolute ground acceleration.";
CM_ SG_ 154 OBJ_Abs_Acc_STD_V_38 "Validator for the STD of the absolute ground acceleration.";
CM_ SG_ 154 OBJ_Inv_TTC_38 "Inverse TTC (time to collision).";
CM_ SG_ 154 OBJ_Inv_TTC_STD_38 "STD for inverse TTC .";
CM_ SG_ 154 OBJ_Inv_TTC_STD_V_38 "Validator for the STD for inverse TTC .";
CM_ SG_ 154 OBJ_Relative_Long_Acc_38 "The relative longitudinal ground acceleration of the object.";
CM_ SG_ 154 OBJ_Relative_Long_Acc_V_38 "Validator for the relative longitudinal ground acceleration of the object.";
CM_ SG_ 154 OBJ_Relative_Long_Acc_STD_38 "STD of the relative longitudinal ground acceleration of the object.";
CM_ SG_ 154 OBJ_Rel_Long_Acc_STD_V_38 "Validator for the STD of the relative longitudinal ground acceleration.";
CM_ SG_ 154 OBJ_Relative_Long_Velocity_38 "The relative longtitudinal speed between the target and ego vehicle. ";
CM_ SG_ 154 OBJ_Relative_Long_Velocity_V_38 "Validator for the relative longtitudinal speed.";
CM_ SG_ 154 OBJ_Relative_Long_Vel_STD_38 "STD of the relative longtitudinal speed.";
CM_ SG_ 154 OBJ_Rel_Long_Vel_STD_V_38 "Validator for the STD of the relative longtitudinal speed.";
CM_ SG_ 154 OBJ_Relative_Lat_Velocity_38 "The relative lateral speed between the target and ego vehicle. ";
CM_ SG_ 154 OBJ_Relative_Lat_Velocity_V_38 "Validator for the relative lateral speed. ";
CM_ SG_ 154 OBJ_Relative_Lat_Velocity_STD_38 "STD of the relative lateral speed. ";
CM_ SG_ 154 OBJ_Rel_Lat_Vel_STD_V_38 "Validator for the STD of the relative lateral speed. ";
CM_ SG_ 154 OBJ_Long_Distance_38 "The longitudinal distance to middle of the rear bumper (middle of the RL and RR corners) of the target.";
CM_ SG_ 154 OBJ_Long_Distance_V_38 "Validator of the longtitudinal distance field";
CM_ SG_ 154 OBJ_Long_Distance_STD_38 "STD of the  longtitudinal distance.";
CM_ SG_ 154 OBJ_Long_Distance_STD_V_38 "Validator for the STD of the  longtitudinal distance.";
CM_ SG_ 154 OBJ_Lat_Distance_38 "Lateral distance to the middle of the RL and RR corners.  ";
CM_ SG_ 154 OBJ_Lat_Distance_V_38 "Validator for the lateral distance of the object.";
CM_ SG_ 154 OBJ_Lat_Distance_STD_38 "STD of the lateral distance of the object.";
CM_ SG_ 154 OBJ_Lat_Distance_STD_V_38 "Validator for the STD of the lateral distance of the object.";
CM_ SG_ 154 OBJ_Absolute_Speed_38 "The absolute ground speed in the targets' heading direction.";
CM_ SG_ 154 OBJ_Absolute_Speed_V_38 "Validator for the absolute ground speed.";
CM_ SG_ 154 OBJ_Absolute_Speed_STD_38 "STD of the absolute ground speed.";
CM_ SG_ 154 OBJ_Absolute_Speed_STD_V_38 "Validator for the STD of the absolute ground speed.";
CM_ SG_ 154 OBJ_Heading_38 "The angle beetweenthe host longitudinal axis and target's heading (clockwise, e.g. PI/2 is a target crossing from left to right).";
CM_ SG_ 154 OBJ_Heading_V_38 "Validator for the object heading.";
CM_ SG_ 154 OBJ_Heading_STD_38 "STD of the object heading.";
CM_ SG_ 154 OBJ_Heading_STD_V_38 "Validator for the STD of the object heading.";
CM_ SG_ 154 OBJ_Angle_Rate_STD_38 "Standard deviation of the angular speed. (radians)";
CM_ SG_ 154 OBJ_Angle_Rate_STD_V_38 "Validator for the STD of the angular speed.";
CM_ SG_ 154 OBJ_Angle_Rate_38 "The momentary angular speed of the object (radians). The positive side is to the host's right.";
CM_ SG_ 154 OBJ_Angle_Rate_V_38 "Validator for the angular speed.";
CM_ SG_ 154 OBJ_Angle_Right_38 "The angle between the host longitudinal axis and the right side of the front / rear of the target (the visible one). The positive side is to the host's right.";
CM_ SG_ 154 OBJ_Angle_Right_V_38 "Validator for angleRight";
CM_ SG_ 154 OBJ_Angle_Right_STD_38 "Standard deviation of angleRight";
CM_ SG_ 154 OBJ_Angle_Right_STD_V_38 "Validator for the standard deviation of angleRight.";
CM_ SG_ 154 OBJ_Angle_Left_38 "The angle between the host longitudinal axis and the left side of the front / rear of the target (the visible one). The positive side is to the host's right.";
CM_ SG_ 154 OBJ_Angle_Left_V_38 "Validator for angleLeft.";
CM_ SG_ 154 OBJ_Angle_Left_STD_38 "Standard deviation of angleLeft.";
CM_ SG_ 154 OBJ_Angle_Left_STD_V_38 "Validator for the standard deviation of angleLeft.";
CM_ SG_ 154 OBJ_Angle_Side_38 "The angle between the host longitudinal axis and the far visible edge - the visible edge of the front / rear of the target that is not visible. Currently supported for vehicles only.";
CM_ SG_ 154 OBJ_Angle_Side_V_38 "Validator for angleSide.";
CM_ SG_ 154 OBJ_Angle_Side_STD_38 "Standard deviation of angleSide.";
CM_ SG_ 154 OBJ_Angle_Side_STD_V_38 "Validator for the STD of angleSide.";
CM_ SG_ 154 OBJ_Angle_Mid_V_38 "Validator for angleMid.";
CM_ SG_ 154 OBJ_Angle_Mid_38 "The angle between the host longitudinal axis and the middle of the front / rear of the target (the visible one). The positive side is to the host's right.";
CM_ SG_ 154 OBJ_Angle_Mid_STD_38 "Standard deviation of angleMid.";
CM_ SG_ 154 OBJ_Angle_Mid_STD_V_38 "Validator for the STD of angleMid.";
CM_ SG_ 154 OBJ_Angle_Bottom_V_38 "Validator for OBJAngle_Bottom. ";
CM_ SG_ 154 OBJ_Angle_Bottom_38 "The angle between the longitudinal axis and the Bottom of the front / rear of the target (the visible one). The positive side is to the host's bottom";
CM_ SG_ 154 OBJ_Angle_Bottom_STD_38 "STD for OBJAngle_Bottom. ";
CM_ SG_ 154 OBJ_Angle_Bottom_STD_V_38 "Validator for OBJAngle_Bottom_STD. ";
CM_ SG_ 154 OBJ_Visibility_Side_V_38 "Currently Supported for VD only";
CM_ SG_ 154 OBJ_Visibility_Side_38 "From what car  side is the object visible";
CM_ SG_ 154 OBJ_Is_In_Drivable_Area_38 "Indicates whether the target is in a driveable area.";
CM_ SG_ 154 OBJ_Is_In_Drivable_Area_V_38 "Validator for OBJ_Is_In_Drivable_Area.";
CM_ SG_ 154 OBJ_Is_VeryClose_V_38 "Validator for OBJ_Is_VeryClose. ";
CM_ SG_ 154 OBJ_Is_VeryClose_38 "Indicates whether the target is very close to the host such that it is hard to measure its distance. Currently relevant for peds only";
CM_ SG_ 154 OBJ_OverlapAngleEgoLaneR_38 "Lateral distance to the middle of the RL and RR corners.";
CM_ SG_ 154 OBJ_OverlapAngleEgoLaneR_V_38 "Validator for OBJ_OverlapAngleEgoLaneR";
CM_ SG_ 154 OBJ_OverlapAngleEgoLaneL_38 "Lateral distance to the middle of the RL and RR corners.  ";
CM_ SG_ 154 OBJ_OverlapAngleEgoLaneL_V_38 "Validator for OBJ_OverlapAngleEgoLaneL";
CM_ SG_ 154 OBJ_Is_EMERGENCY_VCL_38 "Is Object an Emergency Vehicle";
CM_ SG_ 154 OBJ_EMERGENCY_LIGHT_COLOR_38 "Emergency Color";
CM_ SG_ 154 OBJ_EMERGENCY_V_38 "Are OBJ_Is_EMERGENCY_VCL and OBJ_EMERGENCY_LIGHT_COLOR Valid";
CM_ SG_ 154 OBJ_Angle_Top_38 "From VD touching point on the ground till the roof of the car";
CM_ SG_ 154 OBJ_Angle_Top_V_38 "Validator for OBJ_Angle_Top ";
CM_ SG_ 154 OBJ_Angle_Top_STD_38 "STD for OBJ_Angle_Top";
CM_ SG_ 154 OBJ_Angle_Top_STD_V_38 "Validator for OBJ_Angle_Top_STD. ";
CM_ SG_ 154 OBJ_Open_Door_Left_38 "Indicator if left door is open";
CM_ SG_ 154 OBJ_Open_Door_Right_38 "Indicator if right door is open";
CM_ SG_ 154 OBJ_Visible_Left_or_Right_38 "This signal describes the visible Left or Right side of the Target vehicle.";
CM_ SG_ 154 OBJ_Visible_Left_or_Right_V_38 "OBJ_Visible_Left_or_Right";
CM_ SG_ 154 OBJ_2W_Is_Motorbike_Probability_38 "The probability of the Two-wheeler reported object being a Motorbike";
CM_ SG_ 154 OBJ_2W_Is_Bicycle_Probability_38 "The probability of the Two-wheeler reported object being a Bicycle";
CM_ SG_ 154 OBJ_CRC_39 "Calculated over all element signals. From the signal after the CRC until the first signal in the next elements OBJ_CRC_N+1  not including";
CM_ SG_ 154 OBJ_ID_39 "The detected object ID. Range is 1-255, while 0 indicates that the field in unfilled.";
CM_ SG_ 154 OBJ_Existence_Probability_39 "The existence probability of the reported object";
CM_ SG_ 154 OBJ_Fusion_Source_39 "sources ids used for fusion";
CM_ SG_ 154 OBJ_Triggered_SDM_39 "Indicates whether the object has trigered the SDM (Safety Diagnostic Manager) alert.";
CM_ SG_ 154 OBJ_Motion_Category_39 "Relevant for VD only. Full description of values can be found at the ACC guide.";
CM_ SG_ 154 OBJ_Moving_IN_Probability_39 "The probability the object is eventually move into ego lane. (In case that the OBJ_Motion_Category signal is set to  MOVING_IN ";
CM_ SG_ 154 OBJ_Object_Age_39 "The number of frames in which the object was recognized.";
CM_ SG_ 154 OBJ_Measuring_Status_39 "Measurment status. Old vs New marks if this is the first frame in which the object is reported. Predicted vs Measured marks if the report is raw or has been predicted forward in time using the measured dynamics and ego motion.";
CM_ SG_ 154 OBJ_Object_Class_39 "Indicates the object type. Uncertain is outputted in case the probability that a vehicle is a truck is very similar to the probability that it is a car.";
CM_ SG_ 154 OBJ_Class_Probability_39 "The probability of this type classification.";
CM_ SG_ 154 OBJ_Car_Probability_39 "The probability the object is a car";
CM_ SG_ 154 OBJ_Truck_Probability_39 "The probability the object is a Truck";
CM_ SG_ 154 OBJ_Bike_Probability_39 "The probability the object is a Bike";
CM_ SG_ 154 OBJ_Camera_Source_39 "The camera in which this object was detected (best choice).";
CM_ SG_ 154 OBJ_Motion_Status_39 "MOVING - the object is moving STATIONARY - the object was never seen moving STOPPED -  the object was moving and has stopped MOVING_SLOWLY - the object is moving very slowly";
CM_ SG_ 154 OBJ_Motion_Orientation_39 "The direction of the targets heading compared to the host. ";
CM_ SG_ 154 OBJ_Has_Cut_Lane_39 "Indicates whether the object cut the host's (right or left) lane. In case there are no lanes, indicates whether the objects is at most 1 meters away from the host.";
CM_ SG_ 154 OBJ_Has_Cut_Path_39 "Indicates whether the object is in the host's path.";
CM_ SG_ 154 OBJ_Brake_Light_Validity_39 "Validator for braking light indicator";
CM_ SG_ 154 OBJ_Brake_Light_39 "Indication for brake lights ";
CM_ SG_ 154 OBJ_Turn_Indicator_Right_39 "Indication for blinking right light.";
CM_ SG_ 154 OBJ_Turn_Indicator_Left_39 "Indication for blinking left light ";
CM_ SG_ 154 OBJ_Turn_Indicator_Validity_39 "Validator for light indicators";
CM_ SG_ 154 OBJ_Right_Out_Of_Image_39 "Indicates whether the measurment are predicted out of the right side of the image bounderies.";
CM_ SG_ 154 OBJ_Left_Out_Of_Image_39 "Indicates whether if measurment are predicted out of  the left side of the image bounderies";
CM_ SG_ 154 OBJ_Right_Out_Of_Image_V_39 "validator";
CM_ SG_ 154 OBJ_Left_Out_Of_Image_V_39 "validator";
CM_ SG_ 154 OBJ_Top_Out_Of_Image_39 "Indicates whether if measurment are predicted out of  the top of the image bounderies";
CM_ SG_ 154 OBJ_Bottom_Out_Of_Image_39 "Indicates whether if measurment are predicted out of  the bottom of the image bounderies";
CM_ SG_ 154 OBJ_Top_Out_Of_Image_V_39 "validator";
CM_ SG_ 154 OBJ_Bottom_Out_Of_Image_V_39 "validator";
CM_ SG_ 154 OBJ_Lane_Assignment_39 "The object's lane relative to the host lane.";
CM_ SG_ 154 OBJ_Lane_Assignment_V_39 "Validator for lane assignment";
CM_ SG_ 154 OBJ_Age_Seconds_39 "Time in seconds in which the object was recognized. ";
CM_ SG_ 154 OBJ_Age_Seconds_V_39 "Validator for object age";
CM_ SG_ 154 OBJ_Width_39 "The width of the target vehicle in the world (not to be mistaken with the width of the visible part of the vehicle).";
CM_ SG_ 154 OBJ_Width_V_39 "Validator for object width";
CM_ SG_ 154 OBJ_Width_STD_39 "Standard deviation for object width";
CM_ SG_ 154 OBJ_Width_STD_V_39 "Validator for the standard deviation of object width";
CM_ SG_ 154 OBJ_Length_39 "The length of the vehicle in the world. For crossing bicycles it gives the viewed length of the bicycle.";
CM_ SG_ 154 OBJ_Length_V_39 "Validator for object length.";
CM_ SG_ 154 OBJ_Length_STD_39 "Standard deviation for object length.";
CM_ SG_ 154 OBJ_Length_STD_V_39 "Validator for the standard deviation of object length.";
CM_ SG_ 154 OBJ_Radar_ID_39 "Radar Object ID of the Fused Object, Only relvant when OBJ_Fusion_Source is not Camera only";
CM_ SG_ 154 OBJ_Height_39 "The height of the object in the world. ";
CM_ SG_ 154 OBJ_Height_V_39 "Validator for object height.";
CM_ SG_ 154 OBJ_Height_STD_39 "Standard deviation for object height.";
CM_ SG_ 154 OBJ_Height_STD_V_39 "Validator for the standard deviation of object height.";
CM_ SG_ 154 OBJ_Abs_Long_Velocity_39 "Absolute longitudinal velocity.";
CM_ SG_ 154 OBJ_Abs_Long_Velocity_V_39 "Validator for absolute longitudinal velocity.";
CM_ SG_ 154 OBJ_Abs_Long_Velocity_STD_39 "Standard deviation of absolute longitudinal velocity.";
CM_ SG_ 154 OBJ_Abs_Long_Vel_STD_V_39 "Validator for the standard deviation of the absolute longitudinal velocity.";
CM_ SG_ 154 OBJ_Abs_Lat_Velocity_39 "The lateral ground speed of the object.";
CM_ SG_ 154 OBJ_Abs_Lat_Velocity_V_39 "Validator for the lateral ground speed of the object.";
CM_ SG_ 154 OBJ_Abs_Lat_Velocity_STD_39 "STD of the lateral ground speed of the object.";
CM_ SG_ 154 OBJ_Abs_Lat_Vel_STD_V_39 "Validator for the STD of the lateral ground speed of the object.";
CM_ SG_ 154 OBJ_Abs_Long_Acc_39 "The longitudinal ground acceleration of the object.";
CM_ SG_ 154 OBJ_Abs_Long_Acc_V_39 "Validator for the longitudinal ground acceleration of the object.";
CM_ SG_ 154 OBJ_Abs_Long_Acc_STD_39 "STD of the longitudinal ground acceleration of the object.";
CM_ SG_ 154 OBJ_Abs_Long_Acc_STD_V_39 "Validator for the STD of the longitudinal ground acceleration of the object.";
CM_ SG_ 154 OBJ_Abs_Lat_Acc_39 "The lateral ground acceleration of the object.";
CM_ SG_ 154 OBJ_Abs_Lat_Acc_V_39 "Validator for the lateral ground acceleration of the object.";
CM_ SG_ 154 OBJ_Abs_Lat_Acc_STD_39 "STD of the lateral ground acceleration of the object.";
CM_ SG_ 154 OBJ_Abs_Lat_Acc_STD_V_39 "Validator for the STD of the lateral ground acceleration of the object.";
CM_ SG_ 154 OBJ_Abs_Acceleration_39 "The absolute ground acceleration in the target's heading direction.";
CM_ SG_ 154 OBJ_Abs_Acceleration_V_39 "Validator for the absolute ground acceleration.";
CM_ SG_ 154 OBJ_Abs_Acc_STD_39 "STD of the absolute ground acceleration.";
CM_ SG_ 154 OBJ_Abs_Acc_STD_V_39 "Validator for the STD of the absolute ground acceleration.";
CM_ SG_ 154 OBJ_Inv_TTC_39 "Inverse TTC (time to collision).";
CM_ SG_ 154 OBJ_Inv_TTC_STD_39 "STD for inverse TTC .";
CM_ SG_ 154 OBJ_Inv_TTC_STD_V_39 "Validator for the STD for inverse TTC .";
CM_ SG_ 154 OBJ_Relative_Long_Acc_39 "The relative longitudinal ground acceleration of the object.";
CM_ SG_ 154 OBJ_Relative_Long_Acc_V_39 "Validator for the relative longitudinal ground acceleration of the object.";
CM_ SG_ 154 OBJ_Relative_Long_Acc_STD_39 "STD of the relative longitudinal ground acceleration of the object.";
CM_ SG_ 154 OBJ_Rel_Long_Acc_STD_V_39 "Validator for the STD of the relative longitudinal ground acceleration.";
CM_ SG_ 154 OBJ_Relative_Long_Velocity_39 "The relative longtitudinal speed between the target and ego vehicle. ";
CM_ SG_ 154 OBJ_Relative_Long_Velocity_V_39 "Validator for the relative longtitudinal speed.";
CM_ SG_ 154 OBJ_Relative_Long_Vel_STD_39 "STD of the relative longtitudinal speed.";
CM_ SG_ 154 OBJ_Rel_Long_Vel_STD_V_39 "Validator for the STD of the relative longtitudinal speed.";
CM_ SG_ 154 OBJ_Relative_Lat_Velocity_39 "The relative lateral speed between the target and ego vehicle. ";
CM_ SG_ 154 OBJ_Relative_Lat_Velocity_V_39 "Validator for the relative lateral speed. ";
CM_ SG_ 154 OBJ_Relative_Lat_Velocity_STD_39 "STD of the relative lateral speed. ";
CM_ SG_ 154 OBJ_Rel_Lat_Vel_STD_V_39 "Validator for the STD of the relative lateral speed. ";
CM_ SG_ 154 OBJ_Long_Distance_39 "The longitudinal distance to middle of the rear bumper (middle of the RL and RR corners) of the target.";
CM_ SG_ 154 OBJ_Long_Distance_V_39 "Validator of the longtitudinal distance field";
CM_ SG_ 154 OBJ_Long_Distance_STD_39 "STD of the  longtitudinal distance.";
CM_ SG_ 154 OBJ_Long_Distance_STD_V_39 "Validator for the STD of the  longtitudinal distance.";
CM_ SG_ 154 OBJ_Lat_Distance_39 "Lateral distance to the middle of the RL and RR corners.  ";
CM_ SG_ 154 OBJ_Lat_Distance_V_39 "Validator for the lateral distance of the object.";
CM_ SG_ 154 OBJ_Lat_Distance_STD_39 "STD of the lateral distance of the object.";
CM_ SG_ 154 OBJ_Lat_Distance_STD_V_39 "Validator for the STD of the lateral distance of the object.";
CM_ SG_ 154 OBJ_Absolute_Speed_39 "The absolute ground speed in the targets' heading direction.";
CM_ SG_ 154 OBJ_Absolute_Speed_V_39 "Validator for the absolute ground speed.";
CM_ SG_ 154 OBJ_Absolute_Speed_STD_39 "STD of the absolute ground speed.";
CM_ SG_ 154 OBJ_Absolute_Speed_STD_V_39 "Validator for the STD of the absolute ground speed.";
CM_ SG_ 154 OBJ_Heading_39 "The angle beetweenthe host longitudinal axis and target's heading (clockwise, e.g. PI/2 is a target crossing from left to right).";
CM_ SG_ 154 OBJ_Heading_V_39 "Validator for the object heading.";
CM_ SG_ 154 OBJ_Heading_STD_39 "STD of the object heading.";
CM_ SG_ 154 OBJ_Heading_STD_V_39 "Validator for the STD of the object heading.";
CM_ SG_ 154 OBJ_Angle_Rate_STD_39 "Standard deviation of the angular speed. (radians)";
CM_ SG_ 154 OBJ_Angle_Rate_STD_V_39 "Validator for the STD of the angular speed.";
CM_ SG_ 154 OBJ_Angle_Rate_39 "The momentary angular speed of the object (radians). The positive side is to the host's right.";
CM_ SG_ 154 OBJ_Angle_Rate_V_39 "Validator for the angular speed.";
CM_ SG_ 154 OBJ_Angle_Right_39 "The angle between the host longitudinal axis and the right side of the front / rear of the target (the visible one). The positive side is to the host's right.";
CM_ SG_ 154 OBJ_Angle_Right_V_39 "Validator for angleRight";
CM_ SG_ 154 OBJ_Angle_Right_STD_39 "Standard deviation of angleRight";
CM_ SG_ 154 OBJ_Angle_Right_STD_V_39 "Validator for the standard deviation of angleRight.";
CM_ SG_ 154 OBJ_Angle_Left_39 "The angle between the host longitudinal axis and the left side of the front / rear of the target (the visible one). The positive side is to the host's right.";
CM_ SG_ 154 OBJ_Angle_Left_V_39 "Validator for angleLeft.";
CM_ SG_ 154 OBJ_Angle_Left_STD_39 "Standard deviation of angleLeft.";
CM_ SG_ 154 OBJ_Angle_Left_STD_V_39 "Validator for the standard deviation of angleLeft.";
CM_ SG_ 154 OBJ_Angle_Side_39 "The angle between the host longitudinal axis and the far visible edge - the visible edge of the front / rear of the target that is not visible. Currently supported for vehicles only.";
CM_ SG_ 154 OBJ_Angle_Side_V_39 "Validator for angleSide.";
CM_ SG_ 154 OBJ_Angle_Side_STD_39 "Standard deviation of angleSide.";
CM_ SG_ 154 OBJ_Angle_Side_STD_V_39 "Validator for the STD of angleSide.";
CM_ SG_ 154 OBJ_Angle_Mid_V_39 "Validator for angleMid.";
CM_ SG_ 154 OBJ_Angle_Mid_39 "The angle between the host longitudinal axis and the middle of the front / rear of the target (the visible one). The positive side is to the host's right.";
CM_ SG_ 154 OBJ_Angle_Mid_STD_39 "Standard deviation of angleMid.";
CM_ SG_ 154 OBJ_Angle_Mid_STD_V_39 "Validator for the STD of angleMid.";
CM_ SG_ 154 OBJ_Angle_Bottom_V_39 "Validator for OBJAngle_Bottom. ";
CM_ SG_ 154 OBJ_Angle_Bottom_39 "The angle between the longitudinal axis and the Bottom of the front / rear of the target (the visible one). The positive side is to the host's bottom";
CM_ SG_ 154 OBJ_Angle_Bottom_STD_39 "STD for OBJAngle_Bottom. ";
CM_ SG_ 154 OBJ_Angle_Bottom_STD_V_39 "Validator for OBJAngle_Bottom_STD. ";
CM_ SG_ 154 OBJ_Visibility_Side_V_39 "Currently Supported for VD only";
CM_ SG_ 154 OBJ_Visibility_Side_39 "From what car  side is the object visible";
CM_ SG_ 154 OBJ_Is_In_Drivable_Area_39 "Indicates whether the target is in a driveable area.";
CM_ SG_ 154 OBJ_Is_In_Drivable_Area_V_39 "Validator for OBJ_Is_In_Drivable_Area.";
CM_ SG_ 154 OBJ_Is_VeryClose_V_39 "Validator for OBJ_Is_VeryClose. ";
CM_ SG_ 154 OBJ_Is_VeryClose_39 "Indicates whether the target is very close to the host such that it is hard to measure its distance. Currently relevant for peds only";
CM_ SG_ 154 OBJ_OverlapAngleEgoLaneR_39 "Lateral distance to the middle of the RL and RR corners.";
CM_ SG_ 154 OBJ_OverlapAngleEgoLaneR_V_39 "Validator for OBJ_OverlapAngleEgoLaneR";
CM_ SG_ 154 OBJ_OverlapAngleEgoLaneL_39 "Lateral distance to the middle of the RL and RR corners.  ";
CM_ SG_ 154 OBJ_OverlapAngleEgoLaneL_V_39 "Validator for OBJ_OverlapAngleEgoLaneL";
CM_ SG_ 154 OBJ_Is_EMERGENCY_VCL_39 "Is Object an Emergency Vehicle";
CM_ SG_ 154 OBJ_EMERGENCY_LIGHT_COLOR_39 "Emergency Color";
CM_ SG_ 154 OBJ_EMERGENCY_V_39 "Are OBJ_Is_EMERGENCY_VCL and OBJ_EMERGENCY_LIGHT_COLOR Valid";
CM_ SG_ 154 OBJ_Angle_Top_39 "From VD touching point on the ground till the roof of the car";
CM_ SG_ 154 OBJ_Angle_Top_V_39 "Validator for OBJ_Angle_Top ";
CM_ SG_ 154 OBJ_Angle_Top_STD_39 "STD for OBJ_Angle_Top";
CM_ SG_ 154 OBJ_Angle_Top_STD_V_39 "Validator for OBJ_Angle_Top_STD. ";
CM_ SG_ 154 OBJ_Open_Door_Left_39 "Indicator if left door is open";
CM_ SG_ 154 OBJ_Open_Door_Right_39 "Indicator if right door is open";
CM_ SG_ 154 OBJ_Visible_Left_or_Right_39 "This signal describes the visible Left or Right side of the Target vehicle.";
CM_ SG_ 154 OBJ_Visible_Left_or_Right_V_39 "OBJ_Visible_Left_or_Right";
CM_ SG_ 154 OBJ_2W_Is_Motorbike_Probability_39 "The probability of the Two-wheeler reported object being a Motorbike";
CM_ SG_ 154 OBJ_2W_Is_Bicycle_Probability_39 "The probability of the Two-wheeler reported object being a Bicycle";
BA_DEF_ SG_  "GenSigStartValue" INT 0 0;
BA_DEF_DEF_  "GenSigStartValue" 0;
BA_ "GenSigStartValue" SG_ 154 OBJ_Width_35 40;
BA_ "GenSigStartValue" SG_ 154 OBJ_Length_35 12;
BA_ "GenSigStartValue" SG_ 154 OBJ_Width_36 40;
BA_ "GenSigStartValue" SG_ 154 OBJ_Length_36 12;
BA_ "GenSigStartValue" SG_ 154 OBJ_Width_37 40;
BA_ "GenSigStartValue" SG_ 154 OBJ_Length_37 12;
BA_ "GenSigStartValue" SG_ 154 OBJ_Width_38 40;
BA_ "GenSigStartValue" SG_ 154 OBJ_Length_38 12;
BA_ "GenSigStartValue" SG_ 154 OBJ_Width_39 40;
BA_ "GenSigStartValue" SG_ 154 OBJ_Length_39 12;
VAL_ 154 OBJ_Abs_Long_Vel_STD_V_34 1 "VALID" 0 "INVALID" ;
VAL_ 154 OBJ_Abs_Lat_Velocity_V_34 1 "VALID" 0 "INVALID" ;
VAL_ 154 OBJ_Abs_Lat_Vel_STD_V_34 1 "VALID" 0 "INVALID" ;
VAL_ 154 OBJ_Abs_Long_Acc_V_34 1 "VALID" 0 "INVALID" ;
VAL_ 154 OBJ_Abs_Long_Acc_STD_V_34 1 "VALID" 0 "INVALID" ;
VAL_ 154 OBJ_Abs_Lat_Acc_V_34 1 "VALID" 0 "INVALID" ;
VAL_ 154 OBJ_Abs_Lat_Acc_STD_V_34 1 "VALID" 0 "INVALID" ;
VAL_ 154 OBJ_Abs_Acceleration_V_34 1 "VALID" 0 "INVALID" ;
VAL_ 154 OBJ_Abs_Acc_STD_V_34 1 "VALID" 0 "INVALID" ;
VAL_ 154 OBJ_Inv_TTC_V_34 1 "VALID" 0 "INVALID" ;
VAL_ 154 OBJ_Inv_TTC_STD_V_34 1 "VALID" 0 "INVALID" ;
VAL_ 154 OBJ_Relative_Long_Acc_V_34 1 "VALID" 0 "INVALID" ;
VAL_ 154 OBJ_Rel_Long_Acc_STD_V_34 1 "VALID" 0 "INVALID" ;
VAL_ 154 OBJ_Relative_Long_Velocity_V_34 1 "VALID" 0 "INVALID" ;
VAL_ 154 OBJ_Rel_Long_Vel_STD_V_34 1 "VALID" 0 "INVALID" ;
VAL_ 154 OBJ_Relative_Lat_Velocity_V_34 1 "VALID" 0 "INVALID" ;
VAL_ 154 OBJ_Rel_Lat_Vel_STD_V_34 1 "VALID" 0 "INVALID" ;
VAL_ 154 OBJ_Long_Distance_V_34 1 "VALID" 0 "INVALID" ;
VAL_ 154 OBJ_Long_Distance_STD_V_34 1 "VALID" 0 "INVALID" ;
VAL_ 154 OBJ_Lat_Distance_V_34 1 "VALID" 0 "INVALID" ;
VAL_ 154 OBJ_Lat_Distance_STD_V_34 1 "VALID" 0 "INVALID" ;
VAL_ 154 OBJ_Absolute_Speed_V_34 1 "VALID" 0 "INVALID" ;
VAL_ 154 OBJ_Absolute_Speed_STD_V_34 1 "VALID" 0 "INVALID" ;
VAL_ 154 OBJ_Heading_V_34 1 "VALID" 0 "INVALID" ;
VAL_ 154 OBJ_Heading_STD_V_34 1 "VALID" 0 "INVALID" ;
VAL_ 154 OBJ_Angle_Rate_STD_V_34 1 "VALID" 0 "INVALID" ;
VAL_ 154 OBJ_Angle_Rate_V_34 1 "VALID" 0 "INVALID" ;
VAL_ 154 OBJ_Angle_Right_V_34 1 "VALID" 0 "INVALID" ;
VAL_ 154 OBJ_Angle_Right_STD_V_34 1 "VALID" 0 "INVALID" ;
VAL_ 154 OBJ_Angle_Left_V_34 1 "VALID" 0 "INVALID" ;
VAL_ 154 OBJ_Angle_Left_STD_V_34 1 "VALID" 0 "INVALID" ;
VAL_ 154 OBJ_Angle_Side_V_34 1 "VALID" 0 "INVALID" ;
VAL_ 154 OBJ_Angle_Side_STD_V_34 1 "VALID" 0 "INVALID" ;
VAL_ 154 OBJ_Angle_Mid_V_34 1 "VALID" 0 "INVALID" ;
VAL_ 154 OBJ_Angle_Mid_STD_V_34 1 "VALID" 0 "INVALID" ;
VAL_ 154 OBJ_Angle_Bottom_V_34 1 "VALID" 0 "INVALID" ;
VAL_ 154 OBJ_Angle_Bottom_STD_V_34 1 "VALID" 0 "INVALID" ;
VAL_ 154 OBJ_Visibility_Side_V_34 1 "VALID" 0 "INVALID" ;
VAL_ 154 OBJ_Visibility_Side_34 2 "REAR" 1 "FRONT" 0 "NOT_VISIBLE" ;
VAL_ 154 OBJ_Is_In_Drivable_Area_34 1 "TRUE" 0 "FALSE" ;
VAL_ 154 OBJ_Is_In_Drivable_Area_V_34 1 "VALID" 0 "INVALID" ;
VAL_ 154 OBJ_Is_VeryClose_V_34 1 "VALID" 0 "INVALID" ;
VAL_ 154 OBJ_Is_VeryClose_34 1 "TRUE" 0 "FALSE" ;
VAL_ 154 OBJ_OverlapAngleEgoLaneR_V_34 1 "VALID" 0 "INVALID" ;
VAL_ 154 OBJ_OverlapAngleEgoLaneL_V_34 1 "VALID" 0 "INVALID" ;
VAL_ 154 OBJ_Is_EMERGENCY_VCL_34 1 "TRUE" 0 "FALSE" ;
VAL_ 154 OBJ_EMERGENCY_LIGHT_COLOR_34 3 "(1000)ORANGE" 2 "(0100)BLUE" 1 "(0010)RED" 0 "(0001)OTHER" ;
VAL_ 154 OBJ_EMERGENCY_V_34 1 "TRUE" 0 "FALSE" ;
VAL_ 154 OBJ_Angle_Top_V_34 1 "VALID" 0 "INVALID" ;
VAL_ 154 OBJ_Angle_Top_STD_V_34 1 "VALID" 0 "INVALID" ;
VAL_ 154 OBJ_Open_Door_Left_34 1 "TRUE" 0 "FALSE" ;
VAL_ 154 OBJ_Open_Door_Right_34 1 "TRUE" 0 "FALSE" ;
VAL_ 154 OBJ_Visible_Left_or_Right_34 2 "RIGHT" 1 "LEFT" 0 "NOT_VISIBLE" ;
VAL_ 154 OBJ_Visible_Left_or_Right_V_34 1 "VALID" 0 "INVALID" ;
VAL_ 154 OBJ_Fusion_Source_35 2 "(BIT_2)RADAR2" 1 "(BIT_1)RADAR1" 0 "(BIT_0)CAMERA" ;
VAL_ 154 OBJ_Triggered_SDM_35 2 "NOT_TRIGGERED" 1 "TRIGGERED" 0 "NOT_AVAILABLE" ;
VAL_ 154 OBJ_Motion_Category_35 13 "ONCOMING" 12 "PRECEEDING" 11 "MOVING" 10 "RTAP" 9 "LTAP" 8 "CROSSING" 7 "MOVING_OUT" 6 "MOVING_IN" 5 "CLOSE_CUT_IN" 4 "PASSING_OUT" 3 "PASSING_IN" 2 "PASSING" 1 "UNDEFINED" 0 "UNFILLED" ;
VAL_ 154 OBJ_Measuring_Status_35 2 "(BIT_2)NOT_VALID_OR_VALID" 1 "(BIT_1)PREDICTED_OR_MEASURED" 0 "(BIT_0)OLD_OR_NEW" ;
VAL_ 154 OBJ_Object_Class_35 9 "TWO_WHEELER" 8 "UNCERTAIN_VCL" 7 "ANIMAL" 6 "GENERAL_OBJECT" 5 "PEDESTRIAN" 4 "BICYCLE" 3 "MOTORBIKE" 2 "TRUCK" 1 "CAR" 0 "UNFILLED" ;
VAL_ 154 OBJ_Camera_Source_35 11 "PARKING_RIGHT" 10 "PARKING_LEFT" 9 "PARKING_REAR" 8 "PARKING_FRONT" 7 "FRONT_CORNER_RIGHT" 6 "FRONT_CORNER_LEFT" 5 "REAR_CORNER_RIGHT" 4 "REAR_CORNER_LEFT" 3 "REAR" 2 "FRONT_FISHEYE" 1 "FRONT_NARROW" 0 "FRONT_MAIN" ;
VAL_ 154 OBJ_Motion_Status_35 5 "MOVING_SLOWLY" 4 "STOPPED" 3 "STATIONARY" 2 "MOVING" 1 "UNKNOWN" 0 "INVALID" ;
VAL_ 154 OBJ_Motion_Orientation_35 13 "INVALID" 12 "NORTH" 11 "NORTH_WEST" 9 "WEST" 7 "SOUTH_WEST" 6 "SOUTH" 5 "SOUTH_EAST" 3 "EAST" 1 "NORTH_EAST" 0 "UNKNOWN" ;
VAL_ 154 OBJ_Has_Cut_Lane_35 1 "TRUE" 0 "FALSE" ;
VAL_ 154 OBJ_Has_Cut_Path_35 1 "TRUE" 0 "FALSE" ;
VAL_ 154 OBJ_Brake_Light_Validity_35 1 "TRUE" 0 "FALSE" ;
VAL_ 154 OBJ_Brake_Light_35 1 "TRUE" 0 "FALSE" ;
VAL_ 154 OBJ_Turn_Indicator_Right_35 1 "TRUE" 0 "FALSE" ;
VAL_ 154 OBJ_Turn_Indicator_Left_35 1 "TRUE" 0 "FALSE" ;
VAL_ 154 OBJ_Turn_Indicator_Validity_35 1 "TRUE" 0 "FALSE" ;
VAL_ 154 OBJ_Right_Out_Of_Image_35 1 "TRUE" 0 "FALSE" ;
VAL_ 154 OBJ_Left_Out_Of_Image_35 1 "TRUE" 0 "FALSE" ;
VAL_ 154 OBJ_Right_Out_Of_Image_V_35 1 "TRUE" 0 "FALSE" ;
VAL_ 154 OBJ_Left_Out_Of_Image_V_35 1 "TRUE" 0 "FALSE" ;
VAL_ 154 OBJ_Top_Out_Of_Image_35 1 "TRUE" 0 "FALSE" ;
VAL_ 154 OBJ_Bottom_Out_Of_Image_35 1 "TRUE" 0 "FALSE" ;
VAL_ 154 OBJ_Top_Out_Of_Image_V_35 1 "VALID" 0 "INVALID" ;
VAL_ 154 OBJ_Bottom_Out_Of_Image_V_35 1 "VALID" 0 "INVALID" ;
VAL_ 154 OBJ_Lane_Assignment_35 5 "RIGHT_RIGHT" 4 "RIGHT" 3 "HOST" 2 "LEFT" 1 "LEFT_LEFT" 0 "UNKNOWN" ;
VAL_ 154 OBJ_Lane_Assignment_V_35 1 "VALID" 0 "INVALID" ;
VAL_ 154 OBJ_Age_Seconds_V_35 1 "VALID" 0 "INVALID" ;
VAL_ 154 OBJ_Width_V_35 1 "VALID" 0 "INVALID" ;
VAL_ 154 OBJ_Width_STD_V_35 1 "VALID" 0 "INVALID" ;
VAL_ 154 OBJ_Length_V_35 1 "VALID" 0 "INVALID" ;
VAL_ 154 OBJ_Length_STD_V_35 1 "VALID" 0 "INVALID" ;
VAL_ 154 OBJ_Height_V_35 1 "VALID" 0 "INVALID" ;
VAL_ 154 OBJ_Height_STD_V_35 1 "VALID" 0 "INVALID" ;
VAL_ 154 OBJ_Abs_Long_Velocity_V_35 1 "VALID" 0 "INVALID" ;
VAL_ 154 OBJ_Abs_Long_Vel_STD_V_35 1 "VALID" 0 "INVALID" ;
VAL_ 154 OBJ_Abs_Lat_Velocity_V_35 1 "VALID" 0 "INVALID" ;
VAL_ 154 OBJ_Abs_Lat_Vel_STD_V_35 1 "VALID" 0 "INVALID" ;
VAL_ 154 OBJ_Abs_Long_Acc_V_35 1 "VALID" 0 "INVALID" ;
VAL_ 154 OBJ_Abs_Long_Acc_STD_V_35 1 "VALID" 0 "INVALID" ;
VAL_ 154 OBJ_Abs_Lat_Acc_V_35 1 "VALID" 0 "INVALID" ;
VAL_ 154 OBJ_Abs_Lat_Acc_STD_V_35 1 "VALID" 0 "INVALID" ;
VAL_ 154 OBJ_Abs_Acceleration_V_35 1 "VALID" 0 "INVALID" ;
VAL_ 154 OBJ_Abs_Acc_STD_V_35 1 "VALID" 0 "INVALID" ;
VAL_ 154 OBJ_Inv_TTC_V_35 1 "VALID" 0 "INVALID" ;
VAL_ 154 OBJ_Inv_TTC_STD_V_35 1 "VALID" 0 "INVALID" ;
VAL_ 154 OBJ_Relative_Long_Acc_V_35 1 "VALID" 0 "INVALID" ;
VAL_ 154 OBJ_Rel_Long_Acc_STD_V_35 1 "VALID" 0 "INVALID" ;
VAL_ 154 OBJ_Relative_Long_Velocity_V_35 1 "VALID" 0 "INVALID" ;
VAL_ 154 OBJ_Rel_Long_Vel_STD_V_35 1 "VALID" 0 "INVALID" ;
VAL_ 154 OBJ_Relative_Lat_Velocity_V_35 1 "VALID" 0 "INVALID" ;
VAL_ 154 OBJ_Rel_Lat_Vel_STD_V_35 1 "VALID" 0 "INVALID" ;
VAL_ 154 OBJ_Long_Distance_V_35 1 "VALID" 0 "INVALID" ;
VAL_ 154 OBJ_Long_Distance_STD_V_35 1 "VALID" 0 "INVALID" ;
VAL_ 154 OBJ_Lat_Distance_V_35 1 "VALID" 0 "INVALID" ;
VAL_ 154 OBJ_Lat_Distance_STD_V_35 1 "VALID" 0 "INVALID" ;
VAL_ 154 OBJ_Absolute_Speed_V_35 1 "VALID" 0 "INVALID" ;
VAL_ 154 OBJ_Absolute_Speed_STD_V_35 1 "VALID" 0 "INVALID" ;
VAL_ 154 OBJ_Heading_V_35 1 "VALID" 0 "INVALID" ;
VAL_ 154 OBJ_Heading_STD_V_35 1 "VALID" 0 "INVALID" ;
VAL_ 154 OBJ_Angle_Rate_STD_V_35 1 "VALID" 0 "INVALID" ;
VAL_ 154 OBJ_Angle_Rate_V_35 1 "VALID" 0 "INVALID" ;
VAL_ 154 OBJ_Angle_Right_V_35 1 "VALID" 0 "INVALID" ;
VAL_ 154 OBJ_Angle_Right_STD_V_35 1 "VALID" 0 "INVALID" ;
VAL_ 154 OBJ_Angle_Left_V_35 1 "VALID" 0 "INVALID" ;
VAL_ 154 OBJ_Angle_Left_STD_V_35 1 "VALID" 0 "INVALID" ;
VAL_ 154 OBJ_Angle_Side_V_35 1 "VALID" 0 "INVALID" ;
VAL_ 154 OBJ_Angle_Side_STD_V_35 1 "VALID" 0 "INVALID" ;
VAL_ 154 OBJ_Angle_Mid_V_35 1 "VALID" 0 "INVALID" ;
VAL_ 154 OBJ_Angle_Mid_STD_V_35 1 "VALID" 0 "INVALID" ;
VAL_ 154 OBJ_Angle_Bottom_V_35 1 "VALID" 0 "INVALID" ;
VAL_ 154 OBJ_Angle_Bottom_STD_V_35 1 "VALID" 0 "INVALID" ;
VAL_ 154 OBJ_Visibility_Side_V_35 1 "VALID" 0 "INVALID" ;
VAL_ 154 OBJ_Visibility_Side_35 2 "REAR" 1 "FRONT" 0 "NOT_VISIBLE" ;
VAL_ 154 OBJ_Is_In_Drivable_Area_35 1 "TRUE" 0 "FALSE" ;
VAL_ 154 OBJ_Is_In_Drivable_Area_V_35 1 "VALID" 0 "INVALID" ;
VAL_ 154 OBJ_Is_VeryClose_V_35 1 "VALID" 0 "INVALID" ;
VAL_ 154 OBJ_Is_VeryClose_35 1 "TRUE" 0 "FALSE" ;
VAL_ 154 OBJ_OverlapAngleEgoLaneR_V_35 1 "VALID" 0 "INVALID" ;
VAL_ 154 OBJ_OverlapAngleEgoLaneL_V_35 1 "VALID" 0 "INVALID" ;
VAL_ 154 OBJ_Is_EMERGENCY_VCL_35 1 "TRUE" 0 "FALSE" ;
VAL_ 154 OBJ_EMERGENCY_LIGHT_COLOR_35 3 "(1000)ORANGE" 2 "(0100)BLUE" 1 "(0010)RED" 0 "(0001)OTHER" ;
VAL_ 154 OBJ_EMERGENCY_V_35 1 "TRUE" 0 "FALSE" ;
VAL_ 154 OBJ_Angle_Top_V_35 1 "VALID" 0 "INVALID" ;
VAL_ 154 OBJ_Angle_Top_STD_V_35 1 "VALID" 0 "INVALID" ;
VAL_ 154 OBJ_Open_Door_Left_35 1 "TRUE" 0 "FALSE" ;
VAL_ 154 OBJ_Open_Door_Right_35 1 "TRUE" 0 "FALSE" ;
VAL_ 154 OBJ_Visible_Left_or_Right_35 2 "RIGHT" 1 "LEFT" 0 "NOT_VISIBLE" ;
VAL_ 154 OBJ_Visible_Left_or_Right_V_35 1 "VALID" 0 "INVALID" ;
VAL_ 154 OBJ_Fusion_Source_36 2 "(BIT_2)RADAR2" 1 "(BIT_1)RADAR1" 0 "(BIT_0)CAMERA" ;
VAL_ 154 OBJ_Triggered_SDM_36 2 "NOT_TRIGGERED" 1 "TRIGGERED" 0 "NOT_AVAILABLE" ;
VAL_ 154 OBJ_Motion_Category_36 13 "ONCOMING" 12 "PRECEEDING" 11 "MOVING" 10 "RTAP" 9 "LTAP" 8 "CROSSING" 7 "MOVING_OUT" 6 "MOVING_IN" 5 "CLOSE_CUT_IN" 4 "PASSING_OUT" 3 "PASSING_IN" 2 "PASSING" 1 "UNDEFINED" 0 "UNFILLED" ;
VAL_ 154 OBJ_Measuring_Status_36 2 "(BIT_2)NOT_VALID_OR_VALID" 1 "(BIT_1)PREDICTED_OR_MEASURED" 0 "(BIT_0)OLD_OR_NEW" ;
VAL_ 154 OBJ_Object_Class_36 9 "TWO_WHEELER" 8 "UNCERTAIN_VCL" 7 "ANIMAL" 6 "GENERAL_OBJECT" 5 "PEDESTRIAN" 4 "BICYCLE" 3 "MOTORBIKE" 2 "TRUCK" 1 "CAR" 0 "UNFILLED" ;
VAL_ 154 OBJ_Camera_Source_36 11 "PARKING_RIGHT" 10 "PARKING_LEFT" 9 "PARKING_REAR" 8 "PARKING_FRONT" 7 "FRONT_CORNER_RIGHT" 6 "FRONT_CORNER_LEFT" 5 "REAR_CORNER_RIGHT" 4 "REAR_CORNER_LEFT" 3 "REAR" 2 "FRONT_FISHEYE" 1 "FRONT_NARROW" 0 "FRONT_MAIN" ;
VAL_ 154 OBJ_Motion_Status_36 5 "MOVING_SLOWLY" 4 "STOPPED" 3 "STATIONARY" 2 "MOVING" 1 "UNKNOWN" 0 "INVALID" ;
VAL_ 154 OBJ_Motion_Orientation_36 13 "INVALID" 12 "NORTH" 11 "NORTH_WEST" 9 "WEST" 7 "SOUTH_WEST" 6 "SOUTH" 5 "SOUTH_EAST" 3 "EAST" 1 "NORTH_EAST" 0 "UNKNOWN" ;
VAL_ 154 OBJ_Has_Cut_Lane_36 1 "TRUE" 0 "FALSE" ;
VAL_ 154 OBJ_Has_Cut_Path_36 1 "TRUE" 0 "FALSE" ;
VAL_ 154 OBJ_Brake_Light_Validity_36 1 "TRUE" 0 "FALSE" ;
VAL_ 154 OBJ_Brake_Light_36 1 "TRUE" 0 "FALSE" ;
VAL_ 154 OBJ_Turn_Indicator_Right_36 1 "TRUE" 0 "FALSE" ;
VAL_ 154 OBJ_Turn_Indicator_Left_36 1 "TRUE" 0 "FALSE" ;
VAL_ 154 OBJ_Turn_Indicator_Validity_36 1 "TRUE" 0 "FALSE" ;
VAL_ 154 OBJ_Right_Out_Of_Image_36 1 "TRUE" 0 "FALSE" ;
VAL_ 154 OBJ_Left_Out_Of_Image_36 1 "TRUE" 0 "FALSE" ;
VAL_ 154 OBJ_Right_Out_Of_Image_V_36 1 "TRUE" 0 "FALSE" ;
VAL_ 154 OBJ_Left_Out_Of_Image_V_36 1 "TRUE" 0 "FALSE" ;
VAL_ 154 OBJ_Top_Out_Of_Image_36 1 "TRUE" 0 "FALSE" ;
VAL_ 154 OBJ_Bottom_Out_Of_Image_36 1 "TRUE" 0 "FALSE" ;
VAL_ 154 OBJ_Top_Out_Of_Image_V_36 1 "VALID" 0 "INVALID" ;
VAL_ 154 OBJ_Bottom_Out_Of_Image_V_36 1 "VALID" 0 "INVALID" ;
VAL_ 154 OBJ_Lane_Assignment_36 5 "RIGHT_RIGHT" 4 "RIGHT" 3 "HOST" 2 "LEFT" 1 "LEFT_LEFT" 0 "UNKNOWN" ;
VAL_ 154 OBJ_Lane_Assignment_V_36 1 "VALID" 0 "INVALID" ;
VAL_ 154 OBJ_Age_Seconds_V_36 1 "VALID" 0 "INVALID" ;
VAL_ 154 OBJ_Width_V_36 1 "VALID" 0 "INVALID" ;
VAL_ 154 OBJ_Width_STD_V_36 1 "VALID" 0 "INVALID" ;
VAL_ 154 OBJ_Length_V_36 1 "VALID" 0 "INVALID" ;
VAL_ 154 OBJ_Length_STD_V_36 1 "VALID" 0 "INVALID" ;
VAL_ 154 OBJ_Height_V_36 1 "VALID" 0 "INVALID" ;
VAL_ 154 OBJ_Height_STD_V_36 1 "VALID" 0 "INVALID" ;
VAL_ 154 OBJ_Abs_Long_Velocity_V_36 1 "VALID" 0 "INVALID" ;
VAL_ 154 OBJ_Abs_Long_Vel_STD_V_36 1 "VALID" 0 "INVALID" ;
VAL_ 154 OBJ_Abs_Lat_Velocity_V_36 1 "VALID" 0 "INVALID" ;
VAL_ 154 OBJ_Abs_Lat_Vel_STD_V_36 1 "VALID" 0 "INVALID" ;
VAL_ 154 OBJ_Abs_Long_Acc_V_36 1 "VALID" 0 "INVALID" ;
VAL_ 154 OBJ_Abs_Long_Acc_STD_V_36 1 "VALID" 0 "INVALID" ;
VAL_ 154 OBJ_Abs_Lat_Acc_V_36 1 "VALID" 0 "INVALID" ;
VAL_ 154 OBJ_Abs_Lat_Acc_STD_V_36 1 "VALID" 0 "INVALID" ;
VAL_ 154 OBJ_Abs_Acceleration_V_36 1 "VALID" 0 "INVALID" ;
VAL_ 154 OBJ_Abs_Acc_STD_V_36 1 "VALID" 0 "INVALID" ;
VAL_ 154 OBJ_Inv_TTC_V_36 1 "VALID" 0 "INVALID" ;
VAL_ 154 OBJ_Inv_TTC_STD_V_36 1 "VALID" 0 "INVALID" ;
VAL_ 154 OBJ_Relative_Long_Acc_V_36 1 "VALID" 0 "INVALID" ;
VAL_ 154 OBJ_Rel_Long_Acc_STD_V_36 1 "VALID" 0 "INVALID" ;
VAL_ 154 OBJ_Relative_Long_Velocity_V_36 1 "VALID" 0 "INVALID" ;
VAL_ 154 OBJ_Rel_Long_Vel_STD_V_36 1 "VALID" 0 "INVALID" ;
VAL_ 154 OBJ_Relative_Lat_Velocity_V_36 1 "VALID" 0 "INVALID" ;
VAL_ 154 OBJ_Rel_Lat_Vel_STD_V_36 1 "VALID" 0 "INVALID" ;
VAL_ 154 OBJ_Long_Distance_V_36 1 "VALID" 0 "INVALID" ;
VAL_ 154 OBJ_Long_Distance_STD_V_36 1 "VALID" 0 "INVALID" ;
VAL_ 154 OBJ_Lat_Distance_V_36 1 "VALID" 0 "INVALID" ;
VAL_ 154 OBJ_Lat_Distance_STD_V_36 1 "VALID" 0 "INVALID" ;
VAL_ 154 OBJ_Absolute_Speed_V_36 1 "VALID" 0 "INVALID" ;
VAL_ 154 OBJ_Absolute_Speed_STD_V_36 1 "VALID" 0 "INVALID" ;
VAL_ 154 OBJ_Heading_V_36 1 "VALID" 0 "INVALID" ;
VAL_ 154 OBJ_Heading_STD_V_36 1 "VALID" 0 "INVALID" ;
VAL_ 154 OBJ_Angle_Rate_STD_V_36 1 "VALID" 0 "INVALID" ;
VAL_ 154 OBJ_Angle_Rate_V_36 1 "VALID" 0 "INVALID" ;
VAL_ 154 OBJ_Angle_Right_V_36 1 "VALID" 0 "INVALID" ;
VAL_ 154 OBJ_Angle_Right_STD_V_36 1 "VALID" 0 "INVALID" ;
VAL_ 154 OBJ_Angle_Left_V_36 1 "VALID" 0 "INVALID" ;
VAL_ 154 OBJ_Angle_Left_STD_V_36 1 "VALID" 0 "INVALID" ;
VAL_ 154 OBJ_Angle_Side_V_36 1 "VALID" 0 "INVALID" ;
VAL_ 154 OBJ_Angle_Side_STD_V_36 1 "VALID" 0 "INVALID" ;
VAL_ 154 OBJ_Angle_Mid_V_36 1 "VALID" 0 "INVALID" ;
VAL_ 154 OBJ_Angle_Mid_STD_V_36 1 "VALID" 0 "INVALID" ;
VAL_ 154 OBJ_Angle_Bottom_V_36 1 "VALID" 0 "INVALID" ;
VAL_ 154 OBJ_Angle_Bottom_STD_V_36 1 "VALID" 0 "INVALID" ;
VAL_ 154 OBJ_Visibility_Side_V_36 1 "VALID" 0 "INVALID" ;
VAL_ 154 OBJ_Visibility_Side_36 2 "REAR" 1 "FRONT" 0 "NOT_VISIBLE" ;
VAL_ 154 OBJ_Is_In_Drivable_Area_36 1 "TRUE" 0 "FALSE" ;
VAL_ 154 OBJ_Is_In_Drivable_Area_V_36 1 "VALID" 0 "INVALID" ;
VAL_ 154 OBJ_Is_VeryClose_V_36 1 "VALID" 0 "INVALID" ;
VAL_ 154 OBJ_Is_VeryClose_36 1 "TRUE" 0 "FALSE" ;
VAL_ 154 OBJ_OverlapAngleEgoLaneR_V_36 1 "VALID" 0 "INVALID" ;
VAL_ 154 OBJ_OverlapAngleEgoLaneL_V_36 1 "VALID" 0 "INVALID" ;
VAL_ 154 OBJ_Is_EMERGENCY_VCL_36 1 "TRUE" 0 "FALSE" ;
VAL_ 154 OBJ_EMERGENCY_LIGHT_COLOR_36 3 "(1000)ORANGE" 2 "(0100)BLUE" 1 "(0010)RED" 0 "(0001)OTHER" ;
VAL_ 154 OBJ_EMERGENCY_V_36 1 "TRUE" 0 "FALSE" ;
VAL_ 154 OBJ_Angle_Top_V_36 1 "VALID" 0 "INVALID" ;
VAL_ 154 OBJ_Angle_Top_STD_V_36 1 "VALID" 0 "INVALID" ;
VAL_ 154 OBJ_Open_Door_Left_36 1 "TRUE" 0 "FALSE" ;
VAL_ 154 OBJ_Open_Door_Right_36 1 "TRUE" 0 "FALSE" ;
VAL_ 154 OBJ_Visible_Left_or_Right_36 2 "RIGHT" 1 "LEFT" 0 "NOT_VISIBLE" ;
VAL_ 154 OBJ_Visible_Left_or_Right_V_36 1 "VALID" 0 "INVALID" ;
VAL_ 154 OBJ_Fusion_Source_37 2 "(BIT_2)RADAR2" 1 "(BIT_1)RADAR1" 0 "(BIT_0)CAMERA" ;
VAL_ 154 OBJ_Triggered_SDM_37 2 "NOT_TRIGGERED" 1 "TRIGGERED" 0 "NOT_AVAILABLE" ;
VAL_ 154 OBJ_Motion_Category_37 13 "ONCOMING" 12 "PRECEEDING" 11 "MOVING" 10 "RTAP" 9 "LTAP" 8 "CROSSING" 7 "MOVING_OUT" 6 "MOVING_IN" 5 "CLOSE_CUT_IN" 4 "PASSING_OUT" 3 "PASSING_IN" 2 "PASSING" 1 "UNDEFINED" 0 "UNFILLED" ;
VAL_ 154 OBJ_Measuring_Status_37 2 "(BIT_2)NOT_VALID_OR_VALID" 1 "(BIT_1)PREDICTED_OR_MEASURED" 0 "(BIT_0)OLD_OR_NEW" ;
VAL_ 154 OBJ_Object_Class_37 9 "TWO_WHEELER" 8 "UNCERTAIN_VCL" 7 "ANIMAL" 6 "GENERAL_OBJECT" 5 "PEDESTRIAN" 4 "BICYCLE" 3 "MOTORBIKE" 2 "TRUCK" 1 "CAR" 0 "UNFILLED" ;
VAL_ 154 OBJ_Camera_Source_37 11 "PARKING_RIGHT" 10 "PARKING_LEFT" 9 "PARKING_REAR" 8 "PARKING_FRONT" 7 "FRONT_CORNER_RIGHT" 6 "FRONT_CORNER_LEFT" 5 "REAR_CORNER_RIGHT" 4 "REAR_CORNER_LEFT" 3 "REAR" 2 "FRONT_FISHEYE" 1 "FRONT_NARROW" 0 "FRONT_MAIN" ;
VAL_ 154 OBJ_Motion_Status_37 5 "MOVING_SLOWLY" 4 "STOPPED" 3 "STATIONARY" 2 "MOVING" 1 "UNKNOWN" 0 "INVALID" ;
VAL_ 154 OBJ_Motion_Orientation_37 13 "INVALID" 12 "NORTH" 11 "NORTH_WEST" 9 "WEST" 7 "SOUTH_WEST" 6 "SOUTH" 5 "SOUTH_EAST" 3 "EAST" 1 "NORTH_EAST" 0 "UNKNOWN" ;
VAL_ 154 OBJ_Has_Cut_Lane_37 1 "TRUE" 0 "FALSE" ;
VAL_ 154 OBJ_Has_Cut_Path_37 1 "TRUE" 0 "FALSE" ;
VAL_ 154 OBJ_Brake_Light_Validity_37 1 "TRUE" 0 "FALSE" ;
VAL_ 154 OBJ_Brake_Light_37 1 "TRUE" 0 "FALSE" ;
VAL_ 154 OBJ_Turn_Indicator_Right_37 1 "TRUE" 0 "FALSE" ;
VAL_ 154 OBJ_Turn_Indicator_Left_37 1 "TRUE" 0 "FALSE" ;
VAL_ 154 OBJ_Turn_Indicator_Validity_37 1 "TRUE" 0 "FALSE" ;
VAL_ 154 OBJ_Right_Out_Of_Image_37 1 "TRUE" 0 "FALSE" ;
VAL_ 154 OBJ_Left_Out_Of_Image_37 1 "TRUE" 0 "FALSE" ;
VAL_ 154 OBJ_Right_Out_Of_Image_V_37 1 "TRUE" 0 "FALSE" ;
VAL_ 154 OBJ_Left_Out_Of_Image_V_37 1 "TRUE" 0 "FALSE" ;
VAL_ 154 OBJ_Top_Out_Of_Image_37 1 "TRUE" 0 "FALSE" ;
VAL_ 154 OBJ_Bottom_Out_Of_Image_37 1 "TRUE" 0 "FALSE" ;
VAL_ 154 OBJ_Top_Out_Of_Image_V_37 1 "VALID" 0 "INVALID" ;
VAL_ 154 OBJ_Bottom_Out_Of_Image_V_37 1 "VALID" 0 "INVALID" ;
VAL_ 154 OBJ_Lane_Assignment_37 5 "RIGHT_RIGHT" 4 "RIGHT" 3 "HOST" 2 "LEFT" 1 "LEFT_LEFT" 0 "UNKNOWN" ;
VAL_ 154 OBJ_Lane_Assignment_V_37 1 "VALID" 0 "INVALID" ;
VAL_ 154 OBJ_Age_Seconds_V_37 1 "VALID" 0 "INVALID" ;
VAL_ 154 OBJ_Width_V_37 1 "VALID" 0 "INVALID" ;
VAL_ 154 OBJ_Width_STD_V_37 1 "VALID" 0 "INVALID" ;
VAL_ 154 OBJ_Length_V_37 1 "VALID" 0 "INVALID" ;
VAL_ 154 OBJ_Length_STD_V_37 1 "VALID" 0 "INVALID" ;
VAL_ 154 OBJ_Height_V_37 1 "VALID" 0 "INVALID" ;
VAL_ 154 OBJ_Height_STD_V_37 1 "VALID" 0 "INVALID" ;
VAL_ 154 OBJ_Abs_Long_Velocity_V_37 1 "VALID" 0 "INVALID" ;
VAL_ 154 OBJ_Abs_Long_Vel_STD_V_37 1 "VALID" 0 "INVALID" ;
VAL_ 154 OBJ_Abs_Lat_Velocity_V_37 1 "VALID" 0 "INVALID" ;
VAL_ 154 OBJ_Abs_Lat_Vel_STD_V_37 1 "VALID" 0 "INVALID" ;
VAL_ 154 OBJ_Abs_Long_Acc_V_37 1 "VALID" 0 "INVALID" ;
VAL_ 154 OBJ_Abs_Long_Acc_STD_V_37 1 "VALID" 0 "INVALID" ;
VAL_ 154 OBJ_Abs_Lat_Acc_V_37 1 "VALID" 0 "INVALID" ;
VAL_ 154 OBJ_Abs_Lat_Acc_STD_V_37 1 "VALID" 0 "INVALID" ;
VAL_ 154 OBJ_Abs_Acceleration_V_37 1 "VALID" 0 "INVALID" ;
VAL_ 154 OBJ_Abs_Acc_STD_V_37 1 "VALID" 0 "INVALID" ;
VAL_ 154 OBJ_Inv_TTC_V_37 1 "VALID" 0 "INVALID" ;
VAL_ 154 OBJ_Inv_TTC_STD_V_37 1 "VALID" 0 "INVALID" ;
VAL_ 154 OBJ_Relative_Long_Acc_V_37 1 "VALID" 0 "INVALID" ;
VAL_ 154 OBJ_Rel_Long_Acc_STD_V_37 1 "VALID" 0 "INVALID" ;
VAL_ 154 OBJ_Relative_Long_Velocity_V_37 1 "VALID" 0 "INVALID" ;
VAL_ 154 OBJ_Rel_Long_Vel_STD_V_37 1 "VALID" 0 "INVALID" ;
VAL_ 154 OBJ_Relative_Lat_Velocity_V_37 1 "VALID" 0 "INVALID" ;
VAL_ 154 OBJ_Rel_Lat_Vel_STD_V_37 1 "VALID" 0 "INVALID" ;
VAL_ 154 OBJ_Long_Distance_V_37 1 "VALID" 0 "INVALID" ;
VAL_ 154 OBJ_Long_Distance_STD_V_37 1 "VALID" 0 "INVALID" ;
VAL_ 154 OBJ_Lat_Distance_V_37 1 "VALID" 0 "INVALID" ;
VAL_ 154 OBJ_Lat_Distance_STD_V_37 1 "VALID" 0 "INVALID" ;
VAL_ 154 OBJ_Absolute_Speed_V_37 1 "VALID" 0 "INVALID" ;
VAL_ 154 OBJ_Absolute_Speed_STD_V_37 1 "VALID" 0 "INVALID" ;
VAL_ 154 OBJ_Heading_V_37 1 "VALID" 0 "INVALID" ;
VAL_ 154 OBJ_Heading_STD_V_37 1 "VALID" 0 "INVALID" ;
VAL_ 154 OBJ_Angle_Rate_STD_V_37 1 "VALID" 0 "INVALID" ;
VAL_ 154 OBJ_Angle_Rate_V_37 1 "VALID" 0 "INVALID" ;
VAL_ 154 OBJ_Angle_Right_V_37 1 "VALID" 0 "INVALID" ;
VAL_ 154 OBJ_Angle_Right_STD_V_37 1 "VALID" 0 "INVALID" ;
VAL_ 154 OBJ_Angle_Left_V_37 1 "VALID" 0 "INVALID" ;
VAL_ 154 OBJ_Angle_Left_STD_V_37 1 "VALID" 0 "INVALID" ;
VAL_ 154 OBJ_Angle_Side_V_37 1 "VALID" 0 "INVALID" ;
VAL_ 154 OBJ_Angle_Side_STD_V_37 1 "VALID" 0 "INVALID" ;
VAL_ 154 OBJ_Angle_Mid_V_37 1 "VALID" 0 "INVALID" ;
VAL_ 154 OBJ_Angle_Mid_STD_V_37 1 "VALID" 0 "INVALID" ;
VAL_ 154 OBJ_Angle_Bottom_V_37 1 "VALID" 0 "INVALID" ;
VAL_ 154 OBJ_Angle_Bottom_STD_V_37 1 "VALID" 0 "INVALID" ;
VAL_ 154 OBJ_Visibility_Side_V_37 1 "VALID" 0 "INVALID" ;
VAL_ 154 OBJ_Visibility_Side_37 2 "REAR" 1 "FRONT" 0 "NOT_VISIBLE" ;
VAL_ 154 OBJ_Is_In_Drivable_Area_37 1 "TRUE" 0 "FALSE" ;
VAL_ 154 OBJ_Is_In_Drivable_Area_V_37 1 "VALID" 0 "INVALID" ;
VAL_ 154 OBJ_Is_VeryClose_V_37 1 "VALID" 0 "INVALID" ;
VAL_ 154 OBJ_Is_VeryClose_37 1 "TRUE" 0 "FALSE" ;
VAL_ 154 OBJ_OverlapAngleEgoLaneR_V_37 1 "VALID" 0 "INVALID" ;
VAL_ 154 OBJ_OverlapAngleEgoLaneL_V_37 1 "VALID" 0 "INVALID" ;
VAL_ 154 OBJ_Is_EMERGENCY_VCL_37 1 "TRUE" 0 "FALSE" ;
VAL_ 154 OBJ_EMERGENCY_LIGHT_COLOR_37 3 "(1000)ORANGE" 2 "(0100)BLUE" 1 "(0010)RED" 0 "(0001)OTHER" ;
VAL_ 154 OBJ_EMERGENCY_V_37 1 "TRUE" 0 "FALSE" ;
VAL_ 154 OBJ_Angle_Top_V_37 1 "VALID" 0 "INVALID" ;
VAL_ 154 OBJ_Angle_Top_STD_V_37 1 "VALID" 0 "INVALID" ;
VAL_ 154 OBJ_Open_Door_Left_37 1 "TRUE" 0 "FALSE" ;
VAL_ 154 OBJ_Open_Door_Right_37 1 "TRUE" 0 "FALSE" ;
VAL_ 154 OBJ_Visible_Left_or_Right_37 2 "RIGHT" 1 "LEFT" 0 "NOT_VISIBLE" ;
VAL_ 154 OBJ_Visible_Left_or_Right_V_37 1 "VALID" 0 "INVALID" ;
VAL_ 154 OBJ_Fusion_Source_38 2 "(BIT_2)RADAR2" 1 "(BIT_1)RADAR1" 0 "(BIT_0)CAMERA" ;
VAL_ 154 OBJ_Triggered_SDM_38 2 "NOT_TRIGGERED" 1 "TRIGGERED" 0 "NOT_AVAILABLE" ;
VAL_ 154 OBJ_Motion_Category_38 13 "ONCOMING" 12 "PRECEEDING" 11 "MOVING" 10 "RTAP" 9 "LTAP" 8 "CROSSING" 7 "MOVING_OUT" 6 "MOVING_IN" 5 "CLOSE_CUT_IN" 4 "PASSING_OUT" 3 "PASSING_IN" 2 "PASSING" 1 "UNDEFINED" 0 "UNFILLED" ;
VAL_ 154 OBJ_Measuring_Status_38 2 "(BIT_2)NOT_VALID_OR_VALID" 1 "(BIT_1)PREDICTED_OR_MEASURED" 0 "(BIT_0)OLD_OR_NEW" ;
VAL_ 154 OBJ_Object_Class_38 9 "TWO_WHEELER" 8 "UNCERTAIN_VCL" 7 "ANIMAL" 6 "GENERAL_OBJECT" 5 "PEDESTRIAN" 4 "BICYCLE" 3 "MOTORBIKE" 2 "TRUCK" 1 "CAR" 0 "UNFILLED" ;
VAL_ 154 OBJ_Camera_Source_38 11 "PARKING_RIGHT" 10 "PARKING_LEFT" 9 "PARKING_REAR" 8 "PARKING_FRONT" 7 "FRONT_CORNER_RIGHT" 6 "FRONT_CORNER_LEFT" 5 "REAR_CORNER_RIGHT" 4 "REAR_CORNER_LEFT" 3 "REAR" 2 "FRONT_FISHEYE" 1 "FRONT_NARROW" 0 "FRONT_MAIN" ;
VAL_ 154 OBJ_Motion_Status_38 5 "MOVING_SLOWLY" 4 "STOPPED" 3 "STATIONARY" 2 "MOVING" 1 "UNKNOWN" 0 "INVALID" ;
VAL_ 154 OBJ_Motion_Orientation_38 13 "INVALID" 12 "NORTH" 11 "NORTH_WEST" 9 "WEST" 7 "SOUTH_WEST" 6 "SOUTH" 5 "SOUTH_EAST" 3 "EAST" 1 "NORTH_EAST" 0 "UNKNOWN" ;
VAL_ 154 OBJ_Has_Cut_Lane_38 1 "TRUE" 0 "FALSE" ;
VAL_ 154 OBJ_Has_Cut_Path_38 1 "TRUE" 0 "FALSE" ;
VAL_ 154 OBJ_Brake_Light_Validity_38 1 "TRUE" 0 "FALSE" ;
VAL_ 154 OBJ_Brake_Light_38 1 "TRUE" 0 "FALSE" ;
VAL_ 154 OBJ_Turn_Indicator_Right_38 1 "TRUE" 0 "FALSE" ;
VAL_ 154 OBJ_Turn_Indicator_Left_38 1 "TRUE" 0 "FALSE" ;
VAL_ 154 OBJ_Turn_Indicator_Validity_38 1 "TRUE" 0 "FALSE" ;
VAL_ 154 OBJ_Right_Out_Of_Image_38 1 "TRUE" 0 "FALSE" ;
VAL_ 154 OBJ_Left_Out_Of_Image_38 1 "TRUE" 0 "FALSE" ;
VAL_ 154 OBJ_Right_Out_Of_Image_V_38 1 "TRUE" 0 "FALSE" ;
VAL_ 154 OBJ_Left_Out_Of_Image_V_38 1 "TRUE" 0 "FALSE" ;
VAL_ 154 OBJ_Top_Out_Of_Image_38 1 "TRUE" 0 "FALSE" ;
VAL_ 154 OBJ_Bottom_Out_Of_Image_38 1 "TRUE" 0 "FALSE" ;
VAL_ 154 OBJ_Top_Out_Of_Image_V_38 1 "VALID" 0 "INVALID" ;
VAL_ 154 OBJ_Bottom_Out_Of_Image_V_38 1 "VALID" 0 "INVALID" ;
VAL_ 154 OBJ_Lane_Assignment_38 5 "RIGHT_RIGHT" 4 "RIGHT" 3 "HOST" 2 "LEFT" 1 "LEFT_LEFT" 0 "UNKNOWN" ;
VAL_ 154 OBJ_Lane_Assignment_V_38 1 "VALID" 0 "INVALID" ;
VAL_ 154 OBJ_Age_Seconds_V_38 1 "VALID" 0 "INVALID" ;
VAL_ 154 OBJ_Width_V_38 1 "VALID" 0 "INVALID" ;
VAL_ 154 OBJ_Width_STD_V_38 1 "VALID" 0 "INVALID" ;
VAL_ 154 OBJ_Length_V_38 1 "VALID" 0 "INVALID" ;
VAL_ 154 OBJ_Length_STD_V_38 1 "VALID" 0 "INVALID" ;
VAL_ 154 OBJ_Height_V_38 1 "VALID" 0 "INVALID" ;
VAL_ 154 OBJ_Height_STD_V_38 1 "VALID" 0 "INVALID" ;
VAL_ 154 OBJ_Abs_Long_Velocity_V_38 1 "VALID" 0 "INVALID" ;
VAL_ 154 OBJ_Abs_Long_Vel_STD_V_38 1 "VALID" 0 "INVALID" ;
VAL_ 154 OBJ_Abs_Lat_Velocity_V_38 1 "VALID" 0 "INVALID" ;
VAL_ 154 OBJ_Abs_Lat_Vel_STD_V_38 1 "VALID" 0 "INVALID" ;
VAL_ 154 OBJ_Abs_Long_Acc_V_38 1 "VALID" 0 "INVALID" ;
VAL_ 154 OBJ_Abs_Long_Acc_STD_V_38 1 "VALID" 0 "INVALID" ;
VAL_ 154 OBJ_Abs_Lat_Acc_V_38 1 "VALID" 0 "INVALID" ;
VAL_ 154 OBJ_Abs_Lat_Acc_STD_V_38 1 "VALID" 0 "INVALID" ;
VAL_ 154 OBJ_Abs_Acceleration_V_38 1 "VALID" 0 "INVALID" ;
VAL_ 154 OBJ_Abs_Acc_STD_V_38 1 "VALID" 0 "INVALID" ;
VAL_ 154 OBJ_Inv_TTC_V_38 1 "VALID" 0 "INVALID" ;
VAL_ 154 OBJ_Inv_TTC_STD_V_38 1 "VALID" 0 "INVALID" ;
VAL_ 154 OBJ_Relative_Long_Acc_V_38 1 "VALID" 0 "INVALID" ;
VAL_ 154 OBJ_Rel_Long_Acc_STD_V_38 1 "VALID" 0 "INVALID" ;
VAL_ 154 OBJ_Relative_Long_Velocity_V_38 1 "VALID" 0 "INVALID" ;
VAL_ 154 OBJ_Rel_Long_Vel_STD_V_38 1 "VALID" 0 "INVALID" ;
VAL_ 154 OBJ_Relative_Lat_Velocity_V_38 1 "VALID" 0 "INVALID" ;
VAL_ 154 OBJ_Rel_Lat_Vel_STD_V_38 1 "VALID" 0 "INVALID" ;
VAL_ 154 OBJ_Long_Distance_V_38 1 "VALID" 0 "INVALID" ;
VAL_ 154 OBJ_Long_Distance_STD_V_38 1 "VALID" 0 "INVALID" ;
VAL_ 154 OBJ_Lat_Distance_V_38 1 "VALID" 0 "INVALID" ;
VAL_ 154 OBJ_Lat_Distance_STD_V_38 1 "VALID" 0 "INVALID" ;
VAL_ 154 OBJ_Absolute_Speed_V_38 1 "VALID" 0 "INVALID" ;
VAL_ 154 OBJ_Absolute_Speed_STD_V_38 1 "VALID" 0 "INVALID" ;
VAL_ 154 OBJ_Heading_V_38 1 "VALID" 0 "INVALID" ;
VAL_ 154 OBJ_Heading_STD_V_38 1 "VALID" 0 "INVALID" ;
VAL_ 154 OBJ_Angle_Rate_STD_V_38 1 "VALID" 0 "INVALID" ;
VAL_ 154 OBJ_Angle_Rate_V_38 1 "VALID" 0 "INVALID" ;
VAL_ 154 OBJ_Angle_Right_V_38 1 "VALID" 0 "INVALID" ;
VAL_ 154 OBJ_Angle_Right_STD_V_38 1 "VALID" 0 "INVALID" ;
VAL_ 154 OBJ_Angle_Left_V_38 1 "VALID" 0 "INVALID" ;
VAL_ 154 OBJ_Angle_Left_STD_V_38 1 "VALID" 0 "INVALID" ;
VAL_ 154 OBJ_Angle_Side_V_38 1 "VALID" 0 "INVALID" ;
VAL_ 154 OBJ_Angle_Side_STD_V_38 1 "VALID" 0 "INVALID" ;
VAL_ 154 OBJ_Angle_Mid_V_38 1 "VALID" 0 "INVALID" ;
VAL_ 154 OBJ_Angle_Mid_STD_V_38 1 "VALID" 0 "INVALID" ;
VAL_ 154 OBJ_Angle_Bottom_V_38 1 "VALID" 0 "INVALID" ;
VAL_ 154 OBJ_Angle_Bottom_STD_V_38 1 "VALID" 0 "INVALID" ;
VAL_ 154 OBJ_Visibility_Side_V_38 1 "VALID" 0 "INVALID" ;
VAL_ 154 OBJ_Visibility_Side_38 2 "REAR" 1 "FRONT" 0 "NOT_VISIBLE" ;
VAL_ 154 OBJ_Is_In_Drivable_Area_38 1 "TRUE" 0 "FALSE" ;
VAL_ 154 OBJ_Is_In_Drivable_Area_V_38 1 "VALID" 0 "INVALID" ;
VAL_ 154 OBJ_Is_VeryClose_V_38 1 "VALID" 0 "INVALID" ;
VAL_ 154 OBJ_Is_VeryClose_38 1 "TRUE" 0 "FALSE" ;
VAL_ 154 OBJ_OverlapAngleEgoLaneR_V_38 1 "VALID" 0 "INVALID" ;
VAL_ 154 OBJ_OverlapAngleEgoLaneL_V_38 1 "VALID" 0 "INVALID" ;
VAL_ 154 OBJ_Is_EMERGENCY_VCL_38 1 "TRUE" 0 "FALSE" ;
VAL_ 154 OBJ_EMERGENCY_LIGHT_COLOR_38 3 "(1000)ORANGE" 2 "(0100)BLUE" 1 "(0010)RED" 0 "(0001)OTHER" ;
VAL_ 154 OBJ_EMERGENCY_V_38 1 "TRUE" 0 "FALSE" ;
VAL_ 154 OBJ_Angle_Top_V_38 1 "VALID" 0 "INVALID" ;
VAL_ 154 OBJ_Angle_Top_STD_V_38 1 "VALID" 0 "INVALID" ;
VAL_ 154 OBJ_Open_Door_Left_38 1 "TRUE" 0 "FALSE" ;
VAL_ 154 OBJ_Open_Door_Right_38 1 "TRUE" 0 "FALSE" ;
VAL_ 154 OBJ_Visible_Left_or_Right_38 2 "RIGHT" 1 "LEFT" 0 "NOT_VISIBLE" ;
VAL_ 154 OBJ_Visible_Left_or_Right_V_38 1 "VALID" 0 "INVALID" ;
VAL_ 154 OBJ_Fusion_Source_39 2 "(BIT_2)RADAR2" 1 "(BIT_1)RADAR1" 0 "(BIT_0)CAMERA" ;
VAL_ 154 OBJ_Triggered_SDM_39 2 "NOT_TRIGGERED" 1 "TRIGGERED" 0 "NOT_AVAILABLE" ;
VAL_ 154 OBJ_Motion_Category_39 13 "ONCOMING" 12 "PRECEEDING" 11 "MOVING" 10 "RTAP" 9 "LTAP" 8 "CROSSING" 7 "MOVING_OUT" 6 "MOVING_IN" 5 "CLOSE_CUT_IN" 4 "PASSING_OUT" 3 "PASSING_IN" 2 "PASSING" 1 "UNDEFINED" 0 "UNFILLED" ;
VAL_ 154 OBJ_Measuring_Status_39 2 "(BIT_2)NOT_VALID_OR_VALID" 1 "(BIT_1)PREDICTED_OR_MEASURED" 0 "(BIT_0)OLD_OR_NEW" ;
VAL_ 154 OBJ_Object_Class_39 9 "TWO_WHEELER" 8 "UNCERTAIN_VCL" 7 "ANIMAL" 6 "GENERAL_OBJECT" 5 "PEDESTRIAN" 4 "BICYCLE" 3 "MOTORBIKE" 2 "TRUCK" 1 "CAR" 0 "UNFILLED" ;
VAL_ 154 OBJ_Camera_Source_39 11 "PARKING_RIGHT" 10 "PARKING_LEFT" 9 "PARKING_REAR" 8 "PARKING_FRONT" 7 "FRONT_CORNER_RIGHT" 6 "FRONT_CORNER_LEFT" 5 "REAR_CORNER_RIGHT" 4 "REAR_CORNER_LEFT" 3 "REAR" 2 "FRONT_FISHEYE" 1 "FRONT_NARROW" 0 "FRONT_MAIN" ;
VAL_ 154 OBJ_Motion_Status_39 5 "MOVING_SLOWLY" 4 "STOPPED" 3 "STATIONARY" 2 "MOVING" 1 "UNKNOWN" 0 "INVALID" ;
VAL_ 154 OBJ_Motion_Orientation_39 13 "INVALID" 12 "NORTH" 11 "NORTH_WEST" 9 "WEST" 7 "SOUTH_WEST" 6 "SOUTH" 5 "SOUTH_EAST" 3 "EAST" 1 "NORTH_EAST" 0 "UNKNOWN" ;
VAL_ 154 OBJ_Has_Cut_Lane_39 1 "TRUE" 0 "FALSE" ;
VAL_ 154 OBJ_Has_Cut_Path_39 1 "TRUE" 0 "FALSE" ;
VAL_ 154 OBJ_Brake_Light_Validity_39 1 "TRUE" 0 "FALSE" ;
VAL_ 154 OBJ_Brake_Light_39 1 "TRUE" 0 "FALSE" ;
VAL_ 154 OBJ_Turn_Indicator_Right_39 1 "TRUE" 0 "FALSE" ;
VAL_ 154 OBJ_Turn_Indicator_Left_39 1 "TRUE" 0 "FALSE" ;
VAL_ 154 OBJ_Turn_Indicator_Validity_39 1 "TRUE" 0 "FALSE" ;
VAL_ 154 OBJ_Right_Out_Of_Image_39 1 "TRUE" 0 "FALSE" ;
VAL_ 154 OBJ_Left_Out_Of_Image_39 1 "TRUE" 0 "FALSE" ;
VAL_ 154 OBJ_Right_Out_Of_Image_V_39 1 "TRUE" 0 "FALSE" ;
VAL_ 154 OBJ_Left_Out_Of_Image_V_39 1 "TRUE" 0 "FALSE" ;
VAL_ 154 OBJ_Top_Out_Of_Image_39 1 "TRUE" 0 "FALSE" ;
VAL_ 154 OBJ_Bottom_Out_Of_Image_39 1 "TRUE" 0 "FALSE" ;
VAL_ 154 OBJ_Top_Out_Of_Image_V_39 1 "VALID" 0 "INVALID" ;
VAL_ 154 OBJ_Bottom_Out_Of_Image_V_39 1 "VALID" 0 "INVALID" ;
VAL_ 154 OBJ_Lane_Assignment_39 5 "RIGHT_RIGHT" 4 "RIGHT" 3 "HOST" 2 "LEFT" 1 "LEFT_LEFT" 0 "UNKNOWN" ;
VAL_ 154 OBJ_Lane_Assignment_V_39 1 "VALID" 0 "INVALID" ;
VAL_ 154 OBJ_Age_Seconds_V_39 1 "VALID" 0 "INVALID" ;
VAL_ 154 OBJ_Width_V_39 1 "VALID" 0 "INVALID" ;
VAL_ 154 OBJ_Width_STD_V_39 1 "VALID" 0 "INVALID" ;
VAL_ 154 OBJ_Length_V_39 1 "VALID" 0 "INVALID" ;
VAL_ 154 OBJ_Length_STD_V_39 1 "VALID" 0 "INVALID" ;
VAL_ 154 OBJ_Height_V_39 1 "VALID" 0 "INVALID" ;
VAL_ 154 OBJ_Height_STD_V_39 1 "VALID" 0 "INVALID" ;
VAL_ 154 OBJ_Abs_Long_Velocity_V_39 1 "VALID" 0 "INVALID" ;
VAL_ 154 OBJ_Abs_Long_Vel_STD_V_39 1 "VALID" 0 "INVALID" ;
VAL_ 154 OBJ_Abs_Lat_Velocity_V_39 1 "VALID" 0 "INVALID" ;
VAL_ 154 OBJ_Abs_Lat_Vel_STD_V_39 1 "VALID" 0 "INVALID" ;
VAL_ 154 OBJ_Abs_Long_Acc_V_39 1 "VALID" 0 "INVALID" ;
VAL_ 154 OBJ_Abs_Long_Acc_STD_V_39 1 "VALID" 0 "INVALID" ;
VAL_ 154 OBJ_Abs_Lat_Acc_V_39 1 "VALID" 0 "INVALID" ;
VAL_ 154 OBJ_Abs_Lat_Acc_STD_V_39 1 "VALID" 0 "INVALID" ;
VAL_ 154 OBJ_Abs_Acceleration_V_39 1 "VALID" 0 "INVALID" ;
VAL_ 154 OBJ_Abs_Acc_STD_V_39 1 "VALID" 0 "INVALID" ;
VAL_ 154 OBJ_Inv_TTC_V_39 1 "VALID" 0 "INVALID" ;
VAL_ 154 OBJ_Inv_TTC_STD_V_39 1 "VALID" 0 "INVALID" ;
VAL_ 154 OBJ_Relative_Long_Acc_V_39 1 "VALID" 0 "INVALID" ;
VAL_ 154 OBJ_Rel_Long_Acc_STD_V_39 1 "VALID" 0 "INVALID" ;
VAL_ 154 OBJ_Relative_Long_Velocity_V_39 1 "VALID" 0 "INVALID" ;
VAL_ 154 OBJ_Rel_Long_Vel_STD_V_39 1 "VALID" 0 "INVALID" ;
VAL_ 154 OBJ_Relative_Lat_Velocity_V_39 1 "VALID" 0 "INVALID" ;
VAL_ 154 OBJ_Rel_Lat_Vel_STD_V_39 1 "VALID" 0 "INVALID" ;
VAL_ 154 OBJ_Long_Distance_V_39 1 "VALID" 0 "INVALID" ;
VAL_ 154 OBJ_Long_Distance_STD_V_39 1 "VALID" 0 "INVALID" ;
VAL_ 154 OBJ_Lat_Distance_V_39 1 "VALID" 0 "INVALID" ;
VAL_ 154 OBJ_Lat_Distance_STD_V_39 1 "VALID" 0 "INVALID" ;
VAL_ 154 OBJ_Absolute_Speed_V_39 1 "VALID" 0 "INVALID" ;
VAL_ 154 OBJ_Absolute_Speed_STD_V_39 1 "VALID" 0 "INVALID" ;
VAL_ 154 OBJ_Heading_V_39 1 "VALID" 0 "INVALID" ;
VAL_ 154 OBJ_Heading_STD_V_39 1 "VALID" 0 "INVALID" ;
VAL_ 154 OBJ_Angle_Rate_STD_V_39 1 "VALID" 0 "INVALID" ;
VAL_ 154 OBJ_Angle_Rate_V_39 1 "VALID" 0 "INVALID" ;
VAL_ 154 OBJ_Angle_Right_V_39 1 "VALID" 0 "INVALID" ;
VAL_ 154 OBJ_Angle_Right_STD_V_39 1 "VALID" 0 "INVALID" ;
VAL_ 154 OBJ_Angle_Left_V_39 1 "VALID" 0 "INVALID" ;
VAL_ 154 OBJ_Angle_Left_STD_V_39 1 "VALID" 0 "INVALID" ;
VAL_ 154 OBJ_Angle_Side_V_39 1 "VALID" 0 "INVALID" ;
VAL_ 154 OBJ_Angle_Side_STD_V_39 1 "VALID" 0 "INVALID" ;
VAL_ 154 OBJ_Angle_Mid_V_39 1 "VALID" 0 "INVALID" ;
VAL_ 154 OBJ_Angle_Mid_STD_V_39 1 "VALID" 0 "INVALID" ;
VAL_ 154 OBJ_Angle_Bottom_V_39 1 "VALID" 0 "INVALID" ;
VAL_ 154 OBJ_Angle_Bottom_STD_V_39 1 "VALID" 0 "INVALID" ;
VAL_ 154 OBJ_Visibility_Side_V_39 1 "VALID" 0 "INVALID" ;
VAL_ 154 OBJ_Visibility_Side_39 2 "REAR" 1 "FRONT" 0 "NOT_VISIBLE" ;
VAL_ 154 OBJ_Is_In_Drivable_Area_39 1 "TRUE" 0 "FALSE" ;
VAL_ 154 OBJ_Is_In_Drivable_Area_V_39 1 "VALID" 0 "INVALID" ;
VAL_ 154 OBJ_Is_VeryClose_V_39 1 "VALID" 0 "INVALID" ;
VAL_ 154 OBJ_Is_VeryClose_39 1 "TRUE" 0 "FALSE" ;
VAL_ 154 OBJ_OverlapAngleEgoLaneR_V_39 1 "VALID" 0 "INVALID" ;
VAL_ 154 OBJ_OverlapAngleEgoLaneL_V_39 1 "VALID" 0 "INVALID" ;
VAL_ 154 OBJ_Is_EMERGENCY_VCL_39 1 "TRUE" 0 "FALSE" ;
VAL_ 154 OBJ_EMERGENCY_LIGHT_COLOR_39 3 "(1000)ORANGE" 2 "(0100)BLUE" 1 "(0010)RED" 0 "(0001)OTHER" ;
VAL_ 154 OBJ_EMERGENCY_V_39 1 "TRUE" 0 "FALSE" ;
VAL_ 154 OBJ_Angle_Top_V_39 1 "VALID" 0 "INVALID" ;
VAL_ 154 OBJ_Angle_Top_STD_V_39 1 "VALID" 0 "INVALID" ;
VAL_ 154 OBJ_Open_Door_Left_39 1 "TRUE" 0 "FALSE" ;
VAL_ 154 OBJ_Open_Door_Right_39 1 "TRUE" 0 "FALSE" ;
VAL_ 154 OBJ_Visible_Left_or_Right_39 2 "RIGHT" 1 "LEFT" 0 "NOT_VISIBLE" ;
VAL_ 154 OBJ_Visible_Left_or_Right_V_39 1 "VALID" 0 "INVALID" ;
