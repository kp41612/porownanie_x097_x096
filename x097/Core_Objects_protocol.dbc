VERSION "15"
// BundelVersion=v4.21.5_CF1
NS_ :

BS_:

BU_: EyeQ4 MCU

BO_ 154 Core_Objects_protocol: 4820 EyeQ4
 SG_ OBJ_Bottom_Out_Of_Image_17 : 16627|1@1+ (1,0) [0|1] "bool" MCU
 SG_ OBJ_Top_Out_Of_Image_V_17 : 16628|1@1+ (1,0) [0|1] "bool" MCU
 SG_ OBJ_Bottom_Out_Of_Image_V_17 : 16629|1@1+ (1,0) [0|1] "bool" MCU
 SG_ OBJ_Lane_Assignment_17 : 16630|3@1+ (1,0) [0|5] "ENUM" MCU
 SG_ OBJ_Lane_Assignment_V_17 : 16633|1@1+ (1,0) [0|1] "bool" MCU
 SG_ Reserved_5_17 : 16634|6@1+ (1,0) [0|0] "NA" MCU
 SG_ OBJ_Age_Seconds_17 : 16640|7@1+ (1,0) [0|100] "s" MCU
 SG_ OBJ_Age_Seconds_V_17 : 16647|1@1+ (1,0) [0|1] "bool" MCU
 SG_ OBJ_Width_17 : 16648|9@1+ (0.01,0) [0.4|2.95] "m" MCU
 SG_ OBJ_Width_V_17 : 16657|1@1+ (1,0) [0|1] "bool" MCU
 SG_ OBJ_Width_STD_17 : 16658|11@1+ (0.001,0) [0|2] "m" MCU
 SG_ OBJ_Width_STD_V_17 : 16669|1@1+ (1,0) [0|1] "bool" MCU
 SG_ Reserved_6_17 : 16670|2@1+ (1,0) [0|0] "NA" MCU
 SG_ OBJ_Length_17 : 16672|9@1+ (0.05,0) [0.6|21] "m" MCU
 SG_ OBJ_Length_V_17 : 16681|1@1+ (1,0) [0|1] "bool" MCU
 SG_ OBJ_Length_STD_17 : 16682|10@1+ (0.01,0) [0|10] "m" MCU
 SG_ OBJ_Length_STD_V_17 : 16692|1@1+ (1,0) [0|1] "bool" MCU
 SG_ OBJ_Radar_ID_17 : 16693|8@1+ (1,0) [0|255] "counter" MCU
 SG_ Reserved_7_17 : 16701|3@1+ (1,0) [0|0] "NA" MCU
 SG_ OBJ_Height_17 : 16704|9@1+ (0.01,0) [0|2.95] "m" MCU
 SG_ OBJ_Height_V_17 : 16713|1@1+ (1,0) [0|1] "bool" MCU
 SG_ OBJ_Height_STD_17 : 16714|11@1+ (0.001,0) [0|2] "m" MCU
 SG_ OBJ_Height_STD_V_17 : 16725|1@1+ (1,0) [0|1] "bool" MCU
 SG_ Reserved_8_17 : 16726|10@1+ (1,0) [0|0] "NA" MCU
 SG_ OBJ_Abs_Long_Velocity_17 : 16736|12@1+ (0.05,-100) [-100|100] "m_per_s" MCU
 SG_ OBJ_Abs_Long_Velocity_V_17 : 16748|1@1+ (1,0) [0|1] "bool" MCU
 SG_ OBJ_Abs_Long_Velocity_STD_17 : 16749|13@1+ (0.01,0) [0|65] "m_per_s" MCU
 SG_ OBJ_Abs_Long_Vel_STD_V_17 : 16762|1@1+ (1,0) [0|1] "bool" MCU
 SG_ Reserved_9_17 : 16763|5@1+ (1,0) [0|0] "NA" MCU
 SG_ OBJ_Abs_Lat_Velocity_17 : 16768|11@1+ (0.05,-50) [-50|50] "m_per_s" MCU
 SG_ OBJ_Abs_Lat_Velocity_V_17 : 16779|1@1+ (1,0) [0|1] "bool" MCU
 SG_ OBJ_Abs_Lat_Velocity_STD_17 : 16780|13@1+ (0.01,0) [0|50] "m_per_s" MCU
 SG_ OBJ_Abs_Lat_Vel_STD_V_17 : 16793|1@1+ (1,0) [0|1] "bool" MCU
 SG_ Reserved_10_17 : 16794|6@1+ (1,0) [0|0] "NA" MCU
 SG_ OBJ_Abs_Long_Acc_17 : 16800|9@1+ (0.05,-10) [-10|10] "m_per_s2" MCU
 SG_ OBJ_Abs_Long_Acc_V_17 : 16809|1@1+ (1,0) [0|1] "bool" MCU
 SG_ OBJ_Abs_Long_Acc_STD_17 : 16810|10@1+ (0.01,0) [0|7.3] "m_per_s2" MCU
 SG_ OBJ_Abs_Long_Acc_STD_V_17 : 16820|1@1+ (1,0) [0|1] "bool" MCU
 SG_ OBJ_Abs_Lat_Acc_17 : 16821|9@1+ (0.05,-10) [-10|10] "m_per_s2" MCU
 SG_ OBJ_Abs_Lat_Acc_V_17 : 16830|1@1+ (1,0) [0|1] "bool" MCU
 SG_ Reserved_11_17 : 16831|1@1+ (1,0) [0|0] "NA" MCU
 SG_ OBJ_Abs_Lat_Acc_STD_17 : 16832|10@1+ (0.01,0) [0|7.3] "m_per_s2" MCU
 SG_ OBJ_Abs_Lat_Acc_STD_V_17 : 16842|1@1+ (1,0) [0|1] "bool" MCU
 SG_ OBJ_Abs_Acceleration_17 : 16843|9@1+ (0.05,-12.7) [-12.7|12.7] "m_per_s2" MCU
 SG_ OBJ_Abs_Acceleration_V_17 : 16852|1@1+ (1,0) [0|1] "bool" MCU
 SG_ OBJ_Abs_Acc_STD_17 : 16853|10@1+ (0.01,0) [0|7.3] "m_per_s2" MCU
 SG_ OBJ_Abs_Acc_STD_V_17 : 16863|1@1+ (1,0) [0|1] "bool" MCU
 SG_ OBJ_Inv_TTC_17 : 16864|11@1+ (0.01,-8) [-8|8] "INV(s)" MCU
 SG_ OBJ_Inv_TTC_V_17 : 16875|1@1+ (1,0) [0|1] "bool" MCU
 SG_ OBJ_Inv_TTC_STD_17 : 16876|12@1+ (0.001,0) [0|4] "INV(s)" MCU
 SG_ OBJ_Inv_TTC_STD_V_17 : 16888|1@1+ (1,0) [0|1] "bool" MCU
 SG_ Reserved_12_17 : 16889|7@1+ (1,0) [0|0] "NA" MCU
 SG_ OBJ_Relative_Long_Acc_17 : 16896|10@1+ (0.05,-20) [-20|20] "m_per_s2" MCU
 SG_ OBJ_Relative_Long_Acc_V_17 : 16906|1@1+ (1,0) [0|1] "bool" MCU
 SG_ OBJ_Relative_Long_Acc_STD_17 : 16907|10@1+ (0.01,0) [0|7.3] "m_per_s2" MCU
 SG_ OBJ_Rel_Long_Acc_STD_V_17 : 16917|1@1+ (1,0) [0|1] "bool" MCU
 SG_ Reserved_13_17 : 16918|10@1+ (1,0) [0|0] "NA" MCU
 SG_ OBJ_Relative_Long_Velocity_17 : 16928|13@1+ (0.05,-120) [-120|130] "m_per_s" MCU
 SG_ OBJ_Relative_Long_Velocity_V_17 : 16941|1@1+ (1,0) [0|1] "bool" MCU
 SG_ OBJ_Relative_Long_Vel_STD_17 : 16942|14@1+ (0.01,0) [0|130] "m_per_s" MCU
 SG_ OBJ_Rel_Long_Vel_STD_V_17 : 16956|1@1+ (1,0) [0|1] "bool" MCU
 SG_ Reserved_14_17 : 16957|3@1+ (1,0) [0|0] "NA" MCU
 SG_ OBJ_Relative_Lat_Velocity_17 : 16960|11@1+ (0.05,-50) [-50|50] "m_per_s" MCU
 SG_ OBJ_Relative_Lat_Velocity_V_17 : 16971|1@1+ (1,0) [0|1] "bool" MCU
 SG_ OBJ_Relative_Lat_Velocity_STD_17 : 16972|13@1+ (0.01,0) [0|50] "m_per_s" MCU
 SG_ OBJ_Rel_Lat_Vel_STD_V_17 : 16985|1@1+ (1,0) [0|1] "bool" MCU
 SG_ Reserved_15_17 : 16986|6@1+ (1,0) [0|0] "NA" MCU
 SG_ OBJ_Long_Distance_17 : 16992|14@1+ (0.05,-200) [-200|500] "m" MCU
 SG_ OBJ_Long_Distance_V_17 : 17006|1@1+ (1,0) [0|1] "bool" MCU
 SG_ OBJ_Long_Distance_STD_17 : 17007|15@1+ (0.01,0) [0|250] "m" MCU
 SG_ OBJ_Long_Distance_STD_V_17 : 17022|1@1+ (1,0) [0|1] "bool" MCU
 SG_ Reserved_16_17 : 17023|1@1+ (1,0) [0|0] "NA" MCU
 SG_ OBJ_Lat_Distance_17 : 17024|12@1+ (0.05,-100) [-100|100] "m" MCU
 SG_ OBJ_Lat_Distance_V_17 : 17036|1@1+ (1,0) [0|1] "bool" MCU
 SG_ OBJ_Lat_Distance_STD_17 : 17037|14@1+ (0.01,0) [0|100] "m" MCU
 SG_ OBJ_Lat_Distance_STD_V_17 : 17051|1@1+ (1,0) [0|1] "bool" MCU
 SG_ Reserved_17_17 : 17052|4@1+ (1,0) [0|0] "NA" MCU
 SG_ OBJ_Absolute_Speed_17 : 17056|12@1+ (0.05,-65) [-65|65] "m_per_s" MCU
 SG_ OBJ_Absolute_Speed_V_17 : 17068|1@1+ (1,0) [0|1] "bool" MCU
 SG_ OBJ_Absolute_Speed_STD_17 : 17069|13@1+ (0.01,0) [0|65] "m_per_s" MCU
 SG_ OBJ_Absolute_Speed_STD_V_17 : 17082|1@1+ (1,0) [0|1] "bool" MCU
 SG_ Reserved_18_17 : 17083|5@1+ (1,0) [0|0] "NA" MCU
 SG_ OBJ_Heading_17 : 17088|10@1+ (0.01,-3.14) [-3.14|3.14] "rad" MCU
 SG_ OBJ_Heading_V_17 : 17098|1@1+ (1,0) [0|1] "bool" MCU
 SG_ OBJ_Heading_STD_17 : 17099|15@1+ (0.0001,0) [0|3.14] "rad" MCU
 SG_ OBJ_Heading_STD_V_17 : 17114|1@1+ (1,0) [0|1] "bool" MCU
 SG_ Reserved_19_17 : 17115|5@1+ (1,0) [0|0] "NA" MCU
 SG_ OBJ_Angle_Rate_STD_17 : 17120|15@1+ (0.0001,0) [0|2.2318] "RPS" MCU
 SG_ OBJ_Angle_Rate_STD_V_17 : 17135|1@1+ (1,0) [0|1] "bool" MCU
 SG_ OBJ_Angle_Rate_17 : 17136|12@1+ (0.002,-2.234) [-2.234|2.2318] "RPS" MCU
 SG_ OBJ_Angle_Rate_V_17 : 17148|1@1+ (1,0) [0|1] "bool" MCU
 SG_ Reserved_20_17 : 17149|3@1+ (1,0) [0|0] "NA" MCU
 SG_ OBJ_Angle_Right_17 : 17152|14@1+ (0.0002,-1.571) [-1.571|1.571] "rad" MCU
 SG_ OBJ_Angle_Right_V_17 : 17166|1@1+ (1,0) [0|1] "bool" MCU
 SG_ OBJ_Angle_Right_STD_17 : 17167|14@1+ (0.0001,0) [0|1.571] "rad" MCU
 SG_ OBJ_Angle_Right_STD_V_17 : 17181|1@1+ (1,0) [0|1] "bool" MCU
 SG_ Reserved_21_17 : 17182|2@1+ (1,0) [0|0] "NA" MCU
 SG_ OBJ_Angle_Left_17 : 17184|14@1+ (0.0002,-1.571) [-1.571|1.571] "rad" MCU
 SG_ OBJ_Angle_Left_V_17 : 17198|1@1+ (1,0) [0|1] "bool" MCU
 SG_ OBJ_Angle_Left_STD_17 : 17199|14@1+ (0.0001,0) [0|1.571] "rad" MCU
 SG_ OBJ_Angle_Left_STD_V_17 : 17213|1@1+ (1,0) [0|1] "bool" MCU
 SG_ Reserved_22_17 : 17214|2@1+ (1,0) [0|0] "NA" MCU
 SG_ OBJ_Angle_Side_17 : 17216|14@1+ (0.0002,-1.571) [-1.571|1.571] "rad" MCU
 SG_ OBJ_Angle_Side_V_17 : 17230|1@1+ (1,0) [0|1] "bool" MCU
 SG_ OBJ_Angle_Side_STD_17 : 17231|14@1+ (0.0001,0) [0|1.571] "rad" MCU
 SG_ OBJ_Angle_Side_STD_V_17 : 17245|1@1+ (1,0) [0|1] "bool" MCU
 SG_ OBJ_Angle_Mid_V_17 : 17246|1@1+ (1,0) [0|1] "bool" MCU
 SG_ Reserved_23_17 : 17247|1@1+ (1,0) [0|0] "NA" MCU
 SG_ OBJ_Angle_Mid_17 : 17248|14@1+ (0.0002,-1.571) [-1.571|1.571] "rad" MCU
 SG_ OBJ_Angle_Mid_STD_17 : 17262|14@1+ (0.0001,0) [0|1.571] "rad" MCU
 SG_ OBJ_Angle_Mid_STD_V_17 : 17276|1@1+ (1,0) [0|1] "bool" MCU
 SG_ OBJ_Angle_Bottom_V_17 : 17277|1@1+ (1,0) [0|1] "bool" MCU
 SG_ Reserved_24_17 : 17278|2@1+ (1,0) [0|0] "NA" MCU
 SG_ OBJ_Angle_Bottom_17 : 17280|14@1+ (0.0002,-1.571) [-1.571|1.571] "rad" MCU
 SG_ OBJ_Angle_Bottom_STD_17 : 17294|14@1+ (0.0001,0) [0|1.571] "rad" MCU
 SG_ OBJ_Angle_Bottom_STD_V_17 : 17308|1@1+ (1,0) [0|1] "bool" MCU
 SG_ OBJ_Visibility_Side_V_17 : 17309|1@1+ (1,0) [0|1] "bool" MCU
 SG_ OBJ_Visibility_Side_17 : 17310|2@1+ (1,0) [0|2] "ENUM" MCU
 SG_ OBJ_Is_In_Drivable_Area_17 : 17312|1@1+ (1,0) [0|1] "bool" MCU
 SG_ OBJ_Is_In_Drivable_Area_V_17 : 17313|1@1+ (1,0) [0|1] "bool" MCU
 SG_ OBJ_Is_VeryClose_V_17 : 17314|1@1+ (1,0) [0|1] "bool" MCU
 SG_ OBJ_Is_VeryClose_17 : 17315|1@1+ (1,0) [0|1] "bool" MCU
 SG_ OBJ_Buffer_C4_17 : 17316|2@1+ (1,0) [0|2] "NA" MCU
 SG_ OBJ_Buffer_C5_17 : 17318|2@1+ (1,0) [0|2] "NA" MCU
 SG_ OBJ_Buffer_C6_17 : 17320|2@1+ (1,0) [0|2] "NA" MCU
 SG_ OBJ_Buffer_C7_17 : 17322|2@1+ (1,0) [0|2] "NA" MCU
 SG_ OBJ_OverlapAngleEgoLaneR_17 : 17324|10@1+ (0.01,-3.14) [-3.14|3.14] "rad" MCU
 SG_ OBJ_OverlapAngleEgoLaneR_V_17 : 17334|1@1+ (1,0) [0|1] "bool" MCU
 SG_ Reserved_25_17 : 17335|9@1+ (1,0) [0|0] "NA" MCU
 SG_ OBJ_OverlapAngleEgoLaneL_17 : 17344|10@1+ (0.01,-3.14) [-3.14|3.14] "rad" MCU
 SG_ OBJ_OverlapAngleEgoLaneL_V_17 : 17354|1@1+ (1,0) [0|1] "bool" MCU
 SG_ OBJ_Is_EMERGENCY_VCL_17 : 17355|1@1+ (1,0) [0|1] "bool" MCU
 SG_ OBJ_EMERGENCY_LIGHT_COLOR_17 : 17356|4@1+ (1,0) [0|15] "BITWIZE" MCU
 SG_ OBJ_EMERGENCY_V_17 : 17360|1@1+ (1,0) [0|1] "bool" MCU
 SG_ OBJ_Angle_Top_17 : 17361|14@1+ (0.0002,0) [0|3.1415] "rad" MCU
 SG_ OBJ_Angle_Top_V_17 : 17375|1@1+ (1,0) [0|1] "bool" MCU
 SG_ OBJ_Angle_Top_STD_17 : 17376|15@1+ (0.0001,0) [0|3.1415] "rad" MCU
 SG_ OBJ_Angle_Top_STD_V_17 : 17391|1@1+ (1,0) [0|1] "bool" MCU
 SG_ OBJ_Open_Door_Left_17 : 17392|1@1+ (1,0) [0|1] "bool" MCU
 SG_ OBJ_Open_Door_Right_17 : 17393|1@1+ (1,0) [0|1] "bool" MCU
 SG_ OBJ_Visible_Left_or_Right_17 : 17394|2@1+ (1,0) [0|2] "ENUM" MCU
 SG_ OBJ_Visible_Left_or_Right_V_17 : 17396|1@1+ (1,0) [0|1] "bool" MCU
 SG_ OBJ_2W_Is_Motorbike_Probability_17 : 17397|8@1+ (0.01,0) [0|1] "NA" MCU
 SG_ Reserved_26_17 : 17405|3@1+ (1,0) [0|0] "NA" MCU
 SG_ OBJ_2W_Is_Bicycle_Probability_17 : 17408|8@1+ (0.01,0) [0|1] "NA" MCU
 SG_ Reserved_27_17 : 17416|24@1+ (1,0) [0|0] "NA" MCU
 SG_ OBJ_CRC_18 : 17440|32@1+ (1,0) [0|4294967295] "NA" MCU
 SG_ OBJ_ID_18 : 17472|8@1+ (1,0) [0|255] "counter" MCU
 SG_ OBJ_Existence_Probability_18 : 17480|8@1+ (0.01,0) [0|1] "NA" MCU
 SG_ OBJ_Fusion_Source_18 : 17488|16@1+ (1,0) [0|65535] "BITWIZE" MCU
 SG_ OBJ_Triggered_SDM_18 : 17504|2@1+ (1,0) [0|2] "ENUM" MCU
 SG_ OBJ_Motion_Category_18 : 17506|4@1+ (1,0) [0|13] "ENUM" MCU
 SG_ OBJ_Moving_IN_Probability_18 : 17510|7@1+ (0.01,0) [0|1] "NA" MCU
 SG_ OBJ_Object_Age_18 : 17517|11@1+ (1,0) [0|2047] "frames" MCU
 SG_ OBJ_Measuring_Status_18 : 17528|3@1+ (1,0) [0|7] "BITWIZE" MCU
 SG_ OBJ_Object_Class_18 : 17531|4@1+ (1,0) [0|9] "ENUM" MCU
 SG_ Reserved_4_18 : 17535|1@1+ (1,0) [0|0] "NA" MCU
 SG_ OBJ_Class_Probability_18 : 17536|7@1+ (0.01,0) [0|1] "NA" MCU
 SG_ OBJ_Car_Probability_18 : 17543|7@1+ (0.01,0) [0|1] "NA" MCU
 SG_ OBJ_Truck_Probability_18 : 17550|7@1+ (0.01,0) [0|1] "NA" MCU
 SG_ OBJ_Bike_Probability_18 : 17557|7@1+ (0.01,0) [0|1] "NA" MCU
 SG_ OBJ_Camera_Source_18 : 17564|4@1+ (1,0) [0|15] "ENUM" MCU
 SG_ OBJ_Motion_Status_18 : 17568|3@1+ (1,0) [0|5] "ENUM" MCU
 SG_ OBJ_Motion_Orientation_18 : 17571|4@1+ (1,0) [0|13] "ENUM" MCU
 SG_ OBJ_Has_Cut_Lane_18 : 17575|1@1+ (1,0) [0|1] "bool" MCU
 SG_ OBJ_Has_Cut_Path_18 : 17576|1@1+ (1,0) [0|1] "bool" MCU
 SG_ OBJ_Brake_Light_Validity_18 : 17577|1@1+ (1,0) [0|1] "bool" MCU
 SG_ OBJ_Brake_Light_18 : 17578|1@1+ (1,0) [0|1] "bool" MCU
 SG_ OBJ_Turn_Indicator_Right_18 : 17579|1@1+ (1,0) [0|1] "bool" MCU
 SG_ OBJ_Turn_Indicator_Left_18 : 17580|1@1+ (1,0) [0|1] "bool" MCU
 SG_ OBJ_Turn_Indicator_Validity_18 : 17581|1@1+ (1,0) [0|1] "bool" MCU
 SG_ OBJ_Right_Out_Of_Image_18 : 17582|1@1+ (1,0) [0|1] "bool" MCU
 SG_ OBJ_Left_Out_Of_Image_18 : 17583|1@1+ (1,0) [0|1] "bool" MCU
 SG_ OBJ_Right_Out_Of_Image_V_18 : 17584|1@1+ (1,0) [0|1] "bool" MCU
 SG_ OBJ_Left_Out_Of_Image_V_18 : 17585|1@1+ (1,0) [0|1] "bool" MCU
 SG_ OBJ_Top_Out_Of_Image_18 : 17586|1@1+ (1,0) [0|1] "bool" MCU
 SG_ OBJ_Bottom_Out_Of_Image_18 : 17587|1@1+ (1,0) [0|1] "bool" MCU
 SG_ OBJ_Top_Out_Of_Image_V_18 : 17588|1@1+ (1,0) [0|1] "bool" MCU
 SG_ OBJ_Bottom_Out_Of_Image_V_18 : 17589|1@1+ (1,0) [0|1] "bool" MCU
 SG_ OBJ_Lane_Assignment_18 : 17590|3@1+ (1,0) [0|5] "ENUM" MCU
 SG_ OBJ_Lane_Assignment_V_18 : 17593|1@1+ (1,0) [0|1] "bool" MCU
 SG_ Reserved_5_18 : 17594|6@1+ (1,0) [0|0] "NA" MCU
 SG_ OBJ_Age_Seconds_18 : 17600|7@1+ (1,0) [0|100] "s" MCU
 SG_ OBJ_Age_Seconds_V_18 : 17607|1@1+ (1,0) [0|1] "bool" MCU
 SG_ OBJ_Width_18 : 17608|9@1+ (0.01,0) [0.4|2.95] "m" MCU
 SG_ OBJ_Width_V_18 : 17617|1@1+ (1,0) [0|1] "bool" MCU
 SG_ OBJ_Width_STD_18 : 17618|11@1+ (0.001,0) [0|2] "m" MCU
 SG_ OBJ_Width_STD_V_18 : 17629|1@1+ (1,0) [0|1] "bool" MCU
 SG_ Reserved_6_18 : 17630|2@1+ (1,0) [0|0] "NA" MCU
 SG_ OBJ_Length_18 : 17632|9@1+ (0.05,0) [0.6|21] "m" MCU
 SG_ OBJ_Length_V_18 : 17641|1@1+ (1,0) [0|1] "bool" MCU
 SG_ OBJ_Length_STD_18 : 17642|10@1+ (0.01,0) [0|10] "m" MCU
 SG_ OBJ_Length_STD_V_18 : 17652|1@1+ (1,0) [0|1] "bool" MCU
 SG_ OBJ_Radar_ID_18 : 17653|8@1+ (1,0) [0|255] "counter" MCU
 SG_ Reserved_7_18 : 17661|3@1+ (1,0) [0|0] "NA" MCU
 SG_ OBJ_Height_18 : 17664|9@1+ (0.01,0) [0|2.95] "m" MCU
 SG_ OBJ_Height_V_18 : 17673|1@1+ (1,0) [0|1] "bool" MCU
 SG_ OBJ_Height_STD_18 : 17674|11@1+ (0.001,0) [0|2] "m" MCU
 SG_ OBJ_Height_STD_V_18 : 17685|1@1+ (1,0) [0|1] "bool" MCU
 SG_ Reserved_8_18 : 17686|10@1+ (1,0) [0|0] "NA" MCU
 SG_ OBJ_Abs_Long_Velocity_18 : 17696|12@1+ (0.05,-100) [-100|100] "m_per_s" MCU
 SG_ OBJ_Abs_Long_Velocity_V_18 : 17708|1@1+ (1,0) [0|1] "bool" MCU
 SG_ OBJ_Abs_Long_Velocity_STD_18 : 17709|13@1+ (0.01,0) [0|65] "m_per_s" MCU
 SG_ OBJ_Abs_Long_Vel_STD_V_18 : 17722|1@1+ (1,0) [0|1] "bool" MCU
 SG_ Reserved_9_18 : 17723|5@1+ (1,0) [0|0] "NA" MCU
 SG_ OBJ_Abs_Lat_Velocity_18 : 17728|11@1+ (0.05,-50) [-50|50] "m_per_s" MCU
 SG_ OBJ_Abs_Lat_Velocity_V_18 : 17739|1@1+ (1,0) [0|1] "bool" MCU
 SG_ OBJ_Abs_Lat_Velocity_STD_18 : 17740|13@1+ (0.01,0) [0|50] "m_per_s" MCU
 SG_ OBJ_Abs_Lat_Vel_STD_V_18 : 17753|1@1+ (1,0) [0|1] "bool" MCU
 SG_ Reserved_10_18 : 17754|6@1+ (1,0) [0|0] "NA" MCU
 SG_ OBJ_Abs_Long_Acc_18 : 17760|9@1+ (0.05,-10) [-10|10] "m_per_s2" MCU
 SG_ OBJ_Abs_Long_Acc_V_18 : 17769|1@1+ (1,0) [0|1] "bool" MCU
 SG_ OBJ_Abs_Long_Acc_STD_18 : 17770|10@1+ (0.01,0) [0|7.3] "m_per_s2" MCU
 SG_ OBJ_Abs_Long_Acc_STD_V_18 : 17780|1@1+ (1,0) [0|1] "bool" MCU
 SG_ OBJ_Abs_Lat_Acc_18 : 17781|9@1+ (0.05,-10) [-10|10] "m_per_s2" MCU
 SG_ OBJ_Abs_Lat_Acc_V_18 : 17790|1@1+ (1,0) [0|1] "bool" MCU
 SG_ Reserved_11_18 : 17791|1@1+ (1,0) [0|0] "NA" MCU
 SG_ OBJ_Abs_Lat_Acc_STD_18 : 17792|10@1+ (0.01,0) [0|7.3] "m_per_s2" MCU
 SG_ OBJ_Abs_Lat_Acc_STD_V_18 : 17802|1@1+ (1,0) [0|1] "bool" MCU
 SG_ OBJ_Abs_Acceleration_18 : 17803|9@1+ (0.05,-12.7) [-12.7|12.7] "m_per_s2" MCU
 SG_ OBJ_Abs_Acceleration_V_18 : 17812|1@1+ (1,0) [0|1] "bool" MCU
 SG_ OBJ_Abs_Acc_STD_18 : 17813|10@1+ (0.01,0) [0|7.3] "m_per_s2" MCU
 SG_ OBJ_Abs_Acc_STD_V_18 : 17823|1@1+ (1,0) [0|1] "bool" MCU
 SG_ OBJ_Inv_TTC_18 : 17824|11@1+ (0.01,-8) [-8|8] "INV(s)" MCU
 SG_ OBJ_Inv_TTC_V_18 : 17835|1@1+ (1,0) [0|1] "bool" MCU
 SG_ OBJ_Inv_TTC_STD_18 : 17836|12@1+ (0.001,0) [0|4] "INV(s)" MCU
 SG_ OBJ_Inv_TTC_STD_V_18 : 17848|1@1+ (1,0) [0|1] "bool" MCU
 SG_ Reserved_12_18 : 17849|7@1+ (1,0) [0|0] "NA" MCU
 SG_ OBJ_Relative_Long_Acc_18 : 17856|10@1+ (0.05,-20) [-20|20] "m_per_s2" MCU
 SG_ OBJ_Relative_Long_Acc_V_18 : 17866|1@1+ (1,0) [0|1] "bool" MCU
 SG_ OBJ_Relative_Long_Acc_STD_18 : 17867|10@1+ (0.01,0) [0|7.3] "m_per_s2" MCU
 SG_ OBJ_Rel_Long_Acc_STD_V_18 : 17877|1@1+ (1,0) [0|1] "bool" MCU
 SG_ Reserved_13_18 : 17878|10@1+ (1,0) [0|0] "NA" MCU
 SG_ OBJ_Relative_Long_Velocity_18 : 17888|13@1+ (0.05,-120) [-120|130] "m_per_s" MCU
 SG_ OBJ_Relative_Long_Velocity_V_18 : 17901|1@1+ (1,0) [0|1] "bool" MCU
 SG_ OBJ_Relative_Long_Vel_STD_18 : 17902|14@1+ (0.01,0) [0|130] "m_per_s" MCU
 SG_ OBJ_Rel_Long_Vel_STD_V_18 : 17916|1@1+ (1,0) [0|1] "bool" MCU
 SG_ Reserved_14_18 : 17917|3@1+ (1,0) [0|0] "NA" MCU
 SG_ OBJ_Relative_Lat_Velocity_18 : 17920|11@1+ (0.05,-50) [-50|50] "m_per_s" MCU
 SG_ OBJ_Relative_Lat_Velocity_V_18 : 17931|1@1+ (1,0) [0|1] "bool" MCU
 SG_ OBJ_Relative_Lat_Velocity_STD_18 : 17932|13@1+ (0.01,0) [0|50] "m_per_s" MCU
 SG_ OBJ_Rel_Lat_Vel_STD_V_18 : 17945|1@1+ (1,0) [0|1] "bool" MCU
 SG_ Reserved_15_18 : 17946|6@1+ (1,0) [0|0] "NA" MCU
 SG_ OBJ_Long_Distance_18 : 17952|14@1+ (0.05,-200) [-200|500] "m" MCU
 SG_ OBJ_Long_Distance_V_18 : 17966|1@1+ (1,0) [0|1] "bool" MCU
 SG_ OBJ_Long_Distance_STD_18 : 17967|15@1+ (0.01,0) [0|250] "m" MCU
 SG_ OBJ_Long_Distance_STD_V_18 : 17982|1@1+ (1,0) [0|1] "bool" MCU
 SG_ Reserved_16_18 : 17983|1@1+ (1,0) [0|0] "NA" MCU
 SG_ OBJ_Lat_Distance_18 : 17984|12@1+ (0.05,-100) [-100|100] "m" MCU
 SG_ OBJ_Lat_Distance_V_18 : 17996|1@1+ (1,0) [0|1] "bool" MCU
 SG_ OBJ_Lat_Distance_STD_18 : 17997|14@1+ (0.01,0) [0|100] "m" MCU
 SG_ OBJ_Lat_Distance_STD_V_18 : 18011|1@1+ (1,0) [0|1] "bool" MCU
 SG_ Reserved_17_18 : 18012|4@1+ (1,0) [0|0] "NA" MCU
 SG_ OBJ_Absolute_Speed_18 : 18016|12@1+ (0.05,-65) [-65|65] "m_per_s" MCU
 SG_ OBJ_Absolute_Speed_V_18 : 18028|1@1+ (1,0) [0|1] "bool" MCU
 SG_ OBJ_Absolute_Speed_STD_18 : 18029|13@1+ (0.01,0) [0|65] "m_per_s" MCU
 SG_ OBJ_Absolute_Speed_STD_V_18 : 18042|1@1+ (1,0) [0|1] "bool" MCU
 SG_ Reserved_18_18 : 18043|5@1+ (1,0) [0|0] "NA" MCU
 SG_ OBJ_Heading_18 : 18048|10@1+ (0.01,-3.14) [-3.14|3.14] "rad" MCU
 SG_ OBJ_Heading_V_18 : 18058|1@1+ (1,0) [0|1] "bool" MCU
 SG_ OBJ_Heading_STD_18 : 18059|15@1+ (0.0001,0) [0|3.14] "rad" MCU
 SG_ OBJ_Heading_STD_V_18 : 18074|1@1+ (1,0) [0|1] "bool" MCU
 SG_ Reserved_19_18 : 18075|5@1+ (1,0) [0|0] "NA" MCU
 SG_ OBJ_Angle_Rate_STD_18 : 18080|15@1+ (0.0001,0) [0|2.2318] "RPS" MCU
 SG_ OBJ_Angle_Rate_STD_V_18 : 18095|1@1+ (1,0) [0|1] "bool" MCU
 SG_ OBJ_Angle_Rate_18 : 18096|12@1+ (0.002,-2.234) [-2.234|2.2318] "RPS" MCU
 SG_ OBJ_Angle_Rate_V_18 : 18108|1@1+ (1,0) [0|1] "bool" MCU
 SG_ Reserved_20_18 : 18109|3@1+ (1,0) [0|0] "NA" MCU
 SG_ OBJ_Angle_Right_18 : 18112|14@1+ (0.0002,-1.571) [-1.571|1.571] "rad" MCU
 SG_ OBJ_Angle_Right_V_18 : 18126|1@1+ (1,0) [0|1] "bool" MCU
 SG_ OBJ_Angle_Right_STD_18 : 18127|14@1+ (0.0001,0) [0|1.571] "rad" MCU
 SG_ OBJ_Angle_Right_STD_V_18 : 18141|1@1+ (1,0) [0|1] "bool" MCU
 SG_ Reserved_21_18 : 18142|2@1+ (1,0) [0|0] "NA" MCU
 SG_ OBJ_Angle_Left_18 : 18144|14@1+ (0.0002,-1.571) [-1.571|1.571] "rad" MCU
 SG_ OBJ_Angle_Left_V_18 : 18158|1@1+ (1,0) [0|1] "bool" MCU
 SG_ OBJ_Angle_Left_STD_18 : 18159|14@1+ (0.0001,0) [0|1.571] "rad" MCU
 SG_ OBJ_Angle_Left_STD_V_18 : 18173|1@1+ (1,0) [0|1] "bool" MCU
 SG_ Reserved_22_18 : 18174|2@1+ (1,0) [0|0] "NA" MCU
 SG_ OBJ_Angle_Side_18 : 18176|14@1+ (0.0002,-1.571) [-1.571|1.571] "rad" MCU
 SG_ OBJ_Angle_Side_V_18 : 18190|1@1+ (1,0) [0|1] "bool" MCU
 SG_ OBJ_Angle_Side_STD_18 : 18191|14@1+ (0.0001,0) [0|1.571] "rad" MCU
 SG_ OBJ_Angle_Side_STD_V_18 : 18205|1@1+ (1,0) [0|1] "bool" MCU
 SG_ OBJ_Angle_Mid_V_18 : 18206|1@1+ (1,0) [0|1] "bool" MCU
 SG_ Reserved_23_18 : 18207|1@1+ (1,0) [0|0] "NA" MCU
 SG_ OBJ_Angle_Mid_18 : 18208|14@1+ (0.0002,-1.571) [-1.571|1.571] "rad" MCU
 SG_ OBJ_Angle_Mid_STD_18 : 18222|14@1+ (0.0001,0) [0|1.571] "rad" MCU
 SG_ OBJ_Angle_Mid_STD_V_18 : 18236|1@1+ (1,0) [0|1] "bool" MCU
 SG_ OBJ_Angle_Bottom_V_18 : 18237|1@1+ (1,0) [0|1] "bool" MCU
 SG_ Reserved_24_18 : 18238|2@1+ (1,0) [0|0] "NA" MCU
 SG_ OBJ_Angle_Bottom_18 : 18240|14@1+ (0.0002,-1.571) [-1.571|1.571] "rad" MCU
 SG_ OBJ_Angle_Bottom_STD_18 : 18254|14@1+ (0.0001,0) [0|1.571] "rad" MCU
 SG_ OBJ_Angle_Bottom_STD_V_18 : 18268|1@1+ (1,0) [0|1] "bool" MCU
 SG_ OBJ_Visibility_Side_V_18 : 18269|1@1+ (1,0) [0|1] "bool" MCU
 SG_ OBJ_Visibility_Side_18 : 18270|2@1+ (1,0) [0|2] "ENUM" MCU
 SG_ OBJ_Is_In_Drivable_Area_18 : 18272|1@1+ (1,0) [0|1] "bool" MCU
 SG_ OBJ_Is_In_Drivable_Area_V_18 : 18273|1@1+ (1,0) [0|1] "bool" MCU
 SG_ OBJ_Is_VeryClose_V_18 : 18274|1@1+ (1,0) [0|1] "bool" MCU
 SG_ OBJ_Is_VeryClose_18 : 18275|1@1+ (1,0) [0|1] "bool" MCU
 SG_ OBJ_Buffer_C4_18 : 18276|2@1+ (1,0) [0|2] "NA" MCU
 SG_ OBJ_Buffer_C5_18 : 18278|2@1+ (1,0) [0|2] "NA" MCU
 SG_ OBJ_Buffer_C6_18 : 18280|2@1+ (1,0) [0|2] "NA" MCU
 SG_ OBJ_Buffer_C7_18 : 18282|2@1+ (1,0) [0|2] "NA" MCU
 SG_ OBJ_OverlapAngleEgoLaneR_18 : 18284|10@1+ (0.01,-3.14) [-3.14|3.14] "rad" MCU
 SG_ OBJ_OverlapAngleEgoLaneR_V_18 : 18294|1@1+ (1,0) [0|1] "bool" MCU
 SG_ Reserved_25_18 : 18295|9@1+ (1,0) [0|0] "NA" MCU
 SG_ OBJ_OverlapAngleEgoLaneL_18 : 18304|10@1+ (0.01,-3.14) [-3.14|3.14] "rad" MCU
 SG_ OBJ_OverlapAngleEgoLaneL_V_18 : 18314|1@1+ (1,0) [0|1] "bool" MCU
 SG_ OBJ_Is_EMERGENCY_VCL_18 : 18315|1@1+ (1,0) [0|1] "bool" MCU
 SG_ OBJ_EMERGENCY_LIGHT_COLOR_18 : 18316|4@1+ (1,0) [0|15] "BITWIZE" MCU
 SG_ OBJ_EMERGENCY_V_18 : 18320|1@1+ (1,0) [0|1] "bool" MCU
 SG_ OBJ_Angle_Top_18 : 18321|14@1+ (0.0002,0) [0|3.1415] "rad" MCU
 SG_ OBJ_Angle_Top_V_18 : 18335|1@1+ (1,0) [0|1] "bool" MCU
 SG_ OBJ_Angle_Top_STD_18 : 18336|15@1+ (0.0001,0) [0|3.1415] "rad" MCU
 SG_ OBJ_Angle_Top_STD_V_18 : 18351|1@1+ (1,0) [0|1] "bool" MCU
 SG_ OBJ_Open_Door_Left_18 : 18352|1@1+ (1,0) [0|1] "bool" MCU
 SG_ OBJ_Open_Door_Right_18 : 18353|1@1+ (1,0) [0|1] "bool" MCU
 SG_ OBJ_Visible_Left_or_Right_18 : 18354|2@1+ (1,0) [0|2] "ENUM" MCU
 SG_ OBJ_Visible_Left_or_Right_V_18 : 18356|1@1+ (1,0) [0|1] "bool" MCU
 SG_ OBJ_2W_Is_Motorbike_Probability_18 : 18357|8@1+ (0.01,0) [0|1] "NA" MCU
 SG_ Reserved_26_18 : 18365|3@1+ (1,0) [0|0] "NA" MCU
 SG_ OBJ_2W_Is_Bicycle_Probability_18 : 18368|8@1+ (0.01,0) [0|1] "NA" MCU
 SG_ Reserved_27_18 : 18376|24@1+ (1,0) [0|0] "NA" MCU
 SG_ OBJ_CRC_19 : 18400|32@1+ (1,0) [0|4294967295] "NA" MCU
 SG_ OBJ_ID_19 : 18432|8@1+ (1,0) [0|255] "counter" MCU
 SG_ OBJ_Existence_Probability_19 : 18440|8@1+ (0.01,0) [0|1] "NA" MCU
 SG_ OBJ_Fusion_Source_19 : 18448|16@1+ (1,0) [0|65535] "BITWIZE" MCU
 SG_ OBJ_Triggered_SDM_19 : 18464|2@1+ (1,0) [0|2] "ENUM" MCU
 SG_ OBJ_Motion_Category_19 : 18466|4@1+ (1,0) [0|13] "ENUM" MCU
 SG_ OBJ_Moving_IN_Probability_19 : 18470|7@1+ (0.01,0) [0|1] "NA" MCU
 SG_ OBJ_Object_Age_19 : 18477|11@1+ (1,0) [0|2047] "frames" MCU
 SG_ OBJ_Measuring_Status_19 : 18488|3@1+ (1,0) [0|7] "BITWIZE" MCU
 SG_ OBJ_Object_Class_19 : 18491|4@1+ (1,0) [0|9] "ENUM" MCU
 SG_ Reserved_4_19 : 18495|1@1+ (1,0) [0|0] "NA" MCU
 SG_ OBJ_Class_Probability_19 : 18496|7@1+ (0.01,0) [0|1] "NA" MCU
 SG_ OBJ_Car_Probability_19 : 18503|7@1+ (0.01,0) [0|1] "NA" MCU
 SG_ OBJ_Truck_Probability_19 : 18510|7@1+ (0.01,0) [0|1] "NA" MCU
 SG_ OBJ_Bike_Probability_19 : 18517|7@1+ (0.01,0) [0|1] "NA" MCU
 SG_ OBJ_Camera_Source_19 : 18524|4@1+ (1,0) [0|15] "ENUM" MCU
 SG_ OBJ_Motion_Status_19 : 18528|3@1+ (1,0) [0|5] "ENUM" MCU
 SG_ OBJ_Motion_Orientation_19 : 18531|4@1+ (1,0) [0|13] "ENUM" MCU
 SG_ OBJ_Has_Cut_Lane_19 : 18535|1@1+ (1,0) [0|1] "bool" MCU
 SG_ OBJ_Has_Cut_Path_19 : 18536|1@1+ (1,0) [0|1] "bool" MCU
 SG_ OBJ_Brake_Light_Validity_19 : 18537|1@1+ (1,0) [0|1] "bool" MCU
 SG_ OBJ_Brake_Light_19 : 18538|1@1+ (1,0) [0|1] "bool" MCU
 SG_ OBJ_Turn_Indicator_Right_19 : 18539|1@1+ (1,0) [0|1] "bool" MCU
 SG_ OBJ_Turn_Indicator_Left_19 : 18540|1@1+ (1,0) [0|1] "bool" MCU
 SG_ OBJ_Turn_Indicator_Validity_19 : 18541|1@1+ (1,0) [0|1] "bool" MCU
 SG_ OBJ_Right_Out_Of_Image_19 : 18542|1@1+ (1,0) [0|1] "bool" MCU
 SG_ OBJ_Left_Out_Of_Image_19 : 18543|1@1+ (1,0) [0|1] "bool" MCU
 SG_ OBJ_Right_Out_Of_Image_V_19 : 18544|1@1+ (1,0) [0|1] "bool" MCU
 SG_ OBJ_Left_Out_Of_Image_V_19 : 18545|1@1+ (1,0) [0|1] "bool" MCU
 SG_ OBJ_Top_Out_Of_Image_19 : 18546|1@1+ (1,0) [0|1] "bool" MCU
 SG_ OBJ_Bottom_Out_Of_Image_19 : 18547|1@1+ (1,0) [0|1] "bool" MCU
 SG_ OBJ_Top_Out_Of_Image_V_19 : 18548|1@1+ (1,0) [0|1] "bool" MCU
 SG_ OBJ_Bottom_Out_Of_Image_V_19 : 18549|1@1+ (1,0) [0|1] "bool" MCU
 SG_ OBJ_Lane_Assignment_19 : 18550|3@1+ (1,0) [0|5] "ENUM" MCU
 SG_ OBJ_Lane_Assignment_V_19 : 18553|1@1+ (1,0) [0|1] "bool" MCU
 SG_ Reserved_5_19 : 18554|6@1+ (1,0) [0|0] "NA" MCU
 SG_ OBJ_Age_Seconds_19 : 18560|7@1+ (1,0) [0|100] "s" MCU
 SG_ OBJ_Age_Seconds_V_19 : 18567|1@1+ (1,0) [0|1] "bool" MCU
 SG_ OBJ_Width_19 : 18568|9@1+ (0.01,0) [0.4|2.95] "m" MCU
 SG_ OBJ_Width_V_19 : 18577|1@1+ (1,0) [0|1] "bool" MCU
 SG_ OBJ_Width_STD_19 : 18578|11@1+ (0.001,0) [0|2] "m" MCU
 SG_ OBJ_Width_STD_V_19 : 18589|1@1+ (1,0) [0|1] "bool" MCU
 SG_ Reserved_6_19 : 18590|2@1+ (1,0) [0|0] "NA" MCU
 SG_ OBJ_Length_19 : 18592|9@1+ (0.05,0) [0.6|21] "m" MCU
 SG_ OBJ_Length_V_19 : 18601|1@1+ (1,0) [0|1] "bool" MCU
 SG_ OBJ_Length_STD_19 : 18602|10@1+ (0.01,0) [0|10] "m" MCU
 SG_ OBJ_Length_STD_V_19 : 18612|1@1+ (1,0) [0|1] "bool" MCU
 SG_ OBJ_Radar_ID_19 : 18613|8@1+ (1,0) [0|255] "counter" MCU
 SG_ Reserved_7_19 : 18621|3@1+ (1,0) [0|0] "NA" MCU
 SG_ OBJ_Height_19 : 18624|9@1+ (0.01,0) [0|2.95] "m" MCU
 SG_ OBJ_Height_V_19 : 18633|1@1+ (1,0) [0|1] "bool" MCU
 SG_ OBJ_Height_STD_19 : 18634|11@1+ (0.001,0) [0|2] "m" MCU
 SG_ OBJ_Height_STD_V_19 : 18645|1@1+ (1,0) [0|1] "bool" MCU
 SG_ Reserved_8_19 : 18646|10@1+ (1,0) [0|0] "NA" MCU
 SG_ OBJ_Abs_Long_Velocity_19 : 18656|12@1+ (0.05,-100) [-100|100] "m_per_s" MCU
 SG_ OBJ_Abs_Long_Velocity_V_19 : 18668|1@1+ (1,0) [0|1] "bool" MCU
 SG_ OBJ_Abs_Long_Velocity_STD_19 : 18669|13@1+ (0.01,0) [0|65] "m_per_s" MCU
 SG_ OBJ_Abs_Long_Vel_STD_V_19 : 18682|1@1+ (1,0) [0|1] "bool" MCU
 SG_ Reserved_9_19 : 18683|5@1+ (1,0) [0|0] "NA" MCU
 SG_ OBJ_Abs_Lat_Velocity_19 : 18688|11@1+ (0.05,-50) [-50|50] "m_per_s" MCU
 SG_ OBJ_Abs_Lat_Velocity_V_19 : 18699|1@1+ (1,0) [0|1] "bool" MCU
 SG_ OBJ_Abs_Lat_Velocity_STD_19 : 18700|13@1+ (0.01,0) [0|50] "m_per_s" MCU
 SG_ OBJ_Abs_Lat_Vel_STD_V_19 : 18713|1@1+ (1,0) [0|1] "bool" MCU
 SG_ Reserved_10_19 : 18714|6@1+ (1,0) [0|0] "NA" MCU
 SG_ OBJ_Abs_Long_Acc_19 : 18720|9@1+ (0.05,-10) [-10|10] "m_per_s2" MCU
 SG_ OBJ_Abs_Long_Acc_V_19 : 18729|1@1+ (1,0) [0|1] "bool" MCU
 SG_ OBJ_Abs_Long_Acc_STD_19 : 18730|10@1+ (0.01,0) [0|7.3] "m_per_s2" MCU
 SG_ OBJ_Abs_Long_Acc_STD_V_19 : 18740|1@1+ (1,0) [0|1] "bool" MCU
 SG_ OBJ_Abs_Lat_Acc_19 : 18741|9@1+ (0.05,-10) [-10|10] "m_per_s2" MCU
 SG_ OBJ_Abs_Lat_Acc_V_19 : 18750|1@1+ (1,0) [0|1] "bool" MCU
 SG_ Reserved_11_19 : 18751|1@1+ (1,0) [0|0] "NA" MCU
 SG_ OBJ_Abs_Lat_Acc_STD_19 : 18752|10@1+ (0.01,0) [0|7.3] "m_per_s2" MCU
 SG_ OBJ_Abs_Lat_Acc_STD_V_19 : 18762|1@1+ (1,0) [0|1] "bool" MCU
 SG_ OBJ_Abs_Acceleration_19 : 18763|9@1+ (0.05,-12.7) [-12.7|12.7] "m_per_s2" MCU
 SG_ OBJ_Abs_Acceleration_V_19 : 18772|1@1+ (1,0) [0|1] "bool" MCU
 SG_ OBJ_Abs_Acc_STD_19 : 18773|10@1+ (0.01,0) [0|7.3] "m_per_s2" MCU
 SG_ OBJ_Abs_Acc_STD_V_19 : 18783|1@1+ (1,0) [0|1] "bool" MCU
 SG_ OBJ_Inv_TTC_19 : 18784|11@1+ (0.01,-8) [-8|8] "INV(s)" MCU
 SG_ OBJ_Inv_TTC_V_19 : 18795|1@1+ (1,0) [0|1] "bool" MCU
 SG_ OBJ_Inv_TTC_STD_19 : 18796|12@1+ (0.001,0) [0|4] "INV(s)" MCU
 SG_ OBJ_Inv_TTC_STD_V_19 : 18808|1@1+ (1,0) [0|1] "bool" MCU
 SG_ Reserved_12_19 : 18809|7@1+ (1,0) [0|0] "NA" MCU
 SG_ OBJ_Relative_Long_Acc_19 : 18816|10@1+ (0.05,-20) [-20|20] "m_per_s2" MCU
 SG_ OBJ_Relative_Long_Acc_V_19 : 18826|1@1+ (1,0) [0|1] "bool" MCU
 SG_ OBJ_Relative_Long_Acc_STD_19 : 18827|10@1+ (0.01,0) [0|7.3] "m_per_s2" MCU
 SG_ OBJ_Rel_Long_Acc_STD_V_19 : 18837|1@1+ (1,0) [0|1] "bool" MCU
 SG_ Reserved_13_19 : 18838|10@1+ (1,0) [0|0] "NA" MCU
 SG_ OBJ_Relative_Long_Velocity_19 : 18848|13@1+ (0.05,-120) [-120|130] "m_per_s" MCU
 SG_ OBJ_Relative_Long_Velocity_V_19 : 18861|1@1+ (1,0) [0|1] "bool" MCU
 SG_ OBJ_Relative_Long_Vel_STD_19 : 18862|14@1+ (0.01,0) [0|130] "m_per_s" MCU
 SG_ OBJ_Rel_Long_Vel_STD_V_19 : 18876|1@1+ (1,0) [0|1] "bool" MCU
 SG_ Reserved_14_19 : 18877|3@1+ (1,0) [0|0] "NA" MCU
 SG_ OBJ_Relative_Lat_Velocity_19 : 18880|11@1+ (0.05,-50) [-50|50] "m_per_s" MCU
 SG_ OBJ_Relative_Lat_Velocity_V_19 : 18891|1@1+ (1,0) [0|1] "bool" MCU
 SG_ OBJ_Relative_Lat_Velocity_STD_19 : 18892|13@1+ (0.01,0) [0|50] "m_per_s" MCU
 SG_ OBJ_Rel_Lat_Vel_STD_V_19 : 18905|1@1+ (1,0) [0|1] "bool" MCU
 SG_ Reserved_15_19 : 18906|6@1+ (1,0) [0|0] "NA" MCU
 SG_ OBJ_Long_Distance_19 : 18912|14@1+ (0.05,-200) [-200|500] "m" MCU
 SG_ OBJ_Long_Distance_V_19 : 18926|1@1+ (1,0) [0|1] "bool" MCU
 SG_ OBJ_Long_Distance_STD_19 : 18927|15@1+ (0.01,0) [0|250] "m" MCU
 SG_ OBJ_Long_Distance_STD_V_19 : 18942|1@1+ (1,0) [0|1] "bool" MCU
 SG_ Reserved_16_19 : 18943|1@1+ (1,0) [0|0] "NA" MCU
 SG_ OBJ_Lat_Distance_19 : 18944|12@1+ (0.05,-100) [-100|100] "m" MCU
 SG_ OBJ_Lat_Distance_V_19 : 18956|1@1+ (1,0) [0|1] "bool" MCU
 SG_ OBJ_Lat_Distance_STD_19 : 18957|14@1+ (0.01,0) [0|100] "m" MCU
 SG_ OBJ_Lat_Distance_STD_V_19 : 18971|1@1+ (1,0) [0|1] "bool" MCU
 SG_ Reserved_17_19 : 18972|4@1+ (1,0) [0|0] "NA" MCU
 SG_ OBJ_Absolute_Speed_19 : 18976|12@1+ (0.05,-65) [-65|65] "m_per_s" MCU
 SG_ OBJ_Absolute_Speed_V_19 : 18988|1@1+ (1,0) [0|1] "bool" MCU
 SG_ OBJ_Absolute_Speed_STD_19 : 18989|13@1+ (0.01,0) [0|65] "m_per_s" MCU
 SG_ OBJ_Absolute_Speed_STD_V_19 : 19002|1@1+ (1,0) [0|1] "bool" MCU
 SG_ Reserved_18_19 : 19003|5@1+ (1,0) [0|0] "NA" MCU
 SG_ OBJ_Heading_19 : 19008|10@1+ (0.01,-3.14) [-3.14|3.14] "rad" MCU
 SG_ OBJ_Heading_V_19 : 19018|1@1+ (1,0) [0|1] "bool" MCU
 SG_ OBJ_Heading_STD_19 : 19019|15@1+ (0.0001,0) [0|3.14] "rad" MCU
 SG_ OBJ_Heading_STD_V_19 : 19034|1@1+ (1,0) [0|1] "bool" MCU
 SG_ Reserved_19_19 : 19035|5@1+ (1,0) [0|0] "NA" MCU
 SG_ OBJ_Angle_Rate_STD_19 : 19040|15@1+ (0.0001,0) [0|2.2318] "RPS" MCU
 SG_ OBJ_Angle_Rate_STD_V_19 : 19055|1@1+ (1,0) [0|1] "bool" MCU
 SG_ OBJ_Angle_Rate_19 : 19056|12@1+ (0.002,-2.234) [-2.234|2.2318] "RPS" MCU
 SG_ OBJ_Angle_Rate_V_19 : 19068|1@1+ (1,0) [0|1] "bool" MCU
 SG_ Reserved_20_19 : 19069|3@1+ (1,0) [0|0] "NA" MCU
 SG_ OBJ_Angle_Right_19 : 19072|14@1+ (0.0002,-1.571) [-1.571|1.571] "rad" MCU
 SG_ OBJ_Angle_Right_V_19 : 19086|1@1+ (1,0) [0|1] "bool" MCU
 SG_ OBJ_Angle_Right_STD_19 : 19087|14@1+ (0.0001,0) [0|1.571] "rad" MCU
 SG_ OBJ_Angle_Right_STD_V_19 : 19101|1@1+ (1,0) [0|1] "bool" MCU
 SG_ Reserved_21_19 : 19102|2@1+ (1,0) [0|0] "NA" MCU
 SG_ OBJ_Angle_Left_19 : 19104|14@1+ (0.0002,-1.571) [-1.571|1.571] "rad" MCU
 SG_ OBJ_Angle_Left_V_19 : 19118|1@1+ (1,0) [0|1] "bool" MCU
 SG_ OBJ_Angle_Left_STD_19 : 19119|14@1+ (0.0001,0) [0|1.571] "rad" MCU
 SG_ OBJ_Angle_Left_STD_V_19 : 19133|1@1+ (1,0) [0|1] "bool" MCU
 SG_ Reserved_22_19 : 19134|2@1+ (1,0) [0|0] "NA" MCU
 SG_ OBJ_Angle_Side_19 : 19136|14@1+ (0.0002,-1.571) [-1.571|1.571] "rad" MCU
 SG_ OBJ_Angle_Side_V_19 : 19150|1@1+ (1,0) [0|1] "bool" MCU
 SG_ OBJ_Angle_Side_STD_19 : 19151|14@1+ (0.0001,0) [0|1.571] "rad" MCU
 SG_ OBJ_Angle_Side_STD_V_19 : 19165|1@1+ (1,0) [0|1] "bool" MCU
 SG_ OBJ_Angle_Mid_V_19 : 19166|1@1+ (1,0) [0|1] "bool" MCU
 SG_ Reserved_23_19 : 19167|1@1+ (1,0) [0|0] "NA" MCU
 SG_ OBJ_Angle_Mid_19 : 19168|14@1+ (0.0002,-1.571) [-1.571|1.571] "rad" MCU
 SG_ OBJ_Angle_Mid_STD_19 : 19182|14@1+ (0.0001,0) [0|1.571] "rad" MCU
 SG_ OBJ_Angle_Mid_STD_V_19 : 19196|1@1+ (1,0) [0|1] "bool" MCU
 SG_ OBJ_Angle_Bottom_V_19 : 19197|1@1+ (1,0) [0|1] "bool" MCU
 SG_ Reserved_24_19 : 19198|2@1+ (1,0) [0|0] "NA" MCU
 SG_ OBJ_Angle_Bottom_19 : 19200|14@1+ (0.0002,-1.571) [-1.571|1.571] "rad" MCU
 SG_ OBJ_Angle_Bottom_STD_19 : 19214|14@1+ (0.0001,0) [0|1.571] "rad" MCU
 SG_ OBJ_Angle_Bottom_STD_V_19 : 19228|1@1+ (1,0) [0|1] "bool" MCU
 SG_ OBJ_Visibility_Side_V_19 : 19229|1@1+ (1,0) [0|1] "bool" MCU
 SG_ OBJ_Visibility_Side_19 : 19230|2@1+ (1,0) [0|2] "ENUM" MCU
 SG_ OBJ_Is_In_Drivable_Area_19 : 19232|1@1+ (1,0) [0|1] "bool" MCU
 SG_ OBJ_Is_In_Drivable_Area_V_19 : 19233|1@1+ (1,0) [0|1] "bool" MCU
 SG_ OBJ_Is_VeryClose_V_19 : 19234|1@1+ (1,0) [0|1] "bool" MCU
 SG_ OBJ_Is_VeryClose_19 : 19235|1@1+ (1,0) [0|1] "bool" MCU
 SG_ OBJ_Buffer_C4_19 : 19236|2@1+ (1,0) [0|2] "NA" MCU
 SG_ OBJ_Buffer_C5_19 : 19238|2@1+ (1,0) [0|2] "NA" MCU
 SG_ OBJ_Buffer_C6_19 : 19240|2@1+ (1,0) [0|2] "NA" MCU
 SG_ OBJ_Buffer_C7_19 : 19242|2@1+ (1,0) [0|2] "NA" MCU
 SG_ OBJ_OverlapAngleEgoLaneR_19 : 19244|10@1+ (0.01,-3.14) [-3.14|3.14] "rad" MCU
 SG_ OBJ_OverlapAngleEgoLaneR_V_19 : 19254|1@1+ (1,0) [0|1] "bool" MCU
 SG_ Reserved_25_19 : 19255|9@1+ (1,0) [0|0] "NA" MCU
 SG_ OBJ_OverlapAngleEgoLaneL_19 : 19264|10@1+ (0.01,-3.14) [-3.14|3.14] "rad" MCU
 SG_ OBJ_OverlapAngleEgoLaneL_V_19 : 19274|1@1+ (1,0) [0|1] "bool" MCU
 SG_ OBJ_Is_EMERGENCY_VCL_19 : 19275|1@1+ (1,0) [0|1] "bool" MCU
 SG_ OBJ_EMERGENCY_LIGHT_COLOR_19 : 19276|4@1+ (1,0) [0|15] "BITWIZE" MCU
 SG_ OBJ_EMERGENCY_V_19 : 19280|1@1+ (1,0) [0|1] "bool" MCU
 SG_ OBJ_Angle_Top_19 : 19281|14@1+ (0.0002,0) [0|3.1415] "rad" MCU
 SG_ OBJ_Angle_Top_V_19 : 19295|1@1+ (1,0) [0|1] "bool" MCU
 SG_ OBJ_Angle_Top_STD_19 : 19296|15@1+ (0.0001,0) [0|3.1415] "rad" MCU
 SG_ OBJ_Angle_Top_STD_V_19 : 19311|1@1+ (1,0) [0|1] "bool" MCU
 SG_ OBJ_Open_Door_Left_19 : 19312|1@1+ (1,0) [0|1] "bool" MCU
 SG_ OBJ_Open_Door_Right_19 : 19313|1@1+ (1,0) [0|1] "bool" MCU
 SG_ OBJ_Visible_Left_or_Right_19 : 19314|2@1+ (1,0) [0|2] "ENUM" MCU
 SG_ OBJ_Visible_Left_or_Right_V_19 : 19316|1@1+ (1,0) [0|1] "bool" MCU
 SG_ OBJ_2W_Is_Motorbike_Probability_19 : 19317|8@1+ (0.01,0) [0|1] "NA" MCU
 SG_ Reserved_26_19 : 19325|3@1+ (1,0) [0|0] "NA" MCU
 SG_ OBJ_2W_Is_Bicycle_Probability_19 : 19328|8@1+ (0.01,0) [0|1] "NA" MCU
 SG_ Reserved_27_19 : 19336|24@1+ (1,0) [0|0] "NA" MCU
 SG_ OBJ_CRC_20 : 19360|32@1+ (1,0) [0|4294967295] "NA" MCU
 SG_ OBJ_ID_20 : 19392|8@1+ (1,0) [0|255] "counter" MCU
 SG_ OBJ_Existence_Probability_20 : 19400|8@1+ (0.01,0) [0|1] "NA" MCU
 SG_ OBJ_Fusion_Source_20 : 19408|16@1+ (1,0) [0|65535] "BITWIZE" MCU
 SG_ OBJ_Triggered_SDM_20 : 19424|2@1+ (1,0) [0|2] "ENUM" MCU
 SG_ OBJ_Motion_Category_20 : 19426|4@1+ (1,0) [0|13] "ENUM" MCU
 SG_ OBJ_Moving_IN_Probability_20 : 19430|7@1+ (0.01,0) [0|1] "NA" MCU
 SG_ OBJ_Object_Age_20 : 19437|11@1+ (1,0) [0|2047] "frames" MCU
 SG_ OBJ_Measuring_Status_20 : 19448|3@1+ (1,0) [0|7] "BITWIZE" MCU
 SG_ OBJ_Object_Class_20 : 19451|4@1+ (1,0) [0|9] "ENUM" MCU
 SG_ Reserved_4_20 : 19455|1@1+ (1,0) [0|0] "NA" MCU
 SG_ OBJ_Class_Probability_20 : 19456|7@1+ (0.01,0) [0|1] "NA" MCU
 SG_ OBJ_Car_Probability_20 : 19463|7@1+ (0.01,0) [0|1] "NA" MCU
 SG_ OBJ_Truck_Probability_20 : 19470|7@1+ (0.01,0) [0|1] "NA" MCU
 SG_ OBJ_Bike_Probability_20 : 19477|7@1+ (0.01,0) [0|1] "NA" MCU
 SG_ OBJ_Camera_Source_20 : 19484|4@1+ (1,0) [0|15] "ENUM" MCU
 SG_ OBJ_Motion_Status_20 : 19488|3@1+ (1,0) [0|5] "ENUM" MCU
 SG_ OBJ_Motion_Orientation_20 : 19491|4@1+ (1,0) [0|13] "ENUM" MCU
 SG_ OBJ_Has_Cut_Lane_20 : 19495|1@1+ (1,0) [0|1] "bool" MCU
 SG_ OBJ_Has_Cut_Path_20 : 19496|1@1+ (1,0) [0|1] "bool" MCU
 SG_ OBJ_Brake_Light_Validity_20 : 19497|1@1+ (1,0) [0|1] "bool" MCU
 SG_ OBJ_Brake_Light_20 : 19498|1@1+ (1,0) [0|1] "bool" MCU
 SG_ OBJ_Turn_Indicator_Right_20 : 19499|1@1+ (1,0) [0|1] "bool" MCU
 SG_ OBJ_Turn_Indicator_Left_20 : 19500|1@1+ (1,0) [0|1] "bool" MCU
 SG_ OBJ_Turn_Indicator_Validity_20 : 19501|1@1+ (1,0) [0|1] "bool" MCU
 SG_ OBJ_Right_Out_Of_Image_20 : 19502|1@1+ (1,0) [0|1] "bool" MCU
 SG_ OBJ_Left_Out_Of_Image_20 : 19503|1@1+ (1,0) [0|1] "bool" MCU
 SG_ OBJ_Right_Out_Of_Image_V_20 : 19504|1@1+ (1,0) [0|1] "bool" MCU
 SG_ OBJ_Left_Out_Of_Image_V_20 : 19505|1@1+ (1,0) [0|1] "bool" MCU
 SG_ OBJ_Top_Out_Of_Image_20 : 19506|1@1+ (1,0) [0|1] "bool" MCU
 SG_ OBJ_Bottom_Out_Of_Image_20 : 19507|1@1+ (1,0) [0|1] "bool" MCU
 SG_ OBJ_Top_Out_Of_Image_V_20 : 19508|1@1+ (1,0) [0|1] "bool" MCU
 SG_ OBJ_Bottom_Out_Of_Image_V_20 : 19509|1@1+ (1,0) [0|1] "bool" MCU
 SG_ OBJ_Lane_Assignment_20 : 19510|3@1+ (1,0) [0|5] "ENUM" MCU
 SG_ OBJ_Lane_Assignment_V_20 : 19513|1@1+ (1,0) [0|1] "bool" MCU
 SG_ Reserved_5_20 : 19514|6@1+ (1,0) [0|0] "NA" MCU
 SG_ OBJ_Age_Seconds_20 : 19520|7@1+ (1,0) [0|100] "s" MCU
 SG_ OBJ_Age_Seconds_V_20 : 19527|1@1+ (1,0) [0|1] "bool" MCU
 SG_ OBJ_Width_20 : 19528|9@1+ (0.01,0) [0.4|2.95] "m" MCU
 SG_ OBJ_Width_V_20 : 19537|1@1+ (1,0) [0|1] "bool" MCU
 SG_ OBJ_Width_STD_20 : 19538|11@1+ (0.001,0) [0|2] "m" MCU
 SG_ OBJ_Width_STD_V_20 : 19549|1@1+ (1,0) [0|1] "bool" MCU
 SG_ Reserved_6_20 : 19550|2@1+ (1,0) [0|0] "NA" MCU
 SG_ OBJ_Length_20 : 19552|9@1+ (0.05,0) [0.6|21] "m" MCU
 SG_ OBJ_Length_V_20 : 19561|1@1+ (1,0) [0|1] "bool" MCU
 SG_ OBJ_Length_STD_20 : 19562|10@1+ (0.01,0) [0|10] "m" MCU
 SG_ OBJ_Length_STD_V_20 : 19572|1@1+ (1,0) [0|1] "bool" MCU
 SG_ OBJ_Radar_ID_20 : 19573|8@1+ (1,0) [0|255] "counter" MCU
 SG_ Reserved_7_20 : 19581|3@1+ (1,0) [0|0] "NA" MCU
 SG_ OBJ_Height_20 : 19584|9@1+ (0.01,0) [0|2.95] "m" MCU
 SG_ OBJ_Height_V_20 : 19593|1@1+ (1,0) [0|1] "bool" MCU
 SG_ OBJ_Height_STD_20 : 19594|11@1+ (0.001,0) [0|2] "m" MCU
 SG_ OBJ_Height_STD_V_20 : 19605|1@1+ (1,0) [0|1] "bool" MCU
 SG_ Reserved_8_20 : 19606|10@1+ (1,0) [0|0] "NA" MCU
 SG_ OBJ_Abs_Long_Velocity_20 : 19616|12@1+ (0.05,-100) [-100|100] "m_per_s" MCU
 SG_ OBJ_Abs_Long_Velocity_V_20 : 19628|1@1+ (1,0) [0|1] "bool" MCU
 SG_ OBJ_Abs_Long_Velocity_STD_20 : 19629|13@1+ (0.01,0) [0|65] "m_per_s" MCU
 SG_ OBJ_Abs_Long_Vel_STD_V_20 : 19642|1@1+ (1,0) [0|1] "bool" MCU
 SG_ Reserved_9_20 : 19643|5@1+ (1,0) [0|0] "NA" MCU
 SG_ OBJ_Abs_Lat_Velocity_20 : 19648|11@1+ (0.05,-50) [-50|50] "m_per_s" MCU
 SG_ OBJ_Abs_Lat_Velocity_V_20 : 19659|1@1+ (1,0) [0|1] "bool" MCU
 SG_ OBJ_Abs_Lat_Velocity_STD_20 : 19660|13@1+ (0.01,0) [0|50] "m_per_s" MCU
 SG_ OBJ_Abs_Lat_Vel_STD_V_20 : 19673|1@1+ (1,0) [0|1] "bool" MCU
 SG_ Reserved_10_20 : 19674|6@1+ (1,0) [0|0] "NA" MCU
 SG_ OBJ_Abs_Long_Acc_20 : 19680|9@1+ (0.05,-10) [-10|10] "m_per_s2" MCU
 SG_ OBJ_Abs_Long_Acc_V_20 : 19689|1@1+ (1,0) [0|1] "bool" MCU
 SG_ OBJ_Abs_Long_Acc_STD_20 : 19690|10@1+ (0.01,0) [0|7.3] "m_per_s2" MCU
 SG_ OBJ_Abs_Long_Acc_STD_V_20 : 19700|1@1+ (1,0) [0|1] "bool" MCU
 SG_ OBJ_Abs_Lat_Acc_20 : 19701|9@1+ (0.05,-10) [-10|10] "m_per_s2" MCU
 SG_ OBJ_Abs_Lat_Acc_V_20 : 19710|1@1+ (1,0) [0|1] "bool" MCU
 SG_ Reserved_11_20 : 19711|1@1+ (1,0) [0|0] "NA" MCU
 SG_ OBJ_Abs_Lat_Acc_STD_20 : 19712|10@1+ (0.01,0) [0|7.3] "m_per_s2" MCU
 SG_ OBJ_Abs_Lat_Acc_STD_V_20 : 19722|1@1+ (1,0) [0|1] "bool" MCU
 SG_ OBJ_Abs_Acceleration_20 : 19723|9@1+ (0.05,-12.7) [-12.7|12.7] "m_per_s2" MCU
 SG_ OBJ_Abs_Acceleration_V_20 : 19732|1@1+ (1,0) [0|1] "bool" MCU
 SG_ OBJ_Abs_Acc_STD_20 : 19733|10@1+ (0.01,0) [0|7.3] "m_per_s2" MCU
 SG_ OBJ_Abs_Acc_STD_V_20 : 19743|1@1+ (1,0) [0|1] "bool" MCU
 SG_ OBJ_Inv_TTC_20 : 19744|11@1+ (0.01,-8) [-8|8] "INV(s)" MCU
 SG_ OBJ_Inv_TTC_V_20 : 19755|1@1+ (1,0) [0|1] "bool" MCU
 SG_ OBJ_Inv_TTC_STD_20 : 19756|12@1+ (0.001,0) [0|4] "INV(s)" MCU
 SG_ OBJ_Inv_TTC_STD_V_20 : 19768|1@1+ (1,0) [0|1] "bool" MCU
 SG_ Reserved_12_20 : 19769|7@1+ (1,0) [0|0] "NA" MCU
 SG_ OBJ_Relative_Long_Acc_20 : 19776|10@1+ (0.05,-20) [-20|20] "m_per_s2" MCU
 SG_ OBJ_Relative_Long_Acc_V_20 : 19786|1@1+ (1,0) [0|1] "bool" MCU
 SG_ OBJ_Relative_Long_Acc_STD_20 : 19787|10@1+ (0.01,0) [0|7.3] "m_per_s2" MCU
 SG_ OBJ_Rel_Long_Acc_STD_V_20 : 19797|1@1+ (1,0) [0|1] "bool" MCU
 SG_ Reserved_13_20 : 19798|10@1+ (1,0) [0|0] "NA" MCU
 SG_ OBJ_Relative_Long_Velocity_20 : 19808|13@1+ (0.05,-120) [-120|130] "m_per_s" MCU
 SG_ OBJ_Relative_Long_Velocity_V_20 : 19821|1@1+ (1,0) [0|1] "bool" MCU
 SG_ OBJ_Relative_Long_Vel_STD_20 : 19822|14@1+ (0.01,0) [0|130] "m_per_s" MCU
 SG_ OBJ_Rel_Long_Vel_STD_V_20 : 19836|1@1+ (1,0) [0|1] "bool" MCU
 SG_ Reserved_14_20 : 19837|3@1+ (1,0) [0|0] "NA" MCU
 SG_ OBJ_Relative_Lat_Velocity_20 : 19840|11@1+ (0.05,-50) [-50|50] "m_per_s" MCU
 SG_ OBJ_Relative_Lat_Velocity_V_20 : 19851|1@1+ (1,0) [0|1] "bool" MCU
 SG_ OBJ_Relative_Lat_Velocity_STD_20 : 19852|13@1+ (0.01,0) [0|50] "m_per_s" MCU
 SG_ OBJ_Rel_Lat_Vel_STD_V_20 : 19865|1@1+ (1,0) [0|1] "bool" MCU
 SG_ Reserved_15_20 : 19866|6@1+ (1,0) [0|0] "NA" MCU
 SG_ OBJ_Long_Distance_20 : 19872|14@1+ (0.05,-200) [-200|500] "m" MCU
 SG_ OBJ_Long_Distance_V_20 : 19886|1@1+ (1,0) [0|1] "bool" MCU
 SG_ OBJ_Long_Distance_STD_20 : 19887|15@1+ (0.01,0) [0|250] "m" MCU
 SG_ OBJ_Long_Distance_STD_V_20 : 19902|1@1+ (1,0) [0|1] "bool" MCU
 SG_ Reserved_16_20 : 19903|1@1+ (1,0) [0|0] "NA" MCU
 SG_ OBJ_Lat_Distance_20 : 19904|12@1+ (0.05,-100) [-100|100] "m" MCU
 SG_ OBJ_Lat_Distance_V_20 : 19916|1@1+ (1,0) [0|1] "bool" MCU
 SG_ OBJ_Lat_Distance_STD_20 : 19917|14@1+ (0.01,0) [0|100] "m" MCU
 SG_ OBJ_Lat_Distance_STD_V_20 : 19931|1@1+ (1,0) [0|1] "bool" MCU
 SG_ Reserved_17_20 : 19932|4@1+ (1,0) [0|0] "NA" MCU
 SG_ OBJ_Absolute_Speed_20 : 19936|12@1+ (0.05,-65) [-65|65] "m_per_s" MCU
 SG_ OBJ_Absolute_Speed_V_20 : 19948|1@1+ (1,0) [0|1] "bool" MCU
 SG_ OBJ_Absolute_Speed_STD_20 : 19949|13@1+ (0.01,0) [0|65] "m_per_s" MCU
 SG_ OBJ_Absolute_Speed_STD_V_20 : 19962|1@1+ (1,0) [0|1] "bool" MCU
 SG_ Reserved_18_20 : 19963|5@1+ (1,0) [0|0] "NA" MCU
 SG_ OBJ_Heading_20 : 19968|10@1+ (0.01,-3.14) [-3.14|3.14] "rad" MCU
 SG_ OBJ_Heading_V_20 : 19978|1@1+ (1,0) [0|1] "bool" MCU
 SG_ OBJ_Heading_STD_20 : 19979|15@1+ (0.0001,0) [0|3.14] "rad" MCU
 SG_ OBJ_Heading_STD_V_20 : 19994|1@1+ (1,0) [0|1] "bool" MCU
 SG_ Reserved_19_20 : 19995|5@1+ (1,0) [0|0] "NA" MCU
 SG_ OBJ_Angle_Rate_STD_20 : 20000|15@1+ (0.0001,0) [0|2.2318] "RPS" MCU
 SG_ OBJ_Angle_Rate_STD_V_20 : 20015|1@1+ (1,0) [0|1] "bool" MCU
 SG_ OBJ_Angle_Rate_20 : 20016|12@1+ (0.002,-2.234) [-2.234|2.2318] "RPS" MCU
 SG_ OBJ_Angle_Rate_V_20 : 20028|1@1+ (1,0) [0|1] "bool" MCU
 SG_ Reserved_20_20 : 20029|3@1+ (1,0) [0|0] "NA" MCU
 SG_ OBJ_Angle_Right_20 : 20032|14@1+ (0.0002,-1.571) [-1.571|1.571] "rad" MCU
 SG_ OBJ_Angle_Right_V_20 : 20046|1@1+ (1,0) [0|1] "bool" MCU
 SG_ OBJ_Angle_Right_STD_20 : 20047|14@1+ (0.0001,0) [0|1.571] "rad" MCU
 SG_ OBJ_Angle_Right_STD_V_20 : 20061|1@1+ (1,0) [0|1] "bool" MCU
 SG_ Reserved_21_20 : 20062|2@1+ (1,0) [0|0] "NA" MCU
 SG_ OBJ_Angle_Left_20 : 20064|14@1+ (0.0002,-1.571) [-1.571|1.571] "rad" MCU
 SG_ OBJ_Angle_Left_V_20 : 20078|1@1+ (1,0) [0|1] "bool" MCU
 SG_ OBJ_Angle_Left_STD_20 : 20079|14@1+ (0.0001,0) [0|1.571] "rad" MCU
 SG_ OBJ_Angle_Left_STD_V_20 : 20093|1@1+ (1,0) [0|1] "bool" MCU
 SG_ Reserved_22_20 : 20094|2@1+ (1,0) [0|0] "NA" MCU
 SG_ OBJ_Angle_Side_20 : 20096|14@1+ (0.0002,-1.571) [-1.571|1.571] "rad" MCU
 SG_ OBJ_Angle_Side_V_20 : 20110|1@1+ (1,0) [0|1] "bool" MCU
 SG_ OBJ_Angle_Side_STD_20 : 20111|14@1+ (0.0001,0) [0|1.571] "rad" MCU
 SG_ OBJ_Angle_Side_STD_V_20 : 20125|1@1+ (1,0) [0|1] "bool" MCU
 SG_ OBJ_Angle_Mid_V_20 : 20126|1@1+ (1,0) [0|1] "bool" MCU
 SG_ Reserved_23_20 : 20127|1@1+ (1,0) [0|0] "NA" MCU
 SG_ OBJ_Angle_Mid_20 : 20128|14@1+ (0.0002,-1.571) [-1.571|1.571] "rad" MCU
 SG_ OBJ_Angle_Mid_STD_20 : 20142|14@1+ (0.0001,0) [0|1.571] "rad" MCU
 SG_ OBJ_Angle_Mid_STD_V_20 : 20156|1@1+ (1,0) [0|1] "bool" MCU
 SG_ OBJ_Angle_Bottom_V_20 : 20157|1@1+ (1,0) [0|1] "bool" MCU
 SG_ Reserved_24_20 : 20158|2@1+ (1,0) [0|0] "NA" MCU
 SG_ OBJ_Angle_Bottom_20 : 20160|14@1+ (0.0002,-1.571) [-1.571|1.571] "rad" MCU
 SG_ OBJ_Angle_Bottom_STD_20 : 20174|14@1+ (0.0001,0) [0|1.571] "rad" MCU
 SG_ OBJ_Angle_Bottom_STD_V_20 : 20188|1@1+ (1,0) [0|1] "bool" MCU
 SG_ OBJ_Visibility_Side_V_20 : 20189|1@1+ (1,0) [0|1] "bool" MCU
 SG_ OBJ_Visibility_Side_20 : 20190|2@1+ (1,0) [0|2] "ENUM" MCU
 SG_ OBJ_Is_In_Drivable_Area_20 : 20192|1@1+ (1,0) [0|1] "bool" MCU
 SG_ OBJ_Is_In_Drivable_Area_V_20 : 20193|1@1+ (1,0) [0|1] "bool" MCU
 SG_ OBJ_Is_VeryClose_V_20 : 20194|1@1+ (1,0) [0|1] "bool" MCU
 SG_ OBJ_Is_VeryClose_20 : 20195|1@1+ (1,0) [0|1] "bool" MCU
 SG_ OBJ_Buffer_C4_20 : 20196|2@1+ (1,0) [0|2] "NA" MCU
 SG_ OBJ_Buffer_C5_20 : 20198|2@1+ (1,0) [0|2] "NA" MCU
 SG_ OBJ_Buffer_C6_20 : 20200|2@1+ (1,0) [0|2] "NA" MCU
 SG_ OBJ_Buffer_C7_20 : 20202|2@1+ (1,0) [0|2] "NA" MCU
 SG_ OBJ_OverlapAngleEgoLaneR_20 : 20204|10@1+ (0.01,-3.14) [-3.14|3.14] "rad" MCU
 SG_ OBJ_OverlapAngleEgoLaneR_V_20 : 20214|1@1+ (1,0) [0|1] "bool" MCU
 SG_ Reserved_25_20 : 20215|9@1+ (1,0) [0|0] "NA" MCU
 SG_ OBJ_OverlapAngleEgoLaneL_20 : 20224|10@1+ (0.01,-3.14) [-3.14|3.14] "rad" MCU
 SG_ OBJ_OverlapAngleEgoLaneL_V_20 : 20234|1@1+ (1,0) [0|1] "bool" MCU
 SG_ OBJ_Is_EMERGENCY_VCL_20 : 20235|1@1+ (1,0) [0|1] "bool" MCU
 SG_ OBJ_EMERGENCY_LIGHT_COLOR_20 : 20236|4@1+ (1,0) [0|15] "BITWIZE" MCU
 SG_ OBJ_EMERGENCY_V_20 : 20240|1@1+ (1,0) [0|1] "bool" MCU
 SG_ OBJ_Angle_Top_20 : 20241|14@1+ (0.0002,0) [0|3.1415] "rad" MCU
 SG_ OBJ_Angle_Top_V_20 : 20255|1@1+ (1,0) [0|1] "bool" MCU
 SG_ OBJ_Angle_Top_STD_20 : 20256|15@1+ (0.0001,0) [0|3.1415] "rad" MCU
 SG_ OBJ_Angle_Top_STD_V_20 : 20271|1@1+ (1,0) [0|1] "bool" MCU
 SG_ OBJ_Open_Door_Left_20 : 20272|1@1+ (1,0) [0|1] "bool" MCU
 SG_ OBJ_Open_Door_Right_20 : 20273|1@1+ (1,0) [0|1] "bool" MCU
 SG_ OBJ_Visible_Left_or_Right_20 : 20274|2@1+ (1,0) [0|2] "ENUM" MCU
 SG_ OBJ_Visible_Left_or_Right_V_20 : 20276|1@1+ (1,0) [0|1] "bool" MCU
 SG_ OBJ_2W_Is_Motorbike_Probability_20 : 20277|8@1+ (0.01,0) [0|1] "NA" MCU
 SG_ Reserved_26_20 : 20285|3@1+ (1,0) [0|0] "NA" MCU
 SG_ OBJ_2W_Is_Bicycle_Probability_20 : 20288|8@1+ (0.01,0) [0|1] "NA" MCU
 SG_ Reserved_27_20 : 20296|24@1+ (1,0) [0|0] "NA" MCU
 SG_ OBJ_CRC_21 : 20320|32@1+ (1,0) [0|4294967295] "NA" MCU
 SG_ OBJ_ID_21 : 20352|8@1+ (1,0) [0|255] "counter" MCU
 SG_ OBJ_Existence_Probability_21 : 20360|8@1+ (0.01,0) [0|1] "NA" MCU
 SG_ OBJ_Fusion_Source_21 : 20368|16@1+ (1,0) [0|65535] "BITWIZE" MCU
 SG_ OBJ_Triggered_SDM_21 : 20384|2@1+ (1,0) [0|2] "ENUM" MCU
 SG_ OBJ_Motion_Category_21 : 20386|4@1+ (1,0) [0|13] "ENUM" MCU
 SG_ OBJ_Moving_IN_Probability_21 : 20390|7@1+ (0.01,0) [0|1] "NA" MCU
 SG_ OBJ_Object_Age_21 : 20397|11@1+ (1,0) [0|2047] "frames" MCU
 SG_ OBJ_Measuring_Status_21 : 20408|3@1+ (1,0) [0|7] "BITWIZE" MCU
 SG_ OBJ_Object_Class_21 : 20411|4@1+ (1,0) [0|9] "ENUM" MCU
 SG_ Reserved_4_21 : 20415|1@1+ (1,0) [0|0] "NA" MCU
 SG_ OBJ_Class_Probability_21 : 20416|7@1+ (0.01,0) [0|1] "NA" MCU
 SG_ OBJ_Car_Probability_21 : 20423|7@1+ (0.01,0) [0|1] "NA" MCU
 SG_ OBJ_Truck_Probability_21 : 20430|7@1+ (0.01,0) [0|1] "NA" MCU
 SG_ OBJ_Bike_Probability_21 : 20437|7@1+ (0.01,0) [0|1] "NA" MCU
 SG_ OBJ_Camera_Source_21 : 20444|4@1+ (1,0) [0|15] "ENUM" MCU
 SG_ OBJ_Motion_Status_21 : 20448|3@1+ (1,0) [0|5] "ENUM" MCU
 SG_ OBJ_Motion_Orientation_21 : 20451|4@1+ (1,0) [0|13] "ENUM" MCU
 SG_ OBJ_Has_Cut_Lane_21 : 20455|1@1+ (1,0) [0|1] "bool" MCU
 SG_ OBJ_Has_Cut_Path_21 : 20456|1@1+ (1,0) [0|1] "bool" MCU
 SG_ OBJ_Brake_Light_Validity_21 : 20457|1@1+ (1,0) [0|1] "bool" MCU
 SG_ OBJ_Brake_Light_21 : 20458|1@1+ (1,0) [0|1] "bool" MCU
 SG_ OBJ_Turn_Indicator_Right_21 : 20459|1@1+ (1,0) [0|1] "bool" MCU
 SG_ OBJ_Turn_Indicator_Left_21 : 20460|1@1+ (1,0) [0|1] "bool" MCU
 SG_ OBJ_Turn_Indicator_Validity_21 : 20461|1@1+ (1,0) [0|1] "bool" MCU
 SG_ OBJ_Right_Out_Of_Image_21 : 20462|1@1+ (1,0) [0|1] "bool" MCU
 SG_ OBJ_Left_Out_Of_Image_21 : 20463|1@1+ (1,0) [0|1] "bool" MCU
 SG_ OBJ_Right_Out_Of_Image_V_21 : 20464|1@1+ (1,0) [0|1] "bool" MCU
 SG_ OBJ_Left_Out_Of_Image_V_21 : 20465|1@1+ (1,0) [0|1] "bool" MCU
 SG_ OBJ_Top_Out_Of_Image_21 : 20466|1@1+ (1,0) [0|1] "bool" MCU
 SG_ OBJ_Bottom_Out_Of_Image_21 : 20467|1@1+ (1,0) [0|1] "bool" MCU
 SG_ OBJ_Top_Out_Of_Image_V_21 : 20468|1@1+ (1,0) [0|1] "bool" MCU
 SG_ OBJ_Bottom_Out_Of_Image_V_21 : 20469|1@1+ (1,0) [0|1] "bool" MCU
 SG_ OBJ_Lane_Assignment_21 : 20470|3@1+ (1,0) [0|5] "ENUM" MCU
 SG_ OBJ_Lane_Assignment_V_21 : 20473|1@1+ (1,0) [0|1] "bool" MCU
 SG_ Reserved_5_21 : 20474|6@1+ (1,0) [0|0] "NA" MCU
 SG_ OBJ_Age_Seconds_21 : 20480|7@1+ (1,0) [0|100] "s" MCU
 SG_ OBJ_Age_Seconds_V_21 : 20487|1@1+ (1,0) [0|1] "bool" MCU
 SG_ OBJ_Width_21 : 20488|9@1+ (0.01,0) [0.4|2.95] "m" MCU
 SG_ OBJ_Width_V_21 : 20497|1@1+ (1,0) [0|1] "bool" MCU
 SG_ OBJ_Width_STD_21 : 20498|11@1+ (0.001,0) [0|2] "m" MCU
 SG_ OBJ_Width_STD_V_21 : 20509|1@1+ (1,0) [0|1] "bool" MCU
 SG_ Reserved_6_21 : 20510|2@1+ (1,0) [0|0] "NA" MCU
 SG_ OBJ_Length_21 : 20512|9@1+ (0.05,0) [0.6|21] "m" MCU
 SG_ OBJ_Length_V_21 : 20521|1@1+ (1,0) [0|1] "bool" MCU
 SG_ OBJ_Length_STD_21 : 20522|10@1+ (0.01,0) [0|10] "m" MCU
 SG_ OBJ_Length_STD_V_21 : 20532|1@1+ (1,0) [0|1] "bool" MCU
 SG_ OBJ_Radar_ID_21 : 20533|8@1+ (1,0) [0|255] "counter" MCU
 SG_ Reserved_7_21 : 20541|3@1+ (1,0) [0|0] "NA" MCU
 SG_ OBJ_Height_21 : 20544|9@1+ (0.01,0) [0|2.95] "m" MCU
 SG_ OBJ_Height_V_21 : 20553|1@1+ (1,0) [0|1] "bool" MCU
 SG_ OBJ_Height_STD_21 : 20554|11@1+ (0.001,0) [0|2] "m" MCU
 SG_ OBJ_Height_STD_V_21 : 20565|1@1+ (1,0) [0|1] "bool" MCU
 SG_ Reserved_8_21 : 20566|10@1+ (1,0) [0|0] "NA" MCU
 SG_ OBJ_Abs_Long_Velocity_21 : 20576|12@1+ (0.05,-100) [-100|100] "m_per_s" MCU
 SG_ OBJ_Abs_Long_Velocity_V_21 : 20588|1@1+ (1,0) [0|1] "bool" MCU
 SG_ OBJ_Abs_Long_Velocity_STD_21 : 20589|13@1+ (0.01,0) [0|65] "m_per_s" MCU
 SG_ OBJ_Abs_Long_Vel_STD_V_21 : 20602|1@1+ (1,0) [0|1] "bool" MCU
 SG_ Reserved_9_21 : 20603|5@1+ (1,0) [0|0] "NA" MCU
 SG_ OBJ_Abs_Lat_Velocity_21 : 20608|11@1+ (0.05,-50) [-50|50] "m_per_s" MCU
 SG_ OBJ_Abs_Lat_Velocity_V_21 : 20619|1@1+ (1,0) [0|1] "bool" MCU
 SG_ OBJ_Abs_Lat_Velocity_STD_21 : 20620|13@1+ (0.01,0) [0|50] "m_per_s" MCU
 SG_ OBJ_Abs_Lat_Vel_STD_V_21 : 20633|1@1+ (1,0) [0|1] "bool" MCU
 SG_ Reserved_10_21 : 20634|6@1+ (1,0) [0|0] "NA" MCU
 SG_ OBJ_Abs_Long_Acc_21 : 20640|9@1+ (0.05,-10) [-10|10] "m_per_s2" MCU
 SG_ OBJ_Abs_Long_Acc_V_21 : 20649|1@1+ (1,0) [0|1] "bool" MCU
 SG_ OBJ_Abs_Long_Acc_STD_21 : 20650|10@1+ (0.01,0) [0|7.3] "m_per_s2" MCU
 SG_ OBJ_Abs_Long_Acc_STD_V_21 : 20660|1@1+ (1,0) [0|1] "bool" MCU
 SG_ OBJ_Abs_Lat_Acc_21 : 20661|9@1+ (0.05,-10) [-10|10] "m_per_s2" MCU
 SG_ OBJ_Abs_Lat_Acc_V_21 : 20670|1@1+ (1,0) [0|1] "bool" MCU
 SG_ Reserved_11_21 : 20671|1@1+ (1,0) [0|0] "NA" MCU
 SG_ OBJ_Abs_Lat_Acc_STD_21 : 20672|10@1+ (0.01,0) [0|7.3] "m_per_s2" MCU
 SG_ OBJ_Abs_Lat_Acc_STD_V_21 : 20682|1@1+ (1,0) [0|1] "bool" MCU
 SG_ OBJ_Abs_Acceleration_21 : 20683|9@1+ (0.05,-12.7) [-12.7|12.7] "m_per_s2" MCU
 SG_ OBJ_Abs_Acceleration_V_21 : 20692|1@1+ (1,0) [0|1] "bool" MCU
 SG_ OBJ_Abs_Acc_STD_21 : 20693|10@1+ (0.01,0) [0|7.3] "m_per_s2" MCU
 SG_ OBJ_Abs_Acc_STD_V_21 : 20703|1@1+ (1,0) [0|1] "bool" MCU
 SG_ OBJ_Inv_TTC_21 : 20704|11@1+ (0.01,-8) [-8|8] "INV(s)" MCU
 SG_ OBJ_Inv_TTC_V_21 : 20715|1@1+ (1,0) [0|1] "bool" MCU
 SG_ OBJ_Inv_TTC_STD_21 : 20716|12@1+ (0.001,0) [0|4] "INV(s)" MCU
 SG_ OBJ_Inv_TTC_STD_V_21 : 20728|1@1+ (1,0) [0|1] "bool" MCU
 SG_ Reserved_12_21 : 20729|7@1+ (1,0) [0|0] "NA" MCU
 SG_ OBJ_Relative_Long_Acc_21 : 20736|10@1+ (0.05,-20) [-20|20] "m_per_s2" MCU
 SG_ OBJ_Relative_Long_Acc_V_21 : 20746|1@1+ (1,0) [0|1] "bool" MCU
 SG_ OBJ_Relative_Long_Acc_STD_21 : 20747|10@1+ (0.01,0) [0|7.3] "m_per_s2" MCU
 SG_ OBJ_Rel_Long_Acc_STD_V_21 : 20757|1@1+ (1,0) [0|1] "bool" MCU
 SG_ Reserved_13_21 : 20758|10@1+ (1,0) [0|0] "NA" MCU
 SG_ OBJ_Relative_Long_Velocity_21 : 20768|13@1+ (0.05,-120) [-120|130] "m_per_s" MCU
 SG_ OBJ_Relative_Long_Velocity_V_21 : 20781|1@1+ (1,0) [0|1] "bool" MCU
 SG_ OBJ_Relative_Long_Vel_STD_21 : 20782|14@1+ (0.01,0) [0|130] "m_per_s" MCU
 SG_ OBJ_Rel_Long_Vel_STD_V_21 : 20796|1@1+ (1,0) [0|1] "bool" MCU
 SG_ Reserved_14_21 : 20797|3@1+ (1,0) [0|0] "NA" MCU
 SG_ OBJ_Relative_Lat_Velocity_21 : 20800|11@1+ (0.05,-50) [-50|50] "m_per_s" MCU
 SG_ OBJ_Relative_Lat_Velocity_V_21 : 20811|1@1+ (1,0) [0|1] "bool" MCU
 SG_ OBJ_Relative_Lat_Velocity_STD_21 : 20812|13@1+ (0.01,0) [0|50] "m_per_s" MCU
 SG_ OBJ_Rel_Lat_Vel_STD_V_21 : 20825|1@1+ (1,0) [0|1] "bool" MCU
 SG_ Reserved_15_21 : 20826|6@1+ (1,0) [0|0] "NA" MCU
 SG_ OBJ_Long_Distance_21 : 20832|14@1+ (0.05,-200) [-200|500] "m" MCU
 SG_ OBJ_Long_Distance_V_21 : 20846|1@1+ (1,0) [0|1] "bool" MCU
 SG_ OBJ_Long_Distance_STD_21 : 20847|15@1+ (0.01,0) [0|250] "m" MCU
 SG_ OBJ_Long_Distance_STD_V_21 : 20862|1@1+ (1,0) [0|1] "bool" MCU
 SG_ Reserved_16_21 : 20863|1@1+ (1,0) [0|0] "NA" MCU
 SG_ OBJ_Lat_Distance_21 : 20864|12@1+ (0.05,-100) [-100|100] "m" MCU
 SG_ OBJ_Lat_Distance_V_21 : 20876|1@1+ (1,0) [0|1] "bool" MCU
 SG_ OBJ_Lat_Distance_STD_21 : 20877|14@1+ (0.01,0) [0|100] "m" MCU
 SG_ OBJ_Lat_Distance_STD_V_21 : 20891|1@1+ (1,0) [0|1] "bool" MCU
 SG_ Reserved_17_21 : 20892|4@1+ (1,0) [0|0] "NA" MCU
 SG_ OBJ_Absolute_Speed_21 : 20896|12@1+ (0.05,-65) [-65|65] "m_per_s" MCU
 SG_ OBJ_Absolute_Speed_V_21 : 20908|1@1+ (1,0) [0|1] "bool" MCU
 SG_ OBJ_Absolute_Speed_STD_21 : 20909|13@1+ (0.01,0) [0|65] "m_per_s" MCU
 SG_ OBJ_Absolute_Speed_STD_V_21 : 20922|1@1+ (1,0) [0|1] "bool" MCU
 SG_ Reserved_18_21 : 20923|5@1+ (1,0) [0|0] "NA" MCU
 SG_ OBJ_Heading_21 : 20928|10@1+ (0.01,-3.14) [-3.14|3.14] "rad" MCU
 SG_ OBJ_Heading_V_21 : 20938|1@1+ (1,0) [0|1] "bool" MCU
 SG_ OBJ_Heading_STD_21 : 20939|15@1+ (0.0001,0) [0|3.14] "rad" MCU
 SG_ OBJ_Heading_STD_V_21 : 20954|1@1+ (1,0) [0|1] "bool" MCU
 SG_ Reserved_19_21 : 20955|5@1+ (1,0) [0|0] "NA" MCU
 SG_ OBJ_Angle_Rate_STD_21 : 20960|15@1+ (0.0001,0) [0|2.2318] "RPS" MCU
 SG_ OBJ_Angle_Rate_STD_V_21 : 20975|1@1+ (1,0) [0|1] "bool" MCU
 SG_ OBJ_Angle_Rate_21 : 20976|12@1+ (0.002,-2.234) [-2.234|2.2318] "RPS" MCU
 SG_ OBJ_Angle_Rate_V_21 : 20988|1@1+ (1,0) [0|1] "bool" MCU
 SG_ Reserved_20_21 : 20989|3@1+ (1,0) [0|0] "NA" MCU
 SG_ OBJ_Angle_Right_21 : 20992|14@1+ (0.0002,-1.571) [-1.571|1.571] "rad" MCU
 SG_ OBJ_Angle_Right_V_21 : 21006|1@1+ (1,0) [0|1] "bool" MCU
 SG_ OBJ_Angle_Right_STD_21 : 21007|14@1+ (0.0001,0) [0|1.571] "rad" MCU
 SG_ OBJ_Angle_Right_STD_V_21 : 21021|1@1+ (1,0) [0|1] "bool" MCU
 SG_ Reserved_21_21 : 21022|2@1+ (1,0) [0|0] "NA" MCU
 SG_ OBJ_Angle_Left_21 : 21024|14@1+ (0.0002,-1.571) [-1.571|1.571] "rad" MCU
 SG_ OBJ_Angle_Left_V_21 : 21038|1@1+ (1,0) [0|1] "bool" MCU
 SG_ OBJ_Angle_Left_STD_21 : 21039|14@1+ (0.0001,0) [0|1.571] "rad" MCU
 SG_ OBJ_Angle_Left_STD_V_21 : 21053|1@1+ (1,0) [0|1] "bool" MCU
 SG_ Reserved_22_21 : 21054|2@1+ (1,0) [0|0] "NA" MCU
 SG_ OBJ_Angle_Side_21 : 21056|14@1+ (0.0002,-1.571) [-1.571|1.571] "rad" MCU
 SG_ OBJ_Angle_Side_V_21 : 21070|1@1+ (1,0) [0|1] "bool" MCU
 SG_ OBJ_Angle_Side_STD_21 : 21071|14@1+ (0.0001,0) [0|1.571] "rad" MCU
 SG_ OBJ_Angle_Side_STD_V_21 : 21085|1@1+ (1,0) [0|1] "bool" MCU
 SG_ OBJ_Angle_Mid_V_21 : 21086|1@1+ (1,0) [0|1] "bool" MCU
 SG_ Reserved_23_21 : 21087|1@1+ (1,0) [0|0] "NA" MCU
 SG_ OBJ_Angle_Mid_21 : 21088|14@1+ (0.0002,-1.571) [-1.571|1.571] "rad" MCU
 SG_ OBJ_Angle_Mid_STD_21 : 21102|14@1+ (0.0001,0) [0|1.571] "rad" MCU
 SG_ OBJ_Angle_Mid_STD_V_21 : 21116|1@1+ (1,0) [0|1] "bool" MCU
 SG_ OBJ_Angle_Bottom_V_21 : 21117|1@1+ (1,0) [0|1] "bool" MCU
 SG_ Reserved_24_21 : 21118|2@1+ (1,0) [0|0] "NA" MCU
 SG_ OBJ_Angle_Bottom_21 : 21120|14@1+ (0.0002,-1.571) [-1.571|1.571] "rad" MCU
 SG_ OBJ_Angle_Bottom_STD_21 : 21134|14@1+ (0.0001,0) [0|1.571] "rad" MCU
 SG_ OBJ_Angle_Bottom_STD_V_21 : 21148|1@1+ (1,0) [0|1] "bool" MCU
 SG_ OBJ_Visibility_Side_V_21 : 21149|1@1+ (1,0) [0|1] "bool" MCU
 SG_ OBJ_Visibility_Side_21 : 21150|2@1+ (1,0) [0|2] "ENUM" MCU
 SG_ OBJ_Is_In_Drivable_Area_21 : 21152|1@1+ (1,0) [0|1] "bool" MCU
 SG_ OBJ_Is_In_Drivable_Area_V_21 : 21153|1@1+ (1,0) [0|1] "bool" MCU
 SG_ OBJ_Is_VeryClose_V_21 : 21154|1@1+ (1,0) [0|1] "bool" MCU
 SG_ OBJ_Is_VeryClose_21 : 21155|1@1+ (1,0) [0|1] "bool" MCU
 SG_ OBJ_Buffer_C4_21 : 21156|2@1+ (1,0) [0|2] "NA" MCU
 SG_ OBJ_Buffer_C5_21 : 21158|2@1+ (1,0) [0|2] "NA" MCU
 SG_ OBJ_Buffer_C6_21 : 21160|2@1+ (1,0) [0|2] "NA" MCU
 SG_ OBJ_Buffer_C7_21 : 21162|2@1+ (1,0) [0|2] "NA" MCU
 SG_ OBJ_OverlapAngleEgoLaneR_21 : 21164|10@1+ (0.01,-3.14) [-3.14|3.14] "rad" MCU
 SG_ OBJ_OverlapAngleEgoLaneR_V_21 : 21174|1@1+ (1,0) [0|1] "bool" MCU
 SG_ Reserved_25_21 : 21175|9@1+ (1,0) [0|0] "NA" MCU
 SG_ OBJ_OverlapAngleEgoLaneL_21 : 21184|10@1+ (0.01,-3.14) [-3.14|3.14] "rad" MCU
 SG_ OBJ_OverlapAngleEgoLaneL_V_21 : 21194|1@1+ (1,0) [0|1] "bool" MCU
 SG_ OBJ_Is_EMERGENCY_VCL_21 : 21195|1@1+ (1,0) [0|1] "bool" MCU
 SG_ OBJ_EMERGENCY_LIGHT_COLOR_21 : 21196|4@1+ (1,0) [0|15] "BITWIZE" MCU
 SG_ OBJ_EMERGENCY_V_21 : 21200|1@1+ (1,0) [0|1] "bool" MCU
 SG_ OBJ_Angle_Top_21 : 21201|14@1+ (0.0002,0) [0|3.1415] "rad" MCU
 SG_ OBJ_Angle_Top_V_21 : 21215|1@1+ (1,0) [0|1] "bool" MCU
 SG_ OBJ_Angle_Top_STD_21 : 21216|15@1+ (0.0001,0) [0|3.1415] "rad" MCU
 SG_ OBJ_Angle_Top_STD_V_21 : 21231|1@1+ (1,0) [0|1] "bool" MCU
 SG_ OBJ_Open_Door_Left_21 : 21232|1@1+ (1,0) [0|1] "bool" MCU
 SG_ OBJ_Open_Door_Right_21 : 21233|1@1+ (1,0) [0|1] "bool" MCU
 SG_ OBJ_Visible_Left_or_Right_21 : 21234|2@1+ (1,0) [0|2] "ENUM" MCU
 SG_ OBJ_Visible_Left_or_Right_V_21 : 21236|1@1+ (1,0) [0|1] "bool" MCU
 SG_ OBJ_2W_Is_Motorbike_Probability_21 : 21237|8@1+ (0.01,0) [0|1] "NA" MCU
 SG_ Reserved_26_21 : 21245|3@1+ (1,0) [0|0] "NA" MCU
 SG_ OBJ_2W_Is_Bicycle_Probability_21 : 21248|8@1+ (0.01,0) [0|1] "NA" MCU
 SG_ Reserved_27_21 : 21256|24@1+ (1,0) [0|0] "NA" MCU
 SG_ OBJ_CRC_22 : 21280|32@1+ (1,0) [0|4294967295] "NA" MCU
 SG_ OBJ_ID_22 : 21312|8@1+ (1,0) [0|255] "counter" MCU
 SG_ OBJ_Existence_Probability_22 : 21320|8@1+ (0.01,0) [0|1] "NA" MCU
 SG_ OBJ_Fusion_Source_22 : 21328|16@1+ (1,0) [0|65535] "BITWIZE" MCU
 SG_ OBJ_Triggered_SDM_22 : 21344|2@1+ (1,0) [0|2] "ENUM" MCU
 SG_ OBJ_Motion_Category_22 : 21346|4@1+ (1,0) [0|13] "ENUM" MCU
 SG_ OBJ_Moving_IN_Probability_22 : 21350|7@1+ (0.01,0) [0|1] "NA" MCU
 SG_ OBJ_Object_Age_22 : 21357|11@1+ (1,0) [0|2047] "frames" MCU
 SG_ OBJ_Measuring_Status_22 : 21368|3@1+ (1,0) [0|7] "BITWIZE" MCU
 SG_ OBJ_Object_Class_22 : 21371|4@1+ (1,0) [0|9] "ENUM" MCU
 SG_ Reserved_4_22 : 21375|1@1+ (1,0) [0|0] "NA" MCU
 SG_ OBJ_Class_Probability_22 : 21376|7@1+ (0.01,0) [0|1] "NA" MCU
 SG_ OBJ_Car_Probability_22 : 21383|7@1+ (0.01,0) [0|1] "NA" MCU
 SG_ OBJ_Truck_Probability_22 : 21390|7@1+ (0.01,0) [0|1] "NA" MCU
 SG_ OBJ_Bike_Probability_22 : 21397|7@1+ (0.01,0) [0|1] "NA" MCU
 SG_ OBJ_Camera_Source_22 : 21404|4@1+ (1,0) [0|15] "ENUM" MCU
 SG_ OBJ_Motion_Status_22 : 21408|3@1+ (1,0) [0|5] "ENUM" MCU
 SG_ OBJ_Motion_Orientation_22 : 21411|4@1+ (1,0) [0|13] "ENUM" MCU
 SG_ OBJ_Has_Cut_Lane_22 : 21415|1@1+ (1,0) [0|1] "bool" MCU
 SG_ OBJ_Has_Cut_Path_22 : 21416|1@1+ (1,0) [0|1] "bool" MCU
 SG_ OBJ_Brake_Light_Validity_22 : 21417|1@1+ (1,0) [0|1] "bool" MCU
 SG_ OBJ_Brake_Light_22 : 21418|1@1+ (1,0) [0|1] "bool" MCU
 SG_ OBJ_Turn_Indicator_Right_22 : 21419|1@1+ (1,0) [0|1] "bool" MCU
 SG_ OBJ_Turn_Indicator_Left_22 : 21420|1@1+ (1,0) [0|1] "bool" MCU
 SG_ OBJ_Turn_Indicator_Validity_22 : 21421|1@1+ (1,0) [0|1] "bool" MCU
 SG_ OBJ_Right_Out_Of_Image_22 : 21422|1@1+ (1,0) [0|1] "bool" MCU
 SG_ OBJ_Left_Out_Of_Image_22 : 21423|1@1+ (1,0) [0|1] "bool" MCU
 SG_ OBJ_Right_Out_Of_Image_V_22 : 21424|1@1+ (1,0) [0|1] "bool" MCU
 SG_ OBJ_Left_Out_Of_Image_V_22 : 21425|1@1+ (1,0) [0|1] "bool" MCU
 SG_ OBJ_Top_Out_Of_Image_22 : 21426|1@1+ (1,0) [0|1] "bool" MCU
 SG_ OBJ_Bottom_Out_Of_Image_22 : 21427|1@1+ (1,0) [0|1] "bool" MCU
 SG_ OBJ_Top_Out_Of_Image_V_22 : 21428|1@1+ (1,0) [0|1] "bool" MCU
 SG_ OBJ_Bottom_Out_Of_Image_V_22 : 21429|1@1+ (1,0) [0|1] "bool" MCU
 SG_ OBJ_Lane_Assignment_22 : 21430|3@1+ (1,0) [0|5] "ENUM" MCU
 SG_ OBJ_Lane_Assignment_V_22 : 21433|1@1+ (1,0) [0|1] "bool" MCU
 SG_ Reserved_5_22 : 21434|6@1+ (1,0) [0|0] "NA" MCU
 SG_ OBJ_Age_Seconds_22 : 21440|7@1+ (1,0) [0|100] "s" MCU
 SG_ OBJ_Age_Seconds_V_22 : 21447|1@1+ (1,0) [0|1] "bool" MCU
 SG_ OBJ_Width_22 : 21448|9@1+ (0.01,0) [0.4|2.95] "m" MCU
 SG_ OBJ_Width_V_22 : 21457|1@1+ (1,0) [0|1] "bool" MCU
 SG_ OBJ_Width_STD_22 : 21458|11@1+ (0.001,0) [0|2] "m" MCU
 SG_ OBJ_Width_STD_V_22 : 21469|1@1+ (1,0) [0|1] "bool" MCU
 SG_ Reserved_6_22 : 21470|2@1+ (1,0) [0|0] "NA" MCU
 SG_ OBJ_Length_22 : 21472|9@1+ (0.05,0) [0.6|21] "m" MCU
 SG_ OBJ_Length_V_22 : 21481|1@1+ (1,0) [0|1] "bool" MCU
 SG_ OBJ_Length_STD_22 : 21482|10@1+ (0.01,0) [0|10] "m" MCU
 SG_ OBJ_Length_STD_V_22 : 21492|1@1+ (1,0) [0|1] "bool" MCU
 SG_ OBJ_Radar_ID_22 : 21493|8@1+ (1,0) [0|255] "counter" MCU
 SG_ Reserved_7_22 : 21501|3@1+ (1,0) [0|0] "NA" MCU
 SG_ OBJ_Height_22 : 21504|9@1+ (0.01,0) [0|2.95] "m" MCU
 SG_ OBJ_Height_V_22 : 21513|1@1+ (1,0) [0|1] "bool" MCU
 SG_ OBJ_Height_STD_22 : 21514|11@1+ (0.001,0) [0|2] "m" MCU
 SG_ OBJ_Height_STD_V_22 : 21525|1@1+ (1,0) [0|1] "bool" MCU
 SG_ Reserved_8_22 : 21526|10@1+ (1,0) [0|0] "NA" MCU
 SG_ OBJ_Abs_Long_Velocity_22 : 21536|12@1+ (0.05,-100) [-100|100] "m_per_s" MCU
 SG_ OBJ_Abs_Long_Velocity_V_22 : 21548|1@1+ (1,0) [0|1] "bool" MCU
 SG_ OBJ_Abs_Long_Velocity_STD_22 : 21549|13@1+ (0.01,0) [0|65] "m_per_s" MCU
 SG_ OBJ_Abs_Long_Vel_STD_V_22 : 21562|1@1+ (1,0) [0|1] "bool" MCU
 SG_ Reserved_9_22 : 21563|5@1+ (1,0) [0|0] "NA" MCU
 SG_ OBJ_Abs_Lat_Velocity_22 : 21568|11@1+ (0.05,-50) [-50|50] "m_per_s" MCU
 SG_ OBJ_Abs_Lat_Velocity_V_22 : 21579|1@1+ (1,0) [0|1] "bool" MCU
 SG_ OBJ_Abs_Lat_Velocity_STD_22 : 21580|13@1+ (0.01,0) [0|50] "m_per_s" MCU
 SG_ OBJ_Abs_Lat_Vel_STD_V_22 : 21593|1@1+ (1,0) [0|1] "bool" MCU
 SG_ Reserved_10_22 : 21594|6@1+ (1,0) [0|0] "NA" MCU
 SG_ OBJ_Abs_Long_Acc_22 : 21600|9@1+ (0.05,-10) [-10|10] "m_per_s2" MCU
 SG_ OBJ_Abs_Long_Acc_V_22 : 21609|1@1+ (1,0) [0|1] "bool" MCU
 SG_ OBJ_Abs_Long_Acc_STD_22 : 21610|10@1+ (0.01,0) [0|7.3] "m_per_s2" MCU
 SG_ OBJ_Abs_Long_Acc_STD_V_22 : 21620|1@1+ (1,0) [0|1] "bool" MCU
 SG_ OBJ_Abs_Lat_Acc_22 : 21621|9@1+ (0.05,-10) [-10|10] "m_per_s2" MCU
 SG_ OBJ_Abs_Lat_Acc_V_22 : 21630|1@1+ (1,0) [0|1] "bool" MCU
 SG_ Reserved_11_22 : 21631|1@1+ (1,0) [0|0] "NA" MCU
 SG_ OBJ_Abs_Lat_Acc_STD_22 : 21632|10@1+ (0.01,0) [0|7.3] "m_per_s2" MCU
 SG_ OBJ_Abs_Lat_Acc_STD_V_22 : 21642|1@1+ (1,0) [0|1] "bool" MCU
 SG_ OBJ_Abs_Acceleration_22 : 21643|9@1+ (0.05,-12.7) [-12.7|12.7] "m_per_s2" MCU
 SG_ OBJ_Abs_Acceleration_V_22 : 21652|1@1+ (1,0) [0|1] "bool" MCU
 SG_ OBJ_Abs_Acc_STD_22 : 21653|10@1+ (0.01,0) [0|7.3] "m_per_s2" MCU
 SG_ OBJ_Abs_Acc_STD_V_22 : 21663|1@1+ (1,0) [0|1] "bool" MCU
 SG_ OBJ_Inv_TTC_22 : 21664|11@1+ (0.01,-8) [-8|8] "INV(s)" MCU
 SG_ OBJ_Inv_TTC_V_22 : 21675|1@1+ (1,0) [0|1] "bool" MCU
 SG_ OBJ_Inv_TTC_STD_22 : 21676|12@1+ (0.001,0) [0|4] "INV(s)" MCU
 SG_ OBJ_Inv_TTC_STD_V_22 : 21688|1@1+ (1,0) [0|1] "bool" MCU
 SG_ Reserved_12_22 : 21689|7@1+ (1,0) [0|0] "NA" MCU
 SG_ OBJ_Relative_Long_Acc_22 : 21696|10@1+ (0.05,-20) [-20|20] "m_per_s2" MCU
 SG_ OBJ_Relative_Long_Acc_V_22 : 21706|1@1+ (1,0) [0|1] "bool" MCU
 SG_ OBJ_Relative_Long_Acc_STD_22 : 21707|10@1+ (0.01,0) [0|7.3] "m_per_s2" MCU
 SG_ OBJ_Rel_Long_Acc_STD_V_22 : 21717|1@1+ (1,0) [0|1] "bool" MCU
 SG_ Reserved_13_22 : 21718|10@1+ (1,0) [0|0] "NA" MCU
 SG_ OBJ_Relative_Long_Velocity_22 : 21728|13@1+ (0.05,-120) [-120|130] "m_per_s" MCU
 SG_ OBJ_Relative_Long_Velocity_V_22 : 21741|1@1+ (1,0) [0|1] "bool" MCU
 SG_ OBJ_Relative_Long_Vel_STD_22 : 21742|14@1+ (0.01,0) [0|130] "m_per_s" MCU
 SG_ OBJ_Rel_Long_Vel_STD_V_22 : 21756|1@1+ (1,0) [0|1] "bool" MCU
 SG_ Reserved_14_22 : 21757|3@1+ (1,0) [0|0] "NA" MCU
 SG_ OBJ_Relative_Lat_Velocity_22 : 21760|11@1+ (0.05,-50) [-50|50] "m_per_s" MCU
 SG_ OBJ_Relative_Lat_Velocity_V_22 : 21771|1@1+ (1,0) [0|1] "bool" MCU
 SG_ OBJ_Relative_Lat_Velocity_STD_22 : 21772|13@1+ (0.01,0) [0|50] "m_per_s" MCU
 SG_ OBJ_Rel_Lat_Vel_STD_V_22 : 21785|1@1+ (1,0) [0|1] "bool" MCU
 SG_ Reserved_15_22 : 21786|6@1+ (1,0) [0|0] "NA" MCU
 SG_ OBJ_Long_Distance_22 : 21792|14@1+ (0.05,-200) [-200|500] "m" MCU
 SG_ OBJ_Long_Distance_V_22 : 21806|1@1+ (1,0) [0|1] "bool" MCU
 SG_ OBJ_Long_Distance_STD_22 : 21807|15@1+ (0.01,0) [0|250] "m" MCU
 SG_ OBJ_Long_Distance_STD_V_22 : 21822|1@1+ (1,0) [0|1] "bool" MCU
 SG_ Reserved_16_22 : 21823|1@1+ (1,0) [0|0] "NA" MCU
 SG_ OBJ_Lat_Distance_22 : 21824|12@1+ (0.05,-100) [-100|100] "m" MCU
 SG_ OBJ_Lat_Distance_V_22 : 21836|1@1+ (1,0) [0|1] "bool" MCU
 SG_ OBJ_Lat_Distance_STD_22 : 21837|14@1+ (0.01,0) [0|100] "m" MCU
 SG_ OBJ_Lat_Distance_STD_V_22 : 21851|1@1+ (1,0) [0|1] "bool" MCU
 SG_ Reserved_17_22 : 21852|4@1+ (1,0) [0|0] "NA" MCU
 SG_ OBJ_Absolute_Speed_22 : 21856|12@1+ (0.05,-65) [-65|65] "m_per_s" MCU
 SG_ OBJ_Absolute_Speed_V_22 : 21868|1@1+ (1,0) [0|1] "bool" MCU
 SG_ OBJ_Absolute_Speed_STD_22 : 21869|13@1+ (0.01,0) [0|65] "m_per_s" MCU
 SG_ OBJ_Absolute_Speed_STD_V_22 : 21882|1@1+ (1,0) [0|1] "bool" MCU
 SG_ Reserved_18_22 : 21883|5@1+ (1,0) [0|0] "NA" MCU
 SG_ OBJ_Heading_22 : 21888|10@1+ (0.01,-3.14) [-3.14|3.14] "rad" MCU
 SG_ OBJ_Heading_V_22 : 21898|1@1+ (1,0) [0|1] "bool" MCU
 SG_ OBJ_Heading_STD_22 : 21899|15@1+ (0.0001,0) [0|3.14] "rad" MCU
 SG_ OBJ_Heading_STD_V_22 : 21914|1@1+ (1,0) [0|1] "bool" MCU
 SG_ Reserved_19_22 : 21915|5@1+ (1,0) [0|0] "NA" MCU
 SG_ OBJ_Angle_Rate_STD_22 : 21920|15@1+ (0.0001,0) [0|2.2318] "RPS" MCU
 SG_ OBJ_Angle_Rate_STD_V_22 : 21935|1@1+ (1,0) [0|1] "bool" MCU
 SG_ OBJ_Angle_Rate_22 : 21936|12@1+ (0.002,-2.234) [-2.234|2.2318] "RPS" MCU
 SG_ OBJ_Angle_Rate_V_22 : 21948|1@1+ (1,0) [0|1] "bool" MCU
 SG_ Reserved_20_22 : 21949|3@1+ (1,0) [0|0] "NA" MCU
 SG_ OBJ_Angle_Right_22 : 21952|14@1+ (0.0002,-1.571) [-1.571|1.571] "rad" MCU
 SG_ OBJ_Angle_Right_V_22 : 21966|1@1+ (1,0) [0|1] "bool" MCU
 SG_ OBJ_Angle_Right_STD_22 : 21967|14@1+ (0.0001,0) [0|1.571] "rad" MCU
 SG_ OBJ_Angle_Right_STD_V_22 : 21981|1@1+ (1,0) [0|1] "bool" MCU
 SG_ Reserved_21_22 : 21982|2@1+ (1,0) [0|0] "NA" MCU
 SG_ OBJ_Angle_Left_22 : 21984|14@1+ (0.0002,-1.571) [-1.571|1.571] "rad" MCU
 SG_ OBJ_Angle_Left_V_22 : 21998|1@1+ (1,0) [0|1] "bool" MCU
 SG_ OBJ_Angle_Left_STD_22 : 21999|14@1+ (0.0001,0) [0|1.571] "rad" MCU
 SG_ OBJ_Angle_Left_STD_V_22 : 22013|1@1+ (1,0) [0|1] "bool" MCU
 SG_ Reserved_22_22 : 22014|2@1+ (1,0) [0|0] "NA" MCU
 SG_ OBJ_Angle_Side_22 : 22016|14@1+ (0.0002,-1.571) [-1.571|1.571] "rad" MCU
 SG_ OBJ_Angle_Side_V_22 : 22030|1@1+ (1,0) [0|1] "bool" MCU
 SG_ OBJ_Angle_Side_STD_22 : 22031|14@1+ (0.0001,0) [0|1.571] "rad" MCU
 SG_ OBJ_Angle_Side_STD_V_22 : 22045|1@1+ (1,0) [0|1] "bool" MCU
 SG_ OBJ_Angle_Mid_V_22 : 22046|1@1+ (1,0) [0|1] "bool" MCU
 SG_ Reserved_23_22 : 22047|1@1+ (1,0) [0|0] "NA" MCU
 SG_ OBJ_Angle_Mid_22 : 22048|14@1+ (0.0002,-1.571) [-1.571|1.571] "rad" MCU
 SG_ OBJ_Angle_Mid_STD_22 : 22062|14@1+ (0.0001,0) [0|1.571] "rad" MCU
 SG_ OBJ_Angle_Mid_STD_V_22 : 22076|1@1+ (1,0) [0|1] "bool" MCU
 SG_ OBJ_Angle_Bottom_V_22 : 22077|1@1+ (1,0) [0|1] "bool" MCU
 SG_ Reserved_24_22 : 22078|2@1+ (1,0) [0|0] "NA" MCU
 SG_ OBJ_Angle_Bottom_22 : 22080|14@1+ (0.0002,-1.571) [-1.571|1.571] "rad" MCU
 SG_ OBJ_Angle_Bottom_STD_22 : 22094|14@1+ (0.0001,0) [0|1.571] "rad" MCU
 SG_ OBJ_Angle_Bottom_STD_V_22 : 22108|1@1+ (1,0) [0|1] "bool" MCU
 SG_ OBJ_Visibility_Side_V_22 : 22109|1@1+ (1,0) [0|1] "bool" MCU
 SG_ OBJ_Visibility_Side_22 : 22110|2@1+ (1,0) [0|2] "ENUM" MCU
 SG_ OBJ_Is_In_Drivable_Area_22 : 22112|1@1+ (1,0) [0|1] "bool" MCU
 SG_ OBJ_Is_In_Drivable_Area_V_22 : 22113|1@1+ (1,0) [0|1] "bool" MCU
 SG_ OBJ_Is_VeryClose_V_22 : 22114|1@1+ (1,0) [0|1] "bool" MCU
 SG_ OBJ_Is_VeryClose_22 : 22115|1@1+ (1,0) [0|1] "bool" MCU
 SG_ OBJ_Buffer_C4_22 : 22116|2@1+ (1,0) [0|2] "NA" MCU
 SG_ OBJ_Buffer_C5_22 : 22118|2@1+ (1,0) [0|2] "NA" MCU
 SG_ OBJ_Buffer_C6_22 : 22120|2@1+ (1,0) [0|2] "NA" MCU
 SG_ OBJ_Buffer_C7_22 : 22122|2@1+ (1,0) [0|2] "NA" MCU
 SG_ OBJ_OverlapAngleEgoLaneR_22 : 22124|10@1+ (0.01,-3.14) [-3.14|3.14] "rad" MCU
 SG_ OBJ_OverlapAngleEgoLaneR_V_22 : 22134|1@1+ (1,0) [0|1] "bool" MCU
 SG_ Reserved_25_22 : 22135|9@1+ (1,0) [0|0] "NA" MCU
 SG_ OBJ_OverlapAngleEgoLaneL_22 : 22144|10@1+ (0.01,-3.14) [-3.14|3.14] "rad" MCU
 SG_ OBJ_OverlapAngleEgoLaneL_V_22 : 22154|1@1+ (1,0) [0|1] "bool" MCU
 SG_ OBJ_Is_EMERGENCY_VCL_22 : 22155|1@1+ (1,0) [0|1] "bool" MCU
 SG_ OBJ_EMERGENCY_LIGHT_COLOR_22 : 22156|4@1+ (1,0) [0|15] "BITWIZE" MCU
 SG_ OBJ_EMERGENCY_V_22 : 22160|1@1+ (1,0) [0|1] "bool" MCU

CM_ SG_ 154 OBJ_Bottom_Out_Of_Image_17 "Indicates whether if measurment are predicted out of  the bottom of the image bounderies";
CM_ SG_ 154 OBJ_Top_Out_Of_Image_V_17 "validator";
CM_ SG_ 154 OBJ_Bottom_Out_Of_Image_V_17 "validator";
CM_ SG_ 154 OBJ_Lane_Assignment_17 "The object's lane relative to the host lane.";
CM_ SG_ 154 OBJ_Lane_Assignment_V_17 "Validator for lane assignment";
CM_ SG_ 154 OBJ_Age_Seconds_17 "Time in seconds in which the object was recognized. ";
CM_ SG_ 154 OBJ_Age_Seconds_V_17 "Validator for object age";
CM_ SG_ 154 OBJ_Width_17 "The width of the target vehicle in the world (not to be mistaken with the width of the visible part of the vehicle).";
CM_ SG_ 154 OBJ_Width_V_17 "Validator for object width";
CM_ SG_ 154 OBJ_Width_STD_17 "Standard deviation for object width";
CM_ SG_ 154 OBJ_Width_STD_V_17 "Validator for the standard deviation of object width";
CM_ SG_ 154 OBJ_Length_17 "The length of the vehicle in the world. For crossing bicycles it gives the viewed length of the bicycle.";
CM_ SG_ 154 OBJ_Length_V_17 "Validator for object length.";
CM_ SG_ 154 OBJ_Length_STD_17 "Standard deviation for object length.";
CM_ SG_ 154 OBJ_Length_STD_V_17 "Validator for the standard deviation of object length.";
CM_ SG_ 154 OBJ_Radar_ID_17 "Radar Object ID of the Fused Object, Only relvant when OBJ_Fusion_Source is not Camera only";
CM_ SG_ 154 OBJ_Height_17 "The height of the object in the world. ";
CM_ SG_ 154 OBJ_Height_V_17 "Validator for object height.";
CM_ SG_ 154 OBJ_Height_STD_17 "Standard deviation for object height.";
CM_ SG_ 154 OBJ_Height_STD_V_17 "Validator for the standard deviation of object height.";
CM_ SG_ 154 OBJ_Abs_Long_Velocity_17 "Absolute longitudinal velocity.";
CM_ SG_ 154 OBJ_Abs_Long_Velocity_V_17 "Validator for absolute longitudinal velocity.";
CM_ SG_ 154 OBJ_Abs_Long_Velocity_STD_17 "Standard deviation of absolute longitudinal velocity.";
CM_ SG_ 154 OBJ_Abs_Long_Vel_STD_V_17 "Validator for the standard deviation of the absolute longitudinal velocity.";
CM_ SG_ 154 OBJ_Abs_Lat_Velocity_17 "The lateral ground speed of the object.";
CM_ SG_ 154 OBJ_Abs_Lat_Velocity_V_17 "Validator for the lateral ground speed of the object.";
CM_ SG_ 154 OBJ_Abs_Lat_Velocity_STD_17 "STD of the lateral ground speed of the object.";
CM_ SG_ 154 OBJ_Abs_Lat_Vel_STD_V_17 "Validator for the STD of the lateral ground speed of the object.";
CM_ SG_ 154 OBJ_Abs_Long_Acc_17 "The longitudinal ground acceleration of the object.";
CM_ SG_ 154 OBJ_Abs_Long_Acc_V_17 "Validator for the longitudinal ground acceleration of the object.";
CM_ SG_ 154 OBJ_Abs_Long_Acc_STD_17 "STD of the longitudinal ground acceleration of the object.";
CM_ SG_ 154 OBJ_Abs_Long_Acc_STD_V_17 "Validator for the STD of the longitudinal ground acceleration of the object.";
CM_ SG_ 154 OBJ_Abs_Lat_Acc_17 "The lateral ground acceleration of the object.";
CM_ SG_ 154 OBJ_Abs_Lat_Acc_V_17 "Validator for the lateral ground acceleration of the object.";
CM_ SG_ 154 OBJ_Abs_Lat_Acc_STD_17 "STD of the lateral ground acceleration of the object.";
CM_ SG_ 154 OBJ_Abs_Lat_Acc_STD_V_17 "Validator for the STD of the lateral ground acceleration of the object.";
CM_ SG_ 154 OBJ_Abs_Acceleration_17 "The absolute ground acceleration in the target's heading direction.";
CM_ SG_ 154 OBJ_Abs_Acceleration_V_17 "Validator for the absolute ground acceleration.";
CM_ SG_ 154 OBJ_Abs_Acc_STD_17 "STD of the absolute ground acceleration.";
CM_ SG_ 154 OBJ_Abs_Acc_STD_V_17 "Validator for the STD of the absolute ground acceleration.";
CM_ SG_ 154 OBJ_Inv_TTC_17 "Inverse TTC (time to collision).";
CM_ SG_ 154 OBJ_Inv_TTC_STD_17 "STD for inverse TTC .";
CM_ SG_ 154 OBJ_Inv_TTC_STD_V_17 "Validator for the STD for inverse TTC .";
CM_ SG_ 154 OBJ_Relative_Long_Acc_17 "The relative longitudinal ground acceleration of the object.";
CM_ SG_ 154 OBJ_Relative_Long_Acc_V_17 "Validator for the relative longitudinal ground acceleration of the object.";
CM_ SG_ 154 OBJ_Relative_Long_Acc_STD_17 "STD of the relative longitudinal ground acceleration of the object.";
CM_ SG_ 154 OBJ_Rel_Long_Acc_STD_V_17 "Validator for the STD of the relative longitudinal ground acceleration.";
CM_ SG_ 154 OBJ_Relative_Long_Velocity_17 "The relative longtitudinal speed between the target and ego vehicle. ";
CM_ SG_ 154 OBJ_Relative_Long_Velocity_V_17 "Validator for the relative longtitudinal speed.";
CM_ SG_ 154 OBJ_Relative_Long_Vel_STD_17 "STD of the relative longtitudinal speed.";
CM_ SG_ 154 OBJ_Rel_Long_Vel_STD_V_17 "Validator for the STD of the relative longtitudinal speed.";
CM_ SG_ 154 OBJ_Relative_Lat_Velocity_17 "The relative lateral speed between the target and ego vehicle. ";
CM_ SG_ 154 OBJ_Relative_Lat_Velocity_V_17 "Validator for the relative lateral speed. ";
CM_ SG_ 154 OBJ_Relative_Lat_Velocity_STD_17 "STD of the relative lateral speed. ";
CM_ SG_ 154 OBJ_Rel_Lat_Vel_STD_V_17 "Validator for the STD of the relative lateral speed. ";
CM_ SG_ 154 OBJ_Long_Distance_17 "The longitudinal distance to middle of the rear bumper (middle of the RL and RR corners) of the target.";
CM_ SG_ 154 OBJ_Long_Distance_V_17 "Validator of the longtitudinal distance field";
CM_ SG_ 154 OBJ_Long_Distance_STD_17 "STD of the  longtitudinal distance.";
CM_ SG_ 154 OBJ_Long_Distance_STD_V_17 "Validator for the STD of the  longtitudinal distance.";
CM_ SG_ 154 OBJ_Lat_Distance_17 "Lateral distance to the middle of the RL and RR corners.  ";
CM_ SG_ 154 OBJ_Lat_Distance_V_17 "Validator for the lateral distance of the object.";
CM_ SG_ 154 OBJ_Lat_Distance_STD_17 "STD of the lateral distance of the object.";
CM_ SG_ 154 OBJ_Lat_Distance_STD_V_17 "Validator for the STD of the lateral distance of the object.";
CM_ SG_ 154 OBJ_Absolute_Speed_17 "The absolute ground speed in the targets' heading direction.";
CM_ SG_ 154 OBJ_Absolute_Speed_V_17 "Validator for the absolute ground speed.";
CM_ SG_ 154 OBJ_Absolute_Speed_STD_17 "STD of the absolute ground speed.";
CM_ SG_ 154 OBJ_Absolute_Speed_STD_V_17 "Validator for the STD of the absolute ground speed.";
CM_ SG_ 154 OBJ_Heading_17 "The angle beetweenthe host longitudinal axis and target's heading (clockwise, e.g. PI/2 is a target crossing from left to right).";
CM_ SG_ 154 OBJ_Heading_V_17 "Validator for the object heading.";
CM_ SG_ 154 OBJ_Heading_STD_17 "STD of the object heading.";
CM_ SG_ 154 OBJ_Heading_STD_V_17 "Validator for the STD of the object heading.";
CM_ SG_ 154 OBJ_Angle_Rate_STD_17 "Standard deviation of the angular speed. (radians)";
CM_ SG_ 154 OBJ_Angle_Rate_STD_V_17 "Validator for the STD of the angular speed.";
CM_ SG_ 154 OBJ_Angle_Rate_17 "The momentary angular speed of the object (radians). The positive side is to the host's right.";
CM_ SG_ 154 OBJ_Angle_Rate_V_17 "Validator for the angular speed.";
CM_ SG_ 154 OBJ_Angle_Right_17 "The angle between the host longitudinal axis and the right side of the front / rear of the target (the visible one). The positive side is to the host's right.";
CM_ SG_ 154 OBJ_Angle_Right_V_17 "Validator for angleRight";
CM_ SG_ 154 OBJ_Angle_Right_STD_17 "Standard deviation of angleRight";
CM_ SG_ 154 OBJ_Angle_Right_STD_V_17 "Validator for the standard deviation of angleRight.";
CM_ SG_ 154 OBJ_Angle_Left_17 "The angle between the host longitudinal axis and the left side of the front / rear of the target (the visible one). The positive side is to the host's right.";
CM_ SG_ 154 OBJ_Angle_Left_V_17 "Validator for angleLeft.";
CM_ SG_ 154 OBJ_Angle_Left_STD_17 "Standard deviation of angleLeft.";
CM_ SG_ 154 OBJ_Angle_Left_STD_V_17 "Validator for the standard deviation of angleLeft.";
CM_ SG_ 154 OBJ_Angle_Side_17 "The angle between the host longitudinal axis and the far visible edge - the visible edge of the front / rear of the target that is not visible. Currently supported for vehicles only.";
CM_ SG_ 154 OBJ_Angle_Side_V_17 "Validator for angleSide.";
CM_ SG_ 154 OBJ_Angle_Side_STD_17 "Standard deviation of angleSide.";
CM_ SG_ 154 OBJ_Angle_Side_STD_V_17 "Validator for the STD of angleSide.";
CM_ SG_ 154 OBJ_Angle_Mid_V_17 "Validator for angleMid.";
CM_ SG_ 154 OBJ_Angle_Mid_17 "The angle between the host longitudinal axis and the middle of the front / rear of the target (the visible one). The positive side is to the host's right.";
CM_ SG_ 154 OBJ_Angle_Mid_STD_17 "Standard deviation of angleMid.";
CM_ SG_ 154 OBJ_Angle_Mid_STD_V_17 "Validator for the STD of angleMid.";
CM_ SG_ 154 OBJ_Angle_Bottom_V_17 "Validator for OBJAngle_Bottom. ";
CM_ SG_ 154 OBJ_Angle_Bottom_17 "The angle between the longitudinal axis and the Bottom of the front / rear of the target (the visible one). The positive side is to the host's bottom";
CM_ SG_ 154 OBJ_Angle_Bottom_STD_17 "STD for OBJAngle_Bottom. ";
CM_ SG_ 154 OBJ_Angle_Bottom_STD_V_17 "Validator for OBJAngle_Bottom_STD. ";
CM_ SG_ 154 OBJ_Visibility_Side_V_17 "Currently Supported for VD only";
CM_ SG_ 154 OBJ_Visibility_Side_17 "From what car  side is the object visible";
CM_ SG_ 154 OBJ_Is_In_Drivable_Area_17 "Indicates whether the target is in a driveable area.";
CM_ SG_ 154 OBJ_Is_In_Drivable_Area_V_17 "Validator for OBJ_Is_In_Drivable_Area.";
CM_ SG_ 154 OBJ_Is_VeryClose_V_17 "Validator for OBJ_Is_VeryClose. ";
CM_ SG_ 154 OBJ_Is_VeryClose_17 "Indicates whether the target is very close to the host such that it is hard to measure its distance. Currently relevant for peds only";
CM_ SG_ 154 OBJ_OverlapAngleEgoLaneR_17 "Lateral distance to the middle of the RL and RR corners.";
CM_ SG_ 154 OBJ_OverlapAngleEgoLaneR_V_17 "Validator for OBJ_OverlapAngleEgoLaneR";
CM_ SG_ 154 OBJ_OverlapAngleEgoLaneL_17 "Lateral distance to the middle of the RL and RR corners.  ";
CM_ SG_ 154 OBJ_OverlapAngleEgoLaneL_V_17 "Validator for OBJ_OverlapAngleEgoLaneL";
CM_ SG_ 154 OBJ_Is_EMERGENCY_VCL_17 "Is Object an Emergency Vehicle";
CM_ SG_ 154 OBJ_EMERGENCY_LIGHT_COLOR_17 "Emergency Color";
CM_ SG_ 154 OBJ_EMERGENCY_V_17 "Are OBJ_Is_EMERGENCY_VCL and OBJ_EMERGENCY_LIGHT_COLOR Valid";
CM_ SG_ 154 OBJ_Angle_Top_17 "From VD touching point on the ground till the roof of the car";
CM_ SG_ 154 OBJ_Angle_Top_V_17 "Validator for OBJ_Angle_Top ";
CM_ SG_ 154 OBJ_Angle_Top_STD_17 "STD for OBJ_Angle_Top";
CM_ SG_ 154 OBJ_Angle_Top_STD_V_17 "Validator for OBJ_Angle_Top_STD. ";
CM_ SG_ 154 OBJ_Open_Door_Left_17 "Indicator if left door is open";
CM_ SG_ 154 OBJ_Open_Door_Right_17 "Indicator if right door is open";
CM_ SG_ 154 OBJ_Visible_Left_or_Right_17 "This signal describes the visible Left or Right side of the Target vehicle.";
CM_ SG_ 154 OBJ_Visible_Left_or_Right_V_17 "OBJ_Visible_Left_or_Right";
CM_ SG_ 154 OBJ_2W_Is_Motorbike_Probability_17 "The probability of the Two-wheeler reported object being a Motorbike";
CM_ SG_ 154 OBJ_2W_Is_Bicycle_Probability_17 "The probability of the Two-wheeler reported object being a Bicycle";
CM_ SG_ 154 OBJ_CRC_18 "Calculated over all element signals. From the signal after the CRC until the first signal in the next elements OBJ_CRC_N+1  not including";
CM_ SG_ 154 OBJ_ID_18 "The detected object ID. Range is 1-255, while 0 indicates that the field in unfilled.";
CM_ SG_ 154 OBJ_Existence_Probability_18 "The existence probability of the reported object";
CM_ SG_ 154 OBJ_Fusion_Source_18 "sources ids used for fusion";
CM_ SG_ 154 OBJ_Triggered_SDM_18 "Indicates whether the object has trigered the SDM (Safety Diagnostic Manager) alert.";
CM_ SG_ 154 OBJ_Motion_Category_18 "Relevant for VD only. Full description of values can be found at the ACC guide.";
CM_ SG_ 154 OBJ_Moving_IN_Probability_18 "The probability the object is eventually move into ego lane. (In case that the OBJ_Motion_Category signal is set to  MOVING_IN ";
CM_ SG_ 154 OBJ_Object_Age_18 "The number of frames in which the object was recognized.";
CM_ SG_ 154 OBJ_Measuring_Status_18 "Measurment status. Old vs New marks if this is the first frame in which the object is reported. Predicted vs Measured marks if the report is raw or has been predicted forward in time using the measured dynamics and ego motion.";
CM_ SG_ 154 OBJ_Object_Class_18 "Indicates the object type. Uncertain is outputted in case the probability that a vehicle is a truck is very similar to the probability that it is a car.";
CM_ SG_ 154 OBJ_Class_Probability_18 "The probability of this type classification.";
CM_ SG_ 154 OBJ_Car_Probability_18 "The probability the object is a car";
CM_ SG_ 154 OBJ_Truck_Probability_18 "The probability the object is a Truck";
CM_ SG_ 154 OBJ_Bike_Probability_18 "The probability the object is a Bike";
CM_ SG_ 154 OBJ_Camera_Source_18 "The camera in which this object was detected (best choice).";
CM_ SG_ 154 OBJ_Motion_Status_18 "MOVING - the object is moving STATIONARY - the object was never seen moving STOPPED -  the object was moving and has stopped MOVING_SLOWLY - the object is moving very slowly";
CM_ SG_ 154 OBJ_Motion_Orientation_18 "The direction of the targets heading compared to the host. ";
CM_ SG_ 154 OBJ_Has_Cut_Lane_18 "Indicates whether the object cut the host's (right or left) lane. In case there are no lanes, indicates whether the objects is at most 1 meters away from the host.";
CM_ SG_ 154 OBJ_Has_Cut_Path_18 "Indicates whether the object is in the host's path.";
CM_ SG_ 154 OBJ_Brake_Light_Validity_18 "Validator for braking light indicator";
CM_ SG_ 154 OBJ_Brake_Light_18 "Indication for brake lights ";
CM_ SG_ 154 OBJ_Turn_Indicator_Right_18 "Indication for blinking right light.";
CM_ SG_ 154 OBJ_Turn_Indicator_Left_18 "Indication for blinking left light ";
CM_ SG_ 154 OBJ_Turn_Indicator_Validity_18 "Validator for light indicators";
CM_ SG_ 154 OBJ_Right_Out_Of_Image_18 "Indicates whether the measurment are predicted out of the right side of the image bounderies.";
CM_ SG_ 154 OBJ_Left_Out_Of_Image_18 "Indicates whether if measurment are predicted out of  the left side of the image bounderies";
CM_ SG_ 154 OBJ_Right_Out_Of_Image_V_18 "validator";
CM_ SG_ 154 OBJ_Left_Out_Of_Image_V_18 "validator";
CM_ SG_ 154 OBJ_Top_Out_Of_Image_18 "Indicates whether if measurment are predicted out of  the top of the image bounderies";
CM_ SG_ 154 OBJ_Bottom_Out_Of_Image_18 "Indicates whether if measurment are predicted out of  the bottom of the image bounderies";
CM_ SG_ 154 OBJ_Top_Out_Of_Image_V_18 "validator";
CM_ SG_ 154 OBJ_Bottom_Out_Of_Image_V_18 "validator";
CM_ SG_ 154 OBJ_Lane_Assignment_18 "The object's lane relative to the host lane.";
CM_ SG_ 154 OBJ_Lane_Assignment_V_18 "Validator for lane assignment";
CM_ SG_ 154 OBJ_Age_Seconds_18 "Time in seconds in which the object was recognized. ";
CM_ SG_ 154 OBJ_Age_Seconds_V_18 "Validator for object age";
CM_ SG_ 154 OBJ_Width_18 "The width of the target vehicle in the world (not to be mistaken with the width of the visible part of the vehicle).";
CM_ SG_ 154 OBJ_Width_V_18 "Validator for object width";
CM_ SG_ 154 OBJ_Width_STD_18 "Standard deviation for object width";
CM_ SG_ 154 OBJ_Width_STD_V_18 "Validator for the standard deviation of object width";
CM_ SG_ 154 OBJ_Length_18 "The length of the vehicle in the world. For crossing bicycles it gives the viewed length of the bicycle.";
CM_ SG_ 154 OBJ_Length_V_18 "Validator for object length.";
CM_ SG_ 154 OBJ_Length_STD_18 "Standard deviation for object length.";
CM_ SG_ 154 OBJ_Length_STD_V_18 "Validator for the standard deviation of object length.";
CM_ SG_ 154 OBJ_Radar_ID_18 "Radar Object ID of the Fused Object, Only relvant when OBJ_Fusion_Source is not Camera only";
CM_ SG_ 154 OBJ_Height_18 "The height of the object in the world. ";
CM_ SG_ 154 OBJ_Height_V_18 "Validator for object height.";
CM_ SG_ 154 OBJ_Height_STD_18 "Standard deviation for object height.";
CM_ SG_ 154 OBJ_Height_STD_V_18 "Validator for the standard deviation of object height.";
CM_ SG_ 154 OBJ_Abs_Long_Velocity_18 "Absolute longitudinal velocity.";
CM_ SG_ 154 OBJ_Abs_Long_Velocity_V_18 "Validator for absolute longitudinal velocity.";
CM_ SG_ 154 OBJ_Abs_Long_Velocity_STD_18 "Standard deviation of absolute longitudinal velocity.";
CM_ SG_ 154 OBJ_Abs_Long_Vel_STD_V_18 "Validator for the standard deviation of the absolute longitudinal velocity.";
CM_ SG_ 154 OBJ_Abs_Lat_Velocity_18 "The lateral ground speed of the object.";
CM_ SG_ 154 OBJ_Abs_Lat_Velocity_V_18 "Validator for the lateral ground speed of the object.";
CM_ SG_ 154 OBJ_Abs_Lat_Velocity_STD_18 "STD of the lateral ground speed of the object.";
CM_ SG_ 154 OBJ_Abs_Lat_Vel_STD_V_18 "Validator for the STD of the lateral ground speed of the object.";
CM_ SG_ 154 OBJ_Abs_Long_Acc_18 "The longitudinal ground acceleration of the object.";
CM_ SG_ 154 OBJ_Abs_Long_Acc_V_18 "Validator for the longitudinal ground acceleration of the object.";
CM_ SG_ 154 OBJ_Abs_Long_Acc_STD_18 "STD of the longitudinal ground acceleration of the object.";
CM_ SG_ 154 OBJ_Abs_Long_Acc_STD_V_18 "Validator for the STD of the longitudinal ground acceleration of the object.";
CM_ SG_ 154 OBJ_Abs_Lat_Acc_18 "The lateral ground acceleration of the object.";
CM_ SG_ 154 OBJ_Abs_Lat_Acc_V_18 "Validator for the lateral ground acceleration of the object.";
CM_ SG_ 154 OBJ_Abs_Lat_Acc_STD_18 "STD of the lateral ground acceleration of the object.";
CM_ SG_ 154 OBJ_Abs_Lat_Acc_STD_V_18 "Validator for the STD of the lateral ground acceleration of the object.";
CM_ SG_ 154 OBJ_Abs_Acceleration_18 "The absolute ground acceleration in the target's heading direction.";
CM_ SG_ 154 OBJ_Abs_Acceleration_V_18 "Validator for the absolute ground acceleration.";
CM_ SG_ 154 OBJ_Abs_Acc_STD_18 "STD of the absolute ground acceleration.";
CM_ SG_ 154 OBJ_Abs_Acc_STD_V_18 "Validator for the STD of the absolute ground acceleration.";
CM_ SG_ 154 OBJ_Inv_TTC_18 "Inverse TTC (time to collision).";
CM_ SG_ 154 OBJ_Inv_TTC_STD_18 "STD for inverse TTC .";
CM_ SG_ 154 OBJ_Inv_TTC_STD_V_18 "Validator for the STD for inverse TTC .";
CM_ SG_ 154 OBJ_Relative_Long_Acc_18 "The relative longitudinal ground acceleration of the object.";
CM_ SG_ 154 OBJ_Relative_Long_Acc_V_18 "Validator for the relative longitudinal ground acceleration of the object.";
CM_ SG_ 154 OBJ_Relative_Long_Acc_STD_18 "STD of the relative longitudinal ground acceleration of the object.";
CM_ SG_ 154 OBJ_Rel_Long_Acc_STD_V_18 "Validator for the STD of the relative longitudinal ground acceleration.";
CM_ SG_ 154 OBJ_Relative_Long_Velocity_18 "The relative longtitudinal speed between the target and ego vehicle. ";
CM_ SG_ 154 OBJ_Relative_Long_Velocity_V_18 "Validator for the relative longtitudinal speed.";
CM_ SG_ 154 OBJ_Relative_Long_Vel_STD_18 "STD of the relative longtitudinal speed.";
CM_ SG_ 154 OBJ_Rel_Long_Vel_STD_V_18 "Validator for the STD of the relative longtitudinal speed.";
CM_ SG_ 154 OBJ_Relative_Lat_Velocity_18 "The relative lateral speed between the target and ego vehicle. ";
CM_ SG_ 154 OBJ_Relative_Lat_Velocity_V_18 "Validator for the relative lateral speed. ";
CM_ SG_ 154 OBJ_Relative_Lat_Velocity_STD_18 "STD of the relative lateral speed. ";
CM_ SG_ 154 OBJ_Rel_Lat_Vel_STD_V_18 "Validator for the STD of the relative lateral speed. ";
CM_ SG_ 154 OBJ_Long_Distance_18 "The longitudinal distance to middle of the rear bumper (middle of the RL and RR corners) of the target.";
CM_ SG_ 154 OBJ_Long_Distance_V_18 "Validator of the longtitudinal distance field";
CM_ SG_ 154 OBJ_Long_Distance_STD_18 "STD of the  longtitudinal distance.";
CM_ SG_ 154 OBJ_Long_Distance_STD_V_18 "Validator for the STD of the  longtitudinal distance.";
CM_ SG_ 154 OBJ_Lat_Distance_18 "Lateral distance to the middle of the RL and RR corners.  ";
CM_ SG_ 154 OBJ_Lat_Distance_V_18 "Validator for the lateral distance of the object.";
CM_ SG_ 154 OBJ_Lat_Distance_STD_18 "STD of the lateral distance of the object.";
CM_ SG_ 154 OBJ_Lat_Distance_STD_V_18 "Validator for the STD of the lateral distance of the object.";
CM_ SG_ 154 OBJ_Absolute_Speed_18 "The absolute ground speed in the targets' heading direction.";
CM_ SG_ 154 OBJ_Absolute_Speed_V_18 "Validator for the absolute ground speed.";
CM_ SG_ 154 OBJ_Absolute_Speed_STD_18 "STD of the absolute ground speed.";
CM_ SG_ 154 OBJ_Absolute_Speed_STD_V_18 "Validator for the STD of the absolute ground speed.";
CM_ SG_ 154 OBJ_Heading_18 "The angle beetweenthe host longitudinal axis and target's heading (clockwise, e.g. PI/2 is a target crossing from left to right).";
CM_ SG_ 154 OBJ_Heading_V_18 "Validator for the object heading.";
CM_ SG_ 154 OBJ_Heading_STD_18 "STD of the object heading.";
CM_ SG_ 154 OBJ_Heading_STD_V_18 "Validator for the STD of the object heading.";
CM_ SG_ 154 OBJ_Angle_Rate_STD_18 "Standard deviation of the angular speed. (radians)";
CM_ SG_ 154 OBJ_Angle_Rate_STD_V_18 "Validator for the STD of the angular speed.";
CM_ SG_ 154 OBJ_Angle_Rate_18 "The momentary angular speed of the object (radians). The positive side is to the host's right.";
CM_ SG_ 154 OBJ_Angle_Rate_V_18 "Validator for the angular speed.";
CM_ SG_ 154 OBJ_Angle_Right_18 "The angle between the host longitudinal axis and the right side of the front / rear of the target (the visible one). The positive side is to the host's right.";
CM_ SG_ 154 OBJ_Angle_Right_V_18 "Validator for angleRight";
CM_ SG_ 154 OBJ_Angle_Right_STD_18 "Standard deviation of angleRight";
CM_ SG_ 154 OBJ_Angle_Right_STD_V_18 "Validator for the standard deviation of angleRight.";
CM_ SG_ 154 OBJ_Angle_Left_18 "The angle between the host longitudinal axis and the left side of the front / rear of the target (the visible one). The positive side is to the host's right.";
CM_ SG_ 154 OBJ_Angle_Left_V_18 "Validator for angleLeft.";
CM_ SG_ 154 OBJ_Angle_Left_STD_18 "Standard deviation of angleLeft.";
CM_ SG_ 154 OBJ_Angle_Left_STD_V_18 "Validator for the standard deviation of angleLeft.";
CM_ SG_ 154 OBJ_Angle_Side_18 "The angle between the host longitudinal axis and the far visible edge - the visible edge of the front / rear of the target that is not visible. Currently supported for vehicles only.";
CM_ SG_ 154 OBJ_Angle_Side_V_18 "Validator for angleSide.";
CM_ SG_ 154 OBJ_Angle_Side_STD_18 "Standard deviation of angleSide.";
CM_ SG_ 154 OBJ_Angle_Side_STD_V_18 "Validator for the STD of angleSide.";
CM_ SG_ 154 OBJ_Angle_Mid_V_18 "Validator for angleMid.";
CM_ SG_ 154 OBJ_Angle_Mid_18 "The angle between the host longitudinal axis and the middle of the front / rear of the target (the visible one). The positive side is to the host's right.";
CM_ SG_ 154 OBJ_Angle_Mid_STD_18 "Standard deviation of angleMid.";
CM_ SG_ 154 OBJ_Angle_Mid_STD_V_18 "Validator for the STD of angleMid.";
CM_ SG_ 154 OBJ_Angle_Bottom_V_18 "Validator for OBJAngle_Bottom. ";
CM_ SG_ 154 OBJ_Angle_Bottom_18 "The angle between the longitudinal axis and the Bottom of the front / rear of the target (the visible one). The positive side is to the host's bottom";
CM_ SG_ 154 OBJ_Angle_Bottom_STD_18 "STD for OBJAngle_Bottom. ";
CM_ SG_ 154 OBJ_Angle_Bottom_STD_V_18 "Validator for OBJAngle_Bottom_STD. ";
CM_ SG_ 154 OBJ_Visibility_Side_V_18 "Currently Supported for VD only";
CM_ SG_ 154 OBJ_Visibility_Side_18 "From what car  side is the object visible";
CM_ SG_ 154 OBJ_Is_In_Drivable_Area_18 "Indicates whether the target is in a driveable area.";
CM_ SG_ 154 OBJ_Is_In_Drivable_Area_V_18 "Validator for OBJ_Is_In_Drivable_Area.";
CM_ SG_ 154 OBJ_Is_VeryClose_V_18 "Validator for OBJ_Is_VeryClose. ";
CM_ SG_ 154 OBJ_Is_VeryClose_18 "Indicates whether the target is very close to the host such that it is hard to measure its distance. Currently relevant for peds only";
CM_ SG_ 154 OBJ_OverlapAngleEgoLaneR_18 "Lateral distance to the middle of the RL and RR corners.";
CM_ SG_ 154 OBJ_OverlapAngleEgoLaneR_V_18 "Validator for OBJ_OverlapAngleEgoLaneR";
CM_ SG_ 154 OBJ_OverlapAngleEgoLaneL_18 "Lateral distance to the middle of the RL and RR corners.  ";
CM_ SG_ 154 OBJ_OverlapAngleEgoLaneL_V_18 "Validator for OBJ_OverlapAngleEgoLaneL";
CM_ SG_ 154 OBJ_Is_EMERGENCY_VCL_18 "Is Object an Emergency Vehicle";
CM_ SG_ 154 OBJ_EMERGENCY_LIGHT_COLOR_18 "Emergency Color";
CM_ SG_ 154 OBJ_EMERGENCY_V_18 "Are OBJ_Is_EMERGENCY_VCL and OBJ_EMERGENCY_LIGHT_COLOR Valid";
CM_ SG_ 154 OBJ_Angle_Top_18 "From VD touching point on the ground till the roof of the car";
CM_ SG_ 154 OBJ_Angle_Top_V_18 "Validator for OBJ_Angle_Top ";
CM_ SG_ 154 OBJ_Angle_Top_STD_18 "STD for OBJ_Angle_Top";
CM_ SG_ 154 OBJ_Angle_Top_STD_V_18 "Validator for OBJ_Angle_Top_STD. ";
CM_ SG_ 154 OBJ_Open_Door_Left_18 "Indicator if left door is open";
CM_ SG_ 154 OBJ_Open_Door_Right_18 "Indicator if right door is open";
CM_ SG_ 154 OBJ_Visible_Left_or_Right_18 "This signal describes the visible Left or Right side of the Target vehicle.";
CM_ SG_ 154 OBJ_Visible_Left_or_Right_V_18 "OBJ_Visible_Left_or_Right";
CM_ SG_ 154 OBJ_2W_Is_Motorbike_Probability_18 "The probability of the Two-wheeler reported object being a Motorbike";
CM_ SG_ 154 OBJ_2W_Is_Bicycle_Probability_18 "The probability of the Two-wheeler reported object being a Bicycle";
CM_ SG_ 154 OBJ_CRC_19 "Calculated over all element signals. From the signal after the CRC until the first signal in the next elements OBJ_CRC_N+1  not including";
CM_ SG_ 154 OBJ_ID_19 "The detected object ID. Range is 1-255, while 0 indicates that the field in unfilled.";
CM_ SG_ 154 OBJ_Existence_Probability_19 "The existence probability of the reported object";
CM_ SG_ 154 OBJ_Fusion_Source_19 "sources ids used for fusion";
CM_ SG_ 154 OBJ_Triggered_SDM_19 "Indicates whether the object has trigered the SDM (Safety Diagnostic Manager) alert.";
CM_ SG_ 154 OBJ_Motion_Category_19 "Relevant for VD only. Full description of values can be found at the ACC guide.";
CM_ SG_ 154 OBJ_Moving_IN_Probability_19 "The probability the object is eventually move into ego lane. (In case that the OBJ_Motion_Category signal is set to  MOVING_IN ";
CM_ SG_ 154 OBJ_Object_Age_19 "The number of frames in which the object was recognized.";
CM_ SG_ 154 OBJ_Measuring_Status_19 "Measurment status. Old vs New marks if this is the first frame in which the object is reported. Predicted vs Measured marks if the report is raw or has been predicted forward in time using the measured dynamics and ego motion.";
CM_ SG_ 154 OBJ_Object_Class_19 "Indicates the object type. Uncertain is outputted in case the probability that a vehicle is a truck is very similar to the probability that it is a car.";
CM_ SG_ 154 OBJ_Class_Probability_19 "The probability of this type classification.";
CM_ SG_ 154 OBJ_Car_Probability_19 "The probability the object is a car";
CM_ SG_ 154 OBJ_Truck_Probability_19 "The probability the object is a Truck";
CM_ SG_ 154 OBJ_Bike_Probability_19 "The probability the object is a Bike";
CM_ SG_ 154 OBJ_Camera_Source_19 "The camera in which this object was detected (best choice).";
CM_ SG_ 154 OBJ_Motion_Status_19 "MOVING - the object is moving STATIONARY - the object was never seen moving STOPPED -  the object was moving and has stopped MOVING_SLOWLY - the object is moving very slowly";
CM_ SG_ 154 OBJ_Motion_Orientation_19 "The direction of the targets heading compared to the host. ";
CM_ SG_ 154 OBJ_Has_Cut_Lane_19 "Indicates whether the object cut the host's (right or left) lane. In case there are no lanes, indicates whether the objects is at most 1 meters away from the host.";
CM_ SG_ 154 OBJ_Has_Cut_Path_19 "Indicates whether the object is in the host's path.";
CM_ SG_ 154 OBJ_Brake_Light_Validity_19 "Validator for braking light indicator";
CM_ SG_ 154 OBJ_Brake_Light_19 "Indication for brake lights ";
CM_ SG_ 154 OBJ_Turn_Indicator_Right_19 "Indication for blinking right light.";
CM_ SG_ 154 OBJ_Turn_Indicator_Left_19 "Indication for blinking left light ";
CM_ SG_ 154 OBJ_Turn_Indicator_Validity_19 "Validator for light indicators";
CM_ SG_ 154 OBJ_Right_Out_Of_Image_19 "Indicates whether the measurment are predicted out of the right side of the image bounderies.";
CM_ SG_ 154 OBJ_Left_Out_Of_Image_19 "Indicates whether if measurment are predicted out of  the left side of the image bounderies";
CM_ SG_ 154 OBJ_Right_Out_Of_Image_V_19 "validator";
CM_ SG_ 154 OBJ_Left_Out_Of_Image_V_19 "validator";
CM_ SG_ 154 OBJ_Top_Out_Of_Image_19 "Indicates whether if measurment are predicted out of  the top of the image bounderies";
CM_ SG_ 154 OBJ_Bottom_Out_Of_Image_19 "Indicates whether if measurment are predicted out of  the bottom of the image bounderies";
CM_ SG_ 154 OBJ_Top_Out_Of_Image_V_19 "validator";
CM_ SG_ 154 OBJ_Bottom_Out_Of_Image_V_19 "validator";
CM_ SG_ 154 OBJ_Lane_Assignment_19 "The object's lane relative to the host lane.";
CM_ SG_ 154 OBJ_Lane_Assignment_V_19 "Validator for lane assignment";
CM_ SG_ 154 OBJ_Age_Seconds_19 "Time in seconds in which the object was recognized. ";
CM_ SG_ 154 OBJ_Age_Seconds_V_19 "Validator for object age";
CM_ SG_ 154 OBJ_Width_19 "The width of the target vehicle in the world (not to be mistaken with the width of the visible part of the vehicle).";
CM_ SG_ 154 OBJ_Width_V_19 "Validator for object width";
CM_ SG_ 154 OBJ_Width_STD_19 "Standard deviation for object width";
CM_ SG_ 154 OBJ_Width_STD_V_19 "Validator for the standard deviation of object width";
CM_ SG_ 154 OBJ_Length_19 "The length of the vehicle in the world. For crossing bicycles it gives the viewed length of the bicycle.";
CM_ SG_ 154 OBJ_Length_V_19 "Validator for object length.";
CM_ SG_ 154 OBJ_Length_STD_19 "Standard deviation for object length.";
CM_ SG_ 154 OBJ_Length_STD_V_19 "Validator for the standard deviation of object length.";
CM_ SG_ 154 OBJ_Radar_ID_19 "Radar Object ID of the Fused Object, Only relvant when OBJ_Fusion_Source is not Camera only";
CM_ SG_ 154 OBJ_Height_19 "The height of the object in the world. ";
CM_ SG_ 154 OBJ_Height_V_19 "Validator for object height.";
CM_ SG_ 154 OBJ_Height_STD_19 "Standard deviation for object height.";
CM_ SG_ 154 OBJ_Height_STD_V_19 "Validator for the standard deviation of object height.";
CM_ SG_ 154 OBJ_Abs_Long_Velocity_19 "Absolute longitudinal velocity.";
CM_ SG_ 154 OBJ_Abs_Long_Velocity_V_19 "Validator for absolute longitudinal velocity.";
CM_ SG_ 154 OBJ_Abs_Long_Velocity_STD_19 "Standard deviation of absolute longitudinal velocity.";
CM_ SG_ 154 OBJ_Abs_Long_Vel_STD_V_19 "Validator for the standard deviation of the absolute longitudinal velocity.";
CM_ SG_ 154 OBJ_Abs_Lat_Velocity_19 "The lateral ground speed of the object.";
CM_ SG_ 154 OBJ_Abs_Lat_Velocity_V_19 "Validator for the lateral ground speed of the object.";
CM_ SG_ 154 OBJ_Abs_Lat_Velocity_STD_19 "STD of the lateral ground speed of the object.";
CM_ SG_ 154 OBJ_Abs_Lat_Vel_STD_V_19 "Validator for the STD of the lateral ground speed of the object.";
CM_ SG_ 154 OBJ_Abs_Long_Acc_19 "The longitudinal ground acceleration of the object.";
CM_ SG_ 154 OBJ_Abs_Long_Acc_V_19 "Validator for the longitudinal ground acceleration of the object.";
CM_ SG_ 154 OBJ_Abs_Long_Acc_STD_19 "STD of the longitudinal ground acceleration of the object.";
CM_ SG_ 154 OBJ_Abs_Long_Acc_STD_V_19 "Validator for the STD of the longitudinal ground acceleration of the object.";
CM_ SG_ 154 OBJ_Abs_Lat_Acc_19 "The lateral ground acceleration of the object.";
CM_ SG_ 154 OBJ_Abs_Lat_Acc_V_19 "Validator for the lateral ground acceleration of the object.";
CM_ SG_ 154 OBJ_Abs_Lat_Acc_STD_19 "STD of the lateral ground acceleration of the object.";
CM_ SG_ 154 OBJ_Abs_Lat_Acc_STD_V_19 "Validator for the STD of the lateral ground acceleration of the object.";
CM_ SG_ 154 OBJ_Abs_Acceleration_19 "The absolute ground acceleration in the target's heading direction.";
CM_ SG_ 154 OBJ_Abs_Acceleration_V_19 "Validator for the absolute ground acceleration.";
CM_ SG_ 154 OBJ_Abs_Acc_STD_19 "STD of the absolute ground acceleration.";
CM_ SG_ 154 OBJ_Abs_Acc_STD_V_19 "Validator for the STD of the absolute ground acceleration.";
CM_ SG_ 154 OBJ_Inv_TTC_19 "Inverse TTC (time to collision).";
CM_ SG_ 154 OBJ_Inv_TTC_STD_19 "STD for inverse TTC .";
CM_ SG_ 154 OBJ_Inv_TTC_STD_V_19 "Validator for the STD for inverse TTC .";
CM_ SG_ 154 OBJ_Relative_Long_Acc_19 "The relative longitudinal ground acceleration of the object.";
CM_ SG_ 154 OBJ_Relative_Long_Acc_V_19 "Validator for the relative longitudinal ground acceleration of the object.";
CM_ SG_ 154 OBJ_Relative_Long_Acc_STD_19 "STD of the relative longitudinal ground acceleration of the object.";
CM_ SG_ 154 OBJ_Rel_Long_Acc_STD_V_19 "Validator for the STD of the relative longitudinal ground acceleration.";
CM_ SG_ 154 OBJ_Relative_Long_Velocity_19 "The relative longtitudinal speed between the target and ego vehicle. ";
CM_ SG_ 154 OBJ_Relative_Long_Velocity_V_19 "Validator for the relative longtitudinal speed.";
CM_ SG_ 154 OBJ_Relative_Long_Vel_STD_19 "STD of the relative longtitudinal speed.";
CM_ SG_ 154 OBJ_Rel_Long_Vel_STD_V_19 "Validator for the STD of the relative longtitudinal speed.";
CM_ SG_ 154 OBJ_Relative_Lat_Velocity_19 "The relative lateral speed between the target and ego vehicle. ";
CM_ SG_ 154 OBJ_Relative_Lat_Velocity_V_19 "Validator for the relative lateral speed. ";
CM_ SG_ 154 OBJ_Relative_Lat_Velocity_STD_19 "STD of the relative lateral speed. ";
CM_ SG_ 154 OBJ_Rel_Lat_Vel_STD_V_19 "Validator for the STD of the relative lateral speed. ";
CM_ SG_ 154 OBJ_Long_Distance_19 "The longitudinal distance to middle of the rear bumper (middle of the RL and RR corners) of the target.";
CM_ SG_ 154 OBJ_Long_Distance_V_19 "Validator of the longtitudinal distance field";
CM_ SG_ 154 OBJ_Long_Distance_STD_19 "STD of the  longtitudinal distance.";
CM_ SG_ 154 OBJ_Long_Distance_STD_V_19 "Validator for the STD of the  longtitudinal distance.";
CM_ SG_ 154 OBJ_Lat_Distance_19 "Lateral distance to the middle of the RL and RR corners.  ";
CM_ SG_ 154 OBJ_Lat_Distance_V_19 "Validator for the lateral distance of the object.";
CM_ SG_ 154 OBJ_Lat_Distance_STD_19 "STD of the lateral distance of the object.";
CM_ SG_ 154 OBJ_Lat_Distance_STD_V_19 "Validator for the STD of the lateral distance of the object.";
CM_ SG_ 154 OBJ_Absolute_Speed_19 "The absolute ground speed in the targets' heading direction.";
CM_ SG_ 154 OBJ_Absolute_Speed_V_19 "Validator for the absolute ground speed.";
CM_ SG_ 154 OBJ_Absolute_Speed_STD_19 "STD of the absolute ground speed.";
CM_ SG_ 154 OBJ_Absolute_Speed_STD_V_19 "Validator for the STD of the absolute ground speed.";
CM_ SG_ 154 OBJ_Heading_19 "The angle beetweenthe host longitudinal axis and target's heading (clockwise, e.g. PI/2 is a target crossing from left to right).";
CM_ SG_ 154 OBJ_Heading_V_19 "Validator for the object heading.";
CM_ SG_ 154 OBJ_Heading_STD_19 "STD of the object heading.";
CM_ SG_ 154 OBJ_Heading_STD_V_19 "Validator for the STD of the object heading.";
CM_ SG_ 154 OBJ_Angle_Rate_STD_19 "Standard deviation of the angular speed. (radians)";
CM_ SG_ 154 OBJ_Angle_Rate_STD_V_19 "Validator for the STD of the angular speed.";
CM_ SG_ 154 OBJ_Angle_Rate_19 "The momentary angular speed of the object (radians). The positive side is to the host's right.";
CM_ SG_ 154 OBJ_Angle_Rate_V_19 "Validator for the angular speed.";
CM_ SG_ 154 OBJ_Angle_Right_19 "The angle between the host longitudinal axis and the right side of the front / rear of the target (the visible one). The positive side is to the host's right.";
CM_ SG_ 154 OBJ_Angle_Right_V_19 "Validator for angleRight";
CM_ SG_ 154 OBJ_Angle_Right_STD_19 "Standard deviation of angleRight";
CM_ SG_ 154 OBJ_Angle_Right_STD_V_19 "Validator for the standard deviation of angleRight.";
CM_ SG_ 154 OBJ_Angle_Left_19 "The angle between the host longitudinal axis and the left side of the front / rear of the target (the visible one). The positive side is to the host's right.";
CM_ SG_ 154 OBJ_Angle_Left_V_19 "Validator for angleLeft.";
CM_ SG_ 154 OBJ_Angle_Left_STD_19 "Standard deviation of angleLeft.";
CM_ SG_ 154 OBJ_Angle_Left_STD_V_19 "Validator for the standard deviation of angleLeft.";
CM_ SG_ 154 OBJ_Angle_Side_19 "The angle between the host longitudinal axis and the far visible edge - the visible edge of the front / rear of the target that is not visible. Currently supported for vehicles only.";
CM_ SG_ 154 OBJ_Angle_Side_V_19 "Validator for angleSide.";
CM_ SG_ 154 OBJ_Angle_Side_STD_19 "Standard deviation of angleSide.";
CM_ SG_ 154 OBJ_Angle_Side_STD_V_19 "Validator for the STD of angleSide.";
CM_ SG_ 154 OBJ_Angle_Mid_V_19 "Validator for angleMid.";
CM_ SG_ 154 OBJ_Angle_Mid_19 "The angle between the host longitudinal axis and the middle of the front / rear of the target (the visible one). The positive side is to the host's right.";
CM_ SG_ 154 OBJ_Angle_Mid_STD_19 "Standard deviation of angleMid.";
CM_ SG_ 154 OBJ_Angle_Mid_STD_V_19 "Validator for the STD of angleMid.";
CM_ SG_ 154 OBJ_Angle_Bottom_V_19 "Validator for OBJAngle_Bottom. ";
CM_ SG_ 154 OBJ_Angle_Bottom_19 "The angle between the longitudinal axis and the Bottom of the front / rear of the target (the visible one). The positive side is to the host's bottom";
CM_ SG_ 154 OBJ_Angle_Bottom_STD_19 "STD for OBJAngle_Bottom. ";
CM_ SG_ 154 OBJ_Angle_Bottom_STD_V_19 "Validator for OBJAngle_Bottom_STD. ";
CM_ SG_ 154 OBJ_Visibility_Side_V_19 "Currently Supported for VD only";
CM_ SG_ 154 OBJ_Visibility_Side_19 "From what car  side is the object visible";
CM_ SG_ 154 OBJ_Is_In_Drivable_Area_19 "Indicates whether the target is in a driveable area.";
CM_ SG_ 154 OBJ_Is_In_Drivable_Area_V_19 "Validator for OBJ_Is_In_Drivable_Area.";
CM_ SG_ 154 OBJ_Is_VeryClose_V_19 "Validator for OBJ_Is_VeryClose. ";
CM_ SG_ 154 OBJ_Is_VeryClose_19 "Indicates whether the target is very close to the host such that it is hard to measure its distance. Currently relevant for peds only";
CM_ SG_ 154 OBJ_OverlapAngleEgoLaneR_19 "Lateral distance to the middle of the RL and RR corners.";
CM_ SG_ 154 OBJ_OverlapAngleEgoLaneR_V_19 "Validator for OBJ_OverlapAngleEgoLaneR";
CM_ SG_ 154 OBJ_OverlapAngleEgoLaneL_19 "Lateral distance to the middle of the RL and RR corners.  ";
CM_ SG_ 154 OBJ_OverlapAngleEgoLaneL_V_19 "Validator for OBJ_OverlapAngleEgoLaneL";
CM_ SG_ 154 OBJ_Is_EMERGENCY_VCL_19 "Is Object an Emergency Vehicle";
CM_ SG_ 154 OBJ_EMERGENCY_LIGHT_COLOR_19 "Emergency Color";
CM_ SG_ 154 OBJ_EMERGENCY_V_19 "Are OBJ_Is_EMERGENCY_VCL and OBJ_EMERGENCY_LIGHT_COLOR Valid";
CM_ SG_ 154 OBJ_Angle_Top_19 "From VD touching point on the ground till the roof of the car";
CM_ SG_ 154 OBJ_Angle_Top_V_19 "Validator for OBJ_Angle_Top ";
CM_ SG_ 154 OBJ_Angle_Top_STD_19 "STD for OBJ_Angle_Top";
CM_ SG_ 154 OBJ_Angle_Top_STD_V_19 "Validator for OBJ_Angle_Top_STD. ";
CM_ SG_ 154 OBJ_Open_Door_Left_19 "Indicator if left door is open";
CM_ SG_ 154 OBJ_Open_Door_Right_19 "Indicator if right door is open";
CM_ SG_ 154 OBJ_Visible_Left_or_Right_19 "This signal describes the visible Left or Right side of the Target vehicle.";
CM_ SG_ 154 OBJ_Visible_Left_or_Right_V_19 "OBJ_Visible_Left_or_Right";
CM_ SG_ 154 OBJ_2W_Is_Motorbike_Probability_19 "The probability of the Two-wheeler reported object being a Motorbike";
CM_ SG_ 154 OBJ_2W_Is_Bicycle_Probability_19 "The probability of the Two-wheeler reported object being a Bicycle";
CM_ SG_ 154 OBJ_CRC_20 "Calculated over all element signals. From the signal after the CRC until the first signal in the next elements OBJ_CRC_N+1  not including";
CM_ SG_ 154 OBJ_ID_20 "The detected object ID. Range is 1-255, while 0 indicates that the field in unfilled.";
CM_ SG_ 154 OBJ_Existence_Probability_20 "The existence probability of the reported object";
CM_ SG_ 154 OBJ_Fusion_Source_20 "sources ids used for fusion";
CM_ SG_ 154 OBJ_Triggered_SDM_20 "Indicates whether the object has trigered the SDM (Safety Diagnostic Manager) alert.";
CM_ SG_ 154 OBJ_Motion_Category_20 "Relevant for VD only. Full description of values can be found at the ACC guide.";
CM_ SG_ 154 OBJ_Moving_IN_Probability_20 "The probability the object is eventually move into ego lane. (In case that the OBJ_Motion_Category signal is set to  MOVING_IN ";
CM_ SG_ 154 OBJ_Object_Age_20 "The number of frames in which the object was recognized.";
CM_ SG_ 154 OBJ_Measuring_Status_20 "Measurment status. Old vs New marks if this is the first frame in which the object is reported. Predicted vs Measured marks if the report is raw or has been predicted forward in time using the measured dynamics and ego motion.";
CM_ SG_ 154 OBJ_Object_Class_20 "Indicates the object type. Uncertain is outputted in case the probability that a vehicle is a truck is very similar to the probability that it is a car.";
CM_ SG_ 154 OBJ_Class_Probability_20 "The probability of this type classification.";
CM_ SG_ 154 OBJ_Car_Probability_20 "The probability the object is a car";
CM_ SG_ 154 OBJ_Truck_Probability_20 "The probability the object is a Truck";
CM_ SG_ 154 OBJ_Bike_Probability_20 "The probability the object is a Bike";
CM_ SG_ 154 OBJ_Camera_Source_20 "The camera in which this object was detected (best choice).";
CM_ SG_ 154 OBJ_Motion_Status_20 "MOVING - the object is moving STATIONARY - the object was never seen moving STOPPED -  the object was moving and has stopped MOVING_SLOWLY - the object is moving very slowly";
CM_ SG_ 154 OBJ_Motion_Orientation_20 "The direction of the targets heading compared to the host. ";
CM_ SG_ 154 OBJ_Has_Cut_Lane_20 "Indicates whether the object cut the host's (right or left) lane. In case there are no lanes, indicates whether the objects is at most 1 meters away from the host.";
CM_ SG_ 154 OBJ_Has_Cut_Path_20 "Indicates whether the object is in the host's path.";
CM_ SG_ 154 OBJ_Brake_Light_Validity_20 "Validator for braking light indicator";
CM_ SG_ 154 OBJ_Brake_Light_20 "Indication for brake lights ";
CM_ SG_ 154 OBJ_Turn_Indicator_Right_20 "Indication for blinking right light.";
CM_ SG_ 154 OBJ_Turn_Indicator_Left_20 "Indication for blinking left light ";
CM_ SG_ 154 OBJ_Turn_Indicator_Validity_20 "Validator for light indicators";
CM_ SG_ 154 OBJ_Right_Out_Of_Image_20 "Indicates whether the measurment are predicted out of the right side of the image bounderies.";
CM_ SG_ 154 OBJ_Left_Out_Of_Image_20 "Indicates whether if measurment are predicted out of  the left side of the image bounderies";
CM_ SG_ 154 OBJ_Right_Out_Of_Image_V_20 "validator";
CM_ SG_ 154 OBJ_Left_Out_Of_Image_V_20 "validator";
CM_ SG_ 154 OBJ_Top_Out_Of_Image_20 "Indicates whether if measurment are predicted out of  the top of the image bounderies";
CM_ SG_ 154 OBJ_Bottom_Out_Of_Image_20 "Indicates whether if measurment are predicted out of  the bottom of the image bounderies";
CM_ SG_ 154 OBJ_Top_Out_Of_Image_V_20 "validator";
CM_ SG_ 154 OBJ_Bottom_Out_Of_Image_V_20 "validator";
CM_ SG_ 154 OBJ_Lane_Assignment_20 "The object's lane relative to the host lane.";
CM_ SG_ 154 OBJ_Lane_Assignment_V_20 "Validator for lane assignment";
CM_ SG_ 154 OBJ_Age_Seconds_20 "Time in seconds in which the object was recognized. ";
CM_ SG_ 154 OBJ_Age_Seconds_V_20 "Validator for object age";
CM_ SG_ 154 OBJ_Width_20 "The width of the target vehicle in the world (not to be mistaken with the width of the visible part of the vehicle).";
CM_ SG_ 154 OBJ_Width_V_20 "Validator for object width";
CM_ SG_ 154 OBJ_Width_STD_20 "Standard deviation for object width";
CM_ SG_ 154 OBJ_Width_STD_V_20 "Validator for the standard deviation of object width";
CM_ SG_ 154 OBJ_Length_20 "The length of the vehicle in the world. For crossing bicycles it gives the viewed length of the bicycle.";
CM_ SG_ 154 OBJ_Length_V_20 "Validator for object length.";
CM_ SG_ 154 OBJ_Length_STD_20 "Standard deviation for object length.";
CM_ SG_ 154 OBJ_Length_STD_V_20 "Validator for the standard deviation of object length.";
CM_ SG_ 154 OBJ_Radar_ID_20 "Radar Object ID of the Fused Object, Only relvant when OBJ_Fusion_Source is not Camera only";
CM_ SG_ 154 OBJ_Height_20 "The height of the object in the world. ";
CM_ SG_ 154 OBJ_Height_V_20 "Validator for object height.";
CM_ SG_ 154 OBJ_Height_STD_20 "Standard deviation for object height.";
CM_ SG_ 154 OBJ_Height_STD_V_20 "Validator for the standard deviation of object height.";
CM_ SG_ 154 OBJ_Abs_Long_Velocity_20 "Absolute longitudinal velocity.";
CM_ SG_ 154 OBJ_Abs_Long_Velocity_V_20 "Validator for absolute longitudinal velocity.";
CM_ SG_ 154 OBJ_Abs_Long_Velocity_STD_20 "Standard deviation of absolute longitudinal velocity.";
CM_ SG_ 154 OBJ_Abs_Long_Vel_STD_V_20 "Validator for the standard deviation of the absolute longitudinal velocity.";
CM_ SG_ 154 OBJ_Abs_Lat_Velocity_20 "The lateral ground speed of the object.";
CM_ SG_ 154 OBJ_Abs_Lat_Velocity_V_20 "Validator for the lateral ground speed of the object.";
CM_ SG_ 154 OBJ_Abs_Lat_Velocity_STD_20 "STD of the lateral ground speed of the object.";
CM_ SG_ 154 OBJ_Abs_Lat_Vel_STD_V_20 "Validator for the STD of the lateral ground speed of the object.";
CM_ SG_ 154 OBJ_Abs_Long_Acc_20 "The longitudinal ground acceleration of the object.";
CM_ SG_ 154 OBJ_Abs_Long_Acc_V_20 "Validator for the longitudinal ground acceleration of the object.";
CM_ SG_ 154 OBJ_Abs_Long_Acc_STD_20 "STD of the longitudinal ground acceleration of the object.";
CM_ SG_ 154 OBJ_Abs_Long_Acc_STD_V_20 "Validator for the STD of the longitudinal ground acceleration of the object.";
CM_ SG_ 154 OBJ_Abs_Lat_Acc_20 "The lateral ground acceleration of the object.";
CM_ SG_ 154 OBJ_Abs_Lat_Acc_V_20 "Validator for the lateral ground acceleration of the object.";
CM_ SG_ 154 OBJ_Abs_Lat_Acc_STD_20 "STD of the lateral ground acceleration of the object.";
CM_ SG_ 154 OBJ_Abs_Lat_Acc_STD_V_20 "Validator for the STD of the lateral ground acceleration of the object.";
CM_ SG_ 154 OBJ_Abs_Acceleration_20 "The absolute ground acceleration in the target's heading direction.";
CM_ SG_ 154 OBJ_Abs_Acceleration_V_20 "Validator for the absolute ground acceleration.";
CM_ SG_ 154 OBJ_Abs_Acc_STD_20 "STD of the absolute ground acceleration.";
CM_ SG_ 154 OBJ_Abs_Acc_STD_V_20 "Validator for the STD of the absolute ground acceleration.";
CM_ SG_ 154 OBJ_Inv_TTC_20 "Inverse TTC (time to collision).";
CM_ SG_ 154 OBJ_Inv_TTC_STD_20 "STD for inverse TTC .";
CM_ SG_ 154 OBJ_Inv_TTC_STD_V_20 "Validator for the STD for inverse TTC .";
CM_ SG_ 154 OBJ_Relative_Long_Acc_20 "The relative longitudinal ground acceleration of the object.";
CM_ SG_ 154 OBJ_Relative_Long_Acc_V_20 "Validator for the relative longitudinal ground acceleration of the object.";
CM_ SG_ 154 OBJ_Relative_Long_Acc_STD_20 "STD of the relative longitudinal ground acceleration of the object.";
CM_ SG_ 154 OBJ_Rel_Long_Acc_STD_V_20 "Validator for the STD of the relative longitudinal ground acceleration.";
CM_ SG_ 154 OBJ_Relative_Long_Velocity_20 "The relative longtitudinal speed between the target and ego vehicle. ";
CM_ SG_ 154 OBJ_Relative_Long_Velocity_V_20 "Validator for the relative longtitudinal speed.";
CM_ SG_ 154 OBJ_Relative_Long_Vel_STD_20 "STD of the relative longtitudinal speed.";
CM_ SG_ 154 OBJ_Rel_Long_Vel_STD_V_20 "Validator for the STD of the relative longtitudinal speed.";
CM_ SG_ 154 OBJ_Relative_Lat_Velocity_20 "The relative lateral speed between the target and ego vehicle. ";
CM_ SG_ 154 OBJ_Relative_Lat_Velocity_V_20 "Validator for the relative lateral speed. ";
CM_ SG_ 154 OBJ_Relative_Lat_Velocity_STD_20 "STD of the relative lateral speed. ";
CM_ SG_ 154 OBJ_Rel_Lat_Vel_STD_V_20 "Validator for the STD of the relative lateral speed. ";
CM_ SG_ 154 OBJ_Long_Distance_20 "The longitudinal distance to middle of the rear bumper (middle of the RL and RR corners) of the target.";
CM_ SG_ 154 OBJ_Long_Distance_V_20 "Validator of the longtitudinal distance field";
CM_ SG_ 154 OBJ_Long_Distance_STD_20 "STD of the  longtitudinal distance.";
CM_ SG_ 154 OBJ_Long_Distance_STD_V_20 "Validator for the STD of the  longtitudinal distance.";
CM_ SG_ 154 OBJ_Lat_Distance_20 "Lateral distance to the middle of the RL and RR corners.  ";
CM_ SG_ 154 OBJ_Lat_Distance_V_20 "Validator for the lateral distance of the object.";
CM_ SG_ 154 OBJ_Lat_Distance_STD_20 "STD of the lateral distance of the object.";
CM_ SG_ 154 OBJ_Lat_Distance_STD_V_20 "Validator for the STD of the lateral distance of the object.";
CM_ SG_ 154 OBJ_Absolute_Speed_20 "The absolute ground speed in the targets' heading direction.";
CM_ SG_ 154 OBJ_Absolute_Speed_V_20 "Validator for the absolute ground speed.";
CM_ SG_ 154 OBJ_Absolute_Speed_STD_20 "STD of the absolute ground speed.";
CM_ SG_ 154 OBJ_Absolute_Speed_STD_V_20 "Validator for the STD of the absolute ground speed.";
CM_ SG_ 154 OBJ_Heading_20 "The angle beetweenthe host longitudinal axis and target's heading (clockwise, e.g. PI/2 is a target crossing from left to right).";
CM_ SG_ 154 OBJ_Heading_V_20 "Validator for the object heading.";
CM_ SG_ 154 OBJ_Heading_STD_20 "STD of the object heading.";
CM_ SG_ 154 OBJ_Heading_STD_V_20 "Validator for the STD of the object heading.";
CM_ SG_ 154 OBJ_Angle_Rate_STD_20 "Standard deviation of the angular speed. (radians)";
CM_ SG_ 154 OBJ_Angle_Rate_STD_V_20 "Validator for the STD of the angular speed.";
CM_ SG_ 154 OBJ_Angle_Rate_20 "The momentary angular speed of the object (radians). The positive side is to the host's right.";
CM_ SG_ 154 OBJ_Angle_Rate_V_20 "Validator for the angular speed.";
CM_ SG_ 154 OBJ_Angle_Right_20 "The angle between the host longitudinal axis and the right side of the front / rear of the target (the visible one). The positive side is to the host's right.";
CM_ SG_ 154 OBJ_Angle_Right_V_20 "Validator for angleRight";
CM_ SG_ 154 OBJ_Angle_Right_STD_20 "Standard deviation of angleRight";
CM_ SG_ 154 OBJ_Angle_Right_STD_V_20 "Validator for the standard deviation of angleRight.";
CM_ SG_ 154 OBJ_Angle_Left_20 "The angle between the host longitudinal axis and the left side of the front / rear of the target (the visible one). The positive side is to the host's right.";
CM_ SG_ 154 OBJ_Angle_Left_V_20 "Validator for angleLeft.";
CM_ SG_ 154 OBJ_Angle_Left_STD_20 "Standard deviation of angleLeft.";
CM_ SG_ 154 OBJ_Angle_Left_STD_V_20 "Validator for the standard deviation of angleLeft.";
CM_ SG_ 154 OBJ_Angle_Side_20 "The angle between the host longitudinal axis and the far visible edge - the visible edge of the front / rear of the target that is not visible. Currently supported for vehicles only.";
CM_ SG_ 154 OBJ_Angle_Side_V_20 "Validator for angleSide.";
CM_ SG_ 154 OBJ_Angle_Side_STD_20 "Standard deviation of angleSide.";
CM_ SG_ 154 OBJ_Angle_Side_STD_V_20 "Validator for the STD of angleSide.";
CM_ SG_ 154 OBJ_Angle_Mid_V_20 "Validator for angleMid.";
CM_ SG_ 154 OBJ_Angle_Mid_20 "The angle between the host longitudinal axis and the middle of the front / rear of the target (the visible one). The positive side is to the host's right.";
CM_ SG_ 154 OBJ_Angle_Mid_STD_20 "Standard deviation of angleMid.";
CM_ SG_ 154 OBJ_Angle_Mid_STD_V_20 "Validator for the STD of angleMid.";
CM_ SG_ 154 OBJ_Angle_Bottom_V_20 "Validator for OBJAngle_Bottom. ";
CM_ SG_ 154 OBJ_Angle_Bottom_20 "The angle between the longitudinal axis and the Bottom of the front / rear of the target (the visible one). The positive side is to the host's bottom";
CM_ SG_ 154 OBJ_Angle_Bottom_STD_20 "STD for OBJAngle_Bottom. ";
CM_ SG_ 154 OBJ_Angle_Bottom_STD_V_20 "Validator for OBJAngle_Bottom_STD. ";
CM_ SG_ 154 OBJ_Visibility_Side_V_20 "Currently Supported for VD only";
CM_ SG_ 154 OBJ_Visibility_Side_20 "From what car  side is the object visible";
CM_ SG_ 154 OBJ_Is_In_Drivable_Area_20 "Indicates whether the target is in a driveable area.";
CM_ SG_ 154 OBJ_Is_In_Drivable_Area_V_20 "Validator for OBJ_Is_In_Drivable_Area.";
CM_ SG_ 154 OBJ_Is_VeryClose_V_20 "Validator for OBJ_Is_VeryClose. ";
CM_ SG_ 154 OBJ_Is_VeryClose_20 "Indicates whether the target is very close to the host such that it is hard to measure its distance. Currently relevant for peds only";
CM_ SG_ 154 OBJ_OverlapAngleEgoLaneR_20 "Lateral distance to the middle of the RL and RR corners.";
CM_ SG_ 154 OBJ_OverlapAngleEgoLaneR_V_20 "Validator for OBJ_OverlapAngleEgoLaneR";
CM_ SG_ 154 OBJ_OverlapAngleEgoLaneL_20 "Lateral distance to the middle of the RL and RR corners.  ";
CM_ SG_ 154 OBJ_OverlapAngleEgoLaneL_V_20 "Validator for OBJ_OverlapAngleEgoLaneL";
CM_ SG_ 154 OBJ_Is_EMERGENCY_VCL_20 "Is Object an Emergency Vehicle";
CM_ SG_ 154 OBJ_EMERGENCY_LIGHT_COLOR_20 "Emergency Color";
CM_ SG_ 154 OBJ_EMERGENCY_V_20 "Are OBJ_Is_EMERGENCY_VCL and OBJ_EMERGENCY_LIGHT_COLOR Valid";
CM_ SG_ 154 OBJ_Angle_Top_20 "From VD touching point on the ground till the roof of the car";
CM_ SG_ 154 OBJ_Angle_Top_V_20 "Validator for OBJ_Angle_Top ";
CM_ SG_ 154 OBJ_Angle_Top_STD_20 "STD for OBJ_Angle_Top";
CM_ SG_ 154 OBJ_Angle_Top_STD_V_20 "Validator for OBJ_Angle_Top_STD. ";
CM_ SG_ 154 OBJ_Open_Door_Left_20 "Indicator if left door is open";
CM_ SG_ 154 OBJ_Open_Door_Right_20 "Indicator if right door is open";
CM_ SG_ 154 OBJ_Visible_Left_or_Right_20 "This signal describes the visible Left or Right side of the Target vehicle.";
CM_ SG_ 154 OBJ_Visible_Left_or_Right_V_20 "OBJ_Visible_Left_or_Right";
CM_ SG_ 154 OBJ_2W_Is_Motorbike_Probability_20 "The probability of the Two-wheeler reported object being a Motorbike";
CM_ SG_ 154 OBJ_2W_Is_Bicycle_Probability_20 "The probability of the Two-wheeler reported object being a Bicycle";
CM_ SG_ 154 OBJ_CRC_21 "Calculated over all element signals. From the signal after the CRC until the first signal in the next elements OBJ_CRC_N+1  not including";
CM_ SG_ 154 OBJ_ID_21 "The detected object ID. Range is 1-255, while 0 indicates that the field in unfilled.";
CM_ SG_ 154 OBJ_Existence_Probability_21 "The existence probability of the reported object";
CM_ SG_ 154 OBJ_Fusion_Source_21 "sources ids used for fusion";
CM_ SG_ 154 OBJ_Triggered_SDM_21 "Indicates whether the object has trigered the SDM (Safety Diagnostic Manager) alert.";
CM_ SG_ 154 OBJ_Motion_Category_21 "Relevant for VD only. Full description of values can be found at the ACC guide.";
CM_ SG_ 154 OBJ_Moving_IN_Probability_21 "The probability the object is eventually move into ego lane. (In case that the OBJ_Motion_Category signal is set to  MOVING_IN ";
CM_ SG_ 154 OBJ_Object_Age_21 "The number of frames in which the object was recognized.";
CM_ SG_ 154 OBJ_Measuring_Status_21 "Measurment status. Old vs New marks if this is the first frame in which the object is reported. Predicted vs Measured marks if the report is raw or has been predicted forward in time using the measured dynamics and ego motion.";
CM_ SG_ 154 OBJ_Object_Class_21 "Indicates the object type. Uncertain is outputted in case the probability that a vehicle is a truck is very similar to the probability that it is a car.";
CM_ SG_ 154 OBJ_Class_Probability_21 "The probability of this type classification.";
CM_ SG_ 154 OBJ_Car_Probability_21 "The probability the object is a car";
CM_ SG_ 154 OBJ_Truck_Probability_21 "The probability the object is a Truck";
CM_ SG_ 154 OBJ_Bike_Probability_21 "The probability the object is a Bike";
CM_ SG_ 154 OBJ_Camera_Source_21 "The camera in which this object was detected (best choice).";
CM_ SG_ 154 OBJ_Motion_Status_21 "MOVING - the object is moving STATIONARY - the object was never seen moving STOPPED -  the object was moving and has stopped MOVING_SLOWLY - the object is moving very slowly";
CM_ SG_ 154 OBJ_Motion_Orientation_21 "The direction of the targets heading compared to the host. ";
CM_ SG_ 154 OBJ_Has_Cut_Lane_21 "Indicates whether the object cut the host's (right or left) lane. In case there are no lanes, indicates whether the objects is at most 1 meters away from the host.";
CM_ SG_ 154 OBJ_Has_Cut_Path_21 "Indicates whether the object is in the host's path.";
CM_ SG_ 154 OBJ_Brake_Light_Validity_21 "Validator for braking light indicator";
CM_ SG_ 154 OBJ_Brake_Light_21 "Indication for brake lights ";
CM_ SG_ 154 OBJ_Turn_Indicator_Right_21 "Indication for blinking right light.";
CM_ SG_ 154 OBJ_Turn_Indicator_Left_21 "Indication for blinking left light ";
CM_ SG_ 154 OBJ_Turn_Indicator_Validity_21 "Validator for light indicators";
CM_ SG_ 154 OBJ_Right_Out_Of_Image_21 "Indicates whether the measurment are predicted out of the right side of the image bounderies.";
CM_ SG_ 154 OBJ_Left_Out_Of_Image_21 "Indicates whether if measurment are predicted out of  the left side of the image bounderies";
CM_ SG_ 154 OBJ_Right_Out_Of_Image_V_21 "validator";
CM_ SG_ 154 OBJ_Left_Out_Of_Image_V_21 "validator";
CM_ SG_ 154 OBJ_Top_Out_Of_Image_21 "Indicates whether if measurment are predicted out of  the top of the image bounderies";
CM_ SG_ 154 OBJ_Bottom_Out_Of_Image_21 "Indicates whether if measurment are predicted out of  the bottom of the image bounderies";
CM_ SG_ 154 OBJ_Top_Out_Of_Image_V_21 "validator";
CM_ SG_ 154 OBJ_Bottom_Out_Of_Image_V_21 "validator";
CM_ SG_ 154 OBJ_Lane_Assignment_21 "The object's lane relative to the host lane.";
CM_ SG_ 154 OBJ_Lane_Assignment_V_21 "Validator for lane assignment";
CM_ SG_ 154 OBJ_Age_Seconds_21 "Time in seconds in which the object was recognized. ";
CM_ SG_ 154 OBJ_Age_Seconds_V_21 "Validator for object age";
CM_ SG_ 154 OBJ_Width_21 "The width of the target vehicle in the world (not to be mistaken with the width of the visible part of the vehicle).";
CM_ SG_ 154 OBJ_Width_V_21 "Validator for object width";
CM_ SG_ 154 OBJ_Width_STD_21 "Standard deviation for object width";
CM_ SG_ 154 OBJ_Width_STD_V_21 "Validator for the standard deviation of object width";
CM_ SG_ 154 OBJ_Length_21 "The length of the vehicle in the world. For crossing bicycles it gives the viewed length of the bicycle.";
CM_ SG_ 154 OBJ_Length_V_21 "Validator for object length.";
CM_ SG_ 154 OBJ_Length_STD_21 "Standard deviation for object length.";
CM_ SG_ 154 OBJ_Length_STD_V_21 "Validator for the standard deviation of object length.";
CM_ SG_ 154 OBJ_Radar_ID_21 "Radar Object ID of the Fused Object, Only relvant when OBJ_Fusion_Source is not Camera only";
CM_ SG_ 154 OBJ_Height_21 "The height of the object in the world. ";
CM_ SG_ 154 OBJ_Height_V_21 "Validator for object height.";
CM_ SG_ 154 OBJ_Height_STD_21 "Standard deviation for object height.";
CM_ SG_ 154 OBJ_Height_STD_V_21 "Validator for the standard deviation of object height.";
CM_ SG_ 154 OBJ_Abs_Long_Velocity_21 "Absolute longitudinal velocity.";
CM_ SG_ 154 OBJ_Abs_Long_Velocity_V_21 "Validator for absolute longitudinal velocity.";
CM_ SG_ 154 OBJ_Abs_Long_Velocity_STD_21 "Standard deviation of absolute longitudinal velocity.";
CM_ SG_ 154 OBJ_Abs_Long_Vel_STD_V_21 "Validator for the standard deviation of the absolute longitudinal velocity.";
CM_ SG_ 154 OBJ_Abs_Lat_Velocity_21 "The lateral ground speed of the object.";
CM_ SG_ 154 OBJ_Abs_Lat_Velocity_V_21 "Validator for the lateral ground speed of the object.";
CM_ SG_ 154 OBJ_Abs_Lat_Velocity_STD_21 "STD of the lateral ground speed of the object.";
CM_ SG_ 154 OBJ_Abs_Lat_Vel_STD_V_21 "Validator for the STD of the lateral ground speed of the object.";
CM_ SG_ 154 OBJ_Abs_Long_Acc_21 "The longitudinal ground acceleration of the object.";
CM_ SG_ 154 OBJ_Abs_Long_Acc_V_21 "Validator for the longitudinal ground acceleration of the object.";
CM_ SG_ 154 OBJ_Abs_Long_Acc_STD_21 "STD of the longitudinal ground acceleration of the object.";
CM_ SG_ 154 OBJ_Abs_Long_Acc_STD_V_21 "Validator for the STD of the longitudinal ground acceleration of the object.";
CM_ SG_ 154 OBJ_Abs_Lat_Acc_21 "The lateral ground acceleration of the object.";
CM_ SG_ 154 OBJ_Abs_Lat_Acc_V_21 "Validator for the lateral ground acceleration of the object.";
CM_ SG_ 154 OBJ_Abs_Lat_Acc_STD_21 "STD of the lateral ground acceleration of the object.";
CM_ SG_ 154 OBJ_Abs_Lat_Acc_STD_V_21 "Validator for the STD of the lateral ground acceleration of the object.";
CM_ SG_ 154 OBJ_Abs_Acceleration_21 "The absolute ground acceleration in the target's heading direction.";
CM_ SG_ 154 OBJ_Abs_Acceleration_V_21 "Validator for the absolute ground acceleration.";
CM_ SG_ 154 OBJ_Abs_Acc_STD_21 "STD of the absolute ground acceleration.";
CM_ SG_ 154 OBJ_Abs_Acc_STD_V_21 "Validator for the STD of the absolute ground acceleration.";
CM_ SG_ 154 OBJ_Inv_TTC_21 "Inverse TTC (time to collision).";
CM_ SG_ 154 OBJ_Inv_TTC_STD_21 "STD for inverse TTC .";
CM_ SG_ 154 OBJ_Inv_TTC_STD_V_21 "Validator for the STD for inverse TTC .";
CM_ SG_ 154 OBJ_Relative_Long_Acc_21 "The relative longitudinal ground acceleration of the object.";
CM_ SG_ 154 OBJ_Relative_Long_Acc_V_21 "Validator for the relative longitudinal ground acceleration of the object.";
CM_ SG_ 154 OBJ_Relative_Long_Acc_STD_21 "STD of the relative longitudinal ground acceleration of the object.";
CM_ SG_ 154 OBJ_Rel_Long_Acc_STD_V_21 "Validator for the STD of the relative longitudinal ground acceleration.";
CM_ SG_ 154 OBJ_Relative_Long_Velocity_21 "The relative longtitudinal speed between the target and ego vehicle. ";
CM_ SG_ 154 OBJ_Relative_Long_Velocity_V_21 "Validator for the relative longtitudinal speed.";
CM_ SG_ 154 OBJ_Relative_Long_Vel_STD_21 "STD of the relative longtitudinal speed.";
CM_ SG_ 154 OBJ_Rel_Long_Vel_STD_V_21 "Validator for the STD of the relative longtitudinal speed.";
CM_ SG_ 154 OBJ_Relative_Lat_Velocity_21 "The relative lateral speed between the target and ego vehicle. ";
CM_ SG_ 154 OBJ_Relative_Lat_Velocity_V_21 "Validator for the relative lateral speed. ";
CM_ SG_ 154 OBJ_Relative_Lat_Velocity_STD_21 "STD of the relative lateral speed. ";
CM_ SG_ 154 OBJ_Rel_Lat_Vel_STD_V_21 "Validator for the STD of the relative lateral speed. ";
CM_ SG_ 154 OBJ_Long_Distance_21 "The longitudinal distance to middle of the rear bumper (middle of the RL and RR corners) of the target.";
CM_ SG_ 154 OBJ_Long_Distance_V_21 "Validator of the longtitudinal distance field";
CM_ SG_ 154 OBJ_Long_Distance_STD_21 "STD of the  longtitudinal distance.";
CM_ SG_ 154 OBJ_Long_Distance_STD_V_21 "Validator for the STD of the  longtitudinal distance.";
CM_ SG_ 154 OBJ_Lat_Distance_21 "Lateral distance to the middle of the RL and RR corners.  ";
CM_ SG_ 154 OBJ_Lat_Distance_V_21 "Validator for the lateral distance of the object.";
CM_ SG_ 154 OBJ_Lat_Distance_STD_21 "STD of the lateral distance of the object.";
CM_ SG_ 154 OBJ_Lat_Distance_STD_V_21 "Validator for the STD of the lateral distance of the object.";
CM_ SG_ 154 OBJ_Absolute_Speed_21 "The absolute ground speed in the targets' heading direction.";
CM_ SG_ 154 OBJ_Absolute_Speed_V_21 "Validator for the absolute ground speed.";
CM_ SG_ 154 OBJ_Absolute_Speed_STD_21 "STD of the absolute ground speed.";
CM_ SG_ 154 OBJ_Absolute_Speed_STD_V_21 "Validator for the STD of the absolute ground speed.";
CM_ SG_ 154 OBJ_Heading_21 "The angle beetweenthe host longitudinal axis and target's heading (clockwise, e.g. PI/2 is a target crossing from left to right).";
CM_ SG_ 154 OBJ_Heading_V_21 "Validator for the object heading.";
CM_ SG_ 154 OBJ_Heading_STD_21 "STD of the object heading.";
CM_ SG_ 154 OBJ_Heading_STD_V_21 "Validator for the STD of the object heading.";
CM_ SG_ 154 OBJ_Angle_Rate_STD_21 "Standard deviation of the angular speed. (radians)";
CM_ SG_ 154 OBJ_Angle_Rate_STD_V_21 "Validator for the STD of the angular speed.";
CM_ SG_ 154 OBJ_Angle_Rate_21 "The momentary angular speed of the object (radians). The positive side is to the host's right.";
CM_ SG_ 154 OBJ_Angle_Rate_V_21 "Validator for the angular speed.";
CM_ SG_ 154 OBJ_Angle_Right_21 "The angle between the host longitudinal axis and the right side of the front / rear of the target (the visible one). The positive side is to the host's right.";
CM_ SG_ 154 OBJ_Angle_Right_V_21 "Validator for angleRight";
CM_ SG_ 154 OBJ_Angle_Right_STD_21 "Standard deviation of angleRight";
CM_ SG_ 154 OBJ_Angle_Right_STD_V_21 "Validator for the standard deviation of angleRight.";
CM_ SG_ 154 OBJ_Angle_Left_21 "The angle between the host longitudinal axis and the left side of the front / rear of the target (the visible one). The positive side is to the host's right.";
CM_ SG_ 154 OBJ_Angle_Left_V_21 "Validator for angleLeft.";
CM_ SG_ 154 OBJ_Angle_Left_STD_21 "Standard deviation of angleLeft.";
CM_ SG_ 154 OBJ_Angle_Left_STD_V_21 "Validator for the standard deviation of angleLeft.";
CM_ SG_ 154 OBJ_Angle_Side_21 "The angle between the host longitudinal axis and the far visible edge - the visible edge of the front / rear of the target that is not visible. Currently supported for vehicles only.";
CM_ SG_ 154 OBJ_Angle_Side_V_21 "Validator for angleSide.";
CM_ SG_ 154 OBJ_Angle_Side_STD_21 "Standard deviation of angleSide.";
CM_ SG_ 154 OBJ_Angle_Side_STD_V_21 "Validator for the STD of angleSide.";
CM_ SG_ 154 OBJ_Angle_Mid_V_21 "Validator for angleMid.";
CM_ SG_ 154 OBJ_Angle_Mid_21 "The angle between the host longitudinal axis and the middle of the front / rear of the target (the visible one). The positive side is to the host's right.";
CM_ SG_ 154 OBJ_Angle_Mid_STD_21 "Standard deviation of angleMid.";
CM_ SG_ 154 OBJ_Angle_Mid_STD_V_21 "Validator for the STD of angleMid.";
CM_ SG_ 154 OBJ_Angle_Bottom_V_21 "Validator for OBJAngle_Bottom. ";
CM_ SG_ 154 OBJ_Angle_Bottom_21 "The angle between the longitudinal axis and the Bottom of the front / rear of the target (the visible one). The positive side is to the host's bottom";
CM_ SG_ 154 OBJ_Angle_Bottom_STD_21 "STD for OBJAngle_Bottom. ";
CM_ SG_ 154 OBJ_Angle_Bottom_STD_V_21 "Validator for OBJAngle_Bottom_STD. ";
CM_ SG_ 154 OBJ_Visibility_Side_V_21 "Currently Supported for VD only";
CM_ SG_ 154 OBJ_Visibility_Side_21 "From what car  side is the object visible";
CM_ SG_ 154 OBJ_Is_In_Drivable_Area_21 "Indicates whether the target is in a driveable area.";
CM_ SG_ 154 OBJ_Is_In_Drivable_Area_V_21 "Validator for OBJ_Is_In_Drivable_Area.";
CM_ SG_ 154 OBJ_Is_VeryClose_V_21 "Validator for OBJ_Is_VeryClose. ";
CM_ SG_ 154 OBJ_Is_VeryClose_21 "Indicates whether the target is very close to the host such that it is hard to measure its distance. Currently relevant for peds only";
CM_ SG_ 154 OBJ_OverlapAngleEgoLaneR_21 "Lateral distance to the middle of the RL and RR corners.";
CM_ SG_ 154 OBJ_OverlapAngleEgoLaneR_V_21 "Validator for OBJ_OverlapAngleEgoLaneR";
CM_ SG_ 154 OBJ_OverlapAngleEgoLaneL_21 "Lateral distance to the middle of the RL and RR corners.  ";
CM_ SG_ 154 OBJ_OverlapAngleEgoLaneL_V_21 "Validator for OBJ_OverlapAngleEgoLaneL";
CM_ SG_ 154 OBJ_Is_EMERGENCY_VCL_21 "Is Object an Emergency Vehicle";
CM_ SG_ 154 OBJ_EMERGENCY_LIGHT_COLOR_21 "Emergency Color";
CM_ SG_ 154 OBJ_EMERGENCY_V_21 "Are OBJ_Is_EMERGENCY_VCL and OBJ_EMERGENCY_LIGHT_COLOR Valid";
CM_ SG_ 154 OBJ_Angle_Top_21 "From VD touching point on the ground till the roof of the car";
CM_ SG_ 154 OBJ_Angle_Top_V_21 "Validator for OBJ_Angle_Top ";
CM_ SG_ 154 OBJ_Angle_Top_STD_21 "STD for OBJ_Angle_Top";
CM_ SG_ 154 OBJ_Angle_Top_STD_V_21 "Validator for OBJ_Angle_Top_STD. ";
CM_ SG_ 154 OBJ_Open_Door_Left_21 "Indicator if left door is open";
CM_ SG_ 154 OBJ_Open_Door_Right_21 "Indicator if right door is open";
CM_ SG_ 154 OBJ_Visible_Left_or_Right_21 "This signal describes the visible Left or Right side of the Target vehicle.";
CM_ SG_ 154 OBJ_Visible_Left_or_Right_V_21 "OBJ_Visible_Left_or_Right";
CM_ SG_ 154 OBJ_2W_Is_Motorbike_Probability_21 "The probability of the Two-wheeler reported object being a Motorbike";
CM_ SG_ 154 OBJ_2W_Is_Bicycle_Probability_21 "The probability of the Two-wheeler reported object being a Bicycle";
CM_ SG_ 154 OBJ_CRC_22 "Calculated over all element signals. From the signal after the CRC until the first signal in the next elements OBJ_CRC_N+1  not including";
CM_ SG_ 154 OBJ_ID_22 "The detected object ID. Range is 1-255, while 0 indicates that the field in unfilled.";
CM_ SG_ 154 OBJ_Existence_Probability_22 "The existence probability of the reported object";
CM_ SG_ 154 OBJ_Fusion_Source_22 "sources ids used for fusion";
CM_ SG_ 154 OBJ_Triggered_SDM_22 "Indicates whether the object has trigered the SDM (Safety Diagnostic Manager) alert.";
CM_ SG_ 154 OBJ_Motion_Category_22 "Relevant for VD only. Full description of values can be found at the ACC guide.";
CM_ SG_ 154 OBJ_Moving_IN_Probability_22 "The probability the object is eventually move into ego lane. (In case that the OBJ_Motion_Category signal is set to  MOVING_IN ";
CM_ SG_ 154 OBJ_Object_Age_22 "The number of frames in which the object was recognized.";
CM_ SG_ 154 OBJ_Measuring_Status_22 "Measurment status. Old vs New marks if this is the first frame in which the object is reported. Predicted vs Measured marks if the report is raw or has been predicted forward in time using the measured dynamics and ego motion.";
CM_ SG_ 154 OBJ_Object_Class_22 "Indicates the object type. Uncertain is outputted in case the probability that a vehicle is a truck is very similar to the probability that it is a car.";
CM_ SG_ 154 OBJ_Class_Probability_22 "The probability of this type classification.";
CM_ SG_ 154 OBJ_Car_Probability_22 "The probability the object is a car";
CM_ SG_ 154 OBJ_Truck_Probability_22 "The probability the object is a Truck";
CM_ SG_ 154 OBJ_Bike_Probability_22 "The probability the object is a Bike";
CM_ SG_ 154 OBJ_Camera_Source_22 "The camera in which this object was detected (best choice).";
CM_ SG_ 154 OBJ_Motion_Status_22 "MOVING - the object is moving STATIONARY - the object was never seen moving STOPPED -  the object was moving and has stopped MOVING_SLOWLY - the object is moving very slowly";
CM_ SG_ 154 OBJ_Motion_Orientation_22 "The direction of the targets heading compared to the host. ";
CM_ SG_ 154 OBJ_Has_Cut_Lane_22 "Indicates whether the object cut the host's (right or left) lane. In case there are no lanes, indicates whether the objects is at most 1 meters away from the host.";
CM_ SG_ 154 OBJ_Has_Cut_Path_22 "Indicates whether the object is in the host's path.";
CM_ SG_ 154 OBJ_Brake_Light_Validity_22 "Validator for braking light indicator";
CM_ SG_ 154 OBJ_Brake_Light_22 "Indication for brake lights ";
CM_ SG_ 154 OBJ_Turn_Indicator_Right_22 "Indication for blinking right light.";
CM_ SG_ 154 OBJ_Turn_Indicator_Left_22 "Indication for blinking left light ";
CM_ SG_ 154 OBJ_Turn_Indicator_Validity_22 "Validator for light indicators";
CM_ SG_ 154 OBJ_Right_Out_Of_Image_22 "Indicates whether the measurment are predicted out of the right side of the image bounderies.";
CM_ SG_ 154 OBJ_Left_Out_Of_Image_22 "Indicates whether if measurment are predicted out of  the left side of the image bounderies";
CM_ SG_ 154 OBJ_Right_Out_Of_Image_V_22 "validator";
CM_ SG_ 154 OBJ_Left_Out_Of_Image_V_22 "validator";
CM_ SG_ 154 OBJ_Top_Out_Of_Image_22 "Indicates whether if measurment are predicted out of  the top of the image bounderies";
CM_ SG_ 154 OBJ_Bottom_Out_Of_Image_22 "Indicates whether if measurment are predicted out of  the bottom of the image bounderies";
CM_ SG_ 154 OBJ_Top_Out_Of_Image_V_22 "validator";
CM_ SG_ 154 OBJ_Bottom_Out_Of_Image_V_22 "validator";
CM_ SG_ 154 OBJ_Lane_Assignment_22 "The object's lane relative to the host lane.";
CM_ SG_ 154 OBJ_Lane_Assignment_V_22 "Validator for lane assignment";
CM_ SG_ 154 OBJ_Age_Seconds_22 "Time in seconds in which the object was recognized. ";
CM_ SG_ 154 OBJ_Age_Seconds_V_22 "Validator for object age";
CM_ SG_ 154 OBJ_Width_22 "The width of the target vehicle in the world (not to be mistaken with the width of the visible part of the vehicle).";
CM_ SG_ 154 OBJ_Width_V_22 "Validator for object width";
CM_ SG_ 154 OBJ_Width_STD_22 "Standard deviation for object width";
CM_ SG_ 154 OBJ_Width_STD_V_22 "Validator for the standard deviation of object width";
CM_ SG_ 154 OBJ_Length_22 "The length of the vehicle in the world. For crossing bicycles it gives the viewed length of the bicycle.";
CM_ SG_ 154 OBJ_Length_V_22 "Validator for object length.";
CM_ SG_ 154 OBJ_Length_STD_22 "Standard deviation for object length.";
CM_ SG_ 154 OBJ_Length_STD_V_22 "Validator for the standard deviation of object length.";
CM_ SG_ 154 OBJ_Radar_ID_22 "Radar Object ID of the Fused Object, Only relvant when OBJ_Fusion_Source is not Camera only";
CM_ SG_ 154 OBJ_Height_22 "The height of the object in the world. ";
CM_ SG_ 154 OBJ_Height_V_22 "Validator for object height.";
CM_ SG_ 154 OBJ_Height_STD_22 "Standard deviation for object height.";
CM_ SG_ 154 OBJ_Height_STD_V_22 "Validator for the standard deviation of object height.";
CM_ SG_ 154 OBJ_Abs_Long_Velocity_22 "Absolute longitudinal velocity.";
CM_ SG_ 154 OBJ_Abs_Long_Velocity_V_22 "Validator for absolute longitudinal velocity.";
CM_ SG_ 154 OBJ_Abs_Long_Velocity_STD_22 "Standard deviation of absolute longitudinal velocity.";
CM_ SG_ 154 OBJ_Abs_Long_Vel_STD_V_22 "Validator for the standard deviation of the absolute longitudinal velocity.";
CM_ SG_ 154 OBJ_Abs_Lat_Velocity_22 "The lateral ground speed of the object.";
CM_ SG_ 154 OBJ_Abs_Lat_Velocity_V_22 "Validator for the lateral ground speed of the object.";
CM_ SG_ 154 OBJ_Abs_Lat_Velocity_STD_22 "STD of the lateral ground speed of the object.";
CM_ SG_ 154 OBJ_Abs_Lat_Vel_STD_V_22 "Validator for the STD of the lateral ground speed of the object.";
CM_ SG_ 154 OBJ_Abs_Long_Acc_22 "The longitudinal ground acceleration of the object.";
CM_ SG_ 154 OBJ_Abs_Long_Acc_V_22 "Validator for the longitudinal ground acceleration of the object.";
CM_ SG_ 154 OBJ_Abs_Long_Acc_STD_22 "STD of the longitudinal ground acceleration of the object.";
CM_ SG_ 154 OBJ_Abs_Long_Acc_STD_V_22 "Validator for the STD of the longitudinal ground acceleration of the object.";
CM_ SG_ 154 OBJ_Abs_Lat_Acc_22 "The lateral ground acceleration of the object.";
CM_ SG_ 154 OBJ_Abs_Lat_Acc_V_22 "Validator for the lateral ground acceleration of the object.";
CM_ SG_ 154 OBJ_Abs_Lat_Acc_STD_22 "STD of the lateral ground acceleration of the object.";
CM_ SG_ 154 OBJ_Abs_Lat_Acc_STD_V_22 "Validator for the STD of the lateral ground acceleration of the object.";
CM_ SG_ 154 OBJ_Abs_Acceleration_22 "The absolute ground acceleration in the target's heading direction.";
CM_ SG_ 154 OBJ_Abs_Acceleration_V_22 "Validator for the absolute ground acceleration.";
CM_ SG_ 154 OBJ_Abs_Acc_STD_22 "STD of the absolute ground acceleration.";
CM_ SG_ 154 OBJ_Abs_Acc_STD_V_22 "Validator for the STD of the absolute ground acceleration.";
CM_ SG_ 154 OBJ_Inv_TTC_22 "Inverse TTC (time to collision).";
CM_ SG_ 154 OBJ_Inv_TTC_STD_22 "STD for inverse TTC .";
CM_ SG_ 154 OBJ_Inv_TTC_STD_V_22 "Validator for the STD for inverse TTC .";
CM_ SG_ 154 OBJ_Relative_Long_Acc_22 "The relative longitudinal ground acceleration of the object.";
CM_ SG_ 154 OBJ_Relative_Long_Acc_V_22 "Validator for the relative longitudinal ground acceleration of the object.";
CM_ SG_ 154 OBJ_Relative_Long_Acc_STD_22 "STD of the relative longitudinal ground acceleration of the object.";
CM_ SG_ 154 OBJ_Rel_Long_Acc_STD_V_22 "Validator for the STD of the relative longitudinal ground acceleration.";
CM_ SG_ 154 OBJ_Relative_Long_Velocity_22 "The relative longtitudinal speed between the target and ego vehicle. ";
CM_ SG_ 154 OBJ_Relative_Long_Velocity_V_22 "Validator for the relative longtitudinal speed.";
CM_ SG_ 154 OBJ_Relative_Long_Vel_STD_22 "STD of the relative longtitudinal speed.";
CM_ SG_ 154 OBJ_Rel_Long_Vel_STD_V_22 "Validator for the STD of the relative longtitudinal speed.";
CM_ SG_ 154 OBJ_Relative_Lat_Velocity_22 "The relative lateral speed between the target and ego vehicle. ";
CM_ SG_ 154 OBJ_Relative_Lat_Velocity_V_22 "Validator for the relative lateral speed. ";
CM_ SG_ 154 OBJ_Relative_Lat_Velocity_STD_22 "STD of the relative lateral speed. ";
CM_ SG_ 154 OBJ_Rel_Lat_Vel_STD_V_22 "Validator for the STD of the relative lateral speed. ";
CM_ SG_ 154 OBJ_Long_Distance_22 "The longitudinal distance to middle of the rear bumper (middle of the RL and RR corners) of the target.";
CM_ SG_ 154 OBJ_Long_Distance_V_22 "Validator of the longtitudinal distance field";
CM_ SG_ 154 OBJ_Long_Distance_STD_22 "STD of the  longtitudinal distance.";
CM_ SG_ 154 OBJ_Long_Distance_STD_V_22 "Validator for the STD of the  longtitudinal distance.";
CM_ SG_ 154 OBJ_Lat_Distance_22 "Lateral distance to the middle of the RL and RR corners.  ";
CM_ SG_ 154 OBJ_Lat_Distance_V_22 "Validator for the lateral distance of the object.";
CM_ SG_ 154 OBJ_Lat_Distance_STD_22 "STD of the lateral distance of the object.";
CM_ SG_ 154 OBJ_Lat_Distance_STD_V_22 "Validator for the STD of the lateral distance of the object.";
CM_ SG_ 154 OBJ_Absolute_Speed_22 "The absolute ground speed in the targets' heading direction.";
CM_ SG_ 154 OBJ_Absolute_Speed_V_22 "Validator for the absolute ground speed.";
CM_ SG_ 154 OBJ_Absolute_Speed_STD_22 "STD of the absolute ground speed.";
CM_ SG_ 154 OBJ_Absolute_Speed_STD_V_22 "Validator for the STD of the absolute ground speed.";
CM_ SG_ 154 OBJ_Heading_22 "The angle beetweenthe host longitudinal axis and target's heading (clockwise, e.g. PI/2 is a target crossing from left to right).";
CM_ SG_ 154 OBJ_Heading_V_22 "Validator for the object heading.";
CM_ SG_ 154 OBJ_Heading_STD_22 "STD of the object heading.";
CM_ SG_ 154 OBJ_Heading_STD_V_22 "Validator for the STD of the object heading.";
CM_ SG_ 154 OBJ_Angle_Rate_STD_22 "Standard deviation of the angular speed. (radians)";
CM_ SG_ 154 OBJ_Angle_Rate_STD_V_22 "Validator for the STD of the angular speed.";
CM_ SG_ 154 OBJ_Angle_Rate_22 "The momentary angular speed of the object (radians). The positive side is to the host's right.";
CM_ SG_ 154 OBJ_Angle_Rate_V_22 "Validator for the angular speed.";
CM_ SG_ 154 OBJ_Angle_Right_22 "The angle between the host longitudinal axis and the right side of the front / rear of the target (the visible one). The positive side is to the host's right.";
CM_ SG_ 154 OBJ_Angle_Right_V_22 "Validator for angleRight";
CM_ SG_ 154 OBJ_Angle_Right_STD_22 "Standard deviation of angleRight";
CM_ SG_ 154 OBJ_Angle_Right_STD_V_22 "Validator for the standard deviation of angleRight.";
CM_ SG_ 154 OBJ_Angle_Left_22 "The angle between the host longitudinal axis and the left side of the front / rear of the target (the visible one). The positive side is to the host's right.";
CM_ SG_ 154 OBJ_Angle_Left_V_22 "Validator for angleLeft.";
CM_ SG_ 154 OBJ_Angle_Left_STD_22 "Standard deviation of angleLeft.";
CM_ SG_ 154 OBJ_Angle_Left_STD_V_22 "Validator for the standard deviation of angleLeft.";
CM_ SG_ 154 OBJ_Angle_Side_22 "The angle between the host longitudinal axis and the far visible edge - the visible edge of the front / rear of the target that is not visible. Currently supported for vehicles only.";
CM_ SG_ 154 OBJ_Angle_Side_V_22 "Validator for angleSide.";
CM_ SG_ 154 OBJ_Angle_Side_STD_22 "Standard deviation of angleSide.";
CM_ SG_ 154 OBJ_Angle_Side_STD_V_22 "Validator for the STD of angleSide.";
CM_ SG_ 154 OBJ_Angle_Mid_V_22 "Validator for angleMid.";
CM_ SG_ 154 OBJ_Angle_Mid_22 "The angle between the host longitudinal axis and the middle of the front / rear of the target (the visible one). The positive side is to the host's right.";
CM_ SG_ 154 OBJ_Angle_Mid_STD_22 "Standard deviation of angleMid.";
CM_ SG_ 154 OBJ_Angle_Mid_STD_V_22 "Validator for the STD of angleMid.";
CM_ SG_ 154 OBJ_Angle_Bottom_V_22 "Validator for OBJAngle_Bottom. ";
CM_ SG_ 154 OBJ_Angle_Bottom_22 "The angle between the longitudinal axis and the Bottom of the front / rear of the target (the visible one). The positive side is to the host's bottom";
CM_ SG_ 154 OBJ_Angle_Bottom_STD_22 "STD for OBJAngle_Bottom. ";
CM_ SG_ 154 OBJ_Angle_Bottom_STD_V_22 "Validator for OBJAngle_Bottom_STD. ";
CM_ SG_ 154 OBJ_Visibility_Side_V_22 "Currently Supported for VD only";
CM_ SG_ 154 OBJ_Visibility_Side_22 "From what car  side is the object visible";
CM_ SG_ 154 OBJ_Is_In_Drivable_Area_22 "Indicates whether the target is in a driveable area.";
CM_ SG_ 154 OBJ_Is_In_Drivable_Area_V_22 "Validator for OBJ_Is_In_Drivable_Area.";
CM_ SG_ 154 OBJ_Is_VeryClose_V_22 "Validator for OBJ_Is_VeryClose. ";
CM_ SG_ 154 OBJ_Is_VeryClose_22 "Indicates whether the target is very close to the host such that it is hard to measure its distance. Currently relevant for peds only";
CM_ SG_ 154 OBJ_OverlapAngleEgoLaneR_22 "Lateral distance to the middle of the RL and RR corners.";
CM_ SG_ 154 OBJ_OverlapAngleEgoLaneR_V_22 "Validator for OBJ_OverlapAngleEgoLaneR";
CM_ SG_ 154 OBJ_OverlapAngleEgoLaneL_22 "Lateral distance to the middle of the RL and RR corners.  ";
CM_ SG_ 154 OBJ_OverlapAngleEgoLaneL_V_22 "Validator for OBJ_OverlapAngleEgoLaneL";
CM_ SG_ 154 OBJ_Is_EMERGENCY_VCL_22 "Is Object an Emergency Vehicle";
CM_ SG_ 154 OBJ_EMERGENCY_LIGHT_COLOR_22 "Emergency Color";
CM_ SG_ 154 OBJ_EMERGENCY_V_22 "Are OBJ_Is_EMERGENCY_VCL and OBJ_EMERGENCY_LIGHT_COLOR Valid";
BA_DEF_ SG_  "GenSigStartValue" INT 0 0;
BA_DEF_DEF_  "GenSigStartValue" 0;
BA_ "GenSigStartValue" SG_ 154 OBJ_Width_17 40;
BA_ "GenSigStartValue" SG_ 154 OBJ_Length_17 12;
BA_ "GenSigStartValue" SG_ 154 OBJ_Width_18 40;
BA_ "GenSigStartValue" SG_ 154 OBJ_Length_18 12;
BA_ "GenSigStartValue" SG_ 154 OBJ_Width_19 40;
BA_ "GenSigStartValue" SG_ 154 OBJ_Length_19 12;
BA_ "GenSigStartValue" SG_ 154 OBJ_Width_20 40;
BA_ "GenSigStartValue" SG_ 154 OBJ_Length_20 12;
BA_ "GenSigStartValue" SG_ 154 OBJ_Width_21 40;
BA_ "GenSigStartValue" SG_ 154 OBJ_Length_21 12;
BA_ "GenSigStartValue" SG_ 154 OBJ_Width_22 40;
BA_ "GenSigStartValue" SG_ 154 OBJ_Length_22 12;
VAL_ 154 OBJ_Bottom_Out_Of_Image_17 1 "TRUE" 0 "FALSE" ;
VAL_ 154 OBJ_Top_Out_Of_Image_V_17 1 "VALID" 0 "INVALID" ;
VAL_ 154 OBJ_Bottom_Out_Of_Image_V_17 1 "VALID" 0 "INVALID" ;
VAL_ 154 OBJ_Lane_Assignment_17 5 "RIGHT_RIGHT" 4 "RIGHT" 3 "HOST" 2 "LEFT" 1 "LEFT_LEFT" 0 "UNKNOWN" ;
VAL_ 154 OBJ_Lane_Assignment_V_17 1 "VALID" 0 "INVALID" ;
VAL_ 154 OBJ_Age_Seconds_V_17 1 "VALID" 0 "INVALID" ;
VAL_ 154 OBJ_Width_V_17 1 "VALID" 0 "INVALID" ;
VAL_ 154 OBJ_Width_STD_V_17 1 "VALID" 0 "INVALID" ;
VAL_ 154 OBJ_Length_V_17 1 "VALID" 0 "INVALID" ;
VAL_ 154 OBJ_Length_STD_V_17 1 "VALID" 0 "INVALID" ;
VAL_ 154 OBJ_Height_V_17 1 "VALID" 0 "INVALID" ;
VAL_ 154 OBJ_Height_STD_V_17 1 "VALID" 0 "INVALID" ;
VAL_ 154 OBJ_Abs_Long_Velocity_V_17 1 "VALID" 0 "INVALID" ;
VAL_ 154 OBJ_Abs_Long_Vel_STD_V_17 1 "VALID" 0 "INVALID" ;
VAL_ 154 OBJ_Abs_Lat_Velocity_V_17 1 "VALID" 0 "INVALID" ;
VAL_ 154 OBJ_Abs_Lat_Vel_STD_V_17 1 "VALID" 0 "INVALID" ;
VAL_ 154 OBJ_Abs_Long_Acc_V_17 1 "VALID" 0 "INVALID" ;
VAL_ 154 OBJ_Abs_Long_Acc_STD_V_17 1 "VALID" 0 "INVALID" ;
VAL_ 154 OBJ_Abs_Lat_Acc_V_17 1 "VALID" 0 "INVALID" ;
VAL_ 154 OBJ_Abs_Lat_Acc_STD_V_17 1 "VALID" 0 "INVALID" ;
VAL_ 154 OBJ_Abs_Acceleration_V_17 1 "VALID" 0 "INVALID" ;
VAL_ 154 OBJ_Abs_Acc_STD_V_17 1 "VALID" 0 "INVALID" ;
VAL_ 154 OBJ_Inv_TTC_V_17 1 "VALID" 0 "INVALID" ;
VAL_ 154 OBJ_Inv_TTC_STD_V_17 1 "VALID" 0 "INVALID" ;
VAL_ 154 OBJ_Relative_Long_Acc_V_17 1 "VALID" 0 "INVALID" ;
VAL_ 154 OBJ_Rel_Long_Acc_STD_V_17 1 "VALID" 0 "INVALID" ;
VAL_ 154 OBJ_Relative_Long_Velocity_V_17 1 "VALID" 0 "INVALID" ;
VAL_ 154 OBJ_Rel_Long_Vel_STD_V_17 1 "VALID" 0 "INVALID" ;
VAL_ 154 OBJ_Relative_Lat_Velocity_V_17 1 "VALID" 0 "INVALID" ;
VAL_ 154 OBJ_Rel_Lat_Vel_STD_V_17 1 "VALID" 0 "INVALID" ;
VAL_ 154 OBJ_Long_Distance_V_17 1 "VALID" 0 "INVALID" ;
VAL_ 154 OBJ_Long_Distance_STD_V_17 1 "VALID" 0 "INVALID" ;
VAL_ 154 OBJ_Lat_Distance_V_17 1 "VALID" 0 "INVALID" ;
VAL_ 154 OBJ_Lat_Distance_STD_V_17 1 "VALID" 0 "INVALID" ;
VAL_ 154 OBJ_Absolute_Speed_V_17 1 "VALID" 0 "INVALID" ;
VAL_ 154 OBJ_Absolute_Speed_STD_V_17 1 "VALID" 0 "INVALID" ;
VAL_ 154 OBJ_Heading_V_17 1 "VALID" 0 "INVALID" ;
VAL_ 154 OBJ_Heading_STD_V_17 1 "VALID" 0 "INVALID" ;
VAL_ 154 OBJ_Angle_Rate_STD_V_17 1 "VALID" 0 "INVALID" ;
VAL_ 154 OBJ_Angle_Rate_V_17 1 "VALID" 0 "INVALID" ;
VAL_ 154 OBJ_Angle_Right_V_17 1 "VALID" 0 "INVALID" ;
VAL_ 154 OBJ_Angle_Right_STD_V_17 1 "VALID" 0 "INVALID" ;
VAL_ 154 OBJ_Angle_Left_V_17 1 "VALID" 0 "INVALID" ;
VAL_ 154 OBJ_Angle_Left_STD_V_17 1 "VALID" 0 "INVALID" ;
VAL_ 154 OBJ_Angle_Side_V_17 1 "VALID" 0 "INVALID" ;
VAL_ 154 OBJ_Angle_Side_STD_V_17 1 "VALID" 0 "INVALID" ;
VAL_ 154 OBJ_Angle_Mid_V_17 1 "VALID" 0 "INVALID" ;
VAL_ 154 OBJ_Angle_Mid_STD_V_17 1 "VALID" 0 "INVALID" ;
VAL_ 154 OBJ_Angle_Bottom_V_17 1 "VALID" 0 "INVALID" ;
VAL_ 154 OBJ_Angle_Bottom_STD_V_17 1 "VALID" 0 "INVALID" ;
VAL_ 154 OBJ_Visibility_Side_V_17 1 "VALID" 0 "INVALID" ;
VAL_ 154 OBJ_Visibility_Side_17 2 "REAR" 1 "FRONT" 0 "NOT_VISIBLE" ;
VAL_ 154 OBJ_Is_In_Drivable_Area_17 1 "TRUE" 0 "FALSE" ;
VAL_ 154 OBJ_Is_In_Drivable_Area_V_17 1 "VALID" 0 "INVALID" ;
VAL_ 154 OBJ_Is_VeryClose_V_17 1 "VALID" 0 "INVALID" ;
VAL_ 154 OBJ_Is_VeryClose_17 1 "TRUE" 0 "FALSE" ;
VAL_ 154 OBJ_OverlapAngleEgoLaneR_V_17 1 "VALID" 0 "INVALID" ;
VAL_ 154 OBJ_OverlapAngleEgoLaneL_V_17 1 "VALID" 0 "INVALID" ;
VAL_ 154 OBJ_Is_EMERGENCY_VCL_17 1 "TRUE" 0 "FALSE" ;
VAL_ 154 OBJ_EMERGENCY_LIGHT_COLOR_17 3 "(1000)ORANGE" 2 "(0100)BLUE" 1 "(0010)RED" 0 "(0001)OTHER" ;
VAL_ 154 OBJ_EMERGENCY_V_17 1 "TRUE" 0 "FALSE" ;
VAL_ 154 OBJ_Angle_Top_V_17 1 "VALID" 0 "INVALID" ;
VAL_ 154 OBJ_Angle_Top_STD_V_17 1 "VALID" 0 "INVALID" ;
VAL_ 154 OBJ_Open_Door_Left_17 1 "TRUE" 0 "FALSE" ;
VAL_ 154 OBJ_Open_Door_Right_17 1 "TRUE" 0 "FALSE" ;
VAL_ 154 OBJ_Visible_Left_or_Right_17 2 "RIGHT" 1 "LEFT" 0 "NOT_VISIBLE" ;
VAL_ 154 OBJ_Visible_Left_or_Right_V_17 1 "VALID" 0 "INVALID" ;
VAL_ 154 OBJ_Fusion_Source_18 2 "(BIT_2)RADAR2" 1 "(BIT_1)RADAR1" 0 "(BIT_0)CAMERA" ;
VAL_ 154 OBJ_Triggered_SDM_18 2 "NOT_TRIGGERED" 1 "TRIGGERED" 0 "NOT_AVAILABLE" ;
VAL_ 154 OBJ_Motion_Category_18 13 "ONCOMING" 12 "PRECEEDING" 11 "MOVING" 10 "RTAP" 9 "LTAP" 8 "CROSSING" 7 "MOVING_OUT" 6 "MOVING_IN" 5 "CLOSE_CUT_IN" 4 "PASSING_OUT" 3 "PASSING_IN" 2 "PASSING" 1 "UNDEFINED" 0 "UNFILLED" ;
VAL_ 154 OBJ_Measuring_Status_18 2 "(BIT_2)NOT_VALID_OR_VALID" 1 "(BIT_1)PREDICTED_OR_MEASURED" 0 "(BIT_0)OLD_OR_NEW" ;
VAL_ 154 OBJ_Object_Class_18 9 "TWO_WHEELER" 8 "UNCERTAIN_VCL" 7 "ANIMAL" 6 "GENERAL_OBJECT" 5 "PEDESTRIAN" 4 "BICYCLE" 3 "MOTORBIKE" 2 "TRUCK" 1 "CAR" 0 "UNFILLED" ;
VAL_ 154 OBJ_Camera_Source_18 11 "PARKING_RIGHT" 10 "PARKING_LEFT" 9 "PARKING_REAR" 8 "PARKING_FRONT" 7 "FRONT_CORNER_RIGHT" 6 "FRONT_CORNER_LEFT" 5 "REAR_CORNER_RIGHT" 4 "REAR_CORNER_LEFT" 3 "REAR" 2 "FRONT_FISHEYE" 1 "FRONT_NARROW" 0 "FRONT_MAIN" ;
VAL_ 154 OBJ_Motion_Status_18 5 "MOVING_SLOWLY" 4 "STOPPED" 3 "STATIONARY" 2 "MOVING" 1 "UNKNOWN" 0 "INVALID" ;
VAL_ 154 OBJ_Motion_Orientation_18 13 "INVALID" 12 "NORTH" 11 "NORTH_WEST" 9 "WEST" 7 "SOUTH_WEST" 6 "SOUTH" 5 "SOUTH_EAST" 3 "EAST" 1 "NORTH_EAST" 0 "UNKNOWN" ;
VAL_ 154 OBJ_Has_Cut_Lane_18 1 "TRUE" 0 "FALSE" ;
VAL_ 154 OBJ_Has_Cut_Path_18 1 "TRUE" 0 "FALSE" ;
VAL_ 154 OBJ_Brake_Light_Validity_18 1 "TRUE" 0 "FALSE" ;
VAL_ 154 OBJ_Brake_Light_18 1 "TRUE" 0 "FALSE" ;
VAL_ 154 OBJ_Turn_Indicator_Right_18 1 "TRUE" 0 "FALSE" ;
VAL_ 154 OBJ_Turn_Indicator_Left_18 1 "TRUE" 0 "FALSE" ;
VAL_ 154 OBJ_Turn_Indicator_Validity_18 1 "TRUE" 0 "FALSE" ;
VAL_ 154 OBJ_Right_Out_Of_Image_18 1 "TRUE" 0 "FALSE" ;
VAL_ 154 OBJ_Left_Out_Of_Image_18 1 "TRUE" 0 "FALSE" ;
VAL_ 154 OBJ_Right_Out_Of_Image_V_18 1 "TRUE" 0 "FALSE" ;
VAL_ 154 OBJ_Left_Out_Of_Image_V_18 1 "TRUE" 0 "FALSE" ;
VAL_ 154 OBJ_Top_Out_Of_Image_18 1 "TRUE" 0 "FALSE" ;
VAL_ 154 OBJ_Bottom_Out_Of_Image_18 1 "TRUE" 0 "FALSE" ;
VAL_ 154 OBJ_Top_Out_Of_Image_V_18 1 "VALID" 0 "INVALID" ;
VAL_ 154 OBJ_Bottom_Out_Of_Image_V_18 1 "VALID" 0 "INVALID" ;
VAL_ 154 OBJ_Lane_Assignment_18 5 "RIGHT_RIGHT" 4 "RIGHT" 3 "HOST" 2 "LEFT" 1 "LEFT_LEFT" 0 "UNKNOWN" ;
VAL_ 154 OBJ_Lane_Assignment_V_18 1 "VALID" 0 "INVALID" ;
VAL_ 154 OBJ_Age_Seconds_V_18 1 "VALID" 0 "INVALID" ;
VAL_ 154 OBJ_Width_V_18 1 "VALID" 0 "INVALID" ;
VAL_ 154 OBJ_Width_STD_V_18 1 "VALID" 0 "INVALID" ;
VAL_ 154 OBJ_Length_V_18 1 "VALID" 0 "INVALID" ;
VAL_ 154 OBJ_Length_STD_V_18 1 "VALID" 0 "INVALID" ;
VAL_ 154 OBJ_Height_V_18 1 "VALID" 0 "INVALID" ;
VAL_ 154 OBJ_Height_STD_V_18 1 "VALID" 0 "INVALID" ;
VAL_ 154 OBJ_Abs_Long_Velocity_V_18 1 "VALID" 0 "INVALID" ;
VAL_ 154 OBJ_Abs_Long_Vel_STD_V_18 1 "VALID" 0 "INVALID" ;
VAL_ 154 OBJ_Abs_Lat_Velocity_V_18 1 "VALID" 0 "INVALID" ;
VAL_ 154 OBJ_Abs_Lat_Vel_STD_V_18 1 "VALID" 0 "INVALID" ;
VAL_ 154 OBJ_Abs_Long_Acc_V_18 1 "VALID" 0 "INVALID" ;
VAL_ 154 OBJ_Abs_Long_Acc_STD_V_18 1 "VALID" 0 "INVALID" ;
VAL_ 154 OBJ_Abs_Lat_Acc_V_18 1 "VALID" 0 "INVALID" ;
VAL_ 154 OBJ_Abs_Lat_Acc_STD_V_18 1 "VALID" 0 "INVALID" ;
VAL_ 154 OBJ_Abs_Acceleration_V_18 1 "VALID" 0 "INVALID" ;
VAL_ 154 OBJ_Abs_Acc_STD_V_18 1 "VALID" 0 "INVALID" ;
VAL_ 154 OBJ_Inv_TTC_V_18 1 "VALID" 0 "INVALID" ;
VAL_ 154 OBJ_Inv_TTC_STD_V_18 1 "VALID" 0 "INVALID" ;
VAL_ 154 OBJ_Relative_Long_Acc_V_18 1 "VALID" 0 "INVALID" ;
VAL_ 154 OBJ_Rel_Long_Acc_STD_V_18 1 "VALID" 0 "INVALID" ;
VAL_ 154 OBJ_Relative_Long_Velocity_V_18 1 "VALID" 0 "INVALID" ;
VAL_ 154 OBJ_Rel_Long_Vel_STD_V_18 1 "VALID" 0 "INVALID" ;
VAL_ 154 OBJ_Relative_Lat_Velocity_V_18 1 "VALID" 0 "INVALID" ;
VAL_ 154 OBJ_Rel_Lat_Vel_STD_V_18 1 "VALID" 0 "INVALID" ;
VAL_ 154 OBJ_Long_Distance_V_18 1 "VALID" 0 "INVALID" ;
VAL_ 154 OBJ_Long_Distance_STD_V_18 1 "VALID" 0 "INVALID" ;
VAL_ 154 OBJ_Lat_Distance_V_18 1 "VALID" 0 "INVALID" ;
VAL_ 154 OBJ_Lat_Distance_STD_V_18 1 "VALID" 0 "INVALID" ;
VAL_ 154 OBJ_Absolute_Speed_V_18 1 "VALID" 0 "INVALID" ;
VAL_ 154 OBJ_Absolute_Speed_STD_V_18 1 "VALID" 0 "INVALID" ;
VAL_ 154 OBJ_Heading_V_18 1 "VALID" 0 "INVALID" ;
VAL_ 154 OBJ_Heading_STD_V_18 1 "VALID" 0 "INVALID" ;
VAL_ 154 OBJ_Angle_Rate_STD_V_18 1 "VALID" 0 "INVALID" ;
VAL_ 154 OBJ_Angle_Rate_V_18 1 "VALID" 0 "INVALID" ;
VAL_ 154 OBJ_Angle_Right_V_18 1 "VALID" 0 "INVALID" ;
VAL_ 154 OBJ_Angle_Right_STD_V_18 1 "VALID" 0 "INVALID" ;
VAL_ 154 OBJ_Angle_Left_V_18 1 "VALID" 0 "INVALID" ;
VAL_ 154 OBJ_Angle_Left_STD_V_18 1 "VALID" 0 "INVALID" ;
VAL_ 154 OBJ_Angle_Side_V_18 1 "VALID" 0 "INVALID" ;
VAL_ 154 OBJ_Angle_Side_STD_V_18 1 "VALID" 0 "INVALID" ;
VAL_ 154 OBJ_Angle_Mid_V_18 1 "VALID" 0 "INVALID" ;
VAL_ 154 OBJ_Angle_Mid_STD_V_18 1 "VALID" 0 "INVALID" ;
VAL_ 154 OBJ_Angle_Bottom_V_18 1 "VALID" 0 "INVALID" ;
VAL_ 154 OBJ_Angle_Bottom_STD_V_18 1 "VALID" 0 "INVALID" ;
VAL_ 154 OBJ_Visibility_Side_V_18 1 "VALID" 0 "INVALID" ;
VAL_ 154 OBJ_Visibility_Side_18 2 "REAR" 1 "FRONT" 0 "NOT_VISIBLE" ;
VAL_ 154 OBJ_Is_In_Drivable_Area_18 1 "TRUE" 0 "FALSE" ;
VAL_ 154 OBJ_Is_In_Drivable_Area_V_18 1 "VALID" 0 "INVALID" ;
VAL_ 154 OBJ_Is_VeryClose_V_18 1 "VALID" 0 "INVALID" ;
VAL_ 154 OBJ_Is_VeryClose_18 1 "TRUE" 0 "FALSE" ;
VAL_ 154 OBJ_OverlapAngleEgoLaneR_V_18 1 "VALID" 0 "INVALID" ;
VAL_ 154 OBJ_OverlapAngleEgoLaneL_V_18 1 "VALID" 0 "INVALID" ;
VAL_ 154 OBJ_Is_EMERGENCY_VCL_18 1 "TRUE" 0 "FALSE" ;
VAL_ 154 OBJ_EMERGENCY_LIGHT_COLOR_18 3 "(1000)ORANGE" 2 "(0100)BLUE" 1 "(0010)RED" 0 "(0001)OTHER" ;
VAL_ 154 OBJ_EMERGENCY_V_18 1 "TRUE" 0 "FALSE" ;
VAL_ 154 OBJ_Angle_Top_V_18 1 "VALID" 0 "INVALID" ;
VAL_ 154 OBJ_Angle_Top_STD_V_18 1 "VALID" 0 "INVALID" ;
VAL_ 154 OBJ_Open_Door_Left_18 1 "TRUE" 0 "FALSE" ;
VAL_ 154 OBJ_Open_Door_Right_18 1 "TRUE" 0 "FALSE" ;
VAL_ 154 OBJ_Visible_Left_or_Right_18 2 "RIGHT" 1 "LEFT" 0 "NOT_VISIBLE" ;
VAL_ 154 OBJ_Visible_Left_or_Right_V_18 1 "VALID" 0 "INVALID" ;
VAL_ 154 OBJ_Fusion_Source_19 2 "(BIT_2)RADAR2" 1 "(BIT_1)RADAR1" 0 "(BIT_0)CAMERA" ;
VAL_ 154 OBJ_Triggered_SDM_19 2 "NOT_TRIGGERED" 1 "TRIGGERED" 0 "NOT_AVAILABLE" ;
VAL_ 154 OBJ_Motion_Category_19 13 "ONCOMING" 12 "PRECEEDING" 11 "MOVING" 10 "RTAP" 9 "LTAP" 8 "CROSSING" 7 "MOVING_OUT" 6 "MOVING_IN" 5 "CLOSE_CUT_IN" 4 "PASSING_OUT" 3 "PASSING_IN" 2 "PASSING" 1 "UNDEFINED" 0 "UNFILLED" ;
VAL_ 154 OBJ_Measuring_Status_19 2 "(BIT_2)NOT_VALID_OR_VALID" 1 "(BIT_1)PREDICTED_OR_MEASURED" 0 "(BIT_0)OLD_OR_NEW" ;
VAL_ 154 OBJ_Object_Class_19 9 "TWO_WHEELER" 8 "UNCERTAIN_VCL" 7 "ANIMAL" 6 "GENERAL_OBJECT" 5 "PEDESTRIAN" 4 "BICYCLE" 3 "MOTORBIKE" 2 "TRUCK" 1 "CAR" 0 "UNFILLED" ;
VAL_ 154 OBJ_Camera_Source_19 11 "PARKING_RIGHT" 10 "PARKING_LEFT" 9 "PARKING_REAR" 8 "PARKING_FRONT" 7 "FRONT_CORNER_RIGHT" 6 "FRONT_CORNER_LEFT" 5 "REAR_CORNER_RIGHT" 4 "REAR_CORNER_LEFT" 3 "REAR" 2 "FRONT_FISHEYE" 1 "FRONT_NARROW" 0 "FRONT_MAIN" ;
VAL_ 154 OBJ_Motion_Status_19 5 "MOVING_SLOWLY" 4 "STOPPED" 3 "STATIONARY" 2 "MOVING" 1 "UNKNOWN" 0 "INVALID" ;
VAL_ 154 OBJ_Motion_Orientation_19 13 "INVALID" 12 "NORTH" 11 "NORTH_WEST" 9 "WEST" 7 "SOUTH_WEST" 6 "SOUTH" 5 "SOUTH_EAST" 3 "EAST" 1 "NORTH_EAST" 0 "UNKNOWN" ;
VAL_ 154 OBJ_Has_Cut_Lane_19 1 "TRUE" 0 "FALSE" ;
VAL_ 154 OBJ_Has_Cut_Path_19 1 "TRUE" 0 "FALSE" ;
VAL_ 154 OBJ_Brake_Light_Validity_19 1 "TRUE" 0 "FALSE" ;
VAL_ 154 OBJ_Brake_Light_19 1 "TRUE" 0 "FALSE" ;
VAL_ 154 OBJ_Turn_Indicator_Right_19 1 "TRUE" 0 "FALSE" ;
VAL_ 154 OBJ_Turn_Indicator_Left_19 1 "TRUE" 0 "FALSE" ;
VAL_ 154 OBJ_Turn_Indicator_Validity_19 1 "TRUE" 0 "FALSE" ;
VAL_ 154 OBJ_Right_Out_Of_Image_19 1 "TRUE" 0 "FALSE" ;
VAL_ 154 OBJ_Left_Out_Of_Image_19 1 "TRUE" 0 "FALSE" ;
VAL_ 154 OBJ_Right_Out_Of_Image_V_19 1 "TRUE" 0 "FALSE" ;
VAL_ 154 OBJ_Left_Out_Of_Image_V_19 1 "TRUE" 0 "FALSE" ;
VAL_ 154 OBJ_Top_Out_Of_Image_19 1 "TRUE" 0 "FALSE" ;
VAL_ 154 OBJ_Bottom_Out_Of_Image_19 1 "TRUE" 0 "FALSE" ;
VAL_ 154 OBJ_Top_Out_Of_Image_V_19 1 "VALID" 0 "INVALID" ;
VAL_ 154 OBJ_Bottom_Out_Of_Image_V_19 1 "VALID" 0 "INVALID" ;
VAL_ 154 OBJ_Lane_Assignment_19 5 "RIGHT_RIGHT" 4 "RIGHT" 3 "HOST" 2 "LEFT" 1 "LEFT_LEFT" 0 "UNKNOWN" ;
VAL_ 154 OBJ_Lane_Assignment_V_19 1 "VALID" 0 "INVALID" ;
VAL_ 154 OBJ_Age_Seconds_V_19 1 "VALID" 0 "INVALID" ;
VAL_ 154 OBJ_Width_V_19 1 "VALID" 0 "INVALID" ;
VAL_ 154 OBJ_Width_STD_V_19 1 "VALID" 0 "INVALID" ;
VAL_ 154 OBJ_Length_V_19 1 "VALID" 0 "INVALID" ;
VAL_ 154 OBJ_Length_STD_V_19 1 "VALID" 0 "INVALID" ;
VAL_ 154 OBJ_Height_V_19 1 "VALID" 0 "INVALID" ;
VAL_ 154 OBJ_Height_STD_V_19 1 "VALID" 0 "INVALID" ;
VAL_ 154 OBJ_Abs_Long_Velocity_V_19 1 "VALID" 0 "INVALID" ;
VAL_ 154 OBJ_Abs_Long_Vel_STD_V_19 1 "VALID" 0 "INVALID" ;
VAL_ 154 OBJ_Abs_Lat_Velocity_V_19 1 "VALID" 0 "INVALID" ;
VAL_ 154 OBJ_Abs_Lat_Vel_STD_V_19 1 "VALID" 0 "INVALID" ;
VAL_ 154 OBJ_Abs_Long_Acc_V_19 1 "VALID" 0 "INVALID" ;
VAL_ 154 OBJ_Abs_Long_Acc_STD_V_19 1 "VALID" 0 "INVALID" ;
VAL_ 154 OBJ_Abs_Lat_Acc_V_19 1 "VALID" 0 "INVALID" ;
VAL_ 154 OBJ_Abs_Lat_Acc_STD_V_19 1 "VALID" 0 "INVALID" ;
VAL_ 154 OBJ_Abs_Acceleration_V_19 1 "VALID" 0 "INVALID" ;
VAL_ 154 OBJ_Abs_Acc_STD_V_19 1 "VALID" 0 "INVALID" ;
VAL_ 154 OBJ_Inv_TTC_V_19 1 "VALID" 0 "INVALID" ;
VAL_ 154 OBJ_Inv_TTC_STD_V_19 1 "VALID" 0 "INVALID" ;
VAL_ 154 OBJ_Relative_Long_Acc_V_19 1 "VALID" 0 "INVALID" ;
VAL_ 154 OBJ_Rel_Long_Acc_STD_V_19 1 "VALID" 0 "INVALID" ;
VAL_ 154 OBJ_Relative_Long_Velocity_V_19 1 "VALID" 0 "INVALID" ;
VAL_ 154 OBJ_Rel_Long_Vel_STD_V_19 1 "VALID" 0 "INVALID" ;
VAL_ 154 OBJ_Relative_Lat_Velocity_V_19 1 "VALID" 0 "INVALID" ;
VAL_ 154 OBJ_Rel_Lat_Vel_STD_V_19 1 "VALID" 0 "INVALID" ;
VAL_ 154 OBJ_Long_Distance_V_19 1 "VALID" 0 "INVALID" ;
VAL_ 154 OBJ_Long_Distance_STD_V_19 1 "VALID" 0 "INVALID" ;
VAL_ 154 OBJ_Lat_Distance_V_19 1 "VALID" 0 "INVALID" ;
VAL_ 154 OBJ_Lat_Distance_STD_V_19 1 "VALID" 0 "INVALID" ;
VAL_ 154 OBJ_Absolute_Speed_V_19 1 "VALID" 0 "INVALID" ;
VAL_ 154 OBJ_Absolute_Speed_STD_V_19 1 "VALID" 0 "INVALID" ;
VAL_ 154 OBJ_Heading_V_19 1 "VALID" 0 "INVALID" ;
VAL_ 154 OBJ_Heading_STD_V_19 1 "VALID" 0 "INVALID" ;
VAL_ 154 OBJ_Angle_Rate_STD_V_19 1 "VALID" 0 "INVALID" ;
VAL_ 154 OBJ_Angle_Rate_V_19 1 "VALID" 0 "INVALID" ;
VAL_ 154 OBJ_Angle_Right_V_19 1 "VALID" 0 "INVALID" ;
VAL_ 154 OBJ_Angle_Right_STD_V_19 1 "VALID" 0 "INVALID" ;
VAL_ 154 OBJ_Angle_Left_V_19 1 "VALID" 0 "INVALID" ;
VAL_ 154 OBJ_Angle_Left_STD_V_19 1 "VALID" 0 "INVALID" ;
VAL_ 154 OBJ_Angle_Side_V_19 1 "VALID" 0 "INVALID" ;
VAL_ 154 OBJ_Angle_Side_STD_V_19 1 "VALID" 0 "INVALID" ;
VAL_ 154 OBJ_Angle_Mid_V_19 1 "VALID" 0 "INVALID" ;
VAL_ 154 OBJ_Angle_Mid_STD_V_19 1 "VALID" 0 "INVALID" ;
VAL_ 154 OBJ_Angle_Bottom_V_19 1 "VALID" 0 "INVALID" ;
VAL_ 154 OBJ_Angle_Bottom_STD_V_19 1 "VALID" 0 "INVALID" ;
VAL_ 154 OBJ_Visibility_Side_V_19 1 "VALID" 0 "INVALID" ;
VAL_ 154 OBJ_Visibility_Side_19 2 "REAR" 1 "FRONT" 0 "NOT_VISIBLE" ;
VAL_ 154 OBJ_Is_In_Drivable_Area_19 1 "TRUE" 0 "FALSE" ;
VAL_ 154 OBJ_Is_In_Drivable_Area_V_19 1 "VALID" 0 "INVALID" ;
VAL_ 154 OBJ_Is_VeryClose_V_19 1 "VALID" 0 "INVALID" ;
VAL_ 154 OBJ_Is_VeryClose_19 1 "TRUE" 0 "FALSE" ;
VAL_ 154 OBJ_OverlapAngleEgoLaneR_V_19 1 "VALID" 0 "INVALID" ;
VAL_ 154 OBJ_OverlapAngleEgoLaneL_V_19 1 "VALID" 0 "INVALID" ;
VAL_ 154 OBJ_Is_EMERGENCY_VCL_19 1 "TRUE" 0 "FALSE" ;
VAL_ 154 OBJ_EMERGENCY_LIGHT_COLOR_19 3 "(1000)ORANGE" 2 "(0100)BLUE" 1 "(0010)RED" 0 "(0001)OTHER" ;
VAL_ 154 OBJ_EMERGENCY_V_19 1 "TRUE" 0 "FALSE" ;
VAL_ 154 OBJ_Angle_Top_V_19 1 "VALID" 0 "INVALID" ;
VAL_ 154 OBJ_Angle_Top_STD_V_19 1 "VALID" 0 "INVALID" ;
VAL_ 154 OBJ_Open_Door_Left_19 1 "TRUE" 0 "FALSE" ;
VAL_ 154 OBJ_Open_Door_Right_19 1 "TRUE" 0 "FALSE" ;
VAL_ 154 OBJ_Visible_Left_or_Right_19 2 "RIGHT" 1 "LEFT" 0 "NOT_VISIBLE" ;
VAL_ 154 OBJ_Visible_Left_or_Right_V_19 1 "VALID" 0 "INVALID" ;
VAL_ 154 OBJ_Fusion_Source_20 2 "(BIT_2)RADAR2" 1 "(BIT_1)RADAR1" 0 "(BIT_0)CAMERA" ;
VAL_ 154 OBJ_Triggered_SDM_20 2 "NOT_TRIGGERED" 1 "TRIGGERED" 0 "NOT_AVAILABLE" ;
VAL_ 154 OBJ_Motion_Category_20 13 "ONCOMING" 12 "PRECEEDING" 11 "MOVING" 10 "RTAP" 9 "LTAP" 8 "CROSSING" 7 "MOVING_OUT" 6 "MOVING_IN" 5 "CLOSE_CUT_IN" 4 "PASSING_OUT" 3 "PASSING_IN" 2 "PASSING" 1 "UNDEFINED" 0 "UNFILLED" ;
VAL_ 154 OBJ_Measuring_Status_20 2 "(BIT_2)NOT_VALID_OR_VALID" 1 "(BIT_1)PREDICTED_OR_MEASURED" 0 "(BIT_0)OLD_OR_NEW" ;
VAL_ 154 OBJ_Object_Class_20 9 "TWO_WHEELER" 8 "UNCERTAIN_VCL" 7 "ANIMAL" 6 "GENERAL_OBJECT" 5 "PEDESTRIAN" 4 "BICYCLE" 3 "MOTORBIKE" 2 "TRUCK" 1 "CAR" 0 "UNFILLED" ;
VAL_ 154 OBJ_Camera_Source_20 11 "PARKING_RIGHT" 10 "PARKING_LEFT" 9 "PARKING_REAR" 8 "PARKING_FRONT" 7 "FRONT_CORNER_RIGHT" 6 "FRONT_CORNER_LEFT" 5 "REAR_CORNER_RIGHT" 4 "REAR_CORNER_LEFT" 3 "REAR" 2 "FRONT_FISHEYE" 1 "FRONT_NARROW" 0 "FRONT_MAIN" ;
VAL_ 154 OBJ_Motion_Status_20 5 "MOVING_SLOWLY" 4 "STOPPED" 3 "STATIONARY" 2 "MOVING" 1 "UNKNOWN" 0 "INVALID" ;
VAL_ 154 OBJ_Motion_Orientation_20 13 "INVALID" 12 "NORTH" 11 "NORTH_WEST" 9 "WEST" 7 "SOUTH_WEST" 6 "SOUTH" 5 "SOUTH_EAST" 3 "EAST" 1 "NORTH_EAST" 0 "UNKNOWN" ;
VAL_ 154 OBJ_Has_Cut_Lane_20 1 "TRUE" 0 "FALSE" ;
VAL_ 154 OBJ_Has_Cut_Path_20 1 "TRUE" 0 "FALSE" ;
VAL_ 154 OBJ_Brake_Light_Validity_20 1 "TRUE" 0 "FALSE" ;
VAL_ 154 OBJ_Brake_Light_20 1 "TRUE" 0 "FALSE" ;
VAL_ 154 OBJ_Turn_Indicator_Right_20 1 "TRUE" 0 "FALSE" ;
VAL_ 154 OBJ_Turn_Indicator_Left_20 1 "TRUE" 0 "FALSE" ;
VAL_ 154 OBJ_Turn_Indicator_Validity_20 1 "TRUE" 0 "FALSE" ;
VAL_ 154 OBJ_Right_Out_Of_Image_20 1 "TRUE" 0 "FALSE" ;
VAL_ 154 OBJ_Left_Out_Of_Image_20 1 "TRUE" 0 "FALSE" ;
VAL_ 154 OBJ_Right_Out_Of_Image_V_20 1 "TRUE" 0 "FALSE" ;
VAL_ 154 OBJ_Left_Out_Of_Image_V_20 1 "TRUE" 0 "FALSE" ;
VAL_ 154 OBJ_Top_Out_Of_Image_20 1 "TRUE" 0 "FALSE" ;
VAL_ 154 OBJ_Bottom_Out_Of_Image_20 1 "TRUE" 0 "FALSE" ;
VAL_ 154 OBJ_Top_Out_Of_Image_V_20 1 "VALID" 0 "INVALID" ;
VAL_ 154 OBJ_Bottom_Out_Of_Image_V_20 1 "VALID" 0 "INVALID" ;
VAL_ 154 OBJ_Lane_Assignment_20 5 "RIGHT_RIGHT" 4 "RIGHT" 3 "HOST" 2 "LEFT" 1 "LEFT_LEFT" 0 "UNKNOWN" ;
VAL_ 154 OBJ_Lane_Assignment_V_20 1 "VALID" 0 "INVALID" ;
VAL_ 154 OBJ_Age_Seconds_V_20 1 "VALID" 0 "INVALID" ;
VAL_ 154 OBJ_Width_V_20 1 "VALID" 0 "INVALID" ;
VAL_ 154 OBJ_Width_STD_V_20 1 "VALID" 0 "INVALID" ;
VAL_ 154 OBJ_Length_V_20 1 "VALID" 0 "INVALID" ;
VAL_ 154 OBJ_Length_STD_V_20 1 "VALID" 0 "INVALID" ;
VAL_ 154 OBJ_Height_V_20 1 "VALID" 0 "INVALID" ;
VAL_ 154 OBJ_Height_STD_V_20 1 "VALID" 0 "INVALID" ;
VAL_ 154 OBJ_Abs_Long_Velocity_V_20 1 "VALID" 0 "INVALID" ;
VAL_ 154 OBJ_Abs_Long_Vel_STD_V_20 1 "VALID" 0 "INVALID" ;
VAL_ 154 OBJ_Abs_Lat_Velocity_V_20 1 "VALID" 0 "INVALID" ;
VAL_ 154 OBJ_Abs_Lat_Vel_STD_V_20 1 "VALID" 0 "INVALID" ;
VAL_ 154 OBJ_Abs_Long_Acc_V_20 1 "VALID" 0 "INVALID" ;
VAL_ 154 OBJ_Abs_Long_Acc_STD_V_20 1 "VALID" 0 "INVALID" ;
VAL_ 154 OBJ_Abs_Lat_Acc_V_20 1 "VALID" 0 "INVALID" ;
VAL_ 154 OBJ_Abs_Lat_Acc_STD_V_20 1 "VALID" 0 "INVALID" ;
VAL_ 154 OBJ_Abs_Acceleration_V_20 1 "VALID" 0 "INVALID" ;
VAL_ 154 OBJ_Abs_Acc_STD_V_20 1 "VALID" 0 "INVALID" ;
VAL_ 154 OBJ_Inv_TTC_V_20 1 "VALID" 0 "INVALID" ;
VAL_ 154 OBJ_Inv_TTC_STD_V_20 1 "VALID" 0 "INVALID" ;
VAL_ 154 OBJ_Relative_Long_Acc_V_20 1 "VALID" 0 "INVALID" ;
VAL_ 154 OBJ_Rel_Long_Acc_STD_V_20 1 "VALID" 0 "INVALID" ;
VAL_ 154 OBJ_Relative_Long_Velocity_V_20 1 "VALID" 0 "INVALID" ;
VAL_ 154 OBJ_Rel_Long_Vel_STD_V_20 1 "VALID" 0 "INVALID" ;
VAL_ 154 OBJ_Relative_Lat_Velocity_V_20 1 "VALID" 0 "INVALID" ;
VAL_ 154 OBJ_Rel_Lat_Vel_STD_V_20 1 "VALID" 0 "INVALID" ;
VAL_ 154 OBJ_Long_Distance_V_20 1 "VALID" 0 "INVALID" ;
VAL_ 154 OBJ_Long_Distance_STD_V_20 1 "VALID" 0 "INVALID" ;
VAL_ 154 OBJ_Lat_Distance_V_20 1 "VALID" 0 "INVALID" ;
VAL_ 154 OBJ_Lat_Distance_STD_V_20 1 "VALID" 0 "INVALID" ;
VAL_ 154 OBJ_Absolute_Speed_V_20 1 "VALID" 0 "INVALID" ;
VAL_ 154 OBJ_Absolute_Speed_STD_V_20 1 "VALID" 0 "INVALID" ;
VAL_ 154 OBJ_Heading_V_20 1 "VALID" 0 "INVALID" ;
VAL_ 154 OBJ_Heading_STD_V_20 1 "VALID" 0 "INVALID" ;
VAL_ 154 OBJ_Angle_Rate_STD_V_20 1 "VALID" 0 "INVALID" ;
VAL_ 154 OBJ_Angle_Rate_V_20 1 "VALID" 0 "INVALID" ;
VAL_ 154 OBJ_Angle_Right_V_20 1 "VALID" 0 "INVALID" ;
VAL_ 154 OBJ_Angle_Right_STD_V_20 1 "VALID" 0 "INVALID" ;
VAL_ 154 OBJ_Angle_Left_V_20 1 "VALID" 0 "INVALID" ;
VAL_ 154 OBJ_Angle_Left_STD_V_20 1 "VALID" 0 "INVALID" ;
VAL_ 154 OBJ_Angle_Side_V_20 1 "VALID" 0 "INVALID" ;
VAL_ 154 OBJ_Angle_Side_STD_V_20 1 "VALID" 0 "INVALID" ;
VAL_ 154 OBJ_Angle_Mid_V_20 1 "VALID" 0 "INVALID" ;
VAL_ 154 OBJ_Angle_Mid_STD_V_20 1 "VALID" 0 "INVALID" ;
VAL_ 154 OBJ_Angle_Bottom_V_20 1 "VALID" 0 "INVALID" ;
VAL_ 154 OBJ_Angle_Bottom_STD_V_20 1 "VALID" 0 "INVALID" ;
VAL_ 154 OBJ_Visibility_Side_V_20 1 "VALID" 0 "INVALID" ;
VAL_ 154 OBJ_Visibility_Side_20 2 "REAR" 1 "FRONT" 0 "NOT_VISIBLE" ;
VAL_ 154 OBJ_Is_In_Drivable_Area_20 1 "TRUE" 0 "FALSE" ;
VAL_ 154 OBJ_Is_In_Drivable_Area_V_20 1 "VALID" 0 "INVALID" ;
VAL_ 154 OBJ_Is_VeryClose_V_20 1 "VALID" 0 "INVALID" ;
VAL_ 154 OBJ_Is_VeryClose_20 1 "TRUE" 0 "FALSE" ;
VAL_ 154 OBJ_OverlapAngleEgoLaneR_V_20 1 "VALID" 0 "INVALID" ;
VAL_ 154 OBJ_OverlapAngleEgoLaneL_V_20 1 "VALID" 0 "INVALID" ;
VAL_ 154 OBJ_Is_EMERGENCY_VCL_20 1 "TRUE" 0 "FALSE" ;
VAL_ 154 OBJ_EMERGENCY_LIGHT_COLOR_20 3 "(1000)ORANGE" 2 "(0100)BLUE" 1 "(0010)RED" 0 "(0001)OTHER" ;
VAL_ 154 OBJ_EMERGENCY_V_20 1 "TRUE" 0 "FALSE" ;
VAL_ 154 OBJ_Angle_Top_V_20 1 "VALID" 0 "INVALID" ;
VAL_ 154 OBJ_Angle_Top_STD_V_20 1 "VALID" 0 "INVALID" ;
VAL_ 154 OBJ_Open_Door_Left_20 1 "TRUE" 0 "FALSE" ;
VAL_ 154 OBJ_Open_Door_Right_20 1 "TRUE" 0 "FALSE" ;
VAL_ 154 OBJ_Visible_Left_or_Right_20 2 "RIGHT" 1 "LEFT" 0 "NOT_VISIBLE" ;
VAL_ 154 OBJ_Visible_Left_or_Right_V_20 1 "VALID" 0 "INVALID" ;
VAL_ 154 OBJ_Fusion_Source_21 2 "(BIT_2)RADAR2" 1 "(BIT_1)RADAR1" 0 "(BIT_0)CAMERA" ;
VAL_ 154 OBJ_Triggered_SDM_21 2 "NOT_TRIGGERED" 1 "TRIGGERED" 0 "NOT_AVAILABLE" ;
VAL_ 154 OBJ_Motion_Category_21 13 "ONCOMING" 12 "PRECEEDING" 11 "MOVING" 10 "RTAP" 9 "LTAP" 8 "CROSSING" 7 "MOVING_OUT" 6 "MOVING_IN" 5 "CLOSE_CUT_IN" 4 "PASSING_OUT" 3 "PASSING_IN" 2 "PASSING" 1 "UNDEFINED" 0 "UNFILLED" ;
VAL_ 154 OBJ_Measuring_Status_21 2 "(BIT_2)NOT_VALID_OR_VALID" 1 "(BIT_1)PREDICTED_OR_MEASURED" 0 "(BIT_0)OLD_OR_NEW" ;
VAL_ 154 OBJ_Object_Class_21 9 "TWO_WHEELER" 8 "UNCERTAIN_VCL" 7 "ANIMAL" 6 "GENERAL_OBJECT" 5 "PEDESTRIAN" 4 "BICYCLE" 3 "MOTORBIKE" 2 "TRUCK" 1 "CAR" 0 "UNFILLED" ;
VAL_ 154 OBJ_Camera_Source_21 11 "PARKING_RIGHT" 10 "PARKING_LEFT" 9 "PARKING_REAR" 8 "PARKING_FRONT" 7 "FRONT_CORNER_RIGHT" 6 "FRONT_CORNER_LEFT" 5 "REAR_CORNER_RIGHT" 4 "REAR_CORNER_LEFT" 3 "REAR" 2 "FRONT_FISHEYE" 1 "FRONT_NARROW" 0 "FRONT_MAIN" ;
VAL_ 154 OBJ_Motion_Status_21 5 "MOVING_SLOWLY" 4 "STOPPED" 3 "STATIONARY" 2 "MOVING" 1 "UNKNOWN" 0 "INVALID" ;
VAL_ 154 OBJ_Motion_Orientation_21 13 "INVALID" 12 "NORTH" 11 "NORTH_WEST" 9 "WEST" 7 "SOUTH_WEST" 6 "SOUTH" 5 "SOUTH_EAST" 3 "EAST" 1 "NORTH_EAST" 0 "UNKNOWN" ;
VAL_ 154 OBJ_Has_Cut_Lane_21 1 "TRUE" 0 "FALSE" ;
VAL_ 154 OBJ_Has_Cut_Path_21 1 "TRUE" 0 "FALSE" ;
VAL_ 154 OBJ_Brake_Light_Validity_21 1 "TRUE" 0 "FALSE" ;
VAL_ 154 OBJ_Brake_Light_21 1 "TRUE" 0 "FALSE" ;
VAL_ 154 OBJ_Turn_Indicator_Right_21 1 "TRUE" 0 "FALSE" ;
VAL_ 154 OBJ_Turn_Indicator_Left_21 1 "TRUE" 0 "FALSE" ;
VAL_ 154 OBJ_Turn_Indicator_Validity_21 1 "TRUE" 0 "FALSE" ;
VAL_ 154 OBJ_Right_Out_Of_Image_21 1 "TRUE" 0 "FALSE" ;
VAL_ 154 OBJ_Left_Out_Of_Image_21 1 "TRUE" 0 "FALSE" ;
VAL_ 154 OBJ_Right_Out_Of_Image_V_21 1 "TRUE" 0 "FALSE" ;
VAL_ 154 OBJ_Left_Out_Of_Image_V_21 1 "TRUE" 0 "FALSE" ;
VAL_ 154 OBJ_Top_Out_Of_Image_21 1 "TRUE" 0 "FALSE" ;
VAL_ 154 OBJ_Bottom_Out_Of_Image_21 1 "TRUE" 0 "FALSE" ;
VAL_ 154 OBJ_Top_Out_Of_Image_V_21 1 "VALID" 0 "INVALID" ;
VAL_ 154 OBJ_Bottom_Out_Of_Image_V_21 1 "VALID" 0 "INVALID" ;
VAL_ 154 OBJ_Lane_Assignment_21 5 "RIGHT_RIGHT" 4 "RIGHT" 3 "HOST" 2 "LEFT" 1 "LEFT_LEFT" 0 "UNKNOWN" ;
VAL_ 154 OBJ_Lane_Assignment_V_21 1 "VALID" 0 "INVALID" ;
VAL_ 154 OBJ_Age_Seconds_V_21 1 "VALID" 0 "INVALID" ;
VAL_ 154 OBJ_Width_V_21 1 "VALID" 0 "INVALID" ;
VAL_ 154 OBJ_Width_STD_V_21 1 "VALID" 0 "INVALID" ;
VAL_ 154 OBJ_Length_V_21 1 "VALID" 0 "INVALID" ;
VAL_ 154 OBJ_Length_STD_V_21 1 "VALID" 0 "INVALID" ;
VAL_ 154 OBJ_Height_V_21 1 "VALID" 0 "INVALID" ;
VAL_ 154 OBJ_Height_STD_V_21 1 "VALID" 0 "INVALID" ;
VAL_ 154 OBJ_Abs_Long_Velocity_V_21 1 "VALID" 0 "INVALID" ;
VAL_ 154 OBJ_Abs_Long_Vel_STD_V_21 1 "VALID" 0 "INVALID" ;
VAL_ 154 OBJ_Abs_Lat_Velocity_V_21 1 "VALID" 0 "INVALID" ;
VAL_ 154 OBJ_Abs_Lat_Vel_STD_V_21 1 "VALID" 0 "INVALID" ;
VAL_ 154 OBJ_Abs_Long_Acc_V_21 1 "VALID" 0 "INVALID" ;
VAL_ 154 OBJ_Abs_Long_Acc_STD_V_21 1 "VALID" 0 "INVALID" ;
VAL_ 154 OBJ_Abs_Lat_Acc_V_21 1 "VALID" 0 "INVALID" ;
VAL_ 154 OBJ_Abs_Lat_Acc_STD_V_21 1 "VALID" 0 "INVALID" ;
VAL_ 154 OBJ_Abs_Acceleration_V_21 1 "VALID" 0 "INVALID" ;
VAL_ 154 OBJ_Abs_Acc_STD_V_21 1 "VALID" 0 "INVALID" ;
VAL_ 154 OBJ_Inv_TTC_V_21 1 "VALID" 0 "INVALID" ;
VAL_ 154 OBJ_Inv_TTC_STD_V_21 1 "VALID" 0 "INVALID" ;
VAL_ 154 OBJ_Relative_Long_Acc_V_21 1 "VALID" 0 "INVALID" ;
VAL_ 154 OBJ_Rel_Long_Acc_STD_V_21 1 "VALID" 0 "INVALID" ;
VAL_ 154 OBJ_Relative_Long_Velocity_V_21 1 "VALID" 0 "INVALID" ;
VAL_ 154 OBJ_Rel_Long_Vel_STD_V_21 1 "VALID" 0 "INVALID" ;
VAL_ 154 OBJ_Relative_Lat_Velocity_V_21 1 "VALID" 0 "INVALID" ;
VAL_ 154 OBJ_Rel_Lat_Vel_STD_V_21 1 "VALID" 0 "INVALID" ;
VAL_ 154 OBJ_Long_Distance_V_21 1 "VALID" 0 "INVALID" ;
VAL_ 154 OBJ_Long_Distance_STD_V_21 1 "VALID" 0 "INVALID" ;
VAL_ 154 OBJ_Lat_Distance_V_21 1 "VALID" 0 "INVALID" ;
VAL_ 154 OBJ_Lat_Distance_STD_V_21 1 "VALID" 0 "INVALID" ;
VAL_ 154 OBJ_Absolute_Speed_V_21 1 "VALID" 0 "INVALID" ;
VAL_ 154 OBJ_Absolute_Speed_STD_V_21 1 "VALID" 0 "INVALID" ;
VAL_ 154 OBJ_Heading_V_21 1 "VALID" 0 "INVALID" ;
VAL_ 154 OBJ_Heading_STD_V_21 1 "VALID" 0 "INVALID" ;
VAL_ 154 OBJ_Angle_Rate_STD_V_21 1 "VALID" 0 "INVALID" ;
VAL_ 154 OBJ_Angle_Rate_V_21 1 "VALID" 0 "INVALID" ;
VAL_ 154 OBJ_Angle_Right_V_21 1 "VALID" 0 "INVALID" ;
VAL_ 154 OBJ_Angle_Right_STD_V_21 1 "VALID" 0 "INVALID" ;
VAL_ 154 OBJ_Angle_Left_V_21 1 "VALID" 0 "INVALID" ;
VAL_ 154 OBJ_Angle_Left_STD_V_21 1 "VALID" 0 "INVALID" ;
VAL_ 154 OBJ_Angle_Side_V_21 1 "VALID" 0 "INVALID" ;
VAL_ 154 OBJ_Angle_Side_STD_V_21 1 "VALID" 0 "INVALID" ;
VAL_ 154 OBJ_Angle_Mid_V_21 1 "VALID" 0 "INVALID" ;
VAL_ 154 OBJ_Angle_Mid_STD_V_21 1 "VALID" 0 "INVALID" ;
VAL_ 154 OBJ_Angle_Bottom_V_21 1 "VALID" 0 "INVALID" ;
VAL_ 154 OBJ_Angle_Bottom_STD_V_21 1 "VALID" 0 "INVALID" ;
VAL_ 154 OBJ_Visibility_Side_V_21 1 "VALID" 0 "INVALID" ;
VAL_ 154 OBJ_Visibility_Side_21 2 "REAR" 1 "FRONT" 0 "NOT_VISIBLE" ;
VAL_ 154 OBJ_Is_In_Drivable_Area_21 1 "TRUE" 0 "FALSE" ;
VAL_ 154 OBJ_Is_In_Drivable_Area_V_21 1 "VALID" 0 "INVALID" ;
VAL_ 154 OBJ_Is_VeryClose_V_21 1 "VALID" 0 "INVALID" ;
VAL_ 154 OBJ_Is_VeryClose_21 1 "TRUE" 0 "FALSE" ;
VAL_ 154 OBJ_OverlapAngleEgoLaneR_V_21 1 "VALID" 0 "INVALID" ;
VAL_ 154 OBJ_OverlapAngleEgoLaneL_V_21 1 "VALID" 0 "INVALID" ;
VAL_ 154 OBJ_Is_EMERGENCY_VCL_21 1 "TRUE" 0 "FALSE" ;
VAL_ 154 OBJ_EMERGENCY_LIGHT_COLOR_21 3 "(1000)ORANGE" 2 "(0100)BLUE" 1 "(0010)RED" 0 "(0001)OTHER" ;
VAL_ 154 OBJ_EMERGENCY_V_21 1 "TRUE" 0 "FALSE" ;
VAL_ 154 OBJ_Angle_Top_V_21 1 "VALID" 0 "INVALID" ;
VAL_ 154 OBJ_Angle_Top_STD_V_21 1 "VALID" 0 "INVALID" ;
VAL_ 154 OBJ_Open_Door_Left_21 1 "TRUE" 0 "FALSE" ;
VAL_ 154 OBJ_Open_Door_Right_21 1 "TRUE" 0 "FALSE" ;
VAL_ 154 OBJ_Visible_Left_or_Right_21 2 "RIGHT" 1 "LEFT" 0 "NOT_VISIBLE" ;
VAL_ 154 OBJ_Visible_Left_or_Right_V_21 1 "VALID" 0 "INVALID" ;
VAL_ 154 OBJ_Fusion_Source_22 2 "(BIT_2)RADAR2" 1 "(BIT_1)RADAR1" 0 "(BIT_0)CAMERA" ;
VAL_ 154 OBJ_Triggered_SDM_22 2 "NOT_TRIGGERED" 1 "TRIGGERED" 0 "NOT_AVAILABLE" ;
VAL_ 154 OBJ_Motion_Category_22 13 "ONCOMING" 12 "PRECEEDING" 11 "MOVING" 10 "RTAP" 9 "LTAP" 8 "CROSSING" 7 "MOVING_OUT" 6 "MOVING_IN" 5 "CLOSE_CUT_IN" 4 "PASSING_OUT" 3 "PASSING_IN" 2 "PASSING" 1 "UNDEFINED" 0 "UNFILLED" ;
VAL_ 154 OBJ_Measuring_Status_22 2 "(BIT_2)NOT_VALID_OR_VALID" 1 "(BIT_1)PREDICTED_OR_MEASURED" 0 "(BIT_0)OLD_OR_NEW" ;
VAL_ 154 OBJ_Object_Class_22 9 "TWO_WHEELER" 8 "UNCERTAIN_VCL" 7 "ANIMAL" 6 "GENERAL_OBJECT" 5 "PEDESTRIAN" 4 "BICYCLE" 3 "MOTORBIKE" 2 "TRUCK" 1 "CAR" 0 "UNFILLED" ;
VAL_ 154 OBJ_Camera_Source_22 11 "PARKING_RIGHT" 10 "PARKING_LEFT" 9 "PARKING_REAR" 8 "PARKING_FRONT" 7 "FRONT_CORNER_RIGHT" 6 "FRONT_CORNER_LEFT" 5 "REAR_CORNER_RIGHT" 4 "REAR_CORNER_LEFT" 3 "REAR" 2 "FRONT_FISHEYE" 1 "FRONT_NARROW" 0 "FRONT_MAIN" ;
VAL_ 154 OBJ_Motion_Status_22 5 "MOVING_SLOWLY" 4 "STOPPED" 3 "STATIONARY" 2 "MOVING" 1 "UNKNOWN" 0 "INVALID" ;
VAL_ 154 OBJ_Motion_Orientation_22 13 "INVALID" 12 "NORTH" 11 "NORTH_WEST" 9 "WEST" 7 "SOUTH_WEST" 6 "SOUTH" 5 "SOUTH_EAST" 3 "EAST" 1 "NORTH_EAST" 0 "UNKNOWN" ;
VAL_ 154 OBJ_Has_Cut_Lane_22 1 "TRUE" 0 "FALSE" ;
VAL_ 154 OBJ_Has_Cut_Path_22 1 "TRUE" 0 "FALSE" ;
VAL_ 154 OBJ_Brake_Light_Validity_22 1 "TRUE" 0 "FALSE" ;
VAL_ 154 OBJ_Brake_Light_22 1 "TRUE" 0 "FALSE" ;
VAL_ 154 OBJ_Turn_Indicator_Right_22 1 "TRUE" 0 "FALSE" ;
VAL_ 154 OBJ_Turn_Indicator_Left_22 1 "TRUE" 0 "FALSE" ;
VAL_ 154 OBJ_Turn_Indicator_Validity_22 1 "TRUE" 0 "FALSE" ;
VAL_ 154 OBJ_Right_Out_Of_Image_22 1 "TRUE" 0 "FALSE" ;
VAL_ 154 OBJ_Left_Out_Of_Image_22 1 "TRUE" 0 "FALSE" ;
VAL_ 154 OBJ_Right_Out_Of_Image_V_22 1 "TRUE" 0 "FALSE" ;
VAL_ 154 OBJ_Left_Out_Of_Image_V_22 1 "TRUE" 0 "FALSE" ;
VAL_ 154 OBJ_Top_Out_Of_Image_22 1 "TRUE" 0 "FALSE" ;
VAL_ 154 OBJ_Bottom_Out_Of_Image_22 1 "TRUE" 0 "FALSE" ;
VAL_ 154 OBJ_Top_Out_Of_Image_V_22 1 "VALID" 0 "INVALID" ;
VAL_ 154 OBJ_Bottom_Out_Of_Image_V_22 1 "VALID" 0 "INVALID" ;
VAL_ 154 OBJ_Lane_Assignment_22 5 "RIGHT_RIGHT" 4 "RIGHT" 3 "HOST" 2 "LEFT" 1 "LEFT_LEFT" 0 "UNKNOWN" ;
VAL_ 154 OBJ_Lane_Assignment_V_22 1 "VALID" 0 "INVALID" ;
VAL_ 154 OBJ_Age_Seconds_V_22 1 "VALID" 0 "INVALID" ;
VAL_ 154 OBJ_Width_V_22 1 "VALID" 0 "INVALID" ;
VAL_ 154 OBJ_Width_STD_V_22 1 "VALID" 0 "INVALID" ;
VAL_ 154 OBJ_Length_V_22 1 "VALID" 0 "INVALID" ;
VAL_ 154 OBJ_Length_STD_V_22 1 "VALID" 0 "INVALID" ;
VAL_ 154 OBJ_Height_V_22 1 "VALID" 0 "INVALID" ;
VAL_ 154 OBJ_Height_STD_V_22 1 "VALID" 0 "INVALID" ;
VAL_ 154 OBJ_Abs_Long_Velocity_V_22 1 "VALID" 0 "INVALID" ;
VAL_ 154 OBJ_Abs_Long_Vel_STD_V_22 1 "VALID" 0 "INVALID" ;
VAL_ 154 OBJ_Abs_Lat_Velocity_V_22 1 "VALID" 0 "INVALID" ;
VAL_ 154 OBJ_Abs_Lat_Vel_STD_V_22 1 "VALID" 0 "INVALID" ;
VAL_ 154 OBJ_Abs_Long_Acc_V_22 1 "VALID" 0 "INVALID" ;
VAL_ 154 OBJ_Abs_Long_Acc_STD_V_22 1 "VALID" 0 "INVALID" ;
VAL_ 154 OBJ_Abs_Lat_Acc_V_22 1 "VALID" 0 "INVALID" ;
VAL_ 154 OBJ_Abs_Lat_Acc_STD_V_22 1 "VALID" 0 "INVALID" ;
VAL_ 154 OBJ_Abs_Acceleration_V_22 1 "VALID" 0 "INVALID" ;
VAL_ 154 OBJ_Abs_Acc_STD_V_22 1 "VALID" 0 "INVALID" ;
VAL_ 154 OBJ_Inv_TTC_V_22 1 "VALID" 0 "INVALID" ;
VAL_ 154 OBJ_Inv_TTC_STD_V_22 1 "VALID" 0 "INVALID" ;
VAL_ 154 OBJ_Relative_Long_Acc_V_22 1 "VALID" 0 "INVALID" ;
VAL_ 154 OBJ_Rel_Long_Acc_STD_V_22 1 "VALID" 0 "INVALID" ;
VAL_ 154 OBJ_Relative_Long_Velocity_V_22 1 "VALID" 0 "INVALID" ;
VAL_ 154 OBJ_Rel_Long_Vel_STD_V_22 1 "VALID" 0 "INVALID" ;
VAL_ 154 OBJ_Relative_Lat_Velocity_V_22 1 "VALID" 0 "INVALID" ;
VAL_ 154 OBJ_Rel_Lat_Vel_STD_V_22 1 "VALID" 0 "INVALID" ;
VAL_ 154 OBJ_Long_Distance_V_22 1 "VALID" 0 "INVALID" ;
VAL_ 154 OBJ_Long_Distance_STD_V_22 1 "VALID" 0 "INVALID" ;
VAL_ 154 OBJ_Lat_Distance_V_22 1 "VALID" 0 "INVALID" ;
VAL_ 154 OBJ_Lat_Distance_STD_V_22 1 "VALID" 0 "INVALID" ;
VAL_ 154 OBJ_Absolute_Speed_V_22 1 "VALID" 0 "INVALID" ;
VAL_ 154 OBJ_Absolute_Speed_STD_V_22 1 "VALID" 0 "INVALID" ;
VAL_ 154 OBJ_Heading_V_22 1 "VALID" 0 "INVALID" ;
VAL_ 154 OBJ_Heading_STD_V_22 1 "VALID" 0 "INVALID" ;
VAL_ 154 OBJ_Angle_Rate_STD_V_22 1 "VALID" 0 "INVALID" ;
VAL_ 154 OBJ_Angle_Rate_V_22 1 "VALID" 0 "INVALID" ;
VAL_ 154 OBJ_Angle_Right_V_22 1 "VALID" 0 "INVALID" ;
VAL_ 154 OBJ_Angle_Right_STD_V_22 1 "VALID" 0 "INVALID" ;
VAL_ 154 OBJ_Angle_Left_V_22 1 "VALID" 0 "INVALID" ;
VAL_ 154 OBJ_Angle_Left_STD_V_22 1 "VALID" 0 "INVALID" ;
VAL_ 154 OBJ_Angle_Side_V_22 1 "VALID" 0 "INVALID" ;
VAL_ 154 OBJ_Angle_Side_STD_V_22 1 "VALID" 0 "INVALID" ;
VAL_ 154 OBJ_Angle_Mid_V_22 1 "VALID" 0 "INVALID" ;
VAL_ 154 OBJ_Angle_Mid_STD_V_22 1 "VALID" 0 "INVALID" ;
VAL_ 154 OBJ_Angle_Bottom_V_22 1 "VALID" 0 "INVALID" ;
VAL_ 154 OBJ_Angle_Bottom_STD_V_22 1 "VALID" 0 "INVALID" ;
VAL_ 154 OBJ_Visibility_Side_V_22 1 "VALID" 0 "INVALID" ;
VAL_ 154 OBJ_Visibility_Side_22 2 "REAR" 1 "FRONT" 0 "NOT_VISIBLE" ;
VAL_ 154 OBJ_Is_In_Drivable_Area_22 1 "TRUE" 0 "FALSE" ;
VAL_ 154 OBJ_Is_In_Drivable_Area_V_22 1 "VALID" 0 "INVALID" ;
VAL_ 154 OBJ_Is_VeryClose_V_22 1 "VALID" 0 "INVALID" ;
VAL_ 154 OBJ_Is_VeryClose_22 1 "TRUE" 0 "FALSE" ;
VAL_ 154 OBJ_OverlapAngleEgoLaneR_V_22 1 "VALID" 0 "INVALID" ;
VAL_ 154 OBJ_OverlapAngleEgoLaneL_V_22 1 "VALID" 0 "INVALID" ;
VAL_ 154 OBJ_Is_EMERGENCY_VCL_22 1 "TRUE" 0 "FALSE" ;
VAL_ 154 OBJ_EMERGENCY_LIGHT_COLOR_22 3 "(1000)ORANGE" 2 "(0100)BLUE" 1 "(0010)RED" 0 "(0001)OTHER" ;
VAL_ 154 OBJ_EMERGENCY_V_22 1 "TRUE" 0 "FALSE" ;
