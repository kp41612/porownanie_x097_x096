VERSION "15"
// BundelVersion=v4.21.5_CF1
NS_ :

BS_:

BU_: EyeQ4 MCU

BO_ 154 Core_Objects_protocol: 4820 EyeQ4
 SG_ OBJ_Angle_Top_22 : 22161|14@1+ (0.0002,0) [0|3.1415] "rad" MCU
 SG_ OBJ_Angle_Top_V_22 : 22175|1@1+ (1,0) [0|1] "bool" MCU
 SG_ OBJ_Angle_Top_STD_22 : 22176|15@1+ (0.0001,0) [0|3.1415] "rad" MCU
 SG_ OBJ_Angle_Top_STD_V_22 : 22191|1@1+ (1,0) [0|1] "bool" MCU
 SG_ OBJ_Open_Door_Left_22 : 22192|1@1+ (1,0) [0|1] "bool" MCU
 SG_ OBJ_Open_Door_Right_22 : 22193|1@1+ (1,0) [0|1] "bool" MCU
 SG_ OBJ_Visible_Left_or_Right_22 : 22194|2@1+ (1,0) [0|2] "ENUM" MCU
 SG_ OBJ_Visible_Left_or_Right_V_22 : 22196|1@1+ (1,0) [0|1] "bool" MCU
 SG_ OBJ_2W_Is_Motorbike_Probability_22 : 22197|8@1+ (0.01,0) [0|1] "NA" MCU
 SG_ Reserved_26_22 : 22205|3@1+ (1,0) [0|0] "NA" MCU
 SG_ OBJ_2W_Is_Bicycle_Probability_22 : 22208|8@1+ (0.01,0) [0|1] "NA" MCU
 SG_ Reserved_27_22 : 22216|24@1+ (1,0) [0|0] "NA" MCU
 SG_ OBJ_CRC_23 : 22240|32@1+ (1,0) [0|4294967295] "NA" MCU
 SG_ OBJ_ID_23 : 22272|8@1+ (1,0) [0|255] "counter" MCU
 SG_ OBJ_Existence_Probability_23 : 22280|8@1+ (0.01,0) [0|1] "NA" MCU
 SG_ OBJ_Fusion_Source_23 : 22288|16@1+ (1,0) [0|65535] "BITWIZE" MCU
 SG_ OBJ_Triggered_SDM_23 : 22304|2@1+ (1,0) [0|2] "ENUM" MCU
 SG_ OBJ_Motion_Category_23 : 22306|4@1+ (1,0) [0|13] "ENUM" MCU
 SG_ OBJ_Moving_IN_Probability_23 : 22310|7@1+ (0.01,0) [0|1] "NA" MCU
 SG_ OBJ_Object_Age_23 : 22317|11@1+ (1,0) [0|2047] "frames" MCU
 SG_ OBJ_Measuring_Status_23 : 22328|3@1+ (1,0) [0|7] "BITWIZE" MCU
 SG_ OBJ_Object_Class_23 : 22331|4@1+ (1,0) [0|9] "ENUM" MCU
 SG_ Reserved_4_23 : 22335|1@1+ (1,0) [0|0] "NA" MCU
 SG_ OBJ_Class_Probability_23 : 22336|7@1+ (0.01,0) [0|1] "NA" MCU
 SG_ OBJ_Car_Probability_23 : 22343|7@1+ (0.01,0) [0|1] "NA" MCU
 SG_ OBJ_Truck_Probability_23 : 22350|7@1+ (0.01,0) [0|1] "NA" MCU
 SG_ OBJ_Bike_Probability_23 : 22357|7@1+ (0.01,0) [0|1] "NA" MCU
 SG_ OBJ_Camera_Source_23 : 22364|4@1+ (1,0) [0|15] "ENUM" MCU
 SG_ OBJ_Motion_Status_23 : 22368|3@1+ (1,0) [0|5] "ENUM" MCU
 SG_ OBJ_Motion_Orientation_23 : 22371|4@1+ (1,0) [0|13] "ENUM" MCU
 SG_ OBJ_Has_Cut_Lane_23 : 22375|1@1+ (1,0) [0|1] "bool" MCU
 SG_ OBJ_Has_Cut_Path_23 : 22376|1@1+ (1,0) [0|1] "bool" MCU
 SG_ OBJ_Brake_Light_Validity_23 : 22377|1@1+ (1,0) [0|1] "bool" MCU
 SG_ OBJ_Brake_Light_23 : 22378|1@1+ (1,0) [0|1] "bool" MCU
 SG_ OBJ_Turn_Indicator_Right_23 : 22379|1@1+ (1,0) [0|1] "bool" MCU
 SG_ OBJ_Turn_Indicator_Left_23 : 22380|1@1+ (1,0) [0|1] "bool" MCU
 SG_ OBJ_Turn_Indicator_Validity_23 : 22381|1@1+ (1,0) [0|1] "bool" MCU
 SG_ OBJ_Right_Out_Of_Image_23 : 22382|1@1+ (1,0) [0|1] "bool" MCU
 SG_ OBJ_Left_Out_Of_Image_23 : 22383|1@1+ (1,0) [0|1] "bool" MCU
 SG_ OBJ_Right_Out_Of_Image_V_23 : 22384|1@1+ (1,0) [0|1] "bool" MCU
 SG_ OBJ_Left_Out_Of_Image_V_23 : 22385|1@1+ (1,0) [0|1] "bool" MCU
 SG_ OBJ_Top_Out_Of_Image_23 : 22386|1@1+ (1,0) [0|1] "bool" MCU
 SG_ OBJ_Bottom_Out_Of_Image_23 : 22387|1@1+ (1,0) [0|1] "bool" MCU
 SG_ OBJ_Top_Out_Of_Image_V_23 : 22388|1@1+ (1,0) [0|1] "bool" MCU
 SG_ OBJ_Bottom_Out_Of_Image_V_23 : 22389|1@1+ (1,0) [0|1] "bool" MCU
 SG_ OBJ_Lane_Assignment_23 : 22390|3@1+ (1,0) [0|5] "ENUM" MCU
 SG_ OBJ_Lane_Assignment_V_23 : 22393|1@1+ (1,0) [0|1] "bool" MCU
 SG_ Reserved_5_23 : 22394|6@1+ (1,0) [0|0] "NA" MCU
 SG_ OBJ_Age_Seconds_23 : 22400|7@1+ (1,0) [0|100] "s" MCU
 SG_ OBJ_Age_Seconds_V_23 : 22407|1@1+ (1,0) [0|1] "bool" MCU
 SG_ OBJ_Width_23 : 22408|9@1+ (0.01,0) [0.4|2.95] "m" MCU
 SG_ OBJ_Width_V_23 : 22417|1@1+ (1,0) [0|1] "bool" MCU
 SG_ OBJ_Width_STD_23 : 22418|11@1+ (0.001,0) [0|2] "m" MCU
 SG_ OBJ_Width_STD_V_23 : 22429|1@1+ (1,0) [0|1] "bool" MCU
 SG_ Reserved_6_23 : 22430|2@1+ (1,0) [0|0] "NA" MCU
 SG_ OBJ_Length_23 : 22432|9@1+ (0.05,0) [0.6|21] "m" MCU
 SG_ OBJ_Length_V_23 : 22441|1@1+ (1,0) [0|1] "bool" MCU
 SG_ OBJ_Length_STD_23 : 22442|10@1+ (0.01,0) [0|10] "m" MCU
 SG_ OBJ_Length_STD_V_23 : 22452|1@1+ (1,0) [0|1] "bool" MCU
 SG_ OBJ_Radar_ID_23 : 22453|8@1+ (1,0) [0|255] "counter" MCU
 SG_ Reserved_7_23 : 22461|3@1+ (1,0) [0|0] "NA" MCU
 SG_ OBJ_Height_23 : 22464|9@1+ (0.01,0) [0|2.95] "m" MCU
 SG_ OBJ_Height_V_23 : 22473|1@1+ (1,0) [0|1] "bool" MCU
 SG_ OBJ_Height_STD_23 : 22474|11@1+ (0.001,0) [0|2] "m" MCU
 SG_ OBJ_Height_STD_V_23 : 22485|1@1+ (1,0) [0|1] "bool" MCU
 SG_ Reserved_8_23 : 22486|10@1+ (1,0) [0|0] "NA" MCU
 SG_ OBJ_Abs_Long_Velocity_23 : 22496|12@1+ (0.05,-100) [-100|100] "m_per_s" MCU
 SG_ OBJ_Abs_Long_Velocity_V_23 : 22508|1@1+ (1,0) [0|1] "bool" MCU
 SG_ OBJ_Abs_Long_Velocity_STD_23 : 22509|13@1+ (0.01,0) [0|65] "m_per_s" MCU
 SG_ OBJ_Abs_Long_Vel_STD_V_23 : 22522|1@1+ (1,0) [0|1] "bool" MCU
 SG_ Reserved_9_23 : 22523|5@1+ (1,0) [0|0] "NA" MCU
 SG_ OBJ_Abs_Lat_Velocity_23 : 22528|11@1+ (0.05,-50) [-50|50] "m_per_s" MCU
 SG_ OBJ_Abs_Lat_Velocity_V_23 : 22539|1@1+ (1,0) [0|1] "bool" MCU
 SG_ OBJ_Abs_Lat_Velocity_STD_23 : 22540|13@1+ (0.01,0) [0|50] "m_per_s" MCU
 SG_ OBJ_Abs_Lat_Vel_STD_V_23 : 22553|1@1+ (1,0) [0|1] "bool" MCU
 SG_ Reserved_10_23 : 22554|6@1+ (1,0) [0|0] "NA" MCU
 SG_ OBJ_Abs_Long_Acc_23 : 22560|9@1+ (0.05,-10) [-10|10] "m_per_s2" MCU
 SG_ OBJ_Abs_Long_Acc_V_23 : 22569|1@1+ (1,0) [0|1] "bool" MCU
 SG_ OBJ_Abs_Long_Acc_STD_23 : 22570|10@1+ (0.01,0) [0|7.3] "m_per_s2" MCU
 SG_ OBJ_Abs_Long_Acc_STD_V_23 : 22580|1@1+ (1,0) [0|1] "bool" MCU
 SG_ OBJ_Abs_Lat_Acc_23 : 22581|9@1+ (0.05,-10) [-10|10] "m_per_s2" MCU
 SG_ OBJ_Abs_Lat_Acc_V_23 : 22590|1@1+ (1,0) [0|1] "bool" MCU
 SG_ Reserved_11_23 : 22591|1@1+ (1,0) [0|0] "NA" MCU
 SG_ OBJ_Abs_Lat_Acc_STD_23 : 22592|10@1+ (0.01,0) [0|7.3] "m_per_s2" MCU
 SG_ OBJ_Abs_Lat_Acc_STD_V_23 : 22602|1@1+ (1,0) [0|1] "bool" MCU
 SG_ OBJ_Abs_Acceleration_23 : 22603|9@1+ (0.05,-12.7) [-12.7|12.7] "m_per_s2" MCU
 SG_ OBJ_Abs_Acceleration_V_23 : 22612|1@1+ (1,0) [0|1] "bool" MCU
 SG_ OBJ_Abs_Acc_STD_23 : 22613|10@1+ (0.01,0) [0|7.3] "m_per_s2" MCU
 SG_ OBJ_Abs_Acc_STD_V_23 : 22623|1@1+ (1,0) [0|1] "bool" MCU
 SG_ OBJ_Inv_TTC_23 : 22624|11@1+ (0.01,-8) [-8|8] "INV(s)" MCU
 SG_ OBJ_Inv_TTC_V_23 : 22635|1@1+ (1,0) [0|1] "bool" MCU
 SG_ OBJ_Inv_TTC_STD_23 : 22636|12@1+ (0.001,0) [0|4] "INV(s)" MCU
 SG_ OBJ_Inv_TTC_STD_V_23 : 22648|1@1+ (1,0) [0|1] "bool" MCU
 SG_ Reserved_12_23 : 22649|7@1+ (1,0) [0|0] "NA" MCU
 SG_ OBJ_Relative_Long_Acc_23 : 22656|10@1+ (0.05,-20) [-20|20] "m_per_s2" MCU
 SG_ OBJ_Relative_Long_Acc_V_23 : 22666|1@1+ (1,0) [0|1] "bool" MCU
 SG_ OBJ_Relative_Long_Acc_STD_23 : 22667|10@1+ (0.01,0) [0|7.3] "m_per_s2" MCU
 SG_ OBJ_Rel_Long_Acc_STD_V_23 : 22677|1@1+ (1,0) [0|1] "bool" MCU
 SG_ Reserved_13_23 : 22678|10@1+ (1,0) [0|0] "NA" MCU
 SG_ OBJ_Relative_Long_Velocity_23 : 22688|13@1+ (0.05,-120) [-120|130] "m_per_s" MCU
 SG_ OBJ_Relative_Long_Velocity_V_23 : 22701|1@1+ (1,0) [0|1] "bool" MCU
 SG_ OBJ_Relative_Long_Vel_STD_23 : 22702|14@1+ (0.01,0) [0|130] "m_per_s" MCU
 SG_ OBJ_Rel_Long_Vel_STD_V_23 : 22716|1@1+ (1,0) [0|1] "bool" MCU
 SG_ Reserved_14_23 : 22717|3@1+ (1,0) [0|0] "NA" MCU
 SG_ OBJ_Relative_Lat_Velocity_23 : 22720|11@1+ (0.05,-50) [-50|50] "m_per_s" MCU
 SG_ OBJ_Relative_Lat_Velocity_V_23 : 22731|1@1+ (1,0) [0|1] "bool" MCU
 SG_ OBJ_Relative_Lat_Velocity_STD_23 : 22732|13@1+ (0.01,0) [0|50] "m_per_s" MCU
 SG_ OBJ_Rel_Lat_Vel_STD_V_23 : 22745|1@1+ (1,0) [0|1] "bool" MCU
 SG_ Reserved_15_23 : 22746|6@1+ (1,0) [0|0] "NA" MCU
 SG_ OBJ_Long_Distance_23 : 22752|14@1+ (0.05,-200) [-200|500] "m" MCU
 SG_ OBJ_Long_Distance_V_23 : 22766|1@1+ (1,0) [0|1] "bool" MCU
 SG_ OBJ_Long_Distance_STD_23 : 22767|15@1+ (0.01,0) [0|250] "m" MCU
 SG_ OBJ_Long_Distance_STD_V_23 : 22782|1@1+ (1,0) [0|1] "bool" MCU
 SG_ Reserved_16_23 : 22783|1@1+ (1,0) [0|0] "NA" MCU
 SG_ OBJ_Lat_Distance_23 : 22784|12@1+ (0.05,-100) [-100|100] "m" MCU
 SG_ OBJ_Lat_Distance_V_23 : 22796|1@1+ (1,0) [0|1] "bool" MCU
 SG_ OBJ_Lat_Distance_STD_23 : 22797|14@1+ (0.01,0) [0|100] "m" MCU
 SG_ OBJ_Lat_Distance_STD_V_23 : 22811|1@1+ (1,0) [0|1] "bool" MCU
 SG_ Reserved_17_23 : 22812|4@1+ (1,0) [0|0] "NA" MCU
 SG_ OBJ_Absolute_Speed_23 : 22816|12@1+ (0.05,-65) [-65|65] "m_per_s" MCU
 SG_ OBJ_Absolute_Speed_V_23 : 22828|1@1+ (1,0) [0|1] "bool" MCU
 SG_ OBJ_Absolute_Speed_STD_23 : 22829|13@1+ (0.01,0) [0|65] "m_per_s" MCU
 SG_ OBJ_Absolute_Speed_STD_V_23 : 22842|1@1+ (1,0) [0|1] "bool" MCU
 SG_ Reserved_18_23 : 22843|5@1+ (1,0) [0|0] "NA" MCU
 SG_ OBJ_Heading_23 : 22848|10@1+ (0.01,-3.14) [-3.14|3.14] "rad" MCU
 SG_ OBJ_Heading_V_23 : 22858|1@1+ (1,0) [0|1] "bool" MCU
 SG_ OBJ_Heading_STD_23 : 22859|15@1+ (0.0001,0) [0|3.14] "rad" MCU
 SG_ OBJ_Heading_STD_V_23 : 22874|1@1+ (1,0) [0|1] "bool" MCU
 SG_ Reserved_19_23 : 22875|5@1+ (1,0) [0|0] "NA" MCU
 SG_ OBJ_Angle_Rate_STD_23 : 22880|15@1+ (0.0001,0) [0|2.2318] "RPS" MCU
 SG_ OBJ_Angle_Rate_STD_V_23 : 22895|1@1+ (1,0) [0|1] "bool" MCU
 SG_ OBJ_Angle_Rate_23 : 22896|12@1+ (0.002,-2.234) [-2.234|2.2318] "RPS" MCU
 SG_ OBJ_Angle_Rate_V_23 : 22908|1@1+ (1,0) [0|1] "bool" MCU
 SG_ Reserved_20_23 : 22909|3@1+ (1,0) [0|0] "NA" MCU
 SG_ OBJ_Angle_Right_23 : 22912|14@1+ (0.0002,-1.571) [-1.571|1.571] "rad" MCU
 SG_ OBJ_Angle_Right_V_23 : 22926|1@1+ (1,0) [0|1] "bool" MCU
 SG_ OBJ_Angle_Right_STD_23 : 22927|14@1+ (0.0001,0) [0|1.571] "rad" MCU
 SG_ OBJ_Angle_Right_STD_V_23 : 22941|1@1+ (1,0) [0|1] "bool" MCU
 SG_ Reserved_21_23 : 22942|2@1+ (1,0) [0|0] "NA" MCU
 SG_ OBJ_Angle_Left_23 : 22944|14@1+ (0.0002,-1.571) [-1.571|1.571] "rad" MCU
 SG_ OBJ_Angle_Left_V_23 : 22958|1@1+ (1,0) [0|1] "bool" MCU
 SG_ OBJ_Angle_Left_STD_23 : 22959|14@1+ (0.0001,0) [0|1.571] "rad" MCU
 SG_ OBJ_Angle_Left_STD_V_23 : 22973|1@1+ (1,0) [0|1] "bool" MCU
 SG_ Reserved_22_23 : 22974|2@1+ (1,0) [0|0] "NA" MCU
 SG_ OBJ_Angle_Side_23 : 22976|14@1+ (0.0002,-1.571) [-1.571|1.571] "rad" MCU
 SG_ OBJ_Angle_Side_V_23 : 22990|1@1+ (1,0) [0|1] "bool" MCU
 SG_ OBJ_Angle_Side_STD_23 : 22991|14@1+ (0.0001,0) [0|1.571] "rad" MCU
 SG_ OBJ_Angle_Side_STD_V_23 : 23005|1@1+ (1,0) [0|1] "bool" MCU
 SG_ OBJ_Angle_Mid_V_23 : 23006|1@1+ (1,0) [0|1] "bool" MCU
 SG_ Reserved_23_23 : 23007|1@1+ (1,0) [0|0] "NA" MCU
 SG_ OBJ_Angle_Mid_23 : 23008|14@1+ (0.0002,-1.571) [-1.571|1.571] "rad" MCU
 SG_ OBJ_Angle_Mid_STD_23 : 23022|14@1+ (0.0001,0) [0|1.571] "rad" MCU
 SG_ OBJ_Angle_Mid_STD_V_23 : 23036|1@1+ (1,0) [0|1] "bool" MCU
 SG_ OBJ_Angle_Bottom_V_23 : 23037|1@1+ (1,0) [0|1] "bool" MCU
 SG_ Reserved_24_23 : 23038|2@1+ (1,0) [0|0] "NA" MCU
 SG_ OBJ_Angle_Bottom_23 : 23040|14@1+ (0.0002,-1.571) [-1.571|1.571] "rad" MCU
 SG_ OBJ_Angle_Bottom_STD_23 : 23054|14@1+ (0.0001,0) [0|1.571] "rad" MCU
 SG_ OBJ_Angle_Bottom_STD_V_23 : 23068|1@1+ (1,0) [0|1] "bool" MCU
 SG_ OBJ_Visibility_Side_V_23 : 23069|1@1+ (1,0) [0|1] "bool" MCU
 SG_ OBJ_Visibility_Side_23 : 23070|2@1+ (1,0) [0|2] "ENUM" MCU
 SG_ OBJ_Is_In_Drivable_Area_23 : 23072|1@1+ (1,0) [0|1] "bool" MCU
 SG_ OBJ_Is_In_Drivable_Area_V_23 : 23073|1@1+ (1,0) [0|1] "bool" MCU
 SG_ OBJ_Is_VeryClose_V_23 : 23074|1@1+ (1,0) [0|1] "bool" MCU
 SG_ OBJ_Is_VeryClose_23 : 23075|1@1+ (1,0) [0|1] "bool" MCU
 SG_ OBJ_Buffer_C4_23 : 23076|2@1+ (1,0) [0|2] "NA" MCU
 SG_ OBJ_Buffer_C5_23 : 23078|2@1+ (1,0) [0|2] "NA" MCU
 SG_ OBJ_Buffer_C6_23 : 23080|2@1+ (1,0) [0|2] "NA" MCU
 SG_ OBJ_Buffer_C7_23 : 23082|2@1+ (1,0) [0|2] "NA" MCU
 SG_ OBJ_OverlapAngleEgoLaneR_23 : 23084|10@1+ (0.01,-3.14) [-3.14|3.14] "rad" MCU
 SG_ OBJ_OverlapAngleEgoLaneR_V_23 : 23094|1@1+ (1,0) [0|1] "bool" MCU
 SG_ Reserved_25_23 : 23095|9@1+ (1,0) [0|0] "NA" MCU
 SG_ OBJ_OverlapAngleEgoLaneL_23 : 23104|10@1+ (0.01,-3.14) [-3.14|3.14] "rad" MCU
 SG_ OBJ_OverlapAngleEgoLaneL_V_23 : 23114|1@1+ (1,0) [0|1] "bool" MCU
 SG_ OBJ_Is_EMERGENCY_VCL_23 : 23115|1@1+ (1,0) [0|1] "bool" MCU
 SG_ OBJ_EMERGENCY_LIGHT_COLOR_23 : 23116|4@1+ (1,0) [0|15] "BITWIZE" MCU
 SG_ OBJ_EMERGENCY_V_23 : 23120|1@1+ (1,0) [0|1] "bool" MCU
 SG_ OBJ_Angle_Top_23 : 23121|14@1+ (0.0002,0) [0|3.1415] "rad" MCU
 SG_ OBJ_Angle_Top_V_23 : 23135|1@1+ (1,0) [0|1] "bool" MCU
 SG_ OBJ_Angle_Top_STD_23 : 23136|15@1+ (0.0001,0) [0|3.1415] "rad" MCU
 SG_ OBJ_Angle_Top_STD_V_23 : 23151|1@1+ (1,0) [0|1] "bool" MCU
 SG_ OBJ_Open_Door_Left_23 : 23152|1@1+ (1,0) [0|1] "bool" MCU
 SG_ OBJ_Open_Door_Right_23 : 23153|1@1+ (1,0) [0|1] "bool" MCU
 SG_ OBJ_Visible_Left_or_Right_23 : 23154|2@1+ (1,0) [0|2] "ENUM" MCU
 SG_ OBJ_Visible_Left_or_Right_V_23 : 23156|1@1+ (1,0) [0|1] "bool" MCU
 SG_ OBJ_2W_Is_Motorbike_Probability_23 : 23157|8@1+ (0.01,0) [0|1] "NA" MCU
 SG_ Reserved_26_23 : 23165|3@1+ (1,0) [0|0] "NA" MCU
 SG_ OBJ_2W_Is_Bicycle_Probability_23 : 23168|8@1+ (0.01,0) [0|1] "NA" MCU
 SG_ Reserved_27_23 : 23176|24@1+ (1,0) [0|0] "NA" MCU
 SG_ OBJ_CRC_24 : 23200|32@1+ (1,0) [0|4294967295] "NA" MCU
 SG_ OBJ_ID_24 : 23232|8@1+ (1,0) [0|255] "counter" MCU
 SG_ OBJ_Existence_Probability_24 : 23240|8@1+ (0.01,0) [0|1] "NA" MCU
 SG_ OBJ_Fusion_Source_24 : 23248|16@1+ (1,0) [0|65535] "BITWIZE" MCU
 SG_ OBJ_Triggered_SDM_24 : 23264|2@1+ (1,0) [0|2] "ENUM" MCU
 SG_ OBJ_Motion_Category_24 : 23266|4@1+ (1,0) [0|13] "ENUM" MCU
 SG_ OBJ_Moving_IN_Probability_24 : 23270|7@1+ (0.01,0) [0|1] "NA" MCU
 SG_ OBJ_Object_Age_24 : 23277|11@1+ (1,0) [0|2047] "frames" MCU
 SG_ OBJ_Measuring_Status_24 : 23288|3@1+ (1,0) [0|7] "BITWIZE" MCU
 SG_ OBJ_Object_Class_24 : 23291|4@1+ (1,0) [0|9] "ENUM" MCU
 SG_ Reserved_4_24 : 23295|1@1+ (1,0) [0|0] "NA" MCU
 SG_ OBJ_Class_Probability_24 : 23296|7@1+ (0.01,0) [0|1] "NA" MCU
 SG_ OBJ_Car_Probability_24 : 23303|7@1+ (0.01,0) [0|1] "NA" MCU
 SG_ OBJ_Truck_Probability_24 : 23310|7@1+ (0.01,0) [0|1] "NA" MCU
 SG_ OBJ_Bike_Probability_24 : 23317|7@1+ (0.01,0) [0|1] "NA" MCU
 SG_ OBJ_Camera_Source_24 : 23324|4@1+ (1,0) [0|15] "ENUM" MCU
 SG_ OBJ_Motion_Status_24 : 23328|3@1+ (1,0) [0|5] "ENUM" MCU
 SG_ OBJ_Motion_Orientation_24 : 23331|4@1+ (1,0) [0|13] "ENUM" MCU
 SG_ OBJ_Has_Cut_Lane_24 : 23335|1@1+ (1,0) [0|1] "bool" MCU
 SG_ OBJ_Has_Cut_Path_24 : 23336|1@1+ (1,0) [0|1] "bool" MCU
 SG_ OBJ_Brake_Light_Validity_24 : 23337|1@1+ (1,0) [0|1] "bool" MCU
 SG_ OBJ_Brake_Light_24 : 23338|1@1+ (1,0) [0|1] "bool" MCU
 SG_ OBJ_Turn_Indicator_Right_24 : 23339|1@1+ (1,0) [0|1] "bool" MCU
 SG_ OBJ_Turn_Indicator_Left_24 : 23340|1@1+ (1,0) [0|1] "bool" MCU
 SG_ OBJ_Turn_Indicator_Validity_24 : 23341|1@1+ (1,0) [0|1] "bool" MCU
 SG_ OBJ_Right_Out_Of_Image_24 : 23342|1@1+ (1,0) [0|1] "bool" MCU
 SG_ OBJ_Left_Out_Of_Image_24 : 23343|1@1+ (1,0) [0|1] "bool" MCU
 SG_ OBJ_Right_Out_Of_Image_V_24 : 23344|1@1+ (1,0) [0|1] "bool" MCU
 SG_ OBJ_Left_Out_Of_Image_V_24 : 23345|1@1+ (1,0) [0|1] "bool" MCU
 SG_ OBJ_Top_Out_Of_Image_24 : 23346|1@1+ (1,0) [0|1] "bool" MCU
 SG_ OBJ_Bottom_Out_Of_Image_24 : 23347|1@1+ (1,0) [0|1] "bool" MCU
 SG_ OBJ_Top_Out_Of_Image_V_24 : 23348|1@1+ (1,0) [0|1] "bool" MCU
 SG_ OBJ_Bottom_Out_Of_Image_V_24 : 23349|1@1+ (1,0) [0|1] "bool" MCU
 SG_ OBJ_Lane_Assignment_24 : 23350|3@1+ (1,0) [0|5] "ENUM" MCU
 SG_ OBJ_Lane_Assignment_V_24 : 23353|1@1+ (1,0) [0|1] "bool" MCU
 SG_ Reserved_5_24 : 23354|6@1+ (1,0) [0|0] "NA" MCU
 SG_ OBJ_Age_Seconds_24 : 23360|7@1+ (1,0) [0|100] "s" MCU
 SG_ OBJ_Age_Seconds_V_24 : 23367|1@1+ (1,0) [0|1] "bool" MCU
 SG_ OBJ_Width_24 : 23368|9@1+ (0.01,0) [0.4|2.95] "m" MCU
 SG_ OBJ_Width_V_24 : 23377|1@1+ (1,0) [0|1] "bool" MCU
 SG_ OBJ_Width_STD_24 : 23378|11@1+ (0.001,0) [0|2] "m" MCU
 SG_ OBJ_Width_STD_V_24 : 23389|1@1+ (1,0) [0|1] "bool" MCU
 SG_ Reserved_6_24 : 23390|2@1+ (1,0) [0|0] "NA" MCU
 SG_ OBJ_Length_24 : 23392|9@1+ (0.05,0) [0.6|21] "m" MCU
 SG_ OBJ_Length_V_24 : 23401|1@1+ (1,0) [0|1] "bool" MCU
 SG_ OBJ_Length_STD_24 : 23402|10@1+ (0.01,0) [0|10] "m" MCU
 SG_ OBJ_Length_STD_V_24 : 23412|1@1+ (1,0) [0|1] "bool" MCU
 SG_ OBJ_Radar_ID_24 : 23413|8@1+ (1,0) [0|255] "counter" MCU
 SG_ Reserved_7_24 : 23421|3@1+ (1,0) [0|0] "NA" MCU
 SG_ OBJ_Height_24 : 23424|9@1+ (0.01,0) [0|2.95] "m" MCU
 SG_ OBJ_Height_V_24 : 23433|1@1+ (1,0) [0|1] "bool" MCU
 SG_ OBJ_Height_STD_24 : 23434|11@1+ (0.001,0) [0|2] "m" MCU
 SG_ OBJ_Height_STD_V_24 : 23445|1@1+ (1,0) [0|1] "bool" MCU
 SG_ Reserved_8_24 : 23446|10@1+ (1,0) [0|0] "NA" MCU
 SG_ OBJ_Abs_Long_Velocity_24 : 23456|12@1+ (0.05,-100) [-100|100] "m_per_s" MCU
 SG_ OBJ_Abs_Long_Velocity_V_24 : 23468|1@1+ (1,0) [0|1] "bool" MCU
 SG_ OBJ_Abs_Long_Velocity_STD_24 : 23469|13@1+ (0.01,0) [0|65] "m_per_s" MCU
 SG_ OBJ_Abs_Long_Vel_STD_V_24 : 23482|1@1+ (1,0) [0|1] "bool" MCU
 SG_ Reserved_9_24 : 23483|5@1+ (1,0) [0|0] "NA" MCU
 SG_ OBJ_Abs_Lat_Velocity_24 : 23488|11@1+ (0.05,-50) [-50|50] "m_per_s" MCU
 SG_ OBJ_Abs_Lat_Velocity_V_24 : 23499|1@1+ (1,0) [0|1] "bool" MCU
 SG_ OBJ_Abs_Lat_Velocity_STD_24 : 23500|13@1+ (0.01,0) [0|50] "m_per_s" MCU
 SG_ OBJ_Abs_Lat_Vel_STD_V_24 : 23513|1@1+ (1,0) [0|1] "bool" MCU
 SG_ Reserved_10_24 : 23514|6@1+ (1,0) [0|0] "NA" MCU
 SG_ OBJ_Abs_Long_Acc_24 : 23520|9@1+ (0.05,-10) [-10|10] "m_per_s2" MCU
 SG_ OBJ_Abs_Long_Acc_V_24 : 23529|1@1+ (1,0) [0|1] "bool" MCU
 SG_ OBJ_Abs_Long_Acc_STD_24 : 23530|10@1+ (0.01,0) [0|7.3] "m_per_s2" MCU
 SG_ OBJ_Abs_Long_Acc_STD_V_24 : 23540|1@1+ (1,0) [0|1] "bool" MCU
 SG_ OBJ_Abs_Lat_Acc_24 : 23541|9@1+ (0.05,-10) [-10|10] "m_per_s2" MCU
 SG_ OBJ_Abs_Lat_Acc_V_24 : 23550|1@1+ (1,0) [0|1] "bool" MCU
 SG_ Reserved_11_24 : 23551|1@1+ (1,0) [0|0] "NA" MCU
 SG_ OBJ_Abs_Lat_Acc_STD_24 : 23552|10@1+ (0.01,0) [0|7.3] "m_per_s2" MCU
 SG_ OBJ_Abs_Lat_Acc_STD_V_24 : 23562|1@1+ (1,0) [0|1] "bool" MCU
 SG_ OBJ_Abs_Acceleration_24 : 23563|9@1+ (0.05,-12.7) [-12.7|12.7] "m_per_s2" MCU
 SG_ OBJ_Abs_Acceleration_V_24 : 23572|1@1+ (1,0) [0|1] "bool" MCU
 SG_ OBJ_Abs_Acc_STD_24 : 23573|10@1+ (0.01,0) [0|7.3] "m_per_s2" MCU
 SG_ OBJ_Abs_Acc_STD_V_24 : 23583|1@1+ (1,0) [0|1] "bool" MCU
 SG_ OBJ_Inv_TTC_24 : 23584|11@1+ (0.01,-8) [-8|8] "INV(s)" MCU
 SG_ OBJ_Inv_TTC_V_24 : 23595|1@1+ (1,0) [0|1] "bool" MCU
 SG_ OBJ_Inv_TTC_STD_24 : 23596|12@1+ (0.001,0) [0|4] "INV(s)" MCU
 SG_ OBJ_Inv_TTC_STD_V_24 : 23608|1@1+ (1,0) [0|1] "bool" MCU
 SG_ Reserved_12_24 : 23609|7@1+ (1,0) [0|0] "NA" MCU
 SG_ OBJ_Relative_Long_Acc_24 : 23616|10@1+ (0.05,-20) [-20|20] "m_per_s2" MCU
 SG_ OBJ_Relative_Long_Acc_V_24 : 23626|1@1+ (1,0) [0|1] "bool" MCU
 SG_ OBJ_Relative_Long_Acc_STD_24 : 23627|10@1+ (0.01,0) [0|7.3] "m_per_s2" MCU
 SG_ OBJ_Rel_Long_Acc_STD_V_24 : 23637|1@1+ (1,0) [0|1] "bool" MCU
 SG_ Reserved_13_24 : 23638|10@1+ (1,0) [0|0] "NA" MCU
 SG_ OBJ_Relative_Long_Velocity_24 : 23648|13@1+ (0.05,-120) [-120|130] "m_per_s" MCU
 SG_ OBJ_Relative_Long_Velocity_V_24 : 23661|1@1+ (1,0) [0|1] "bool" MCU
 SG_ OBJ_Relative_Long_Vel_STD_24 : 23662|14@1+ (0.01,0) [0|130] "m_per_s" MCU
 SG_ OBJ_Rel_Long_Vel_STD_V_24 : 23676|1@1+ (1,0) [0|1] "bool" MCU
 SG_ Reserved_14_24 : 23677|3@1+ (1,0) [0|0] "NA" MCU
 SG_ OBJ_Relative_Lat_Velocity_24 : 23680|11@1+ (0.05,-50) [-50|50] "m_per_s" MCU
 SG_ OBJ_Relative_Lat_Velocity_V_24 : 23691|1@1+ (1,0) [0|1] "bool" MCU
 SG_ OBJ_Relative_Lat_Velocity_STD_24 : 23692|13@1+ (0.01,0) [0|50] "m_per_s" MCU
 SG_ OBJ_Rel_Lat_Vel_STD_V_24 : 23705|1@1+ (1,0) [0|1] "bool" MCU
 SG_ Reserved_15_24 : 23706|6@1+ (1,0) [0|0] "NA" MCU
 SG_ OBJ_Long_Distance_24 : 23712|14@1+ (0.05,-200) [-200|500] "m" MCU
 SG_ OBJ_Long_Distance_V_24 : 23726|1@1+ (1,0) [0|1] "bool" MCU
 SG_ OBJ_Long_Distance_STD_24 : 23727|15@1+ (0.01,0) [0|250] "m" MCU
 SG_ OBJ_Long_Distance_STD_V_24 : 23742|1@1+ (1,0) [0|1] "bool" MCU
 SG_ Reserved_16_24 : 23743|1@1+ (1,0) [0|0] "NA" MCU
 SG_ OBJ_Lat_Distance_24 : 23744|12@1+ (0.05,-100) [-100|100] "m" MCU
 SG_ OBJ_Lat_Distance_V_24 : 23756|1@1+ (1,0) [0|1] "bool" MCU
 SG_ OBJ_Lat_Distance_STD_24 : 23757|14@1+ (0.01,0) [0|100] "m" MCU
 SG_ OBJ_Lat_Distance_STD_V_24 : 23771|1@1+ (1,0) [0|1] "bool" MCU
 SG_ Reserved_17_24 : 23772|4@1+ (1,0) [0|0] "NA" MCU
 SG_ OBJ_Absolute_Speed_24 : 23776|12@1+ (0.05,-65) [-65|65] "m_per_s" MCU
 SG_ OBJ_Absolute_Speed_V_24 : 23788|1@1+ (1,0) [0|1] "bool" MCU
 SG_ OBJ_Absolute_Speed_STD_24 : 23789|13@1+ (0.01,0) [0|65] "m_per_s" MCU
 SG_ OBJ_Absolute_Speed_STD_V_24 : 23802|1@1+ (1,0) [0|1] "bool" MCU
 SG_ Reserved_18_24 : 23803|5@1+ (1,0) [0|0] "NA" MCU
 SG_ OBJ_Heading_24 : 23808|10@1+ (0.01,-3.14) [-3.14|3.14] "rad" MCU
 SG_ OBJ_Heading_V_24 : 23818|1@1+ (1,0) [0|1] "bool" MCU
 SG_ OBJ_Heading_STD_24 : 23819|15@1+ (0.0001,0) [0|3.14] "rad" MCU
 SG_ OBJ_Heading_STD_V_24 : 23834|1@1+ (1,0) [0|1] "bool" MCU
 SG_ Reserved_19_24 : 23835|5@1+ (1,0) [0|0] "NA" MCU
 SG_ OBJ_Angle_Rate_STD_24 : 23840|15@1+ (0.0001,0) [0|2.2318] "RPS" MCU
 SG_ OBJ_Angle_Rate_STD_V_24 : 23855|1@1+ (1,0) [0|1] "bool" MCU
 SG_ OBJ_Angle_Rate_24 : 23856|12@1+ (0.002,-2.234) [-2.234|2.2318] "RPS" MCU
 SG_ OBJ_Angle_Rate_V_24 : 23868|1@1+ (1,0) [0|1] "bool" MCU
 SG_ Reserved_20_24 : 23869|3@1+ (1,0) [0|0] "NA" MCU
 SG_ OBJ_Angle_Right_24 : 23872|14@1+ (0.0002,-1.571) [-1.571|1.571] "rad" MCU
 SG_ OBJ_Angle_Right_V_24 : 23886|1@1+ (1,0) [0|1] "bool" MCU
 SG_ OBJ_Angle_Right_STD_24 : 23887|14@1+ (0.0001,0) [0|1.571] "rad" MCU
 SG_ OBJ_Angle_Right_STD_V_24 : 23901|1@1+ (1,0) [0|1] "bool" MCU
 SG_ Reserved_21_24 : 23902|2@1+ (1,0) [0|0] "NA" MCU
 SG_ OBJ_Angle_Left_24 : 23904|14@1+ (0.0002,-1.571) [-1.571|1.571] "rad" MCU
 SG_ OBJ_Angle_Left_V_24 : 23918|1@1+ (1,0) [0|1] "bool" MCU
 SG_ OBJ_Angle_Left_STD_24 : 23919|14@1+ (0.0001,0) [0|1.571] "rad" MCU
 SG_ OBJ_Angle_Left_STD_V_24 : 23933|1@1+ (1,0) [0|1] "bool" MCU
 SG_ Reserved_22_24 : 23934|2@1+ (1,0) [0|0] "NA" MCU
 SG_ OBJ_Angle_Side_24 : 23936|14@1+ (0.0002,-1.571) [-1.571|1.571] "rad" MCU
 SG_ OBJ_Angle_Side_V_24 : 23950|1@1+ (1,0) [0|1] "bool" MCU
 SG_ OBJ_Angle_Side_STD_24 : 23951|14@1+ (0.0001,0) [0|1.571] "rad" MCU
 SG_ OBJ_Angle_Side_STD_V_24 : 23965|1@1+ (1,0) [0|1] "bool" MCU
 SG_ OBJ_Angle_Mid_V_24 : 23966|1@1+ (1,0) [0|1] "bool" MCU
 SG_ Reserved_23_24 : 23967|1@1+ (1,0) [0|0] "NA" MCU
 SG_ OBJ_Angle_Mid_24 : 23968|14@1+ (0.0002,-1.571) [-1.571|1.571] "rad" MCU
 SG_ OBJ_Angle_Mid_STD_24 : 23982|14@1+ (0.0001,0) [0|1.571] "rad" MCU
 SG_ OBJ_Angle_Mid_STD_V_24 : 23996|1@1+ (1,0) [0|1] "bool" MCU
 SG_ OBJ_Angle_Bottom_V_24 : 23997|1@1+ (1,0) [0|1] "bool" MCU
 SG_ Reserved_24_24 : 23998|2@1+ (1,0) [0|0] "NA" MCU
 SG_ OBJ_Angle_Bottom_24 : 24000|14@1+ (0.0002,-1.571) [-1.571|1.571] "rad" MCU
 SG_ OBJ_Angle_Bottom_STD_24 : 24014|14@1+ (0.0001,0) [0|1.571] "rad" MCU
 SG_ OBJ_Angle_Bottom_STD_V_24 : 24028|1@1+ (1,0) [0|1] "bool" MCU
 SG_ OBJ_Visibility_Side_V_24 : 24029|1@1+ (1,0) [0|1] "bool" MCU
 SG_ OBJ_Visibility_Side_24 : 24030|2@1+ (1,0) [0|2] "ENUM" MCU
 SG_ OBJ_Is_In_Drivable_Area_24 : 24032|1@1+ (1,0) [0|1] "bool" MCU
 SG_ OBJ_Is_In_Drivable_Area_V_24 : 24033|1@1+ (1,0) [0|1] "bool" MCU
 SG_ OBJ_Is_VeryClose_V_24 : 24034|1@1+ (1,0) [0|1] "bool" MCU
 SG_ OBJ_Is_VeryClose_24 : 24035|1@1+ (1,0) [0|1] "bool" MCU
 SG_ OBJ_Buffer_C4_24 : 24036|2@1+ (1,0) [0|2] "NA" MCU
 SG_ OBJ_Buffer_C5_24 : 24038|2@1+ (1,0) [0|2] "NA" MCU
 SG_ OBJ_Buffer_C6_24 : 24040|2@1+ (1,0) [0|2] "NA" MCU
 SG_ OBJ_Buffer_C7_24 : 24042|2@1+ (1,0) [0|2] "NA" MCU
 SG_ OBJ_OverlapAngleEgoLaneR_24 : 24044|10@1+ (0.01,-3.14) [-3.14|3.14] "rad" MCU
 SG_ OBJ_OverlapAngleEgoLaneR_V_24 : 24054|1@1+ (1,0) [0|1] "bool" MCU
 SG_ Reserved_25_24 : 24055|9@1+ (1,0) [0|0] "NA" MCU
 SG_ OBJ_OverlapAngleEgoLaneL_24 : 24064|10@1+ (0.01,-3.14) [-3.14|3.14] "rad" MCU
 SG_ OBJ_OverlapAngleEgoLaneL_V_24 : 24074|1@1+ (1,0) [0|1] "bool" MCU
 SG_ OBJ_Is_EMERGENCY_VCL_24 : 24075|1@1+ (1,0) [0|1] "bool" MCU
 SG_ OBJ_EMERGENCY_LIGHT_COLOR_24 : 24076|4@1+ (1,0) [0|15] "BITWIZE" MCU
 SG_ OBJ_EMERGENCY_V_24 : 24080|1@1+ (1,0) [0|1] "bool" MCU
 SG_ OBJ_Angle_Top_24 : 24081|14@1+ (0.0002,0) [0|3.1415] "rad" MCU
 SG_ OBJ_Angle_Top_V_24 : 24095|1@1+ (1,0) [0|1] "bool" MCU
 SG_ OBJ_Angle_Top_STD_24 : 24096|15@1+ (0.0001,0) [0|3.1415] "rad" MCU
 SG_ OBJ_Angle_Top_STD_V_24 : 24111|1@1+ (1,0) [0|1] "bool" MCU
 SG_ OBJ_Open_Door_Left_24 : 24112|1@1+ (1,0) [0|1] "bool" MCU
 SG_ OBJ_Open_Door_Right_24 : 24113|1@1+ (1,0) [0|1] "bool" MCU
 SG_ OBJ_Visible_Left_or_Right_24 : 24114|2@1+ (1,0) [0|2] "ENUM" MCU
 SG_ OBJ_Visible_Left_or_Right_V_24 : 24116|1@1+ (1,0) [0|1] "bool" MCU
 SG_ OBJ_2W_Is_Motorbike_Probability_24 : 24117|8@1+ (0.01,0) [0|1] "NA" MCU
 SG_ Reserved_26_24 : 24125|3@1+ (1,0) [0|0] "NA" MCU
 SG_ OBJ_2W_Is_Bicycle_Probability_24 : 24128|8@1+ (0.01,0) [0|1] "NA" MCU
 SG_ Reserved_27_24 : 24136|24@1+ (1,0) [0|0] "NA" MCU
 SG_ OBJ_CRC_25 : 24160|32@1+ (1,0) [0|4294967295] "NA" MCU
 SG_ OBJ_ID_25 : 24192|8@1+ (1,0) [0|255] "counter" MCU
 SG_ OBJ_Existence_Probability_25 : 24200|8@1+ (0.01,0) [0|1] "NA" MCU
 SG_ OBJ_Fusion_Source_25 : 24208|16@1+ (1,0) [0|65535] "BITWIZE" MCU
 SG_ OBJ_Triggered_SDM_25 : 24224|2@1+ (1,0) [0|2] "ENUM" MCU
 SG_ OBJ_Motion_Category_25 : 24226|4@1+ (1,0) [0|13] "ENUM" MCU
 SG_ OBJ_Moving_IN_Probability_25 : 24230|7@1+ (0.01,0) [0|1] "NA" MCU
 SG_ OBJ_Object_Age_25 : 24237|11@1+ (1,0) [0|2047] "frames" MCU
 SG_ OBJ_Measuring_Status_25 : 24248|3@1+ (1,0) [0|7] "BITWIZE" MCU
 SG_ OBJ_Object_Class_25 : 24251|4@1+ (1,0) [0|9] "ENUM" MCU
 SG_ Reserved_4_25 : 24255|1@1+ (1,0) [0|0] "NA" MCU
 SG_ OBJ_Class_Probability_25 : 24256|7@1+ (0.01,0) [0|1] "NA" MCU
 SG_ OBJ_Car_Probability_25 : 24263|7@1+ (0.01,0) [0|1] "NA" MCU
 SG_ OBJ_Truck_Probability_25 : 24270|7@1+ (0.01,0) [0|1] "NA" MCU
 SG_ OBJ_Bike_Probability_25 : 24277|7@1+ (0.01,0) [0|1] "NA" MCU
 SG_ OBJ_Camera_Source_25 : 24284|4@1+ (1,0) [0|15] "ENUM" MCU
 SG_ OBJ_Motion_Status_25 : 24288|3@1+ (1,0) [0|5] "ENUM" MCU
 SG_ OBJ_Motion_Orientation_25 : 24291|4@1+ (1,0) [0|13] "ENUM" MCU
 SG_ OBJ_Has_Cut_Lane_25 : 24295|1@1+ (1,0) [0|1] "bool" MCU
 SG_ OBJ_Has_Cut_Path_25 : 24296|1@1+ (1,0) [0|1] "bool" MCU
 SG_ OBJ_Brake_Light_Validity_25 : 24297|1@1+ (1,0) [0|1] "bool" MCU
 SG_ OBJ_Brake_Light_25 : 24298|1@1+ (1,0) [0|1] "bool" MCU
 SG_ OBJ_Turn_Indicator_Right_25 : 24299|1@1+ (1,0) [0|1] "bool" MCU
 SG_ OBJ_Turn_Indicator_Left_25 : 24300|1@1+ (1,0) [0|1] "bool" MCU
 SG_ OBJ_Turn_Indicator_Validity_25 : 24301|1@1+ (1,0) [0|1] "bool" MCU
 SG_ OBJ_Right_Out_Of_Image_25 : 24302|1@1+ (1,0) [0|1] "bool" MCU
 SG_ OBJ_Left_Out_Of_Image_25 : 24303|1@1+ (1,0) [0|1] "bool" MCU
 SG_ OBJ_Right_Out_Of_Image_V_25 : 24304|1@1+ (1,0) [0|1] "bool" MCU
 SG_ OBJ_Left_Out_Of_Image_V_25 : 24305|1@1+ (1,0) [0|1] "bool" MCU
 SG_ OBJ_Top_Out_Of_Image_25 : 24306|1@1+ (1,0) [0|1] "bool" MCU
 SG_ OBJ_Bottom_Out_Of_Image_25 : 24307|1@1+ (1,0) [0|1] "bool" MCU
 SG_ OBJ_Top_Out_Of_Image_V_25 : 24308|1@1+ (1,0) [0|1] "bool" MCU
 SG_ OBJ_Bottom_Out_Of_Image_V_25 : 24309|1@1+ (1,0) [0|1] "bool" MCU
 SG_ OBJ_Lane_Assignment_25 : 24310|3@1+ (1,0) [0|5] "ENUM" MCU
 SG_ OBJ_Lane_Assignment_V_25 : 24313|1@1+ (1,0) [0|1] "bool" MCU
 SG_ Reserved_5_25 : 24314|6@1+ (1,0) [0|0] "NA" MCU
 SG_ OBJ_Age_Seconds_25 : 24320|7@1+ (1,0) [0|100] "s" MCU
 SG_ OBJ_Age_Seconds_V_25 : 24327|1@1+ (1,0) [0|1] "bool" MCU
 SG_ OBJ_Width_25 : 24328|9@1+ (0.01,0) [0.4|2.95] "m" MCU
 SG_ OBJ_Width_V_25 : 24337|1@1+ (1,0) [0|1] "bool" MCU
 SG_ OBJ_Width_STD_25 : 24338|11@1+ (0.001,0) [0|2] "m" MCU
 SG_ OBJ_Width_STD_V_25 : 24349|1@1+ (1,0) [0|1] "bool" MCU
 SG_ Reserved_6_25 : 24350|2@1+ (1,0) [0|0] "NA" MCU
 SG_ OBJ_Length_25 : 24352|9@1+ (0.05,0) [0.6|21] "m" MCU
 SG_ OBJ_Length_V_25 : 24361|1@1+ (1,0) [0|1] "bool" MCU
 SG_ OBJ_Length_STD_25 : 24362|10@1+ (0.01,0) [0|10] "m" MCU
 SG_ OBJ_Length_STD_V_25 : 24372|1@1+ (1,0) [0|1] "bool" MCU
 SG_ OBJ_Radar_ID_25 : 24373|8@1+ (1,0) [0|255] "counter" MCU
 SG_ Reserved_7_25 : 24381|3@1+ (1,0) [0|0] "NA" MCU
 SG_ OBJ_Height_25 : 24384|9@1+ (0.01,0) [0|2.95] "m" MCU
 SG_ OBJ_Height_V_25 : 24393|1@1+ (1,0) [0|1] "bool" MCU
 SG_ OBJ_Height_STD_25 : 24394|11@1+ (0.001,0) [0|2] "m" MCU
 SG_ OBJ_Height_STD_V_25 : 24405|1@1+ (1,0) [0|1] "bool" MCU
 SG_ Reserved_8_25 : 24406|10@1+ (1,0) [0|0] "NA" MCU
 SG_ OBJ_Abs_Long_Velocity_25 : 24416|12@1+ (0.05,-100) [-100|100] "m_per_s" MCU
 SG_ OBJ_Abs_Long_Velocity_V_25 : 24428|1@1+ (1,0) [0|1] "bool" MCU
 SG_ OBJ_Abs_Long_Velocity_STD_25 : 24429|13@1+ (0.01,0) [0|65] "m_per_s" MCU
 SG_ OBJ_Abs_Long_Vel_STD_V_25 : 24442|1@1+ (1,0) [0|1] "bool" MCU
 SG_ Reserved_9_25 : 24443|5@1+ (1,0) [0|0] "NA" MCU
 SG_ OBJ_Abs_Lat_Velocity_25 : 24448|11@1+ (0.05,-50) [-50|50] "m_per_s" MCU
 SG_ OBJ_Abs_Lat_Velocity_V_25 : 24459|1@1+ (1,0) [0|1] "bool" MCU
 SG_ OBJ_Abs_Lat_Velocity_STD_25 : 24460|13@1+ (0.01,0) [0|50] "m_per_s" MCU
 SG_ OBJ_Abs_Lat_Vel_STD_V_25 : 24473|1@1+ (1,0) [0|1] "bool" MCU
 SG_ Reserved_10_25 : 24474|6@1+ (1,0) [0|0] "NA" MCU
 SG_ OBJ_Abs_Long_Acc_25 : 24480|9@1+ (0.05,-10) [-10|10] "m_per_s2" MCU
 SG_ OBJ_Abs_Long_Acc_V_25 : 24489|1@1+ (1,0) [0|1] "bool" MCU
 SG_ OBJ_Abs_Long_Acc_STD_25 : 24490|10@1+ (0.01,0) [0|7.3] "m_per_s2" MCU
 SG_ OBJ_Abs_Long_Acc_STD_V_25 : 24500|1@1+ (1,0) [0|1] "bool" MCU
 SG_ OBJ_Abs_Lat_Acc_25 : 24501|9@1+ (0.05,-10) [-10|10] "m_per_s2" MCU
 SG_ OBJ_Abs_Lat_Acc_V_25 : 24510|1@1+ (1,0) [0|1] "bool" MCU
 SG_ Reserved_11_25 : 24511|1@1+ (1,0) [0|0] "NA" MCU
 SG_ OBJ_Abs_Lat_Acc_STD_25 : 24512|10@1+ (0.01,0) [0|7.3] "m_per_s2" MCU
 SG_ OBJ_Abs_Lat_Acc_STD_V_25 : 24522|1@1+ (1,0) [0|1] "bool" MCU
 SG_ OBJ_Abs_Acceleration_25 : 24523|9@1+ (0.05,-12.7) [-12.7|12.7] "m_per_s2" MCU
 SG_ OBJ_Abs_Acceleration_V_25 : 24532|1@1+ (1,0) [0|1] "bool" MCU
 SG_ OBJ_Abs_Acc_STD_25 : 24533|10@1+ (0.01,0) [0|7.3] "m_per_s2" MCU
 SG_ OBJ_Abs_Acc_STD_V_25 : 24543|1@1+ (1,0) [0|1] "bool" MCU
 SG_ OBJ_Inv_TTC_25 : 24544|11@1+ (0.01,-8) [-8|8] "INV(s)" MCU
 SG_ OBJ_Inv_TTC_V_25 : 24555|1@1+ (1,0) [0|1] "bool" MCU
 SG_ OBJ_Inv_TTC_STD_25 : 24556|12@1+ (0.001,0) [0|4] "INV(s)" MCU
 SG_ OBJ_Inv_TTC_STD_V_25 : 24568|1@1+ (1,0) [0|1] "bool" MCU
 SG_ Reserved_12_25 : 24569|7@1+ (1,0) [0|0] "NA" MCU
 SG_ OBJ_Relative_Long_Acc_25 : 24576|10@1+ (0.05,-20) [-20|20] "m_per_s2" MCU
 SG_ OBJ_Relative_Long_Acc_V_25 : 24586|1@1+ (1,0) [0|1] "bool" MCU
 SG_ OBJ_Relative_Long_Acc_STD_25 : 24587|10@1+ (0.01,0) [0|7.3] "m_per_s2" MCU
 SG_ OBJ_Rel_Long_Acc_STD_V_25 : 24597|1@1+ (1,0) [0|1] "bool" MCU
 SG_ Reserved_13_25 : 24598|10@1+ (1,0) [0|0] "NA" MCU
 SG_ OBJ_Relative_Long_Velocity_25 : 24608|13@1+ (0.05,-120) [-120|130] "m_per_s" MCU
 SG_ OBJ_Relative_Long_Velocity_V_25 : 24621|1@1+ (1,0) [0|1] "bool" MCU
 SG_ OBJ_Relative_Long_Vel_STD_25 : 24622|14@1+ (0.01,0) [0|130] "m_per_s" MCU
 SG_ OBJ_Rel_Long_Vel_STD_V_25 : 24636|1@1+ (1,0) [0|1] "bool" MCU
 SG_ Reserved_14_25 : 24637|3@1+ (1,0) [0|0] "NA" MCU
 SG_ OBJ_Relative_Lat_Velocity_25 : 24640|11@1+ (0.05,-50) [-50|50] "m_per_s" MCU
 SG_ OBJ_Relative_Lat_Velocity_V_25 : 24651|1@1+ (1,0) [0|1] "bool" MCU
 SG_ OBJ_Relative_Lat_Velocity_STD_25 : 24652|13@1+ (0.01,0) [0|50] "m_per_s" MCU
 SG_ OBJ_Rel_Lat_Vel_STD_V_25 : 24665|1@1+ (1,0) [0|1] "bool" MCU
 SG_ Reserved_15_25 : 24666|6@1+ (1,0) [0|0] "NA" MCU
 SG_ OBJ_Long_Distance_25 : 24672|14@1+ (0.05,-200) [-200|500] "m" MCU
 SG_ OBJ_Long_Distance_V_25 : 24686|1@1+ (1,0) [0|1] "bool" MCU
 SG_ OBJ_Long_Distance_STD_25 : 24687|15@1+ (0.01,0) [0|250] "m" MCU
 SG_ OBJ_Long_Distance_STD_V_25 : 24702|1@1+ (1,0) [0|1] "bool" MCU
 SG_ Reserved_16_25 : 24703|1@1+ (1,0) [0|0] "NA" MCU
 SG_ OBJ_Lat_Distance_25 : 24704|12@1+ (0.05,-100) [-100|100] "m" MCU
 SG_ OBJ_Lat_Distance_V_25 : 24716|1@1+ (1,0) [0|1] "bool" MCU
 SG_ OBJ_Lat_Distance_STD_25 : 24717|14@1+ (0.01,0) [0|100] "m" MCU
 SG_ OBJ_Lat_Distance_STD_V_25 : 24731|1@1+ (1,0) [0|1] "bool" MCU
 SG_ Reserved_17_25 : 24732|4@1+ (1,0) [0|0] "NA" MCU
 SG_ OBJ_Absolute_Speed_25 : 24736|12@1+ (0.05,-65) [-65|65] "m_per_s" MCU
 SG_ OBJ_Absolute_Speed_V_25 : 24748|1@1+ (1,0) [0|1] "bool" MCU
 SG_ OBJ_Absolute_Speed_STD_25 : 24749|13@1+ (0.01,0) [0|65] "m_per_s" MCU
 SG_ OBJ_Absolute_Speed_STD_V_25 : 24762|1@1+ (1,0) [0|1] "bool" MCU
 SG_ Reserved_18_25 : 24763|5@1+ (1,0) [0|0] "NA" MCU
 SG_ OBJ_Heading_25 : 24768|10@1+ (0.01,-3.14) [-3.14|3.14] "rad" MCU
 SG_ OBJ_Heading_V_25 : 24778|1@1+ (1,0) [0|1] "bool" MCU
 SG_ OBJ_Heading_STD_25 : 24779|15@1+ (0.0001,0) [0|3.14] "rad" MCU
 SG_ OBJ_Heading_STD_V_25 : 24794|1@1+ (1,0) [0|1] "bool" MCU
 SG_ Reserved_19_25 : 24795|5@1+ (1,0) [0|0] "NA" MCU
 SG_ OBJ_Angle_Rate_STD_25 : 24800|15@1+ (0.0001,0) [0|2.2318] "RPS" MCU
 SG_ OBJ_Angle_Rate_STD_V_25 : 24815|1@1+ (1,0) [0|1] "bool" MCU
 SG_ OBJ_Angle_Rate_25 : 24816|12@1+ (0.002,-2.234) [-2.234|2.2318] "RPS" MCU
 SG_ OBJ_Angle_Rate_V_25 : 24828|1@1+ (1,0) [0|1] "bool" MCU
 SG_ Reserved_20_25 : 24829|3@1+ (1,0) [0|0] "NA" MCU
 SG_ OBJ_Angle_Right_25 : 24832|14@1+ (0.0002,-1.571) [-1.571|1.571] "rad" MCU
 SG_ OBJ_Angle_Right_V_25 : 24846|1@1+ (1,0) [0|1] "bool" MCU
 SG_ OBJ_Angle_Right_STD_25 : 24847|14@1+ (0.0001,0) [0|1.571] "rad" MCU
 SG_ OBJ_Angle_Right_STD_V_25 : 24861|1@1+ (1,0) [0|1] "bool" MCU
 SG_ Reserved_21_25 : 24862|2@1+ (1,0) [0|0] "NA" MCU
 SG_ OBJ_Angle_Left_25 : 24864|14@1+ (0.0002,-1.571) [-1.571|1.571] "rad" MCU
 SG_ OBJ_Angle_Left_V_25 : 24878|1@1+ (1,0) [0|1] "bool" MCU
 SG_ OBJ_Angle_Left_STD_25 : 24879|14@1+ (0.0001,0) [0|1.571] "rad" MCU
 SG_ OBJ_Angle_Left_STD_V_25 : 24893|1@1+ (1,0) [0|1] "bool" MCU
 SG_ Reserved_22_25 : 24894|2@1+ (1,0) [0|0] "NA" MCU
 SG_ OBJ_Angle_Side_25 : 24896|14@1+ (0.0002,-1.571) [-1.571|1.571] "rad" MCU
 SG_ OBJ_Angle_Side_V_25 : 24910|1@1+ (1,0) [0|1] "bool" MCU
 SG_ OBJ_Angle_Side_STD_25 : 24911|14@1+ (0.0001,0) [0|1.571] "rad" MCU
 SG_ OBJ_Angle_Side_STD_V_25 : 24925|1@1+ (1,0) [0|1] "bool" MCU
 SG_ OBJ_Angle_Mid_V_25 : 24926|1@1+ (1,0) [0|1] "bool" MCU
 SG_ Reserved_23_25 : 24927|1@1+ (1,0) [0|0] "NA" MCU
 SG_ OBJ_Angle_Mid_25 : 24928|14@1+ (0.0002,-1.571) [-1.571|1.571] "rad" MCU
 SG_ OBJ_Angle_Mid_STD_25 : 24942|14@1+ (0.0001,0) [0|1.571] "rad" MCU
 SG_ OBJ_Angle_Mid_STD_V_25 : 24956|1@1+ (1,0) [0|1] "bool" MCU
 SG_ OBJ_Angle_Bottom_V_25 : 24957|1@1+ (1,0) [0|1] "bool" MCU
 SG_ Reserved_24_25 : 24958|2@1+ (1,0) [0|0] "NA" MCU
 SG_ OBJ_Angle_Bottom_25 : 24960|14@1+ (0.0002,-1.571) [-1.571|1.571] "rad" MCU
 SG_ OBJ_Angle_Bottom_STD_25 : 24974|14@1+ (0.0001,0) [0|1.571] "rad" MCU
 SG_ OBJ_Angle_Bottom_STD_V_25 : 24988|1@1+ (1,0) [0|1] "bool" MCU
 SG_ OBJ_Visibility_Side_V_25 : 24989|1@1+ (1,0) [0|1] "bool" MCU
 SG_ OBJ_Visibility_Side_25 : 24990|2@1+ (1,0) [0|2] "ENUM" MCU
 SG_ OBJ_Is_In_Drivable_Area_25 : 24992|1@1+ (1,0) [0|1] "bool" MCU
 SG_ OBJ_Is_In_Drivable_Area_V_25 : 24993|1@1+ (1,0) [0|1] "bool" MCU
 SG_ OBJ_Is_VeryClose_V_25 : 24994|1@1+ (1,0) [0|1] "bool" MCU
 SG_ OBJ_Is_VeryClose_25 : 24995|1@1+ (1,0) [0|1] "bool" MCU
 SG_ OBJ_Buffer_C4_25 : 24996|2@1+ (1,0) [0|2] "NA" MCU
 SG_ OBJ_Buffer_C5_25 : 24998|2@1+ (1,0) [0|2] "NA" MCU
 SG_ OBJ_Buffer_C6_25 : 25000|2@1+ (1,0) [0|2] "NA" MCU
 SG_ OBJ_Buffer_C7_25 : 25002|2@1+ (1,0) [0|2] "NA" MCU
 SG_ OBJ_OverlapAngleEgoLaneR_25 : 25004|10@1+ (0.01,-3.14) [-3.14|3.14] "rad" MCU
 SG_ OBJ_OverlapAngleEgoLaneR_V_25 : 25014|1@1+ (1,0) [0|1] "bool" MCU
 SG_ Reserved_25_25 : 25015|9@1+ (1,0) [0|0] "NA" MCU
 SG_ OBJ_OverlapAngleEgoLaneL_25 : 25024|10@1+ (0.01,-3.14) [-3.14|3.14] "rad" MCU
 SG_ OBJ_OverlapAngleEgoLaneL_V_25 : 25034|1@1+ (1,0) [0|1] "bool" MCU
 SG_ OBJ_Is_EMERGENCY_VCL_25 : 25035|1@1+ (1,0) [0|1] "bool" MCU
 SG_ OBJ_EMERGENCY_LIGHT_COLOR_25 : 25036|4@1+ (1,0) [0|15] "BITWIZE" MCU
 SG_ OBJ_EMERGENCY_V_25 : 25040|1@1+ (1,0) [0|1] "bool" MCU
 SG_ OBJ_Angle_Top_25 : 25041|14@1+ (0.0002,0) [0|3.1415] "rad" MCU
 SG_ OBJ_Angle_Top_V_25 : 25055|1@1+ (1,0) [0|1] "bool" MCU
 SG_ OBJ_Angle_Top_STD_25 : 25056|15@1+ (0.0001,0) [0|3.1415] "rad" MCU
 SG_ OBJ_Angle_Top_STD_V_25 : 25071|1@1+ (1,0) [0|1] "bool" MCU
 SG_ OBJ_Open_Door_Left_25 : 25072|1@1+ (1,0) [0|1] "bool" MCU
 SG_ OBJ_Open_Door_Right_25 : 25073|1@1+ (1,0) [0|1] "bool" MCU
 SG_ OBJ_Visible_Left_or_Right_25 : 25074|2@1+ (1,0) [0|2] "ENUM" MCU
 SG_ OBJ_Visible_Left_or_Right_V_25 : 25076|1@1+ (1,0) [0|1] "bool" MCU
 SG_ OBJ_2W_Is_Motorbike_Probability_25 : 25077|8@1+ (0.01,0) [0|1] "NA" MCU
 SG_ Reserved_26_25 : 25085|3@1+ (1,0) [0|0] "NA" MCU
 SG_ OBJ_2W_Is_Bicycle_Probability_25 : 25088|8@1+ (0.01,0) [0|1] "NA" MCU
 SG_ Reserved_27_25 : 25096|24@1+ (1,0) [0|0] "NA" MCU
 SG_ OBJ_CRC_26 : 25120|32@1+ (1,0) [0|4294967295] "NA" MCU
 SG_ OBJ_ID_26 : 25152|8@1+ (1,0) [0|255] "counter" MCU
 SG_ OBJ_Existence_Probability_26 : 25160|8@1+ (0.01,0) [0|1] "NA" MCU
 SG_ OBJ_Fusion_Source_26 : 25168|16@1+ (1,0) [0|65535] "BITWIZE" MCU
 SG_ OBJ_Triggered_SDM_26 : 25184|2@1+ (1,0) [0|2] "ENUM" MCU
 SG_ OBJ_Motion_Category_26 : 25186|4@1+ (1,0) [0|13] "ENUM" MCU
 SG_ OBJ_Moving_IN_Probability_26 : 25190|7@1+ (0.01,0) [0|1] "NA" MCU
 SG_ OBJ_Object_Age_26 : 25197|11@1+ (1,0) [0|2047] "frames" MCU
 SG_ OBJ_Measuring_Status_26 : 25208|3@1+ (1,0) [0|7] "BITWIZE" MCU
 SG_ OBJ_Object_Class_26 : 25211|4@1+ (1,0) [0|9] "ENUM" MCU
 SG_ Reserved_4_26 : 25215|1@1+ (1,0) [0|0] "NA" MCU
 SG_ OBJ_Class_Probability_26 : 25216|7@1+ (0.01,0) [0|1] "NA" MCU
 SG_ OBJ_Car_Probability_26 : 25223|7@1+ (0.01,0) [0|1] "NA" MCU
 SG_ OBJ_Truck_Probability_26 : 25230|7@1+ (0.01,0) [0|1] "NA" MCU
 SG_ OBJ_Bike_Probability_26 : 25237|7@1+ (0.01,0) [0|1] "NA" MCU
 SG_ OBJ_Camera_Source_26 : 25244|4@1+ (1,0) [0|15] "ENUM" MCU
 SG_ OBJ_Motion_Status_26 : 25248|3@1+ (1,0) [0|5] "ENUM" MCU
 SG_ OBJ_Motion_Orientation_26 : 25251|4@1+ (1,0) [0|13] "ENUM" MCU
 SG_ OBJ_Has_Cut_Lane_26 : 25255|1@1+ (1,0) [0|1] "bool" MCU
 SG_ OBJ_Has_Cut_Path_26 : 25256|1@1+ (1,0) [0|1] "bool" MCU
 SG_ OBJ_Brake_Light_Validity_26 : 25257|1@1+ (1,0) [0|1] "bool" MCU
 SG_ OBJ_Brake_Light_26 : 25258|1@1+ (1,0) [0|1] "bool" MCU
 SG_ OBJ_Turn_Indicator_Right_26 : 25259|1@1+ (1,0) [0|1] "bool" MCU
 SG_ OBJ_Turn_Indicator_Left_26 : 25260|1@1+ (1,0) [0|1] "bool" MCU
 SG_ OBJ_Turn_Indicator_Validity_26 : 25261|1@1+ (1,0) [0|1] "bool" MCU
 SG_ OBJ_Right_Out_Of_Image_26 : 25262|1@1+ (1,0) [0|1] "bool" MCU
 SG_ OBJ_Left_Out_Of_Image_26 : 25263|1@1+ (1,0) [0|1] "bool" MCU
 SG_ OBJ_Right_Out_Of_Image_V_26 : 25264|1@1+ (1,0) [0|1] "bool" MCU
 SG_ OBJ_Left_Out_Of_Image_V_26 : 25265|1@1+ (1,0) [0|1] "bool" MCU
 SG_ OBJ_Top_Out_Of_Image_26 : 25266|1@1+ (1,0) [0|1] "bool" MCU
 SG_ OBJ_Bottom_Out_Of_Image_26 : 25267|1@1+ (1,0) [0|1] "bool" MCU
 SG_ OBJ_Top_Out_Of_Image_V_26 : 25268|1@1+ (1,0) [0|1] "bool" MCU
 SG_ OBJ_Bottom_Out_Of_Image_V_26 : 25269|1@1+ (1,0) [0|1] "bool" MCU
 SG_ OBJ_Lane_Assignment_26 : 25270|3@1+ (1,0) [0|5] "ENUM" MCU
 SG_ OBJ_Lane_Assignment_V_26 : 25273|1@1+ (1,0) [0|1] "bool" MCU
 SG_ Reserved_5_26 : 25274|6@1+ (1,0) [0|0] "NA" MCU
 SG_ OBJ_Age_Seconds_26 : 25280|7@1+ (1,0) [0|100] "s" MCU
 SG_ OBJ_Age_Seconds_V_26 : 25287|1@1+ (1,0) [0|1] "bool" MCU
 SG_ OBJ_Width_26 : 25288|9@1+ (0.01,0) [0.4|2.95] "m" MCU
 SG_ OBJ_Width_V_26 : 25297|1@1+ (1,0) [0|1] "bool" MCU
 SG_ OBJ_Width_STD_26 : 25298|11@1+ (0.001,0) [0|2] "m" MCU
 SG_ OBJ_Width_STD_V_26 : 25309|1@1+ (1,0) [0|1] "bool" MCU
 SG_ Reserved_6_26 : 25310|2@1+ (1,0) [0|0] "NA" MCU
 SG_ OBJ_Length_26 : 25312|9@1+ (0.05,0) [0.6|21] "m" MCU
 SG_ OBJ_Length_V_26 : 25321|1@1+ (1,0) [0|1] "bool" MCU
 SG_ OBJ_Length_STD_26 : 25322|10@1+ (0.01,0) [0|10] "m" MCU
 SG_ OBJ_Length_STD_V_26 : 25332|1@1+ (1,0) [0|1] "bool" MCU
 SG_ OBJ_Radar_ID_26 : 25333|8@1+ (1,0) [0|255] "counter" MCU
 SG_ Reserved_7_26 : 25341|3@1+ (1,0) [0|0] "NA" MCU
 SG_ OBJ_Height_26 : 25344|9@1+ (0.01,0) [0|2.95] "m" MCU
 SG_ OBJ_Height_V_26 : 25353|1@1+ (1,0) [0|1] "bool" MCU
 SG_ OBJ_Height_STD_26 : 25354|11@1+ (0.001,0) [0|2] "m" MCU
 SG_ OBJ_Height_STD_V_26 : 25365|1@1+ (1,0) [0|1] "bool" MCU
 SG_ Reserved_8_26 : 25366|10@1+ (1,0) [0|0] "NA" MCU
 SG_ OBJ_Abs_Long_Velocity_26 : 25376|12@1+ (0.05,-100) [-100|100] "m_per_s" MCU
 SG_ OBJ_Abs_Long_Velocity_V_26 : 25388|1@1+ (1,0) [0|1] "bool" MCU
 SG_ OBJ_Abs_Long_Velocity_STD_26 : 25389|13@1+ (0.01,0) [0|65] "m_per_s" MCU
 SG_ OBJ_Abs_Long_Vel_STD_V_26 : 25402|1@1+ (1,0) [0|1] "bool" MCU
 SG_ Reserved_9_26 : 25403|5@1+ (1,0) [0|0] "NA" MCU
 SG_ OBJ_Abs_Lat_Velocity_26 : 25408|11@1+ (0.05,-50) [-50|50] "m_per_s" MCU
 SG_ OBJ_Abs_Lat_Velocity_V_26 : 25419|1@1+ (1,0) [0|1] "bool" MCU
 SG_ OBJ_Abs_Lat_Velocity_STD_26 : 25420|13@1+ (0.01,0) [0|50] "m_per_s" MCU
 SG_ OBJ_Abs_Lat_Vel_STD_V_26 : 25433|1@1+ (1,0) [0|1] "bool" MCU
 SG_ Reserved_10_26 : 25434|6@1+ (1,0) [0|0] "NA" MCU
 SG_ OBJ_Abs_Long_Acc_26 : 25440|9@1+ (0.05,-10) [-10|10] "m_per_s2" MCU
 SG_ OBJ_Abs_Long_Acc_V_26 : 25449|1@1+ (1,0) [0|1] "bool" MCU
 SG_ OBJ_Abs_Long_Acc_STD_26 : 25450|10@1+ (0.01,0) [0|7.3] "m_per_s2" MCU
 SG_ OBJ_Abs_Long_Acc_STD_V_26 : 25460|1@1+ (1,0) [0|1] "bool" MCU
 SG_ OBJ_Abs_Lat_Acc_26 : 25461|9@1+ (0.05,-10) [-10|10] "m_per_s2" MCU
 SG_ OBJ_Abs_Lat_Acc_V_26 : 25470|1@1+ (1,0) [0|1] "bool" MCU
 SG_ Reserved_11_26 : 25471|1@1+ (1,0) [0|0] "NA" MCU
 SG_ OBJ_Abs_Lat_Acc_STD_26 : 25472|10@1+ (0.01,0) [0|7.3] "m_per_s2" MCU
 SG_ OBJ_Abs_Lat_Acc_STD_V_26 : 25482|1@1+ (1,0) [0|1] "bool" MCU
 SG_ OBJ_Abs_Acceleration_26 : 25483|9@1+ (0.05,-12.7) [-12.7|12.7] "m_per_s2" MCU
 SG_ OBJ_Abs_Acceleration_V_26 : 25492|1@1+ (1,0) [0|1] "bool" MCU
 SG_ OBJ_Abs_Acc_STD_26 : 25493|10@1+ (0.01,0) [0|7.3] "m_per_s2" MCU
 SG_ OBJ_Abs_Acc_STD_V_26 : 25503|1@1+ (1,0) [0|1] "bool" MCU
 SG_ OBJ_Inv_TTC_26 : 25504|11@1+ (0.01,-8) [-8|8] "INV(s)" MCU
 SG_ OBJ_Inv_TTC_V_26 : 25515|1@1+ (1,0) [0|1] "bool" MCU
 SG_ OBJ_Inv_TTC_STD_26 : 25516|12@1+ (0.001,0) [0|4] "INV(s)" MCU
 SG_ OBJ_Inv_TTC_STD_V_26 : 25528|1@1+ (1,0) [0|1] "bool" MCU
 SG_ Reserved_12_26 : 25529|7@1+ (1,0) [0|0] "NA" MCU
 SG_ OBJ_Relative_Long_Acc_26 : 25536|10@1+ (0.05,-20) [-20|20] "m_per_s2" MCU
 SG_ OBJ_Relative_Long_Acc_V_26 : 25546|1@1+ (1,0) [0|1] "bool" MCU
 SG_ OBJ_Relative_Long_Acc_STD_26 : 25547|10@1+ (0.01,0) [0|7.3] "m_per_s2" MCU
 SG_ OBJ_Rel_Long_Acc_STD_V_26 : 25557|1@1+ (1,0) [0|1] "bool" MCU
 SG_ Reserved_13_26 : 25558|10@1+ (1,0) [0|0] "NA" MCU
 SG_ OBJ_Relative_Long_Velocity_26 : 25568|13@1+ (0.05,-120) [-120|130] "m_per_s" MCU
 SG_ OBJ_Relative_Long_Velocity_V_26 : 25581|1@1+ (1,0) [0|1] "bool" MCU
 SG_ OBJ_Relative_Long_Vel_STD_26 : 25582|14@1+ (0.01,0) [0|130] "m_per_s" MCU
 SG_ OBJ_Rel_Long_Vel_STD_V_26 : 25596|1@1+ (1,0) [0|1] "bool" MCU
 SG_ Reserved_14_26 : 25597|3@1+ (1,0) [0|0] "NA" MCU
 SG_ OBJ_Relative_Lat_Velocity_26 : 25600|11@1+ (0.05,-50) [-50|50] "m_per_s" MCU
 SG_ OBJ_Relative_Lat_Velocity_V_26 : 25611|1@1+ (1,0) [0|1] "bool" MCU
 SG_ OBJ_Relative_Lat_Velocity_STD_26 : 25612|13@1+ (0.01,0) [0|50] "m_per_s" MCU
 SG_ OBJ_Rel_Lat_Vel_STD_V_26 : 25625|1@1+ (1,0) [0|1] "bool" MCU
 SG_ Reserved_15_26 : 25626|6@1+ (1,0) [0|0] "NA" MCU
 SG_ OBJ_Long_Distance_26 : 25632|14@1+ (0.05,-200) [-200|500] "m" MCU
 SG_ OBJ_Long_Distance_V_26 : 25646|1@1+ (1,0) [0|1] "bool" MCU
 SG_ OBJ_Long_Distance_STD_26 : 25647|15@1+ (0.01,0) [0|250] "m" MCU
 SG_ OBJ_Long_Distance_STD_V_26 : 25662|1@1+ (1,0) [0|1] "bool" MCU
 SG_ Reserved_16_26 : 25663|1@1+ (1,0) [0|0] "NA" MCU
 SG_ OBJ_Lat_Distance_26 : 25664|12@1+ (0.05,-100) [-100|100] "m" MCU
 SG_ OBJ_Lat_Distance_V_26 : 25676|1@1+ (1,0) [0|1] "bool" MCU
 SG_ OBJ_Lat_Distance_STD_26 : 25677|14@1+ (0.01,0) [0|100] "m" MCU
 SG_ OBJ_Lat_Distance_STD_V_26 : 25691|1@1+ (1,0) [0|1] "bool" MCU
 SG_ Reserved_17_26 : 25692|4@1+ (1,0) [0|0] "NA" MCU
 SG_ OBJ_Absolute_Speed_26 : 25696|12@1+ (0.05,-65) [-65|65] "m_per_s" MCU
 SG_ OBJ_Absolute_Speed_V_26 : 25708|1@1+ (1,0) [0|1] "bool" MCU
 SG_ OBJ_Absolute_Speed_STD_26 : 25709|13@1+ (0.01,0) [0|65] "m_per_s" MCU
 SG_ OBJ_Absolute_Speed_STD_V_26 : 25722|1@1+ (1,0) [0|1] "bool" MCU
 SG_ Reserved_18_26 : 25723|5@1+ (1,0) [0|0] "NA" MCU
 SG_ OBJ_Heading_26 : 25728|10@1+ (0.01,-3.14) [-3.14|3.14] "rad" MCU
 SG_ OBJ_Heading_V_26 : 25738|1@1+ (1,0) [0|1] "bool" MCU
 SG_ OBJ_Heading_STD_26 : 25739|15@1+ (0.0001,0) [0|3.14] "rad" MCU
 SG_ OBJ_Heading_STD_V_26 : 25754|1@1+ (1,0) [0|1] "bool" MCU
 SG_ Reserved_19_26 : 25755|5@1+ (1,0) [0|0] "NA" MCU
 SG_ OBJ_Angle_Rate_STD_26 : 25760|15@1+ (0.0001,0) [0|2.2318] "RPS" MCU
 SG_ OBJ_Angle_Rate_STD_V_26 : 25775|1@1+ (1,0) [0|1] "bool" MCU
 SG_ OBJ_Angle_Rate_26 : 25776|12@1+ (0.002,-2.234) [-2.234|2.2318] "RPS" MCU
 SG_ OBJ_Angle_Rate_V_26 : 25788|1@1+ (1,0) [0|1] "bool" MCU
 SG_ Reserved_20_26 : 25789|3@1+ (1,0) [0|0] "NA" MCU
 SG_ OBJ_Angle_Right_26 : 25792|14@1+ (0.0002,-1.571) [-1.571|1.571] "rad" MCU
 SG_ OBJ_Angle_Right_V_26 : 25806|1@1+ (1,0) [0|1] "bool" MCU
 SG_ OBJ_Angle_Right_STD_26 : 25807|14@1+ (0.0001,0) [0|1.571] "rad" MCU
 SG_ OBJ_Angle_Right_STD_V_26 : 25821|1@1+ (1,0) [0|1] "bool" MCU
 SG_ Reserved_21_26 : 25822|2@1+ (1,0) [0|0] "NA" MCU
 SG_ OBJ_Angle_Left_26 : 25824|14@1+ (0.0002,-1.571) [-1.571|1.571] "rad" MCU
 SG_ OBJ_Angle_Left_V_26 : 25838|1@1+ (1,0) [0|1] "bool" MCU
 SG_ OBJ_Angle_Left_STD_26 : 25839|14@1+ (0.0001,0) [0|1.571] "rad" MCU
 SG_ OBJ_Angle_Left_STD_V_26 : 25853|1@1+ (1,0) [0|1] "bool" MCU
 SG_ Reserved_22_26 : 25854|2@1+ (1,0) [0|0] "NA" MCU
 SG_ OBJ_Angle_Side_26 : 25856|14@1+ (0.0002,-1.571) [-1.571|1.571] "rad" MCU
 SG_ OBJ_Angle_Side_V_26 : 25870|1@1+ (1,0) [0|1] "bool" MCU
 SG_ OBJ_Angle_Side_STD_26 : 25871|14@1+ (0.0001,0) [0|1.571] "rad" MCU
 SG_ OBJ_Angle_Side_STD_V_26 : 25885|1@1+ (1,0) [0|1] "bool" MCU
 SG_ OBJ_Angle_Mid_V_26 : 25886|1@1+ (1,0) [0|1] "bool" MCU
 SG_ Reserved_23_26 : 25887|1@1+ (1,0) [0|0] "NA" MCU
 SG_ OBJ_Angle_Mid_26 : 25888|14@1+ (0.0002,-1.571) [-1.571|1.571] "rad" MCU
 SG_ OBJ_Angle_Mid_STD_26 : 25902|14@1+ (0.0001,0) [0|1.571] "rad" MCU
 SG_ OBJ_Angle_Mid_STD_V_26 : 25916|1@1+ (1,0) [0|1] "bool" MCU
 SG_ OBJ_Angle_Bottom_V_26 : 25917|1@1+ (1,0) [0|1] "bool" MCU
 SG_ Reserved_24_26 : 25918|2@1+ (1,0) [0|0] "NA" MCU
 SG_ OBJ_Angle_Bottom_26 : 25920|14@1+ (0.0002,-1.571) [-1.571|1.571] "rad" MCU
 SG_ OBJ_Angle_Bottom_STD_26 : 25934|14@1+ (0.0001,0) [0|1.571] "rad" MCU
 SG_ OBJ_Angle_Bottom_STD_V_26 : 25948|1@1+ (1,0) [0|1] "bool" MCU
 SG_ OBJ_Visibility_Side_V_26 : 25949|1@1+ (1,0) [0|1] "bool" MCU
 SG_ OBJ_Visibility_Side_26 : 25950|2@1+ (1,0) [0|2] "ENUM" MCU
 SG_ OBJ_Is_In_Drivable_Area_26 : 25952|1@1+ (1,0) [0|1] "bool" MCU
 SG_ OBJ_Is_In_Drivable_Area_V_26 : 25953|1@1+ (1,0) [0|1] "bool" MCU
 SG_ OBJ_Is_VeryClose_V_26 : 25954|1@1+ (1,0) [0|1] "bool" MCU
 SG_ OBJ_Is_VeryClose_26 : 25955|1@1+ (1,0) [0|1] "bool" MCU
 SG_ OBJ_Buffer_C4_26 : 25956|2@1+ (1,0) [0|2] "NA" MCU
 SG_ OBJ_Buffer_C5_26 : 25958|2@1+ (1,0) [0|2] "NA" MCU
 SG_ OBJ_Buffer_C6_26 : 25960|2@1+ (1,0) [0|2] "NA" MCU
 SG_ OBJ_Buffer_C7_26 : 25962|2@1+ (1,0) [0|2] "NA" MCU
 SG_ OBJ_OverlapAngleEgoLaneR_26 : 25964|10@1+ (0.01,-3.14) [-3.14|3.14] "rad" MCU
 SG_ OBJ_OverlapAngleEgoLaneR_V_26 : 25974|1@1+ (1,0) [0|1] "bool" MCU
 SG_ Reserved_25_26 : 25975|9@1+ (1,0) [0|0] "NA" MCU
 SG_ OBJ_OverlapAngleEgoLaneL_26 : 25984|10@1+ (0.01,-3.14) [-3.14|3.14] "rad" MCU
 SG_ OBJ_OverlapAngleEgoLaneL_V_26 : 25994|1@1+ (1,0) [0|1] "bool" MCU
 SG_ OBJ_Is_EMERGENCY_VCL_26 : 25995|1@1+ (1,0) [0|1] "bool" MCU
 SG_ OBJ_EMERGENCY_LIGHT_COLOR_26 : 25996|4@1+ (1,0) [0|15] "BITWIZE" MCU
 SG_ OBJ_EMERGENCY_V_26 : 26000|1@1+ (1,0) [0|1] "bool" MCU
 SG_ OBJ_Angle_Top_26 : 26001|14@1+ (0.0002,0) [0|3.1415] "rad" MCU
 SG_ OBJ_Angle_Top_V_26 : 26015|1@1+ (1,0) [0|1] "bool" MCU
 SG_ OBJ_Angle_Top_STD_26 : 26016|15@1+ (0.0001,0) [0|3.1415] "rad" MCU
 SG_ OBJ_Angle_Top_STD_V_26 : 26031|1@1+ (1,0) [0|1] "bool" MCU
 SG_ OBJ_Open_Door_Left_26 : 26032|1@1+ (1,0) [0|1] "bool" MCU
 SG_ OBJ_Open_Door_Right_26 : 26033|1@1+ (1,0) [0|1] "bool" MCU
 SG_ OBJ_Visible_Left_or_Right_26 : 26034|2@1+ (1,0) [0|2] "ENUM" MCU
 SG_ OBJ_Visible_Left_or_Right_V_26 : 26036|1@1+ (1,0) [0|1] "bool" MCU
 SG_ OBJ_2W_Is_Motorbike_Probability_26 : 26037|8@1+ (0.01,0) [0|1] "NA" MCU
 SG_ Reserved_26_26 : 26045|3@1+ (1,0) [0|0] "NA" MCU
 SG_ OBJ_2W_Is_Bicycle_Probability_26 : 26048|8@1+ (0.01,0) [0|1] "NA" MCU
 SG_ Reserved_27_26 : 26056|24@1+ (1,0) [0|0] "NA" MCU
 SG_ OBJ_CRC_27 : 26080|32@1+ (1,0) [0|4294967295] "NA" MCU
 SG_ OBJ_ID_27 : 26112|8@1+ (1,0) [0|255] "counter" MCU
 SG_ OBJ_Existence_Probability_27 : 26120|8@1+ (0.01,0) [0|1] "NA" MCU
 SG_ OBJ_Fusion_Source_27 : 26128|16@1+ (1,0) [0|65535] "BITWIZE" MCU
 SG_ OBJ_Triggered_SDM_27 : 26144|2@1+ (1,0) [0|2] "ENUM" MCU
 SG_ OBJ_Motion_Category_27 : 26146|4@1+ (1,0) [0|13] "ENUM" MCU
 SG_ OBJ_Moving_IN_Probability_27 : 26150|7@1+ (0.01,0) [0|1] "NA" MCU
 SG_ OBJ_Object_Age_27 : 26157|11@1+ (1,0) [0|2047] "frames" MCU
 SG_ OBJ_Measuring_Status_27 : 26168|3@1+ (1,0) [0|7] "BITWIZE" MCU
 SG_ OBJ_Object_Class_27 : 26171|4@1+ (1,0) [0|9] "ENUM" MCU
 SG_ Reserved_4_27 : 26175|1@1+ (1,0) [0|0] "NA" MCU
 SG_ OBJ_Class_Probability_27 : 26176|7@1+ (0.01,0) [0|1] "NA" MCU
 SG_ OBJ_Car_Probability_27 : 26183|7@1+ (0.01,0) [0|1] "NA" MCU
 SG_ OBJ_Truck_Probability_27 : 26190|7@1+ (0.01,0) [0|1] "NA" MCU
 SG_ OBJ_Bike_Probability_27 : 26197|7@1+ (0.01,0) [0|1] "NA" MCU
 SG_ OBJ_Camera_Source_27 : 26204|4@1+ (1,0) [0|15] "ENUM" MCU
 SG_ OBJ_Motion_Status_27 : 26208|3@1+ (1,0) [0|5] "ENUM" MCU
 SG_ OBJ_Motion_Orientation_27 : 26211|4@1+ (1,0) [0|13] "ENUM" MCU
 SG_ OBJ_Has_Cut_Lane_27 : 26215|1@1+ (1,0) [0|1] "bool" MCU
 SG_ OBJ_Has_Cut_Path_27 : 26216|1@1+ (1,0) [0|1] "bool" MCU
 SG_ OBJ_Brake_Light_Validity_27 : 26217|1@1+ (1,0) [0|1] "bool" MCU
 SG_ OBJ_Brake_Light_27 : 26218|1@1+ (1,0) [0|1] "bool" MCU
 SG_ OBJ_Turn_Indicator_Right_27 : 26219|1@1+ (1,0) [0|1] "bool" MCU
 SG_ OBJ_Turn_Indicator_Left_27 : 26220|1@1+ (1,0) [0|1] "bool" MCU
 SG_ OBJ_Turn_Indicator_Validity_27 : 26221|1@1+ (1,0) [0|1] "bool" MCU
 SG_ OBJ_Right_Out_Of_Image_27 : 26222|1@1+ (1,0) [0|1] "bool" MCU
 SG_ OBJ_Left_Out_Of_Image_27 : 26223|1@1+ (1,0) [0|1] "bool" MCU
 SG_ OBJ_Right_Out_Of_Image_V_27 : 26224|1@1+ (1,0) [0|1] "bool" MCU
 SG_ OBJ_Left_Out_Of_Image_V_27 : 26225|1@1+ (1,0) [0|1] "bool" MCU
 SG_ OBJ_Top_Out_Of_Image_27 : 26226|1@1+ (1,0) [0|1] "bool" MCU
 SG_ OBJ_Bottom_Out_Of_Image_27 : 26227|1@1+ (1,0) [0|1] "bool" MCU
 SG_ OBJ_Top_Out_Of_Image_V_27 : 26228|1@1+ (1,0) [0|1] "bool" MCU
 SG_ OBJ_Bottom_Out_Of_Image_V_27 : 26229|1@1+ (1,0) [0|1] "bool" MCU
 SG_ OBJ_Lane_Assignment_27 : 26230|3@1+ (1,0) [0|5] "ENUM" MCU
 SG_ OBJ_Lane_Assignment_V_27 : 26233|1@1+ (1,0) [0|1] "bool" MCU
 SG_ Reserved_5_27 : 26234|6@1+ (1,0) [0|0] "NA" MCU
 SG_ OBJ_Age_Seconds_27 : 26240|7@1+ (1,0) [0|100] "s" MCU
 SG_ OBJ_Age_Seconds_V_27 : 26247|1@1+ (1,0) [0|1] "bool" MCU
 SG_ OBJ_Width_27 : 26248|9@1+ (0.01,0) [0.4|2.95] "m" MCU
 SG_ OBJ_Width_V_27 : 26257|1@1+ (1,0) [0|1] "bool" MCU
 SG_ OBJ_Width_STD_27 : 26258|11@1+ (0.001,0) [0|2] "m" MCU
 SG_ OBJ_Width_STD_V_27 : 26269|1@1+ (1,0) [0|1] "bool" MCU
 SG_ Reserved_6_27 : 26270|2@1+ (1,0) [0|0] "NA" MCU
 SG_ OBJ_Length_27 : 26272|9@1+ (0.05,0) [0.6|21] "m" MCU
 SG_ OBJ_Length_V_27 : 26281|1@1+ (1,0) [0|1] "bool" MCU
 SG_ OBJ_Length_STD_27 : 26282|10@1+ (0.01,0) [0|10] "m" MCU
 SG_ OBJ_Length_STD_V_27 : 26292|1@1+ (1,0) [0|1] "bool" MCU
 SG_ OBJ_Radar_ID_27 : 26293|8@1+ (1,0) [0|255] "counter" MCU
 SG_ Reserved_7_27 : 26301|3@1+ (1,0) [0|0] "NA" MCU
 SG_ OBJ_Height_27 : 26304|9@1+ (0.01,0) [0|2.95] "m" MCU
 SG_ OBJ_Height_V_27 : 26313|1@1+ (1,0) [0|1] "bool" MCU
 SG_ OBJ_Height_STD_27 : 26314|11@1+ (0.001,0) [0|2] "m" MCU
 SG_ OBJ_Height_STD_V_27 : 26325|1@1+ (1,0) [0|1] "bool" MCU
 SG_ Reserved_8_27 : 26326|10@1+ (1,0) [0|0] "NA" MCU
 SG_ OBJ_Abs_Long_Velocity_27 : 26336|12@1+ (0.05,-100) [-100|100] "m_per_s" MCU
 SG_ OBJ_Abs_Long_Velocity_V_27 : 26348|1@1+ (1,0) [0|1] "bool" MCU
 SG_ OBJ_Abs_Long_Velocity_STD_27 : 26349|13@1+ (0.01,0) [0|65] "m_per_s" MCU
 SG_ OBJ_Abs_Long_Vel_STD_V_27 : 26362|1@1+ (1,0) [0|1] "bool" MCU
 SG_ Reserved_9_27 : 26363|5@1+ (1,0) [0|0] "NA" MCU
 SG_ OBJ_Abs_Lat_Velocity_27 : 26368|11@1+ (0.05,-50) [-50|50] "m_per_s" MCU
 SG_ OBJ_Abs_Lat_Velocity_V_27 : 26379|1@1+ (1,0) [0|1] "bool" MCU
 SG_ OBJ_Abs_Lat_Velocity_STD_27 : 26380|13@1+ (0.01,0) [0|50] "m_per_s" MCU
 SG_ OBJ_Abs_Lat_Vel_STD_V_27 : 26393|1@1+ (1,0) [0|1] "bool" MCU
 SG_ Reserved_10_27 : 26394|6@1+ (1,0) [0|0] "NA" MCU
 SG_ OBJ_Abs_Long_Acc_27 : 26400|9@1+ (0.05,-10) [-10|10] "m_per_s2" MCU
 SG_ OBJ_Abs_Long_Acc_V_27 : 26409|1@1+ (1,0) [0|1] "bool" MCU
 SG_ OBJ_Abs_Long_Acc_STD_27 : 26410|10@1+ (0.01,0) [0|7.3] "m_per_s2" MCU
 SG_ OBJ_Abs_Long_Acc_STD_V_27 : 26420|1@1+ (1,0) [0|1] "bool" MCU
 SG_ OBJ_Abs_Lat_Acc_27 : 26421|9@1+ (0.05,-10) [-10|10] "m_per_s2" MCU
 SG_ OBJ_Abs_Lat_Acc_V_27 : 26430|1@1+ (1,0) [0|1] "bool" MCU
 SG_ Reserved_11_27 : 26431|1@1+ (1,0) [0|0] "NA" MCU
 SG_ OBJ_Abs_Lat_Acc_STD_27 : 26432|10@1+ (0.01,0) [0|7.3] "m_per_s2" MCU
 SG_ OBJ_Abs_Lat_Acc_STD_V_27 : 26442|1@1+ (1,0) [0|1] "bool" MCU
 SG_ OBJ_Abs_Acceleration_27 : 26443|9@1+ (0.05,-12.7) [-12.7|12.7] "m_per_s2" MCU
 SG_ OBJ_Abs_Acceleration_V_27 : 26452|1@1+ (1,0) [0|1] "bool" MCU
 SG_ OBJ_Abs_Acc_STD_27 : 26453|10@1+ (0.01,0) [0|7.3] "m_per_s2" MCU
 SG_ OBJ_Abs_Acc_STD_V_27 : 26463|1@1+ (1,0) [0|1] "bool" MCU
 SG_ OBJ_Inv_TTC_27 : 26464|11@1+ (0.01,-8) [-8|8] "INV(s)" MCU
 SG_ OBJ_Inv_TTC_V_27 : 26475|1@1+ (1,0) [0|1] "bool" MCU
 SG_ OBJ_Inv_TTC_STD_27 : 26476|12@1+ (0.001,0) [0|4] "INV(s)" MCU
 SG_ OBJ_Inv_TTC_STD_V_27 : 26488|1@1+ (1,0) [0|1] "bool" MCU
 SG_ Reserved_12_27 : 26489|7@1+ (1,0) [0|0] "NA" MCU
 SG_ OBJ_Relative_Long_Acc_27 : 26496|10@1+ (0.05,-20) [-20|20] "m_per_s2" MCU
 SG_ OBJ_Relative_Long_Acc_V_27 : 26506|1@1+ (1,0) [0|1] "bool" MCU
 SG_ OBJ_Relative_Long_Acc_STD_27 : 26507|10@1+ (0.01,0) [0|7.3] "m_per_s2" MCU
 SG_ OBJ_Rel_Long_Acc_STD_V_27 : 26517|1@1+ (1,0) [0|1] "bool" MCU
 SG_ Reserved_13_27 : 26518|10@1+ (1,0) [0|0] "NA" MCU
 SG_ OBJ_Relative_Long_Velocity_27 : 26528|13@1+ (0.05,-120) [-120|130] "m_per_s" MCU
 SG_ OBJ_Relative_Long_Velocity_V_27 : 26541|1@1+ (1,0) [0|1] "bool" MCU
 SG_ OBJ_Relative_Long_Vel_STD_27 : 26542|14@1+ (0.01,0) [0|130] "m_per_s" MCU
 SG_ OBJ_Rel_Long_Vel_STD_V_27 : 26556|1@1+ (1,0) [0|1] "bool" MCU
 SG_ Reserved_14_27 : 26557|3@1+ (1,0) [0|0] "NA" MCU
 SG_ OBJ_Relative_Lat_Velocity_27 : 26560|11@1+ (0.05,-50) [-50|50] "m_per_s" MCU
 SG_ OBJ_Relative_Lat_Velocity_V_27 : 26571|1@1+ (1,0) [0|1] "bool" MCU
 SG_ OBJ_Relative_Lat_Velocity_STD_27 : 26572|13@1+ (0.01,0) [0|50] "m_per_s" MCU
 SG_ OBJ_Rel_Lat_Vel_STD_V_27 : 26585|1@1+ (1,0) [0|1] "bool" MCU
 SG_ Reserved_15_27 : 26586|6@1+ (1,0) [0|0] "NA" MCU
 SG_ OBJ_Long_Distance_27 : 26592|14@1+ (0.05,-200) [-200|500] "m" MCU
 SG_ OBJ_Long_Distance_V_27 : 26606|1@1+ (1,0) [0|1] "bool" MCU
 SG_ OBJ_Long_Distance_STD_27 : 26607|15@1+ (0.01,0) [0|250] "m" MCU
 SG_ OBJ_Long_Distance_STD_V_27 : 26622|1@1+ (1,0) [0|1] "bool" MCU
 SG_ Reserved_16_27 : 26623|1@1+ (1,0) [0|0] "NA" MCU
 SG_ OBJ_Lat_Distance_27 : 26624|12@1+ (0.05,-100) [-100|100] "m" MCU
 SG_ OBJ_Lat_Distance_V_27 : 26636|1@1+ (1,0) [0|1] "bool" MCU
 SG_ OBJ_Lat_Distance_STD_27 : 26637|14@1+ (0.01,0) [0|100] "m" MCU
 SG_ OBJ_Lat_Distance_STD_V_27 : 26651|1@1+ (1,0) [0|1] "bool" MCU
 SG_ Reserved_17_27 : 26652|4@1+ (1,0) [0|0] "NA" MCU
 SG_ OBJ_Absolute_Speed_27 : 26656|12@1+ (0.05,-65) [-65|65] "m_per_s" MCU
 SG_ OBJ_Absolute_Speed_V_27 : 26668|1@1+ (1,0) [0|1] "bool" MCU
 SG_ OBJ_Absolute_Speed_STD_27 : 26669|13@1+ (0.01,0) [0|65] "m_per_s" MCU
 SG_ OBJ_Absolute_Speed_STD_V_27 : 26682|1@1+ (1,0) [0|1] "bool" MCU
 SG_ Reserved_18_27 : 26683|5@1+ (1,0) [0|0] "NA" MCU
 SG_ OBJ_Heading_27 : 26688|10@1+ (0.01,-3.14) [-3.14|3.14] "rad" MCU
 SG_ OBJ_Heading_V_27 : 26698|1@1+ (1,0) [0|1] "bool" MCU
 SG_ OBJ_Heading_STD_27 : 26699|15@1+ (0.0001,0) [0|3.14] "rad" MCU
 SG_ OBJ_Heading_STD_V_27 : 26714|1@1+ (1,0) [0|1] "bool" MCU
 SG_ Reserved_19_27 : 26715|5@1+ (1,0) [0|0] "NA" MCU
 SG_ OBJ_Angle_Rate_STD_27 : 26720|15@1+ (0.0001,0) [0|2.2318] "RPS" MCU
 SG_ OBJ_Angle_Rate_STD_V_27 : 26735|1@1+ (1,0) [0|1] "bool" MCU
 SG_ OBJ_Angle_Rate_27 : 26736|12@1+ (0.002,-2.234) [-2.234|2.2318] "RPS" MCU
 SG_ OBJ_Angle_Rate_V_27 : 26748|1@1+ (1,0) [0|1] "bool" MCU
 SG_ Reserved_20_27 : 26749|3@1+ (1,0) [0|0] "NA" MCU
 SG_ OBJ_Angle_Right_27 : 26752|14@1+ (0.0002,-1.571) [-1.571|1.571] "rad" MCU
 SG_ OBJ_Angle_Right_V_27 : 26766|1@1+ (1,0) [0|1] "bool" MCU
 SG_ OBJ_Angle_Right_STD_27 : 26767|14@1+ (0.0001,0) [0|1.571] "rad" MCU
 SG_ OBJ_Angle_Right_STD_V_27 : 26781|1@1+ (1,0) [0|1] "bool" MCU
 SG_ Reserved_21_27 : 26782|2@1+ (1,0) [0|0] "NA" MCU
 SG_ OBJ_Angle_Left_27 : 26784|14@1+ (0.0002,-1.571) [-1.571|1.571] "rad" MCU
 SG_ OBJ_Angle_Left_V_27 : 26798|1@1+ (1,0) [0|1] "bool" MCU
 SG_ OBJ_Angle_Left_STD_27 : 26799|14@1+ (0.0001,0) [0|1.571] "rad" MCU
 SG_ OBJ_Angle_Left_STD_V_27 : 26813|1@1+ (1,0) [0|1] "bool" MCU
 SG_ Reserved_22_27 : 26814|2@1+ (1,0) [0|0] "NA" MCU
 SG_ OBJ_Angle_Side_27 : 26816|14@1+ (0.0002,-1.571) [-1.571|1.571] "rad" MCU
 SG_ OBJ_Angle_Side_V_27 : 26830|1@1+ (1,0) [0|1] "bool" MCU
 SG_ OBJ_Angle_Side_STD_27 : 26831|14@1+ (0.0001,0) [0|1.571] "rad" MCU
 SG_ OBJ_Angle_Side_STD_V_27 : 26845|1@1+ (1,0) [0|1] "bool" MCU
 SG_ OBJ_Angle_Mid_V_27 : 26846|1@1+ (1,0) [0|1] "bool" MCU
 SG_ Reserved_23_27 : 26847|1@1+ (1,0) [0|0] "NA" MCU
 SG_ OBJ_Angle_Mid_27 : 26848|14@1+ (0.0002,-1.571) [-1.571|1.571] "rad" MCU
 SG_ OBJ_Angle_Mid_STD_27 : 26862|14@1+ (0.0001,0) [0|1.571] "rad" MCU
 SG_ OBJ_Angle_Mid_STD_V_27 : 26876|1@1+ (1,0) [0|1] "bool" MCU
 SG_ OBJ_Angle_Bottom_V_27 : 26877|1@1+ (1,0) [0|1] "bool" MCU
 SG_ Reserved_24_27 : 26878|2@1+ (1,0) [0|0] "NA" MCU
 SG_ OBJ_Angle_Bottom_27 : 26880|14@1+ (0.0002,-1.571) [-1.571|1.571] "rad" MCU
 SG_ OBJ_Angle_Bottom_STD_27 : 26894|14@1+ (0.0001,0) [0|1.571] "rad" MCU
 SG_ OBJ_Angle_Bottom_STD_V_27 : 26908|1@1+ (1,0) [0|1] "bool" MCU
 SG_ OBJ_Visibility_Side_V_27 : 26909|1@1+ (1,0) [0|1] "bool" MCU
 SG_ OBJ_Visibility_Side_27 : 26910|2@1+ (1,0) [0|2] "ENUM" MCU
 SG_ OBJ_Is_In_Drivable_Area_27 : 26912|1@1+ (1,0) [0|1] "bool" MCU
 SG_ OBJ_Is_In_Drivable_Area_V_27 : 26913|1@1+ (1,0) [0|1] "bool" MCU
 SG_ OBJ_Is_VeryClose_V_27 : 26914|1@1+ (1,0) [0|1] "bool" MCU
 SG_ OBJ_Is_VeryClose_27 : 26915|1@1+ (1,0) [0|1] "bool" MCU
 SG_ OBJ_Buffer_C4_27 : 26916|2@1+ (1,0) [0|2] "NA" MCU
 SG_ OBJ_Buffer_C5_27 : 26918|2@1+ (1,0) [0|2] "NA" MCU
 SG_ OBJ_Buffer_C6_27 : 26920|2@1+ (1,0) [0|2] "NA" MCU
 SG_ OBJ_Buffer_C7_27 : 26922|2@1+ (1,0) [0|2] "NA" MCU
 SG_ OBJ_OverlapAngleEgoLaneR_27 : 26924|10@1+ (0.01,-3.14) [-3.14|3.14] "rad" MCU
 SG_ OBJ_OverlapAngleEgoLaneR_V_27 : 26934|1@1+ (1,0) [0|1] "bool" MCU
 SG_ Reserved_25_27 : 26935|9@1+ (1,0) [0|0] "NA" MCU
 SG_ OBJ_OverlapAngleEgoLaneL_27 : 26944|10@1+ (0.01,-3.14) [-3.14|3.14] "rad" MCU
 SG_ OBJ_OverlapAngleEgoLaneL_V_27 : 26954|1@1+ (1,0) [0|1] "bool" MCU
 SG_ OBJ_Is_EMERGENCY_VCL_27 : 26955|1@1+ (1,0) [0|1] "bool" MCU
 SG_ OBJ_EMERGENCY_LIGHT_COLOR_27 : 26956|4@1+ (1,0) [0|15] "BITWIZE" MCU
 SG_ OBJ_EMERGENCY_V_27 : 26960|1@1+ (1,0) [0|1] "bool" MCU
 SG_ OBJ_Angle_Top_27 : 26961|14@1+ (0.0002,0) [0|3.1415] "rad" MCU
 SG_ OBJ_Angle_Top_V_27 : 26975|1@1+ (1,0) [0|1] "bool" MCU
 SG_ OBJ_Angle_Top_STD_27 : 26976|15@1+ (0.0001,0) [0|3.1415] "rad" MCU
 SG_ OBJ_Angle_Top_STD_V_27 : 26991|1@1+ (1,0) [0|1] "bool" MCU
 SG_ OBJ_Open_Door_Left_27 : 26992|1@1+ (1,0) [0|1] "bool" MCU
 SG_ OBJ_Open_Door_Right_27 : 26993|1@1+ (1,0) [0|1] "bool" MCU
 SG_ OBJ_Visible_Left_or_Right_27 : 26994|2@1+ (1,0) [0|2] "ENUM" MCU
 SG_ OBJ_Visible_Left_or_Right_V_27 : 26996|1@1+ (1,0) [0|1] "bool" MCU
 SG_ OBJ_2W_Is_Motorbike_Probability_27 : 26997|8@1+ (0.01,0) [0|1] "NA" MCU
 SG_ Reserved_26_27 : 27005|3@1+ (1,0) [0|0] "NA" MCU
 SG_ OBJ_2W_Is_Bicycle_Probability_27 : 27008|8@1+ (0.01,0) [0|1] "NA" MCU
 SG_ Reserved_27_27 : 27016|24@1+ (1,0) [0|0] "NA" MCU
 SG_ OBJ_CRC_28 : 27040|32@1+ (1,0) [0|4294967295] "NA" MCU
 SG_ OBJ_ID_28 : 27072|8@1+ (1,0) [0|255] "counter" MCU
 SG_ OBJ_Existence_Probability_28 : 27080|8@1+ (0.01,0) [0|1] "NA" MCU
 SG_ OBJ_Fusion_Source_28 : 27088|16@1+ (1,0) [0|65535] "BITWIZE" MCU
 SG_ OBJ_Triggered_SDM_28 : 27104|2@1+ (1,0) [0|2] "ENUM" MCU
 SG_ OBJ_Motion_Category_28 : 27106|4@1+ (1,0) [0|13] "ENUM" MCU
 SG_ OBJ_Moving_IN_Probability_28 : 27110|7@1+ (0.01,0) [0|1] "NA" MCU
 SG_ OBJ_Object_Age_28 : 27117|11@1+ (1,0) [0|2047] "frames" MCU
 SG_ OBJ_Measuring_Status_28 : 27128|3@1+ (1,0) [0|7] "BITWIZE" MCU
 SG_ OBJ_Object_Class_28 : 27131|4@1+ (1,0) [0|9] "ENUM" MCU
 SG_ Reserved_4_28 : 27135|1@1+ (1,0) [0|0] "NA" MCU
 SG_ OBJ_Class_Probability_28 : 27136|7@1+ (0.01,0) [0|1] "NA" MCU
 SG_ OBJ_Car_Probability_28 : 27143|7@1+ (0.01,0) [0|1] "NA" MCU
 SG_ OBJ_Truck_Probability_28 : 27150|7@1+ (0.01,0) [0|1] "NA" MCU
 SG_ OBJ_Bike_Probability_28 : 27157|7@1+ (0.01,0) [0|1] "NA" MCU
 SG_ OBJ_Camera_Source_28 : 27164|4@1+ (1,0) [0|15] "ENUM" MCU
 SG_ OBJ_Motion_Status_28 : 27168|3@1+ (1,0) [0|5] "ENUM" MCU
 SG_ OBJ_Motion_Orientation_28 : 27171|4@1+ (1,0) [0|13] "ENUM" MCU
 SG_ OBJ_Has_Cut_Lane_28 : 27175|1@1+ (1,0) [0|1] "bool" MCU
 SG_ OBJ_Has_Cut_Path_28 : 27176|1@1+ (1,0) [0|1] "bool" MCU
 SG_ OBJ_Brake_Light_Validity_28 : 27177|1@1+ (1,0) [0|1] "bool" MCU
 SG_ OBJ_Brake_Light_28 : 27178|1@1+ (1,0) [0|1] "bool" MCU
 SG_ OBJ_Turn_Indicator_Right_28 : 27179|1@1+ (1,0) [0|1] "bool" MCU
 SG_ OBJ_Turn_Indicator_Left_28 : 27180|1@1+ (1,0) [0|1] "bool" MCU
 SG_ OBJ_Turn_Indicator_Validity_28 : 27181|1@1+ (1,0) [0|1] "bool" MCU
 SG_ OBJ_Right_Out_Of_Image_28 : 27182|1@1+ (1,0) [0|1] "bool" MCU
 SG_ OBJ_Left_Out_Of_Image_28 : 27183|1@1+ (1,0) [0|1] "bool" MCU
 SG_ OBJ_Right_Out_Of_Image_V_28 : 27184|1@1+ (1,0) [0|1] "bool" MCU
 SG_ OBJ_Left_Out_Of_Image_V_28 : 27185|1@1+ (1,0) [0|1] "bool" MCU
 SG_ OBJ_Top_Out_Of_Image_28 : 27186|1@1+ (1,0) [0|1] "bool" MCU
 SG_ OBJ_Bottom_Out_Of_Image_28 : 27187|1@1+ (1,0) [0|1] "bool" MCU
 SG_ OBJ_Top_Out_Of_Image_V_28 : 27188|1@1+ (1,0) [0|1] "bool" MCU
 SG_ OBJ_Bottom_Out_Of_Image_V_28 : 27189|1@1+ (1,0) [0|1] "bool" MCU
 SG_ OBJ_Lane_Assignment_28 : 27190|3@1+ (1,0) [0|5] "ENUM" MCU
 SG_ OBJ_Lane_Assignment_V_28 : 27193|1@1+ (1,0) [0|1] "bool" MCU
 SG_ Reserved_5_28 : 27194|6@1+ (1,0) [0|0] "NA" MCU
 SG_ OBJ_Age_Seconds_28 : 27200|7@1+ (1,0) [0|100] "s" MCU
 SG_ OBJ_Age_Seconds_V_28 : 27207|1@1+ (1,0) [0|1] "bool" MCU
 SG_ OBJ_Width_28 : 27208|9@1+ (0.01,0) [0.4|2.95] "m" MCU
 SG_ OBJ_Width_V_28 : 27217|1@1+ (1,0) [0|1] "bool" MCU
 SG_ OBJ_Width_STD_28 : 27218|11@1+ (0.001,0) [0|2] "m" MCU
 SG_ OBJ_Width_STD_V_28 : 27229|1@1+ (1,0) [0|1] "bool" MCU
 SG_ Reserved_6_28 : 27230|2@1+ (1,0) [0|0] "NA" MCU
 SG_ OBJ_Length_28 : 27232|9@1+ (0.05,0) [0.6|21] "m" MCU
 SG_ OBJ_Length_V_28 : 27241|1@1+ (1,0) [0|1] "bool" MCU
 SG_ OBJ_Length_STD_28 : 27242|10@1+ (0.01,0) [0|10] "m" MCU
 SG_ OBJ_Length_STD_V_28 : 27252|1@1+ (1,0) [0|1] "bool" MCU
 SG_ OBJ_Radar_ID_28 : 27253|8@1+ (1,0) [0|255] "counter" MCU
 SG_ Reserved_7_28 : 27261|3@1+ (1,0) [0|0] "NA" MCU
 SG_ OBJ_Height_28 : 27264|9@1+ (0.01,0) [0|2.95] "m" MCU
 SG_ OBJ_Height_V_28 : 27273|1@1+ (1,0) [0|1] "bool" MCU
 SG_ OBJ_Height_STD_28 : 27274|11@1+ (0.001,0) [0|2] "m" MCU
 SG_ OBJ_Height_STD_V_28 : 27285|1@1+ (1,0) [0|1] "bool" MCU
 SG_ Reserved_8_28 : 27286|10@1+ (1,0) [0|0] "NA" MCU
 SG_ OBJ_Abs_Long_Velocity_28 : 27296|12@1+ (0.05,-100) [-100|100] "m_per_s" MCU
 SG_ OBJ_Abs_Long_Velocity_V_28 : 27308|1@1+ (1,0) [0|1] "bool" MCU
 SG_ OBJ_Abs_Long_Velocity_STD_28 : 27309|13@1+ (0.01,0) [0|65] "m_per_s" MCU
 SG_ OBJ_Abs_Long_Vel_STD_V_28 : 27322|1@1+ (1,0) [0|1] "bool" MCU
 SG_ Reserved_9_28 : 27323|5@1+ (1,0) [0|0] "NA" MCU
 SG_ OBJ_Abs_Lat_Velocity_28 : 27328|11@1+ (0.05,-50) [-50|50] "m_per_s" MCU
 SG_ OBJ_Abs_Lat_Velocity_V_28 : 27339|1@1+ (1,0) [0|1] "bool" MCU
 SG_ OBJ_Abs_Lat_Velocity_STD_28 : 27340|13@1+ (0.01,0) [0|50] "m_per_s" MCU
 SG_ OBJ_Abs_Lat_Vel_STD_V_28 : 27353|1@1+ (1,0) [0|1] "bool" MCU
 SG_ Reserved_10_28 : 27354|6@1+ (1,0) [0|0] "NA" MCU
 SG_ OBJ_Abs_Long_Acc_28 : 27360|9@1+ (0.05,-10) [-10|10] "m_per_s2" MCU
 SG_ OBJ_Abs_Long_Acc_V_28 : 27369|1@1+ (1,0) [0|1] "bool" MCU
 SG_ OBJ_Abs_Long_Acc_STD_28 : 27370|10@1+ (0.01,0) [0|7.3] "m_per_s2" MCU
 SG_ OBJ_Abs_Long_Acc_STD_V_28 : 27380|1@1+ (1,0) [0|1] "bool" MCU
 SG_ OBJ_Abs_Lat_Acc_28 : 27381|9@1+ (0.05,-10) [-10|10] "m_per_s2" MCU
 SG_ OBJ_Abs_Lat_Acc_V_28 : 27390|1@1+ (1,0) [0|1] "bool" MCU
 SG_ Reserved_11_28 : 27391|1@1+ (1,0) [0|0] "NA" MCU
 SG_ OBJ_Abs_Lat_Acc_STD_28 : 27392|10@1+ (0.01,0) [0|7.3] "m_per_s2" MCU
 SG_ OBJ_Abs_Lat_Acc_STD_V_28 : 27402|1@1+ (1,0) [0|1] "bool" MCU
 SG_ OBJ_Abs_Acceleration_28 : 27403|9@1+ (0.05,-12.7) [-12.7|12.7] "m_per_s2" MCU
 SG_ OBJ_Abs_Acceleration_V_28 : 27412|1@1+ (1,0) [0|1] "bool" MCU
 SG_ OBJ_Abs_Acc_STD_28 : 27413|10@1+ (0.01,0) [0|7.3] "m_per_s2" MCU
 SG_ OBJ_Abs_Acc_STD_V_28 : 27423|1@1+ (1,0) [0|1] "bool" MCU
 SG_ OBJ_Inv_TTC_28 : 27424|11@1+ (0.01,-8) [-8|8] "INV(s)" MCU
 SG_ OBJ_Inv_TTC_V_28 : 27435|1@1+ (1,0) [0|1] "bool" MCU
 SG_ OBJ_Inv_TTC_STD_28 : 27436|12@1+ (0.001,0) [0|4] "INV(s)" MCU
 SG_ OBJ_Inv_TTC_STD_V_28 : 27448|1@1+ (1,0) [0|1] "bool" MCU
 SG_ Reserved_12_28 : 27449|7@1+ (1,0) [0|0] "NA" MCU
 SG_ OBJ_Relative_Long_Acc_28 : 27456|10@1+ (0.05,-20) [-20|20] "m_per_s2" MCU
 SG_ OBJ_Relative_Long_Acc_V_28 : 27466|1@1+ (1,0) [0|1] "bool" MCU
 SG_ OBJ_Relative_Long_Acc_STD_28 : 27467|10@1+ (0.01,0) [0|7.3] "m_per_s2" MCU
 SG_ OBJ_Rel_Long_Acc_STD_V_28 : 27477|1@1+ (1,0) [0|1] "bool" MCU
 SG_ Reserved_13_28 : 27478|10@1+ (1,0) [0|0] "NA" MCU
 SG_ OBJ_Relative_Long_Velocity_28 : 27488|13@1+ (0.05,-120) [-120|130] "m_per_s" MCU
 SG_ OBJ_Relative_Long_Velocity_V_28 : 27501|1@1+ (1,0) [0|1] "bool" MCU
 SG_ OBJ_Relative_Long_Vel_STD_28 : 27502|14@1+ (0.01,0) [0|130] "m_per_s" MCU
 SG_ OBJ_Rel_Long_Vel_STD_V_28 : 27516|1@1+ (1,0) [0|1] "bool" MCU
 SG_ Reserved_14_28 : 27517|3@1+ (1,0) [0|0] "NA" MCU
 SG_ OBJ_Relative_Lat_Velocity_28 : 27520|11@1+ (0.05,-50) [-50|50] "m_per_s" MCU
 SG_ OBJ_Relative_Lat_Velocity_V_28 : 27531|1@1+ (1,0) [0|1] "bool" MCU
 SG_ OBJ_Relative_Lat_Velocity_STD_28 : 27532|13@1+ (0.01,0) [0|50] "m_per_s" MCU
 SG_ OBJ_Rel_Lat_Vel_STD_V_28 : 27545|1@1+ (1,0) [0|1] "bool" MCU
 SG_ Reserved_15_28 : 27546|6@1+ (1,0) [0|0] "NA" MCU
 SG_ OBJ_Long_Distance_28 : 27552|14@1+ (0.05,-200) [-200|500] "m" MCU
 SG_ OBJ_Long_Distance_V_28 : 27566|1@1+ (1,0) [0|1] "bool" MCU
 SG_ OBJ_Long_Distance_STD_28 : 27567|15@1+ (0.01,0) [0|250] "m" MCU
 SG_ OBJ_Long_Distance_STD_V_28 : 27582|1@1+ (1,0) [0|1] "bool" MCU
 SG_ Reserved_16_28 : 27583|1@1+ (1,0) [0|0] "NA" MCU
 SG_ OBJ_Lat_Distance_28 : 27584|12@1+ (0.05,-100) [-100|100] "m" MCU
 SG_ OBJ_Lat_Distance_V_28 : 27596|1@1+ (1,0) [0|1] "bool" MCU
 SG_ OBJ_Lat_Distance_STD_28 : 27597|14@1+ (0.01,0) [0|100] "m" MCU
 SG_ OBJ_Lat_Distance_STD_V_28 : 27611|1@1+ (1,0) [0|1] "bool" MCU
 SG_ Reserved_17_28 : 27612|4@1+ (1,0) [0|0] "NA" MCU
 SG_ OBJ_Absolute_Speed_28 : 27616|12@1+ (0.05,-65) [-65|65] "m_per_s" MCU
 SG_ OBJ_Absolute_Speed_V_28 : 27628|1@1+ (1,0) [0|1] "bool" MCU
 SG_ OBJ_Absolute_Speed_STD_28 : 27629|13@1+ (0.01,0) [0|65] "m_per_s" MCU

CM_ SG_ 154 OBJ_Angle_Top_22 "From VD touching point on the ground till the roof of the car";
CM_ SG_ 154 OBJ_Angle_Top_V_22 "Validator for OBJ_Angle_Top ";
CM_ SG_ 154 OBJ_Angle_Top_STD_22 "STD for OBJ_Angle_Top";
CM_ SG_ 154 OBJ_Angle_Top_STD_V_22 "Validator for OBJ_Angle_Top_STD. ";
CM_ SG_ 154 OBJ_Open_Door_Left_22 "Indicator if left door is open";
CM_ SG_ 154 OBJ_Open_Door_Right_22 "Indicator if right door is open";
CM_ SG_ 154 OBJ_Visible_Left_or_Right_22 "This signal describes the visible Left or Right side of the Target vehicle.";
CM_ SG_ 154 OBJ_Visible_Left_or_Right_V_22 "OBJ_Visible_Left_or_Right";
CM_ SG_ 154 OBJ_2W_Is_Motorbike_Probability_22 "The probability of the Two-wheeler reported object being a Motorbike";
CM_ SG_ 154 OBJ_2W_Is_Bicycle_Probability_22 "The probability of the Two-wheeler reported object being a Bicycle";
CM_ SG_ 154 OBJ_CRC_23 "Calculated over all element signals. From the signal after the CRC until the first signal in the next elements OBJ_CRC_N+1  not including";
CM_ SG_ 154 OBJ_ID_23 "The detected object ID. Range is 1-255, while 0 indicates that the field in unfilled.";
CM_ SG_ 154 OBJ_Existence_Probability_23 "The existence probability of the reported object";
CM_ SG_ 154 OBJ_Fusion_Source_23 "sources ids used for fusion";
CM_ SG_ 154 OBJ_Triggered_SDM_23 "Indicates whether the object has trigered the SDM (Safety Diagnostic Manager) alert.";
CM_ SG_ 154 OBJ_Motion_Category_23 "Relevant for VD only. Full description of values can be found at the ACC guide.";
CM_ SG_ 154 OBJ_Moving_IN_Probability_23 "The probability the object is eventually move into ego lane. (In case that the OBJ_Motion_Category signal is set to  MOVING_IN ";
CM_ SG_ 154 OBJ_Object_Age_23 "The number of frames in which the object was recognized.";
CM_ SG_ 154 OBJ_Measuring_Status_23 "Measurment status. Old vs New marks if this is the first frame in which the object is reported. Predicted vs Measured marks if the report is raw or has been predicted forward in time using the measured dynamics and ego motion.";
CM_ SG_ 154 OBJ_Object_Class_23 "Indicates the object type. Uncertain is outputted in case the probability that a vehicle is a truck is very similar to the probability that it is a car.";
CM_ SG_ 154 OBJ_Class_Probability_23 "The probability of this type classification.";
CM_ SG_ 154 OBJ_Car_Probability_23 "The probability the object is a car";
CM_ SG_ 154 OBJ_Truck_Probability_23 "The probability the object is a Truck";
CM_ SG_ 154 OBJ_Bike_Probability_23 "The probability the object is a Bike";
CM_ SG_ 154 OBJ_Camera_Source_23 "The camera in which this object was detected (best choice).";
CM_ SG_ 154 OBJ_Motion_Status_23 "MOVING - the object is moving STATIONARY - the object was never seen moving STOPPED -  the object was moving and has stopped MOVING_SLOWLY - the object is moving very slowly";
CM_ SG_ 154 OBJ_Motion_Orientation_23 "The direction of the targets heading compared to the host. ";
CM_ SG_ 154 OBJ_Has_Cut_Lane_23 "Indicates whether the object cut the host's (right or left) lane. In case there are no lanes, indicates whether the objects is at most 1 meters away from the host.";
CM_ SG_ 154 OBJ_Has_Cut_Path_23 "Indicates whether the object is in the host's path.";
CM_ SG_ 154 OBJ_Brake_Light_Validity_23 "Validator for braking light indicator";
CM_ SG_ 154 OBJ_Brake_Light_23 "Indication for brake lights ";
CM_ SG_ 154 OBJ_Turn_Indicator_Right_23 "Indication for blinking right light.";
CM_ SG_ 154 OBJ_Turn_Indicator_Left_23 "Indication for blinking left light ";
CM_ SG_ 154 OBJ_Turn_Indicator_Validity_23 "Validator for light indicators";
CM_ SG_ 154 OBJ_Right_Out_Of_Image_23 "Indicates whether the measurment are predicted out of the right side of the image bounderies.";
CM_ SG_ 154 OBJ_Left_Out_Of_Image_23 "Indicates whether if measurment are predicted out of  the left side of the image bounderies";
CM_ SG_ 154 OBJ_Right_Out_Of_Image_V_23 "validator";
CM_ SG_ 154 OBJ_Left_Out_Of_Image_V_23 "validator";
CM_ SG_ 154 OBJ_Top_Out_Of_Image_23 "Indicates whether if measurment are predicted out of  the top of the image bounderies";
CM_ SG_ 154 OBJ_Bottom_Out_Of_Image_23 "Indicates whether if measurment are predicted out of  the bottom of the image bounderies";
CM_ SG_ 154 OBJ_Top_Out_Of_Image_V_23 "validator";
CM_ SG_ 154 OBJ_Bottom_Out_Of_Image_V_23 "validator";
CM_ SG_ 154 OBJ_Lane_Assignment_23 "The object's lane relative to the host lane.";
CM_ SG_ 154 OBJ_Lane_Assignment_V_23 "Validator for lane assignment";
CM_ SG_ 154 OBJ_Age_Seconds_23 "Time in seconds in which the object was recognized. ";
CM_ SG_ 154 OBJ_Age_Seconds_V_23 "Validator for object age";
CM_ SG_ 154 OBJ_Width_23 "The width of the target vehicle in the world (not to be mistaken with the width of the visible part of the vehicle).";
CM_ SG_ 154 OBJ_Width_V_23 "Validator for object width";
CM_ SG_ 154 OBJ_Width_STD_23 "Standard deviation for object width";
CM_ SG_ 154 OBJ_Width_STD_V_23 "Validator for the standard deviation of object width";
CM_ SG_ 154 OBJ_Length_23 "The length of the vehicle in the world. For crossing bicycles it gives the viewed length of the bicycle.";
CM_ SG_ 154 OBJ_Length_V_23 "Validator for object length.";
CM_ SG_ 154 OBJ_Length_STD_23 "Standard deviation for object length.";
CM_ SG_ 154 OBJ_Length_STD_V_23 "Validator for the standard deviation of object length.";
CM_ SG_ 154 OBJ_Radar_ID_23 "Radar Object ID of the Fused Object, Only relvant when OBJ_Fusion_Source is not Camera only";
CM_ SG_ 154 OBJ_Height_23 "The height of the object in the world. ";
CM_ SG_ 154 OBJ_Height_V_23 "Validator for object height.";
CM_ SG_ 154 OBJ_Height_STD_23 "Standard deviation for object height.";
CM_ SG_ 154 OBJ_Height_STD_V_23 "Validator for the standard deviation of object height.";
CM_ SG_ 154 OBJ_Abs_Long_Velocity_23 "Absolute longitudinal velocity.";
CM_ SG_ 154 OBJ_Abs_Long_Velocity_V_23 "Validator for absolute longitudinal velocity.";
CM_ SG_ 154 OBJ_Abs_Long_Velocity_STD_23 "Standard deviation of absolute longitudinal velocity.";
CM_ SG_ 154 OBJ_Abs_Long_Vel_STD_V_23 "Validator for the standard deviation of the absolute longitudinal velocity.";
CM_ SG_ 154 OBJ_Abs_Lat_Velocity_23 "The lateral ground speed of the object.";
CM_ SG_ 154 OBJ_Abs_Lat_Velocity_V_23 "Validator for the lateral ground speed of the object.";
CM_ SG_ 154 OBJ_Abs_Lat_Velocity_STD_23 "STD of the lateral ground speed of the object.";
CM_ SG_ 154 OBJ_Abs_Lat_Vel_STD_V_23 "Validator for the STD of the lateral ground speed of the object.";
CM_ SG_ 154 OBJ_Abs_Long_Acc_23 "The longitudinal ground acceleration of the object.";
CM_ SG_ 154 OBJ_Abs_Long_Acc_V_23 "Validator for the longitudinal ground acceleration of the object.";
CM_ SG_ 154 OBJ_Abs_Long_Acc_STD_23 "STD of the longitudinal ground acceleration of the object.";
CM_ SG_ 154 OBJ_Abs_Long_Acc_STD_V_23 "Validator for the STD of the longitudinal ground acceleration of the object.";
CM_ SG_ 154 OBJ_Abs_Lat_Acc_23 "The lateral ground acceleration of the object.";
CM_ SG_ 154 OBJ_Abs_Lat_Acc_V_23 "Validator for the lateral ground acceleration of the object.";
CM_ SG_ 154 OBJ_Abs_Lat_Acc_STD_23 "STD of the lateral ground acceleration of the object.";
CM_ SG_ 154 OBJ_Abs_Lat_Acc_STD_V_23 "Validator for the STD of the lateral ground acceleration of the object.";
CM_ SG_ 154 OBJ_Abs_Acceleration_23 "The absolute ground acceleration in the target's heading direction.";
CM_ SG_ 154 OBJ_Abs_Acceleration_V_23 "Validator for the absolute ground acceleration.";
CM_ SG_ 154 OBJ_Abs_Acc_STD_23 "STD of the absolute ground acceleration.";
CM_ SG_ 154 OBJ_Abs_Acc_STD_V_23 "Validator for the STD of the absolute ground acceleration.";
CM_ SG_ 154 OBJ_Inv_TTC_23 "Inverse TTC (time to collision).";
CM_ SG_ 154 OBJ_Inv_TTC_STD_23 "STD for inverse TTC .";
CM_ SG_ 154 OBJ_Inv_TTC_STD_V_23 "Validator for the STD for inverse TTC .";
CM_ SG_ 154 OBJ_Relative_Long_Acc_23 "The relative longitudinal ground acceleration of the object.";
CM_ SG_ 154 OBJ_Relative_Long_Acc_V_23 "Validator for the relative longitudinal ground acceleration of the object.";
CM_ SG_ 154 OBJ_Relative_Long_Acc_STD_23 "STD of the relative longitudinal ground acceleration of the object.";
CM_ SG_ 154 OBJ_Rel_Long_Acc_STD_V_23 "Validator for the STD of the relative longitudinal ground acceleration.";
CM_ SG_ 154 OBJ_Relative_Long_Velocity_23 "The relative longtitudinal speed between the target and ego vehicle. ";
CM_ SG_ 154 OBJ_Relative_Long_Velocity_V_23 "Validator for the relative longtitudinal speed.";
CM_ SG_ 154 OBJ_Relative_Long_Vel_STD_23 "STD of the relative longtitudinal speed.";
CM_ SG_ 154 OBJ_Rel_Long_Vel_STD_V_23 "Validator for the STD of the relative longtitudinal speed.";
CM_ SG_ 154 OBJ_Relative_Lat_Velocity_23 "The relative lateral speed between the target and ego vehicle. ";
CM_ SG_ 154 OBJ_Relative_Lat_Velocity_V_23 "Validator for the relative lateral speed. ";
CM_ SG_ 154 OBJ_Relative_Lat_Velocity_STD_23 "STD of the relative lateral speed. ";
CM_ SG_ 154 OBJ_Rel_Lat_Vel_STD_V_23 "Validator for the STD of the relative lateral speed. ";
CM_ SG_ 154 OBJ_Long_Distance_23 "The longitudinal distance to middle of the rear bumper (middle of the RL and RR corners) of the target.";
CM_ SG_ 154 OBJ_Long_Distance_V_23 "Validator of the longtitudinal distance field";
CM_ SG_ 154 OBJ_Long_Distance_STD_23 "STD of the  longtitudinal distance.";
CM_ SG_ 154 OBJ_Long_Distance_STD_V_23 "Validator for the STD of the  longtitudinal distance.";
CM_ SG_ 154 OBJ_Lat_Distance_23 "Lateral distance to the middle of the RL and RR corners.  ";
CM_ SG_ 154 OBJ_Lat_Distance_V_23 "Validator for the lateral distance of the object.";
CM_ SG_ 154 OBJ_Lat_Distance_STD_23 "STD of the lateral distance of the object.";
CM_ SG_ 154 OBJ_Lat_Distance_STD_V_23 "Validator for the STD of the lateral distance of the object.";
CM_ SG_ 154 OBJ_Absolute_Speed_23 "The absolute ground speed in the targets' heading direction.";
CM_ SG_ 154 OBJ_Absolute_Speed_V_23 "Validator for the absolute ground speed.";
CM_ SG_ 154 OBJ_Absolute_Speed_STD_23 "STD of the absolute ground speed.";
CM_ SG_ 154 OBJ_Absolute_Speed_STD_V_23 "Validator for the STD of the absolute ground speed.";
CM_ SG_ 154 OBJ_Heading_23 "The angle beetweenthe host longitudinal axis and target's heading (clockwise, e.g. PI/2 is a target crossing from left to right).";
CM_ SG_ 154 OBJ_Heading_V_23 "Validator for the object heading.";
CM_ SG_ 154 OBJ_Heading_STD_23 "STD of the object heading.";
CM_ SG_ 154 OBJ_Heading_STD_V_23 "Validator for the STD of the object heading.";
CM_ SG_ 154 OBJ_Angle_Rate_STD_23 "Standard deviation of the angular speed. (radians)";
CM_ SG_ 154 OBJ_Angle_Rate_STD_V_23 "Validator for the STD of the angular speed.";
CM_ SG_ 154 OBJ_Angle_Rate_23 "The momentary angular speed of the object (radians). The positive side is to the host's right.";
CM_ SG_ 154 OBJ_Angle_Rate_V_23 "Validator for the angular speed.";
CM_ SG_ 154 OBJ_Angle_Right_23 "The angle between the host longitudinal axis and the right side of the front / rear of the target (the visible one). The positive side is to the host's right.";
CM_ SG_ 154 OBJ_Angle_Right_V_23 "Validator for angleRight";
CM_ SG_ 154 OBJ_Angle_Right_STD_23 "Standard deviation of angleRight";
CM_ SG_ 154 OBJ_Angle_Right_STD_V_23 "Validator for the standard deviation of angleRight.";
CM_ SG_ 154 OBJ_Angle_Left_23 "The angle between the host longitudinal axis and the left side of the front / rear of the target (the visible one). The positive side is to the host's right.";
CM_ SG_ 154 OBJ_Angle_Left_V_23 "Validator for angleLeft.";
CM_ SG_ 154 OBJ_Angle_Left_STD_23 "Standard deviation of angleLeft.";
CM_ SG_ 154 OBJ_Angle_Left_STD_V_23 "Validator for the standard deviation of angleLeft.";
CM_ SG_ 154 OBJ_Angle_Side_23 "The angle between the host longitudinal axis and the far visible edge - the visible edge of the front / rear of the target that is not visible. Currently supported for vehicles only.";
CM_ SG_ 154 OBJ_Angle_Side_V_23 "Validator for angleSide.";
CM_ SG_ 154 OBJ_Angle_Side_STD_23 "Standard deviation of angleSide.";
CM_ SG_ 154 OBJ_Angle_Side_STD_V_23 "Validator for the STD of angleSide.";
CM_ SG_ 154 OBJ_Angle_Mid_V_23 "Validator for angleMid.";
CM_ SG_ 154 OBJ_Angle_Mid_23 "The angle between the host longitudinal axis and the middle of the front / rear of the target (the visible one). The positive side is to the host's right.";
CM_ SG_ 154 OBJ_Angle_Mid_STD_23 "Standard deviation of angleMid.";
CM_ SG_ 154 OBJ_Angle_Mid_STD_V_23 "Validator for the STD of angleMid.";
CM_ SG_ 154 OBJ_Angle_Bottom_V_23 "Validator for OBJAngle_Bottom. ";
CM_ SG_ 154 OBJ_Angle_Bottom_23 "The angle between the longitudinal axis and the Bottom of the front / rear of the target (the visible one). The positive side is to the host's bottom";
CM_ SG_ 154 OBJ_Angle_Bottom_STD_23 "STD for OBJAngle_Bottom. ";
CM_ SG_ 154 OBJ_Angle_Bottom_STD_V_23 "Validator for OBJAngle_Bottom_STD. ";
CM_ SG_ 154 OBJ_Visibility_Side_V_23 "Currently Supported for VD only";
CM_ SG_ 154 OBJ_Visibility_Side_23 "From what car  side is the object visible";
CM_ SG_ 154 OBJ_Is_In_Drivable_Area_23 "Indicates whether the target is in a driveable area.";
CM_ SG_ 154 OBJ_Is_In_Drivable_Area_V_23 "Validator for OBJ_Is_In_Drivable_Area.";
CM_ SG_ 154 OBJ_Is_VeryClose_V_23 "Validator for OBJ_Is_VeryClose. ";
CM_ SG_ 154 OBJ_Is_VeryClose_23 "Indicates whether the target is very close to the host such that it is hard to measure its distance. Currently relevant for peds only";
CM_ SG_ 154 OBJ_OverlapAngleEgoLaneR_23 "Lateral distance to the middle of the RL and RR corners.";
CM_ SG_ 154 OBJ_OverlapAngleEgoLaneR_V_23 "Validator for OBJ_OverlapAngleEgoLaneR";
CM_ SG_ 154 OBJ_OverlapAngleEgoLaneL_23 "Lateral distance to the middle of the RL and RR corners.  ";
CM_ SG_ 154 OBJ_OverlapAngleEgoLaneL_V_23 "Validator for OBJ_OverlapAngleEgoLaneL";
CM_ SG_ 154 OBJ_Is_EMERGENCY_VCL_23 "Is Object an Emergency Vehicle";
CM_ SG_ 154 OBJ_EMERGENCY_LIGHT_COLOR_23 "Emergency Color";
CM_ SG_ 154 OBJ_EMERGENCY_V_23 "Are OBJ_Is_EMERGENCY_VCL and OBJ_EMERGENCY_LIGHT_COLOR Valid";
CM_ SG_ 154 OBJ_Angle_Top_23 "From VD touching point on the ground till the roof of the car";
CM_ SG_ 154 OBJ_Angle_Top_V_23 "Validator for OBJ_Angle_Top ";
CM_ SG_ 154 OBJ_Angle_Top_STD_23 "STD for OBJ_Angle_Top";
CM_ SG_ 154 OBJ_Angle_Top_STD_V_23 "Validator for OBJ_Angle_Top_STD. ";
CM_ SG_ 154 OBJ_Open_Door_Left_23 "Indicator if left door is open";
CM_ SG_ 154 OBJ_Open_Door_Right_23 "Indicator if right door is open";
CM_ SG_ 154 OBJ_Visible_Left_or_Right_23 "This signal describes the visible Left or Right side of the Target vehicle.";
CM_ SG_ 154 OBJ_Visible_Left_or_Right_V_23 "OBJ_Visible_Left_or_Right";
CM_ SG_ 154 OBJ_2W_Is_Motorbike_Probability_23 "The probability of the Two-wheeler reported object being a Motorbike";
CM_ SG_ 154 OBJ_2W_Is_Bicycle_Probability_23 "The probability of the Two-wheeler reported object being a Bicycle";
CM_ SG_ 154 OBJ_CRC_24 "Calculated over all element signals. From the signal after the CRC until the first signal in the next elements OBJ_CRC_N+1  not including";
CM_ SG_ 154 OBJ_ID_24 "The detected object ID. Range is 1-255, while 0 indicates that the field in unfilled.";
CM_ SG_ 154 OBJ_Existence_Probability_24 "The existence probability of the reported object";
CM_ SG_ 154 OBJ_Fusion_Source_24 "sources ids used for fusion";
CM_ SG_ 154 OBJ_Triggered_SDM_24 "Indicates whether the object has trigered the SDM (Safety Diagnostic Manager) alert.";
CM_ SG_ 154 OBJ_Motion_Category_24 "Relevant for VD only. Full description of values can be found at the ACC guide.";
CM_ SG_ 154 OBJ_Moving_IN_Probability_24 "The probability the object is eventually move into ego lane. (In case that the OBJ_Motion_Category signal is set to  MOVING_IN ";
CM_ SG_ 154 OBJ_Object_Age_24 "The number of frames in which the object was recognized.";
CM_ SG_ 154 OBJ_Measuring_Status_24 "Measurment status. Old vs New marks if this is the first frame in which the object is reported. Predicted vs Measured marks if the report is raw or has been predicted forward in time using the measured dynamics and ego motion.";
CM_ SG_ 154 OBJ_Object_Class_24 "Indicates the object type. Uncertain is outputted in case the probability that a vehicle is a truck is very similar to the probability that it is a car.";
CM_ SG_ 154 OBJ_Class_Probability_24 "The probability of this type classification.";
CM_ SG_ 154 OBJ_Car_Probability_24 "The probability the object is a car";
CM_ SG_ 154 OBJ_Truck_Probability_24 "The probability the object is a Truck";
CM_ SG_ 154 OBJ_Bike_Probability_24 "The probability the object is a Bike";
CM_ SG_ 154 OBJ_Camera_Source_24 "The camera in which this object was detected (best choice).";
CM_ SG_ 154 OBJ_Motion_Status_24 "MOVING - the object is moving STATIONARY - the object was never seen moving STOPPED -  the object was moving and has stopped MOVING_SLOWLY - the object is moving very slowly";
CM_ SG_ 154 OBJ_Motion_Orientation_24 "The direction of the targets heading compared to the host. ";
CM_ SG_ 154 OBJ_Has_Cut_Lane_24 "Indicates whether the object cut the host's (right or left) lane. In case there are no lanes, indicates whether the objects is at most 1 meters away from the host.";
CM_ SG_ 154 OBJ_Has_Cut_Path_24 "Indicates whether the object is in the host's path.";
CM_ SG_ 154 OBJ_Brake_Light_Validity_24 "Validator for braking light indicator";
CM_ SG_ 154 OBJ_Brake_Light_24 "Indication for brake lights ";
CM_ SG_ 154 OBJ_Turn_Indicator_Right_24 "Indication for blinking right light.";
CM_ SG_ 154 OBJ_Turn_Indicator_Left_24 "Indication for blinking left light ";
CM_ SG_ 154 OBJ_Turn_Indicator_Validity_24 "Validator for light indicators";
CM_ SG_ 154 OBJ_Right_Out_Of_Image_24 "Indicates whether the measurment are predicted out of the right side of the image bounderies.";
CM_ SG_ 154 OBJ_Left_Out_Of_Image_24 "Indicates whether if measurment are predicted out of  the left side of the image bounderies";
CM_ SG_ 154 OBJ_Right_Out_Of_Image_V_24 "validator";
CM_ SG_ 154 OBJ_Left_Out_Of_Image_V_24 "validator";
CM_ SG_ 154 OBJ_Top_Out_Of_Image_24 "Indicates whether if measurment are predicted out of  the top of the image bounderies";
CM_ SG_ 154 OBJ_Bottom_Out_Of_Image_24 "Indicates whether if measurment are predicted out of  the bottom of the image bounderies";
CM_ SG_ 154 OBJ_Top_Out_Of_Image_V_24 "validator";
CM_ SG_ 154 OBJ_Bottom_Out_Of_Image_V_24 "validator";
CM_ SG_ 154 OBJ_Lane_Assignment_24 "The object's lane relative to the host lane.";
CM_ SG_ 154 OBJ_Lane_Assignment_V_24 "Validator for lane assignment";
CM_ SG_ 154 OBJ_Age_Seconds_24 "Time in seconds in which the object was recognized. ";
CM_ SG_ 154 OBJ_Age_Seconds_V_24 "Validator for object age";
CM_ SG_ 154 OBJ_Width_24 "The width of the target vehicle in the world (not to be mistaken with the width of the visible part of the vehicle).";
CM_ SG_ 154 OBJ_Width_V_24 "Validator for object width";
CM_ SG_ 154 OBJ_Width_STD_24 "Standard deviation for object width";
CM_ SG_ 154 OBJ_Width_STD_V_24 "Validator for the standard deviation of object width";
CM_ SG_ 154 OBJ_Length_24 "The length of the vehicle in the world. For crossing bicycles it gives the viewed length of the bicycle.";
CM_ SG_ 154 OBJ_Length_V_24 "Validator for object length.";
CM_ SG_ 154 OBJ_Length_STD_24 "Standard deviation for object length.";
CM_ SG_ 154 OBJ_Length_STD_V_24 "Validator for the standard deviation of object length.";
CM_ SG_ 154 OBJ_Radar_ID_24 "Radar Object ID of the Fused Object, Only relvant when OBJ_Fusion_Source is not Camera only";
CM_ SG_ 154 OBJ_Height_24 "The height of the object in the world. ";
CM_ SG_ 154 OBJ_Height_V_24 "Validator for object height.";
CM_ SG_ 154 OBJ_Height_STD_24 "Standard deviation for object height.";
CM_ SG_ 154 OBJ_Height_STD_V_24 "Validator for the standard deviation of object height.";
CM_ SG_ 154 OBJ_Abs_Long_Velocity_24 "Absolute longitudinal velocity.";
CM_ SG_ 154 OBJ_Abs_Long_Velocity_V_24 "Validator for absolute longitudinal velocity.";
CM_ SG_ 154 OBJ_Abs_Long_Velocity_STD_24 "Standard deviation of absolute longitudinal velocity.";
CM_ SG_ 154 OBJ_Abs_Long_Vel_STD_V_24 "Validator for the standard deviation of the absolute longitudinal velocity.";
CM_ SG_ 154 OBJ_Abs_Lat_Velocity_24 "The lateral ground speed of the object.";
CM_ SG_ 154 OBJ_Abs_Lat_Velocity_V_24 "Validator for the lateral ground speed of the object.";
CM_ SG_ 154 OBJ_Abs_Lat_Velocity_STD_24 "STD of the lateral ground speed of the object.";
CM_ SG_ 154 OBJ_Abs_Lat_Vel_STD_V_24 "Validator for the STD of the lateral ground speed of the object.";
CM_ SG_ 154 OBJ_Abs_Long_Acc_24 "The longitudinal ground acceleration of the object.";
CM_ SG_ 154 OBJ_Abs_Long_Acc_V_24 "Validator for the longitudinal ground acceleration of the object.";
CM_ SG_ 154 OBJ_Abs_Long_Acc_STD_24 "STD of the longitudinal ground acceleration of the object.";
CM_ SG_ 154 OBJ_Abs_Long_Acc_STD_V_24 "Validator for the STD of the longitudinal ground acceleration of the object.";
CM_ SG_ 154 OBJ_Abs_Lat_Acc_24 "The lateral ground acceleration of the object.";
CM_ SG_ 154 OBJ_Abs_Lat_Acc_V_24 "Validator for the lateral ground acceleration of the object.";
CM_ SG_ 154 OBJ_Abs_Lat_Acc_STD_24 "STD of the lateral ground acceleration of the object.";
CM_ SG_ 154 OBJ_Abs_Lat_Acc_STD_V_24 "Validator for the STD of the lateral ground acceleration of the object.";
CM_ SG_ 154 OBJ_Abs_Acceleration_24 "The absolute ground acceleration in the target's heading direction.";
CM_ SG_ 154 OBJ_Abs_Acceleration_V_24 "Validator for the absolute ground acceleration.";
CM_ SG_ 154 OBJ_Abs_Acc_STD_24 "STD of the absolute ground acceleration.";
CM_ SG_ 154 OBJ_Abs_Acc_STD_V_24 "Validator for the STD of the absolute ground acceleration.";
CM_ SG_ 154 OBJ_Inv_TTC_24 "Inverse TTC (time to collision).";
CM_ SG_ 154 OBJ_Inv_TTC_STD_24 "STD for inverse TTC .";
CM_ SG_ 154 OBJ_Inv_TTC_STD_V_24 "Validator for the STD for inverse TTC .";
CM_ SG_ 154 OBJ_Relative_Long_Acc_24 "The relative longitudinal ground acceleration of the object.";
CM_ SG_ 154 OBJ_Relative_Long_Acc_V_24 "Validator for the relative longitudinal ground acceleration of the object.";
CM_ SG_ 154 OBJ_Relative_Long_Acc_STD_24 "STD of the relative longitudinal ground acceleration of the object.";
CM_ SG_ 154 OBJ_Rel_Long_Acc_STD_V_24 "Validator for the STD of the relative longitudinal ground acceleration.";
CM_ SG_ 154 OBJ_Relative_Long_Velocity_24 "The relative longtitudinal speed between the target and ego vehicle. ";
CM_ SG_ 154 OBJ_Relative_Long_Velocity_V_24 "Validator for the relative longtitudinal speed.";
CM_ SG_ 154 OBJ_Relative_Long_Vel_STD_24 "STD of the relative longtitudinal speed.";
CM_ SG_ 154 OBJ_Rel_Long_Vel_STD_V_24 "Validator for the STD of the relative longtitudinal speed.";
CM_ SG_ 154 OBJ_Relative_Lat_Velocity_24 "The relative lateral speed between the target and ego vehicle. ";
CM_ SG_ 154 OBJ_Relative_Lat_Velocity_V_24 "Validator for the relative lateral speed. ";
CM_ SG_ 154 OBJ_Relative_Lat_Velocity_STD_24 "STD of the relative lateral speed. ";
CM_ SG_ 154 OBJ_Rel_Lat_Vel_STD_V_24 "Validator for the STD of the relative lateral speed. ";
CM_ SG_ 154 OBJ_Long_Distance_24 "The longitudinal distance to middle of the rear bumper (middle of the RL and RR corners) of the target.";
CM_ SG_ 154 OBJ_Long_Distance_V_24 "Validator of the longtitudinal distance field";
CM_ SG_ 154 OBJ_Long_Distance_STD_24 "STD of the  longtitudinal distance.";
CM_ SG_ 154 OBJ_Long_Distance_STD_V_24 "Validator for the STD of the  longtitudinal distance.";
CM_ SG_ 154 OBJ_Lat_Distance_24 "Lateral distance to the middle of the RL and RR corners.  ";
CM_ SG_ 154 OBJ_Lat_Distance_V_24 "Validator for the lateral distance of the object.";
CM_ SG_ 154 OBJ_Lat_Distance_STD_24 "STD of the lateral distance of the object.";
CM_ SG_ 154 OBJ_Lat_Distance_STD_V_24 "Validator for the STD of the lateral distance of the object.";
CM_ SG_ 154 OBJ_Absolute_Speed_24 "The absolute ground speed in the targets' heading direction.";
CM_ SG_ 154 OBJ_Absolute_Speed_V_24 "Validator for the absolute ground speed.";
CM_ SG_ 154 OBJ_Absolute_Speed_STD_24 "STD of the absolute ground speed.";
CM_ SG_ 154 OBJ_Absolute_Speed_STD_V_24 "Validator for the STD of the absolute ground speed.";
CM_ SG_ 154 OBJ_Heading_24 "The angle beetweenthe host longitudinal axis and target's heading (clockwise, e.g. PI/2 is a target crossing from left to right).";
CM_ SG_ 154 OBJ_Heading_V_24 "Validator for the object heading.";
CM_ SG_ 154 OBJ_Heading_STD_24 "STD of the object heading.";
CM_ SG_ 154 OBJ_Heading_STD_V_24 "Validator for the STD of the object heading.";
CM_ SG_ 154 OBJ_Angle_Rate_STD_24 "Standard deviation of the angular speed. (radians)";
CM_ SG_ 154 OBJ_Angle_Rate_STD_V_24 "Validator for the STD of the angular speed.";
CM_ SG_ 154 OBJ_Angle_Rate_24 "The momentary angular speed of the object (radians). The positive side is to the host's right.";
CM_ SG_ 154 OBJ_Angle_Rate_V_24 "Validator for the angular speed.";
CM_ SG_ 154 OBJ_Angle_Right_24 "The angle between the host longitudinal axis and the right side of the front / rear of the target (the visible one). The positive side is to the host's right.";
CM_ SG_ 154 OBJ_Angle_Right_V_24 "Validator for angleRight";
CM_ SG_ 154 OBJ_Angle_Right_STD_24 "Standard deviation of angleRight";
CM_ SG_ 154 OBJ_Angle_Right_STD_V_24 "Validator for the standard deviation of angleRight.";
CM_ SG_ 154 OBJ_Angle_Left_24 "The angle between the host longitudinal axis and the left side of the front / rear of the target (the visible one). The positive side is to the host's right.";
CM_ SG_ 154 OBJ_Angle_Left_V_24 "Validator for angleLeft.";
CM_ SG_ 154 OBJ_Angle_Left_STD_24 "Standard deviation of angleLeft.";
CM_ SG_ 154 OBJ_Angle_Left_STD_V_24 "Validator for the standard deviation of angleLeft.";
CM_ SG_ 154 OBJ_Angle_Side_24 "The angle between the host longitudinal axis and the far visible edge - the visible edge of the front / rear of the target that is not visible. Currently supported for vehicles only.";
CM_ SG_ 154 OBJ_Angle_Side_V_24 "Validator for angleSide.";
CM_ SG_ 154 OBJ_Angle_Side_STD_24 "Standard deviation of angleSide.";
CM_ SG_ 154 OBJ_Angle_Side_STD_V_24 "Validator for the STD of angleSide.";
CM_ SG_ 154 OBJ_Angle_Mid_V_24 "Validator for angleMid.";
CM_ SG_ 154 OBJ_Angle_Mid_24 "The angle between the host longitudinal axis and the middle of the front / rear of the target (the visible one). The positive side is to the host's right.";
CM_ SG_ 154 OBJ_Angle_Mid_STD_24 "Standard deviation of angleMid.";
CM_ SG_ 154 OBJ_Angle_Mid_STD_V_24 "Validator for the STD of angleMid.";
CM_ SG_ 154 OBJ_Angle_Bottom_V_24 "Validator for OBJAngle_Bottom. ";
CM_ SG_ 154 OBJ_Angle_Bottom_24 "The angle between the longitudinal axis and the Bottom of the front / rear of the target (the visible one). The positive side is to the host's bottom";
CM_ SG_ 154 OBJ_Angle_Bottom_STD_24 "STD for OBJAngle_Bottom. ";
CM_ SG_ 154 OBJ_Angle_Bottom_STD_V_24 "Validator for OBJAngle_Bottom_STD. ";
CM_ SG_ 154 OBJ_Visibility_Side_V_24 "Currently Supported for VD only";
CM_ SG_ 154 OBJ_Visibility_Side_24 "From what car  side is the object visible";
CM_ SG_ 154 OBJ_Is_In_Drivable_Area_24 "Indicates whether the target is in a driveable area.";
CM_ SG_ 154 OBJ_Is_In_Drivable_Area_V_24 "Validator for OBJ_Is_In_Drivable_Area.";
CM_ SG_ 154 OBJ_Is_VeryClose_V_24 "Validator for OBJ_Is_VeryClose. ";
CM_ SG_ 154 OBJ_Is_VeryClose_24 "Indicates whether the target is very close to the host such that it is hard to measure its distance. Currently relevant for peds only";
CM_ SG_ 154 OBJ_OverlapAngleEgoLaneR_24 "Lateral distance to the middle of the RL and RR corners.";
CM_ SG_ 154 OBJ_OverlapAngleEgoLaneR_V_24 "Validator for OBJ_OverlapAngleEgoLaneR";
CM_ SG_ 154 OBJ_OverlapAngleEgoLaneL_24 "Lateral distance to the middle of the RL and RR corners.  ";
CM_ SG_ 154 OBJ_OverlapAngleEgoLaneL_V_24 "Validator for OBJ_OverlapAngleEgoLaneL";
CM_ SG_ 154 OBJ_Is_EMERGENCY_VCL_24 "Is Object an Emergency Vehicle";
CM_ SG_ 154 OBJ_EMERGENCY_LIGHT_COLOR_24 "Emergency Color";
CM_ SG_ 154 OBJ_EMERGENCY_V_24 "Are OBJ_Is_EMERGENCY_VCL and OBJ_EMERGENCY_LIGHT_COLOR Valid";
CM_ SG_ 154 OBJ_Angle_Top_24 "From VD touching point on the ground till the roof of the car";
CM_ SG_ 154 OBJ_Angle_Top_V_24 "Validator for OBJ_Angle_Top ";
CM_ SG_ 154 OBJ_Angle_Top_STD_24 "STD for OBJ_Angle_Top";
CM_ SG_ 154 OBJ_Angle_Top_STD_V_24 "Validator for OBJ_Angle_Top_STD. ";
CM_ SG_ 154 OBJ_Open_Door_Left_24 "Indicator if left door is open";
CM_ SG_ 154 OBJ_Open_Door_Right_24 "Indicator if right door is open";
CM_ SG_ 154 OBJ_Visible_Left_or_Right_24 "This signal describes the visible Left or Right side of the Target vehicle.";
CM_ SG_ 154 OBJ_Visible_Left_or_Right_V_24 "OBJ_Visible_Left_or_Right";
CM_ SG_ 154 OBJ_2W_Is_Motorbike_Probability_24 "The probability of the Two-wheeler reported object being a Motorbike";
CM_ SG_ 154 OBJ_2W_Is_Bicycle_Probability_24 "The probability of the Two-wheeler reported object being a Bicycle";
CM_ SG_ 154 OBJ_CRC_25 "Calculated over all element signals. From the signal after the CRC until the first signal in the next elements OBJ_CRC_N+1  not including";
CM_ SG_ 154 OBJ_ID_25 "The detected object ID. Range is 1-255, while 0 indicates that the field in unfilled.";
CM_ SG_ 154 OBJ_Existence_Probability_25 "The existence probability of the reported object";
CM_ SG_ 154 OBJ_Fusion_Source_25 "sources ids used for fusion";
CM_ SG_ 154 OBJ_Triggered_SDM_25 "Indicates whether the object has trigered the SDM (Safety Diagnostic Manager) alert.";
CM_ SG_ 154 OBJ_Motion_Category_25 "Relevant for VD only. Full description of values can be found at the ACC guide.";
CM_ SG_ 154 OBJ_Moving_IN_Probability_25 "The probability the object is eventually move into ego lane. (In case that the OBJ_Motion_Category signal is set to  MOVING_IN ";
CM_ SG_ 154 OBJ_Object_Age_25 "The number of frames in which the object was recognized.";
CM_ SG_ 154 OBJ_Measuring_Status_25 "Measurment status. Old vs New marks if this is the first frame in which the object is reported. Predicted vs Measured marks if the report is raw or has been predicted forward in time using the measured dynamics and ego motion.";
CM_ SG_ 154 OBJ_Object_Class_25 "Indicates the object type. Uncertain is outputted in case the probability that a vehicle is a truck is very similar to the probability that it is a car.";
CM_ SG_ 154 OBJ_Class_Probability_25 "The probability of this type classification.";
CM_ SG_ 154 OBJ_Car_Probability_25 "The probability the object is a car";
CM_ SG_ 154 OBJ_Truck_Probability_25 "The probability the object is a Truck";
CM_ SG_ 154 OBJ_Bike_Probability_25 "The probability the object is a Bike";
CM_ SG_ 154 OBJ_Camera_Source_25 "The camera in which this object was detected (best choice).";
CM_ SG_ 154 OBJ_Motion_Status_25 "MOVING - the object is moving STATIONARY - the object was never seen moving STOPPED -  the object was moving and has stopped MOVING_SLOWLY - the object is moving very slowly";
CM_ SG_ 154 OBJ_Motion_Orientation_25 "The direction of the targets heading compared to the host. ";
CM_ SG_ 154 OBJ_Has_Cut_Lane_25 "Indicates whether the object cut the host's (right or left) lane. In case there are no lanes, indicates whether the objects is at most 1 meters away from the host.";
CM_ SG_ 154 OBJ_Has_Cut_Path_25 "Indicates whether the object is in the host's path.";
CM_ SG_ 154 OBJ_Brake_Light_Validity_25 "Validator for braking light indicator";
CM_ SG_ 154 OBJ_Brake_Light_25 "Indication for brake lights ";
CM_ SG_ 154 OBJ_Turn_Indicator_Right_25 "Indication for blinking right light.";
CM_ SG_ 154 OBJ_Turn_Indicator_Left_25 "Indication for blinking left light ";
CM_ SG_ 154 OBJ_Turn_Indicator_Validity_25 "Validator for light indicators";
CM_ SG_ 154 OBJ_Right_Out_Of_Image_25 "Indicates whether the measurment are predicted out of the right side of the image bounderies.";
CM_ SG_ 154 OBJ_Left_Out_Of_Image_25 "Indicates whether if measurment are predicted out of  the left side of the image bounderies";
CM_ SG_ 154 OBJ_Right_Out_Of_Image_V_25 "validator";
CM_ SG_ 154 OBJ_Left_Out_Of_Image_V_25 "validator";
CM_ SG_ 154 OBJ_Top_Out_Of_Image_25 "Indicates whether if measurment are predicted out of  the top of the image bounderies";
CM_ SG_ 154 OBJ_Bottom_Out_Of_Image_25 "Indicates whether if measurment are predicted out of  the bottom of the image bounderies";
CM_ SG_ 154 OBJ_Top_Out_Of_Image_V_25 "validator";
CM_ SG_ 154 OBJ_Bottom_Out_Of_Image_V_25 "validator";
CM_ SG_ 154 OBJ_Lane_Assignment_25 "The object's lane relative to the host lane.";
CM_ SG_ 154 OBJ_Lane_Assignment_V_25 "Validator for lane assignment";
CM_ SG_ 154 OBJ_Age_Seconds_25 "Time in seconds in which the object was recognized. ";
CM_ SG_ 154 OBJ_Age_Seconds_V_25 "Validator for object age";
CM_ SG_ 154 OBJ_Width_25 "The width of the target vehicle in the world (not to be mistaken with the width of the visible part of the vehicle).";
CM_ SG_ 154 OBJ_Width_V_25 "Validator for object width";
CM_ SG_ 154 OBJ_Width_STD_25 "Standard deviation for object width";
CM_ SG_ 154 OBJ_Width_STD_V_25 "Validator for the standard deviation of object width";
CM_ SG_ 154 OBJ_Length_25 "The length of the vehicle in the world. For crossing bicycles it gives the viewed length of the bicycle.";
CM_ SG_ 154 OBJ_Length_V_25 "Validator for object length.";
CM_ SG_ 154 OBJ_Length_STD_25 "Standard deviation for object length.";
CM_ SG_ 154 OBJ_Length_STD_V_25 "Validator for the standard deviation of object length.";
CM_ SG_ 154 OBJ_Radar_ID_25 "Radar Object ID of the Fused Object, Only relvant when OBJ_Fusion_Source is not Camera only";
CM_ SG_ 154 OBJ_Height_25 "The height of the object in the world. ";
CM_ SG_ 154 OBJ_Height_V_25 "Validator for object height.";
CM_ SG_ 154 OBJ_Height_STD_25 "Standard deviation for object height.";
CM_ SG_ 154 OBJ_Height_STD_V_25 "Validator for the standard deviation of object height.";
CM_ SG_ 154 OBJ_Abs_Long_Velocity_25 "Absolute longitudinal velocity.";
CM_ SG_ 154 OBJ_Abs_Long_Velocity_V_25 "Validator for absolute longitudinal velocity.";
CM_ SG_ 154 OBJ_Abs_Long_Velocity_STD_25 "Standard deviation of absolute longitudinal velocity.";
CM_ SG_ 154 OBJ_Abs_Long_Vel_STD_V_25 "Validator for the standard deviation of the absolute longitudinal velocity.";
CM_ SG_ 154 OBJ_Abs_Lat_Velocity_25 "The lateral ground speed of the object.";
CM_ SG_ 154 OBJ_Abs_Lat_Velocity_V_25 "Validator for the lateral ground speed of the object.";
CM_ SG_ 154 OBJ_Abs_Lat_Velocity_STD_25 "STD of the lateral ground speed of the object.";
CM_ SG_ 154 OBJ_Abs_Lat_Vel_STD_V_25 "Validator for the STD of the lateral ground speed of the object.";
CM_ SG_ 154 OBJ_Abs_Long_Acc_25 "The longitudinal ground acceleration of the object.";
CM_ SG_ 154 OBJ_Abs_Long_Acc_V_25 "Validator for the longitudinal ground acceleration of the object.";
CM_ SG_ 154 OBJ_Abs_Long_Acc_STD_25 "STD of the longitudinal ground acceleration of the object.";
CM_ SG_ 154 OBJ_Abs_Long_Acc_STD_V_25 "Validator for the STD of the longitudinal ground acceleration of the object.";
CM_ SG_ 154 OBJ_Abs_Lat_Acc_25 "The lateral ground acceleration of the object.";
CM_ SG_ 154 OBJ_Abs_Lat_Acc_V_25 "Validator for the lateral ground acceleration of the object.";
CM_ SG_ 154 OBJ_Abs_Lat_Acc_STD_25 "STD of the lateral ground acceleration of the object.";
CM_ SG_ 154 OBJ_Abs_Lat_Acc_STD_V_25 "Validator for the STD of the lateral ground acceleration of the object.";
CM_ SG_ 154 OBJ_Abs_Acceleration_25 "The absolute ground acceleration in the target's heading direction.";
CM_ SG_ 154 OBJ_Abs_Acceleration_V_25 "Validator for the absolute ground acceleration.";
CM_ SG_ 154 OBJ_Abs_Acc_STD_25 "STD of the absolute ground acceleration.";
CM_ SG_ 154 OBJ_Abs_Acc_STD_V_25 "Validator for the STD of the absolute ground acceleration.";
CM_ SG_ 154 OBJ_Inv_TTC_25 "Inverse TTC (time to collision).";
CM_ SG_ 154 OBJ_Inv_TTC_STD_25 "STD for inverse TTC .";
CM_ SG_ 154 OBJ_Inv_TTC_STD_V_25 "Validator for the STD for inverse TTC .";
CM_ SG_ 154 OBJ_Relative_Long_Acc_25 "The relative longitudinal ground acceleration of the object.";
CM_ SG_ 154 OBJ_Relative_Long_Acc_V_25 "Validator for the relative longitudinal ground acceleration of the object.";
CM_ SG_ 154 OBJ_Relative_Long_Acc_STD_25 "STD of the relative longitudinal ground acceleration of the object.";
CM_ SG_ 154 OBJ_Rel_Long_Acc_STD_V_25 "Validator for the STD of the relative longitudinal ground acceleration.";
CM_ SG_ 154 OBJ_Relative_Long_Velocity_25 "The relative longtitudinal speed between the target and ego vehicle. ";
CM_ SG_ 154 OBJ_Relative_Long_Velocity_V_25 "Validator for the relative longtitudinal speed.";
CM_ SG_ 154 OBJ_Relative_Long_Vel_STD_25 "STD of the relative longtitudinal speed.";
CM_ SG_ 154 OBJ_Rel_Long_Vel_STD_V_25 "Validator for the STD of the relative longtitudinal speed.";
CM_ SG_ 154 OBJ_Relative_Lat_Velocity_25 "The relative lateral speed between the target and ego vehicle. ";
CM_ SG_ 154 OBJ_Relative_Lat_Velocity_V_25 "Validator for the relative lateral speed. ";
CM_ SG_ 154 OBJ_Relative_Lat_Velocity_STD_25 "STD of the relative lateral speed. ";
CM_ SG_ 154 OBJ_Rel_Lat_Vel_STD_V_25 "Validator for the STD of the relative lateral speed. ";
CM_ SG_ 154 OBJ_Long_Distance_25 "The longitudinal distance to middle of the rear bumper (middle of the RL and RR corners) of the target.";
CM_ SG_ 154 OBJ_Long_Distance_V_25 "Validator of the longtitudinal distance field";
CM_ SG_ 154 OBJ_Long_Distance_STD_25 "STD of the  longtitudinal distance.";
CM_ SG_ 154 OBJ_Long_Distance_STD_V_25 "Validator for the STD of the  longtitudinal distance.";
CM_ SG_ 154 OBJ_Lat_Distance_25 "Lateral distance to the middle of the RL and RR corners.  ";
CM_ SG_ 154 OBJ_Lat_Distance_V_25 "Validator for the lateral distance of the object.";
CM_ SG_ 154 OBJ_Lat_Distance_STD_25 "STD of the lateral distance of the object.";
CM_ SG_ 154 OBJ_Lat_Distance_STD_V_25 "Validator for the STD of the lateral distance of the object.";
CM_ SG_ 154 OBJ_Absolute_Speed_25 "The absolute ground speed in the targets' heading direction.";
CM_ SG_ 154 OBJ_Absolute_Speed_V_25 "Validator for the absolute ground speed.";
CM_ SG_ 154 OBJ_Absolute_Speed_STD_25 "STD of the absolute ground speed.";
CM_ SG_ 154 OBJ_Absolute_Speed_STD_V_25 "Validator for the STD of the absolute ground speed.";
CM_ SG_ 154 OBJ_Heading_25 "The angle beetweenthe host longitudinal axis and target's heading (clockwise, e.g. PI/2 is a target crossing from left to right).";
CM_ SG_ 154 OBJ_Heading_V_25 "Validator for the object heading.";
CM_ SG_ 154 OBJ_Heading_STD_25 "STD of the object heading.";
CM_ SG_ 154 OBJ_Heading_STD_V_25 "Validator for the STD of the object heading.";
CM_ SG_ 154 OBJ_Angle_Rate_STD_25 "Standard deviation of the angular speed. (radians)";
CM_ SG_ 154 OBJ_Angle_Rate_STD_V_25 "Validator for the STD of the angular speed.";
CM_ SG_ 154 OBJ_Angle_Rate_25 "The momentary angular speed of the object (radians). The positive side is to the host's right.";
CM_ SG_ 154 OBJ_Angle_Rate_V_25 "Validator for the angular speed.";
CM_ SG_ 154 OBJ_Angle_Right_25 "The angle between the host longitudinal axis and the right side of the front / rear of the target (the visible one). The positive side is to the host's right.";
CM_ SG_ 154 OBJ_Angle_Right_V_25 "Validator for angleRight";
CM_ SG_ 154 OBJ_Angle_Right_STD_25 "Standard deviation of angleRight";
CM_ SG_ 154 OBJ_Angle_Right_STD_V_25 "Validator for the standard deviation of angleRight.";
CM_ SG_ 154 OBJ_Angle_Left_25 "The angle between the host longitudinal axis and the left side of the front / rear of the target (the visible one). The positive side is to the host's right.";
CM_ SG_ 154 OBJ_Angle_Left_V_25 "Validator for angleLeft.";
CM_ SG_ 154 OBJ_Angle_Left_STD_25 "Standard deviation of angleLeft.";
CM_ SG_ 154 OBJ_Angle_Left_STD_V_25 "Validator for the standard deviation of angleLeft.";
CM_ SG_ 154 OBJ_Angle_Side_25 "The angle between the host longitudinal axis and the far visible edge - the visible edge of the front / rear of the target that is not visible. Currently supported for vehicles only.";
CM_ SG_ 154 OBJ_Angle_Side_V_25 "Validator for angleSide.";
CM_ SG_ 154 OBJ_Angle_Side_STD_25 "Standard deviation of angleSide.";
CM_ SG_ 154 OBJ_Angle_Side_STD_V_25 "Validator for the STD of angleSide.";
CM_ SG_ 154 OBJ_Angle_Mid_V_25 "Validator for angleMid.";
CM_ SG_ 154 OBJ_Angle_Mid_25 "The angle between the host longitudinal axis and the middle of the front / rear of the target (the visible one). The positive side is to the host's right.";
CM_ SG_ 154 OBJ_Angle_Mid_STD_25 "Standard deviation of angleMid.";
CM_ SG_ 154 OBJ_Angle_Mid_STD_V_25 "Validator for the STD of angleMid.";
CM_ SG_ 154 OBJ_Angle_Bottom_V_25 "Validator for OBJAngle_Bottom. ";
CM_ SG_ 154 OBJ_Angle_Bottom_25 "The angle between the longitudinal axis and the Bottom of the front / rear of the target (the visible one). The positive side is to the host's bottom";
CM_ SG_ 154 OBJ_Angle_Bottom_STD_25 "STD for OBJAngle_Bottom. ";
CM_ SG_ 154 OBJ_Angle_Bottom_STD_V_25 "Validator for OBJAngle_Bottom_STD. ";
CM_ SG_ 154 OBJ_Visibility_Side_V_25 "Currently Supported for VD only";
CM_ SG_ 154 OBJ_Visibility_Side_25 "From what car  side is the object visible";
CM_ SG_ 154 OBJ_Is_In_Drivable_Area_25 "Indicates whether the target is in a driveable area.";
CM_ SG_ 154 OBJ_Is_In_Drivable_Area_V_25 "Validator for OBJ_Is_In_Drivable_Area.";
CM_ SG_ 154 OBJ_Is_VeryClose_V_25 "Validator for OBJ_Is_VeryClose. ";
CM_ SG_ 154 OBJ_Is_VeryClose_25 "Indicates whether the target is very close to the host such that it is hard to measure its distance. Currently relevant for peds only";
CM_ SG_ 154 OBJ_OverlapAngleEgoLaneR_25 "Lateral distance to the middle of the RL and RR corners.";
CM_ SG_ 154 OBJ_OverlapAngleEgoLaneR_V_25 "Validator for OBJ_OverlapAngleEgoLaneR";
CM_ SG_ 154 OBJ_OverlapAngleEgoLaneL_25 "Lateral distance to the middle of the RL and RR corners.  ";
CM_ SG_ 154 OBJ_OverlapAngleEgoLaneL_V_25 "Validator for OBJ_OverlapAngleEgoLaneL";
CM_ SG_ 154 OBJ_Is_EMERGENCY_VCL_25 "Is Object an Emergency Vehicle";
CM_ SG_ 154 OBJ_EMERGENCY_LIGHT_COLOR_25 "Emergency Color";
CM_ SG_ 154 OBJ_EMERGENCY_V_25 "Are OBJ_Is_EMERGENCY_VCL and OBJ_EMERGENCY_LIGHT_COLOR Valid";
CM_ SG_ 154 OBJ_Angle_Top_25 "From VD touching point on the ground till the roof of the car";
CM_ SG_ 154 OBJ_Angle_Top_V_25 "Validator for OBJ_Angle_Top ";
CM_ SG_ 154 OBJ_Angle_Top_STD_25 "STD for OBJ_Angle_Top";
CM_ SG_ 154 OBJ_Angle_Top_STD_V_25 "Validator for OBJ_Angle_Top_STD. ";
CM_ SG_ 154 OBJ_Open_Door_Left_25 "Indicator if left door is open";
CM_ SG_ 154 OBJ_Open_Door_Right_25 "Indicator if right door is open";
CM_ SG_ 154 OBJ_Visible_Left_or_Right_25 "This signal describes the visible Left or Right side of the Target vehicle.";
CM_ SG_ 154 OBJ_Visible_Left_or_Right_V_25 "OBJ_Visible_Left_or_Right";
CM_ SG_ 154 OBJ_2W_Is_Motorbike_Probability_25 "The probability of the Two-wheeler reported object being a Motorbike";
CM_ SG_ 154 OBJ_2W_Is_Bicycle_Probability_25 "The probability of the Two-wheeler reported object being a Bicycle";
CM_ SG_ 154 OBJ_CRC_26 "Calculated over all element signals. From the signal after the CRC until the first signal in the next elements OBJ_CRC_N+1  not including";
CM_ SG_ 154 OBJ_ID_26 "The detected object ID. Range is 1-255, while 0 indicates that the field in unfilled.";
CM_ SG_ 154 OBJ_Existence_Probability_26 "The existence probability of the reported object";
CM_ SG_ 154 OBJ_Fusion_Source_26 "sources ids used for fusion";
CM_ SG_ 154 OBJ_Triggered_SDM_26 "Indicates whether the object has trigered the SDM (Safety Diagnostic Manager) alert.";
CM_ SG_ 154 OBJ_Motion_Category_26 "Relevant for VD only. Full description of values can be found at the ACC guide.";
CM_ SG_ 154 OBJ_Moving_IN_Probability_26 "The probability the object is eventually move into ego lane. (In case that the OBJ_Motion_Category signal is set to  MOVING_IN ";
CM_ SG_ 154 OBJ_Object_Age_26 "The number of frames in which the object was recognized.";
CM_ SG_ 154 OBJ_Measuring_Status_26 "Measurment status. Old vs New marks if this is the first frame in which the object is reported. Predicted vs Measured marks if the report is raw or has been predicted forward in time using the measured dynamics and ego motion.";
CM_ SG_ 154 OBJ_Object_Class_26 "Indicates the object type. Uncertain is outputted in case the probability that a vehicle is a truck is very similar to the probability that it is a car.";
CM_ SG_ 154 OBJ_Class_Probability_26 "The probability of this type classification.";
CM_ SG_ 154 OBJ_Car_Probability_26 "The probability the object is a car";
CM_ SG_ 154 OBJ_Truck_Probability_26 "The probability the object is a Truck";
CM_ SG_ 154 OBJ_Bike_Probability_26 "The probability the object is a Bike";
CM_ SG_ 154 OBJ_Camera_Source_26 "The camera in which this object was detected (best choice).";
CM_ SG_ 154 OBJ_Motion_Status_26 "MOVING - the object is moving STATIONARY - the object was never seen moving STOPPED -  the object was moving and has stopped MOVING_SLOWLY - the object is moving very slowly";
CM_ SG_ 154 OBJ_Motion_Orientation_26 "The direction of the targets heading compared to the host. ";
CM_ SG_ 154 OBJ_Has_Cut_Lane_26 "Indicates whether the object cut the host's (right or left) lane. In case there are no lanes, indicates whether the objects is at most 1 meters away from the host.";
CM_ SG_ 154 OBJ_Has_Cut_Path_26 "Indicates whether the object is in the host's path.";
CM_ SG_ 154 OBJ_Brake_Light_Validity_26 "Validator for braking light indicator";
CM_ SG_ 154 OBJ_Brake_Light_26 "Indication for brake lights ";
CM_ SG_ 154 OBJ_Turn_Indicator_Right_26 "Indication for blinking right light.";
CM_ SG_ 154 OBJ_Turn_Indicator_Left_26 "Indication for blinking left light ";
CM_ SG_ 154 OBJ_Turn_Indicator_Validity_26 "Validator for light indicators";
CM_ SG_ 154 OBJ_Right_Out_Of_Image_26 "Indicates whether the measurment are predicted out of the right side of the image bounderies.";
CM_ SG_ 154 OBJ_Left_Out_Of_Image_26 "Indicates whether if measurment are predicted out of  the left side of the image bounderies";
CM_ SG_ 154 OBJ_Right_Out_Of_Image_V_26 "validator";
CM_ SG_ 154 OBJ_Left_Out_Of_Image_V_26 "validator";
CM_ SG_ 154 OBJ_Top_Out_Of_Image_26 "Indicates whether if measurment are predicted out of  the top of the image bounderies";
CM_ SG_ 154 OBJ_Bottom_Out_Of_Image_26 "Indicates whether if measurment are predicted out of  the bottom of the image bounderies";
CM_ SG_ 154 OBJ_Top_Out_Of_Image_V_26 "validator";
CM_ SG_ 154 OBJ_Bottom_Out_Of_Image_V_26 "validator";
CM_ SG_ 154 OBJ_Lane_Assignment_26 "The object's lane relative to the host lane.";
CM_ SG_ 154 OBJ_Lane_Assignment_V_26 "Validator for lane assignment";
CM_ SG_ 154 OBJ_Age_Seconds_26 "Time in seconds in which the object was recognized. ";
CM_ SG_ 154 OBJ_Age_Seconds_V_26 "Validator for object age";
CM_ SG_ 154 OBJ_Width_26 "The width of the target vehicle in the world (not to be mistaken with the width of the visible part of the vehicle).";
CM_ SG_ 154 OBJ_Width_V_26 "Validator for object width";
CM_ SG_ 154 OBJ_Width_STD_26 "Standard deviation for object width";
CM_ SG_ 154 OBJ_Width_STD_V_26 "Validator for the standard deviation of object width";
CM_ SG_ 154 OBJ_Length_26 "The length of the vehicle in the world. For crossing bicycles it gives the viewed length of the bicycle.";
CM_ SG_ 154 OBJ_Length_V_26 "Validator for object length.";
CM_ SG_ 154 OBJ_Length_STD_26 "Standard deviation for object length.";
CM_ SG_ 154 OBJ_Length_STD_V_26 "Validator for the standard deviation of object length.";
CM_ SG_ 154 OBJ_Radar_ID_26 "Radar Object ID of the Fused Object, Only relvant when OBJ_Fusion_Source is not Camera only";
CM_ SG_ 154 OBJ_Height_26 "The height of the object in the world. ";
CM_ SG_ 154 OBJ_Height_V_26 "Validator for object height.";
CM_ SG_ 154 OBJ_Height_STD_26 "Standard deviation for object height.";
CM_ SG_ 154 OBJ_Height_STD_V_26 "Validator for the standard deviation of object height.";
CM_ SG_ 154 OBJ_Abs_Long_Velocity_26 "Absolute longitudinal velocity.";
CM_ SG_ 154 OBJ_Abs_Long_Velocity_V_26 "Validator for absolute longitudinal velocity.";
CM_ SG_ 154 OBJ_Abs_Long_Velocity_STD_26 "Standard deviation of absolute longitudinal velocity.";
CM_ SG_ 154 OBJ_Abs_Long_Vel_STD_V_26 "Validator for the standard deviation of the absolute longitudinal velocity.";
CM_ SG_ 154 OBJ_Abs_Lat_Velocity_26 "The lateral ground speed of the object.";
CM_ SG_ 154 OBJ_Abs_Lat_Velocity_V_26 "Validator for the lateral ground speed of the object.";
CM_ SG_ 154 OBJ_Abs_Lat_Velocity_STD_26 "STD of the lateral ground speed of the object.";
CM_ SG_ 154 OBJ_Abs_Lat_Vel_STD_V_26 "Validator for the STD of the lateral ground speed of the object.";
CM_ SG_ 154 OBJ_Abs_Long_Acc_26 "The longitudinal ground acceleration of the object.";
CM_ SG_ 154 OBJ_Abs_Long_Acc_V_26 "Validator for the longitudinal ground acceleration of the object.";
CM_ SG_ 154 OBJ_Abs_Long_Acc_STD_26 "STD of the longitudinal ground acceleration of the object.";
CM_ SG_ 154 OBJ_Abs_Long_Acc_STD_V_26 "Validator for the STD of the longitudinal ground acceleration of the object.";
CM_ SG_ 154 OBJ_Abs_Lat_Acc_26 "The lateral ground acceleration of the object.";
CM_ SG_ 154 OBJ_Abs_Lat_Acc_V_26 "Validator for the lateral ground acceleration of the object.";
CM_ SG_ 154 OBJ_Abs_Lat_Acc_STD_26 "STD of the lateral ground acceleration of the object.";
CM_ SG_ 154 OBJ_Abs_Lat_Acc_STD_V_26 "Validator for the STD of the lateral ground acceleration of the object.";
CM_ SG_ 154 OBJ_Abs_Acceleration_26 "The absolute ground acceleration in the target's heading direction.";
CM_ SG_ 154 OBJ_Abs_Acceleration_V_26 "Validator for the absolute ground acceleration.";
CM_ SG_ 154 OBJ_Abs_Acc_STD_26 "STD of the absolute ground acceleration.";
CM_ SG_ 154 OBJ_Abs_Acc_STD_V_26 "Validator for the STD of the absolute ground acceleration.";
CM_ SG_ 154 OBJ_Inv_TTC_26 "Inverse TTC (time to collision).";
CM_ SG_ 154 OBJ_Inv_TTC_STD_26 "STD for inverse TTC .";
CM_ SG_ 154 OBJ_Inv_TTC_STD_V_26 "Validator for the STD for inverse TTC .";
CM_ SG_ 154 OBJ_Relative_Long_Acc_26 "The relative longitudinal ground acceleration of the object.";
CM_ SG_ 154 OBJ_Relative_Long_Acc_V_26 "Validator for the relative longitudinal ground acceleration of the object.";
CM_ SG_ 154 OBJ_Relative_Long_Acc_STD_26 "STD of the relative longitudinal ground acceleration of the object.";
CM_ SG_ 154 OBJ_Rel_Long_Acc_STD_V_26 "Validator for the STD of the relative longitudinal ground acceleration.";
CM_ SG_ 154 OBJ_Relative_Long_Velocity_26 "The relative longtitudinal speed between the target and ego vehicle. ";
CM_ SG_ 154 OBJ_Relative_Long_Velocity_V_26 "Validator for the relative longtitudinal speed.";
CM_ SG_ 154 OBJ_Relative_Long_Vel_STD_26 "STD of the relative longtitudinal speed.";
CM_ SG_ 154 OBJ_Rel_Long_Vel_STD_V_26 "Validator for the STD of the relative longtitudinal speed.";
CM_ SG_ 154 OBJ_Relative_Lat_Velocity_26 "The relative lateral speed between the target and ego vehicle. ";
CM_ SG_ 154 OBJ_Relative_Lat_Velocity_V_26 "Validator for the relative lateral speed. ";
CM_ SG_ 154 OBJ_Relative_Lat_Velocity_STD_26 "STD of the relative lateral speed. ";
CM_ SG_ 154 OBJ_Rel_Lat_Vel_STD_V_26 "Validator for the STD of the relative lateral speed. ";
CM_ SG_ 154 OBJ_Long_Distance_26 "The longitudinal distance to middle of the rear bumper (middle of the RL and RR corners) of the target.";
CM_ SG_ 154 OBJ_Long_Distance_V_26 "Validator of the longtitudinal distance field";
CM_ SG_ 154 OBJ_Long_Distance_STD_26 "STD of the  longtitudinal distance.";
CM_ SG_ 154 OBJ_Long_Distance_STD_V_26 "Validator for the STD of the  longtitudinal distance.";
CM_ SG_ 154 OBJ_Lat_Distance_26 "Lateral distance to the middle of the RL and RR corners.  ";
CM_ SG_ 154 OBJ_Lat_Distance_V_26 "Validator for the lateral distance of the object.";
CM_ SG_ 154 OBJ_Lat_Distance_STD_26 "STD of the lateral distance of the object.";
CM_ SG_ 154 OBJ_Lat_Distance_STD_V_26 "Validator for the STD of the lateral distance of the object.";
CM_ SG_ 154 OBJ_Absolute_Speed_26 "The absolute ground speed in the targets' heading direction.";
CM_ SG_ 154 OBJ_Absolute_Speed_V_26 "Validator for the absolute ground speed.";
CM_ SG_ 154 OBJ_Absolute_Speed_STD_26 "STD of the absolute ground speed.";
CM_ SG_ 154 OBJ_Absolute_Speed_STD_V_26 "Validator for the STD of the absolute ground speed.";
CM_ SG_ 154 OBJ_Heading_26 "The angle beetweenthe host longitudinal axis and target's heading (clockwise, e.g. PI/2 is a target crossing from left to right).";
CM_ SG_ 154 OBJ_Heading_V_26 "Validator for the object heading.";
CM_ SG_ 154 OBJ_Heading_STD_26 "STD of the object heading.";
CM_ SG_ 154 OBJ_Heading_STD_V_26 "Validator for the STD of the object heading.";
CM_ SG_ 154 OBJ_Angle_Rate_STD_26 "Standard deviation of the angular speed. (radians)";
CM_ SG_ 154 OBJ_Angle_Rate_STD_V_26 "Validator for the STD of the angular speed.";
CM_ SG_ 154 OBJ_Angle_Rate_26 "The momentary angular speed of the object (radians). The positive side is to the host's right.";
CM_ SG_ 154 OBJ_Angle_Rate_V_26 "Validator for the angular speed.";
CM_ SG_ 154 OBJ_Angle_Right_26 "The angle between the host longitudinal axis and the right side of the front / rear of the target (the visible one). The positive side is to the host's right.";
CM_ SG_ 154 OBJ_Angle_Right_V_26 "Validator for angleRight";
CM_ SG_ 154 OBJ_Angle_Right_STD_26 "Standard deviation of angleRight";
CM_ SG_ 154 OBJ_Angle_Right_STD_V_26 "Validator for the standard deviation of angleRight.";
CM_ SG_ 154 OBJ_Angle_Left_26 "The angle between the host longitudinal axis and the left side of the front / rear of the target (the visible one). The positive side is to the host's right.";
CM_ SG_ 154 OBJ_Angle_Left_V_26 "Validator for angleLeft.";
CM_ SG_ 154 OBJ_Angle_Left_STD_26 "Standard deviation of angleLeft.";
CM_ SG_ 154 OBJ_Angle_Left_STD_V_26 "Validator for the standard deviation of angleLeft.";
CM_ SG_ 154 OBJ_Angle_Side_26 "The angle between the host longitudinal axis and the far visible edge - the visible edge of the front / rear of the target that is not visible. Currently supported for vehicles only.";
CM_ SG_ 154 OBJ_Angle_Side_V_26 "Validator for angleSide.";
CM_ SG_ 154 OBJ_Angle_Side_STD_26 "Standard deviation of angleSide.";
CM_ SG_ 154 OBJ_Angle_Side_STD_V_26 "Validator for the STD of angleSide.";
CM_ SG_ 154 OBJ_Angle_Mid_V_26 "Validator for angleMid.";
CM_ SG_ 154 OBJ_Angle_Mid_26 "The angle between the host longitudinal axis and the middle of the front / rear of the target (the visible one). The positive side is to the host's right.";
CM_ SG_ 154 OBJ_Angle_Mid_STD_26 "Standard deviation of angleMid.";
CM_ SG_ 154 OBJ_Angle_Mid_STD_V_26 "Validator for the STD of angleMid.";
CM_ SG_ 154 OBJ_Angle_Bottom_V_26 "Validator for OBJAngle_Bottom. ";
CM_ SG_ 154 OBJ_Angle_Bottom_26 "The angle between the longitudinal axis and the Bottom of the front / rear of the target (the visible one). The positive side is to the host's bottom";
CM_ SG_ 154 OBJ_Angle_Bottom_STD_26 "STD for OBJAngle_Bottom. ";
CM_ SG_ 154 OBJ_Angle_Bottom_STD_V_26 "Validator for OBJAngle_Bottom_STD. ";
CM_ SG_ 154 OBJ_Visibility_Side_V_26 "Currently Supported for VD only";
CM_ SG_ 154 OBJ_Visibility_Side_26 "From what car  side is the object visible";
CM_ SG_ 154 OBJ_Is_In_Drivable_Area_26 "Indicates whether the target is in a driveable area.";
CM_ SG_ 154 OBJ_Is_In_Drivable_Area_V_26 "Validator for OBJ_Is_In_Drivable_Area.";
CM_ SG_ 154 OBJ_Is_VeryClose_V_26 "Validator for OBJ_Is_VeryClose. ";
CM_ SG_ 154 OBJ_Is_VeryClose_26 "Indicates whether the target is very close to the host such that it is hard to measure its distance. Currently relevant for peds only";
CM_ SG_ 154 OBJ_OverlapAngleEgoLaneR_26 "Lateral distance to the middle of the RL and RR corners.";
CM_ SG_ 154 OBJ_OverlapAngleEgoLaneR_V_26 "Validator for OBJ_OverlapAngleEgoLaneR";
CM_ SG_ 154 OBJ_OverlapAngleEgoLaneL_26 "Lateral distance to the middle of the RL and RR corners.  ";
CM_ SG_ 154 OBJ_OverlapAngleEgoLaneL_V_26 "Validator for OBJ_OverlapAngleEgoLaneL";
CM_ SG_ 154 OBJ_Is_EMERGENCY_VCL_26 "Is Object an Emergency Vehicle";
CM_ SG_ 154 OBJ_EMERGENCY_LIGHT_COLOR_26 "Emergency Color";
CM_ SG_ 154 OBJ_EMERGENCY_V_26 "Are OBJ_Is_EMERGENCY_VCL and OBJ_EMERGENCY_LIGHT_COLOR Valid";
CM_ SG_ 154 OBJ_Angle_Top_26 "From VD touching point on the ground till the roof of the car";
CM_ SG_ 154 OBJ_Angle_Top_V_26 "Validator for OBJ_Angle_Top ";
CM_ SG_ 154 OBJ_Angle_Top_STD_26 "STD for OBJ_Angle_Top";
CM_ SG_ 154 OBJ_Angle_Top_STD_V_26 "Validator for OBJ_Angle_Top_STD. ";
CM_ SG_ 154 OBJ_Open_Door_Left_26 "Indicator if left door is open";
CM_ SG_ 154 OBJ_Open_Door_Right_26 "Indicator if right door is open";
CM_ SG_ 154 OBJ_Visible_Left_or_Right_26 "This signal describes the visible Left or Right side of the Target vehicle.";
CM_ SG_ 154 OBJ_Visible_Left_or_Right_V_26 "OBJ_Visible_Left_or_Right";
CM_ SG_ 154 OBJ_2W_Is_Motorbike_Probability_26 "The probability of the Two-wheeler reported object being a Motorbike";
CM_ SG_ 154 OBJ_2W_Is_Bicycle_Probability_26 "The probability of the Two-wheeler reported object being a Bicycle";
CM_ SG_ 154 OBJ_CRC_27 "Calculated over all element signals. From the signal after the CRC until the first signal in the next elements OBJ_CRC_N+1  not including";
CM_ SG_ 154 OBJ_ID_27 "The detected object ID. Range is 1-255, while 0 indicates that the field in unfilled.";
CM_ SG_ 154 OBJ_Existence_Probability_27 "The existence probability of the reported object";
CM_ SG_ 154 OBJ_Fusion_Source_27 "sources ids used for fusion";
CM_ SG_ 154 OBJ_Triggered_SDM_27 "Indicates whether the object has trigered the SDM (Safety Diagnostic Manager) alert.";
CM_ SG_ 154 OBJ_Motion_Category_27 "Relevant for VD only. Full description of values can be found at the ACC guide.";
CM_ SG_ 154 OBJ_Moving_IN_Probability_27 "The probability the object is eventually move into ego lane. (In case that the OBJ_Motion_Category signal is set to  MOVING_IN ";
CM_ SG_ 154 OBJ_Object_Age_27 "The number of frames in which the object was recognized.";
CM_ SG_ 154 OBJ_Measuring_Status_27 "Measurment status. Old vs New marks if this is the first frame in which the object is reported. Predicted vs Measured marks if the report is raw or has been predicted forward in time using the measured dynamics and ego motion.";
CM_ SG_ 154 OBJ_Object_Class_27 "Indicates the object type. Uncertain is outputted in case the probability that a vehicle is a truck is very similar to the probability that it is a car.";
CM_ SG_ 154 OBJ_Class_Probability_27 "The probability of this type classification.";
CM_ SG_ 154 OBJ_Car_Probability_27 "The probability the object is a car";
CM_ SG_ 154 OBJ_Truck_Probability_27 "The probability the object is a Truck";
CM_ SG_ 154 OBJ_Bike_Probability_27 "The probability the object is a Bike";
CM_ SG_ 154 OBJ_Camera_Source_27 "The camera in which this object was detected (best choice).";
CM_ SG_ 154 OBJ_Motion_Status_27 "MOVING - the object is moving STATIONARY - the object was never seen moving STOPPED -  the object was moving and has stopped MOVING_SLOWLY - the object is moving very slowly";
CM_ SG_ 154 OBJ_Motion_Orientation_27 "The direction of the targets heading compared to the host. ";
CM_ SG_ 154 OBJ_Has_Cut_Lane_27 "Indicates whether the object cut the host's (right or left) lane. In case there are no lanes, indicates whether the objects is at most 1 meters away from the host.";
CM_ SG_ 154 OBJ_Has_Cut_Path_27 "Indicates whether the object is in the host's path.";
CM_ SG_ 154 OBJ_Brake_Light_Validity_27 "Validator for braking light indicator";
CM_ SG_ 154 OBJ_Brake_Light_27 "Indication for brake lights ";
CM_ SG_ 154 OBJ_Turn_Indicator_Right_27 "Indication for blinking right light.";
CM_ SG_ 154 OBJ_Turn_Indicator_Left_27 "Indication for blinking left light ";
CM_ SG_ 154 OBJ_Turn_Indicator_Validity_27 "Validator for light indicators";
CM_ SG_ 154 OBJ_Right_Out_Of_Image_27 "Indicates whether the measurment are predicted out of the right side of the image bounderies.";
CM_ SG_ 154 OBJ_Left_Out_Of_Image_27 "Indicates whether if measurment are predicted out of  the left side of the image bounderies";
CM_ SG_ 154 OBJ_Right_Out_Of_Image_V_27 "validator";
CM_ SG_ 154 OBJ_Left_Out_Of_Image_V_27 "validator";
CM_ SG_ 154 OBJ_Top_Out_Of_Image_27 "Indicates whether if measurment are predicted out of  the top of the image bounderies";
CM_ SG_ 154 OBJ_Bottom_Out_Of_Image_27 "Indicates whether if measurment are predicted out of  the bottom of the image bounderies";
CM_ SG_ 154 OBJ_Top_Out_Of_Image_V_27 "validator";
CM_ SG_ 154 OBJ_Bottom_Out_Of_Image_V_27 "validator";
CM_ SG_ 154 OBJ_Lane_Assignment_27 "The object's lane relative to the host lane.";
CM_ SG_ 154 OBJ_Lane_Assignment_V_27 "Validator for lane assignment";
CM_ SG_ 154 OBJ_Age_Seconds_27 "Time in seconds in which the object was recognized. ";
CM_ SG_ 154 OBJ_Age_Seconds_V_27 "Validator for object age";
CM_ SG_ 154 OBJ_Width_27 "The width of the target vehicle in the world (not to be mistaken with the width of the visible part of the vehicle).";
CM_ SG_ 154 OBJ_Width_V_27 "Validator for object width";
CM_ SG_ 154 OBJ_Width_STD_27 "Standard deviation for object width";
CM_ SG_ 154 OBJ_Width_STD_V_27 "Validator for the standard deviation of object width";
CM_ SG_ 154 OBJ_Length_27 "The length of the vehicle in the world. For crossing bicycles it gives the viewed length of the bicycle.";
CM_ SG_ 154 OBJ_Length_V_27 "Validator for object length.";
CM_ SG_ 154 OBJ_Length_STD_27 "Standard deviation for object length.";
CM_ SG_ 154 OBJ_Length_STD_V_27 "Validator for the standard deviation of object length.";
CM_ SG_ 154 OBJ_Radar_ID_27 "Radar Object ID of the Fused Object, Only relvant when OBJ_Fusion_Source is not Camera only";
CM_ SG_ 154 OBJ_Height_27 "The height of the object in the world. ";
CM_ SG_ 154 OBJ_Height_V_27 "Validator for object height.";
CM_ SG_ 154 OBJ_Height_STD_27 "Standard deviation for object height.";
CM_ SG_ 154 OBJ_Height_STD_V_27 "Validator for the standard deviation of object height.";
CM_ SG_ 154 OBJ_Abs_Long_Velocity_27 "Absolute longitudinal velocity.";
CM_ SG_ 154 OBJ_Abs_Long_Velocity_V_27 "Validator for absolute longitudinal velocity.";
CM_ SG_ 154 OBJ_Abs_Long_Velocity_STD_27 "Standard deviation of absolute longitudinal velocity.";
CM_ SG_ 154 OBJ_Abs_Long_Vel_STD_V_27 "Validator for the standard deviation of the absolute longitudinal velocity.";
CM_ SG_ 154 OBJ_Abs_Lat_Velocity_27 "The lateral ground speed of the object.";
CM_ SG_ 154 OBJ_Abs_Lat_Velocity_V_27 "Validator for the lateral ground speed of the object.";
CM_ SG_ 154 OBJ_Abs_Lat_Velocity_STD_27 "STD of the lateral ground speed of the object.";
CM_ SG_ 154 OBJ_Abs_Lat_Vel_STD_V_27 "Validator for the STD of the lateral ground speed of the object.";
CM_ SG_ 154 OBJ_Abs_Long_Acc_27 "The longitudinal ground acceleration of the object.";
CM_ SG_ 154 OBJ_Abs_Long_Acc_V_27 "Validator for the longitudinal ground acceleration of the object.";
CM_ SG_ 154 OBJ_Abs_Long_Acc_STD_27 "STD of the longitudinal ground acceleration of the object.";
CM_ SG_ 154 OBJ_Abs_Long_Acc_STD_V_27 "Validator for the STD of the longitudinal ground acceleration of the object.";
CM_ SG_ 154 OBJ_Abs_Lat_Acc_27 "The lateral ground acceleration of the object.";
CM_ SG_ 154 OBJ_Abs_Lat_Acc_V_27 "Validator for the lateral ground acceleration of the object.";
CM_ SG_ 154 OBJ_Abs_Lat_Acc_STD_27 "STD of the lateral ground acceleration of the object.";
CM_ SG_ 154 OBJ_Abs_Lat_Acc_STD_V_27 "Validator for the STD of the lateral ground acceleration of the object.";
CM_ SG_ 154 OBJ_Abs_Acceleration_27 "The absolute ground acceleration in the target's heading direction.";
CM_ SG_ 154 OBJ_Abs_Acceleration_V_27 "Validator for the absolute ground acceleration.";
CM_ SG_ 154 OBJ_Abs_Acc_STD_27 "STD of the absolute ground acceleration.";
CM_ SG_ 154 OBJ_Abs_Acc_STD_V_27 "Validator for the STD of the absolute ground acceleration.";
CM_ SG_ 154 OBJ_Inv_TTC_27 "Inverse TTC (time to collision).";
CM_ SG_ 154 OBJ_Inv_TTC_STD_27 "STD for inverse TTC .";
CM_ SG_ 154 OBJ_Inv_TTC_STD_V_27 "Validator for the STD for inverse TTC .";
CM_ SG_ 154 OBJ_Relative_Long_Acc_27 "The relative longitudinal ground acceleration of the object.";
CM_ SG_ 154 OBJ_Relative_Long_Acc_V_27 "Validator for the relative longitudinal ground acceleration of the object.";
CM_ SG_ 154 OBJ_Relative_Long_Acc_STD_27 "STD of the relative longitudinal ground acceleration of the object.";
CM_ SG_ 154 OBJ_Rel_Long_Acc_STD_V_27 "Validator for the STD of the relative longitudinal ground acceleration.";
CM_ SG_ 154 OBJ_Relative_Long_Velocity_27 "The relative longtitudinal speed between the target and ego vehicle. ";
CM_ SG_ 154 OBJ_Relative_Long_Velocity_V_27 "Validator for the relative longtitudinal speed.";
CM_ SG_ 154 OBJ_Relative_Long_Vel_STD_27 "STD of the relative longtitudinal speed.";
CM_ SG_ 154 OBJ_Rel_Long_Vel_STD_V_27 "Validator for the STD of the relative longtitudinal speed.";
CM_ SG_ 154 OBJ_Relative_Lat_Velocity_27 "The relative lateral speed between the target and ego vehicle. ";
CM_ SG_ 154 OBJ_Relative_Lat_Velocity_V_27 "Validator for the relative lateral speed. ";
CM_ SG_ 154 OBJ_Relative_Lat_Velocity_STD_27 "STD of the relative lateral speed. ";
CM_ SG_ 154 OBJ_Rel_Lat_Vel_STD_V_27 "Validator for the STD of the relative lateral speed. ";
CM_ SG_ 154 OBJ_Long_Distance_27 "The longitudinal distance to middle of the rear bumper (middle of the RL and RR corners) of the target.";
CM_ SG_ 154 OBJ_Long_Distance_V_27 "Validator of the longtitudinal distance field";
CM_ SG_ 154 OBJ_Long_Distance_STD_27 "STD of the  longtitudinal distance.";
CM_ SG_ 154 OBJ_Long_Distance_STD_V_27 "Validator for the STD of the  longtitudinal distance.";
CM_ SG_ 154 OBJ_Lat_Distance_27 "Lateral distance to the middle of the RL and RR corners.  ";
CM_ SG_ 154 OBJ_Lat_Distance_V_27 "Validator for the lateral distance of the object.";
CM_ SG_ 154 OBJ_Lat_Distance_STD_27 "STD of the lateral distance of the object.";
CM_ SG_ 154 OBJ_Lat_Distance_STD_V_27 "Validator for the STD of the lateral distance of the object.";
CM_ SG_ 154 OBJ_Absolute_Speed_27 "The absolute ground speed in the targets' heading direction.";
CM_ SG_ 154 OBJ_Absolute_Speed_V_27 "Validator for the absolute ground speed.";
CM_ SG_ 154 OBJ_Absolute_Speed_STD_27 "STD of the absolute ground speed.";
CM_ SG_ 154 OBJ_Absolute_Speed_STD_V_27 "Validator for the STD of the absolute ground speed.";
CM_ SG_ 154 OBJ_Heading_27 "The angle beetweenthe host longitudinal axis and target's heading (clockwise, e.g. PI/2 is a target crossing from left to right).";
CM_ SG_ 154 OBJ_Heading_V_27 "Validator for the object heading.";
CM_ SG_ 154 OBJ_Heading_STD_27 "STD of the object heading.";
CM_ SG_ 154 OBJ_Heading_STD_V_27 "Validator for the STD of the object heading.";
CM_ SG_ 154 OBJ_Angle_Rate_STD_27 "Standard deviation of the angular speed. (radians)";
CM_ SG_ 154 OBJ_Angle_Rate_STD_V_27 "Validator for the STD of the angular speed.";
CM_ SG_ 154 OBJ_Angle_Rate_27 "The momentary angular speed of the object (radians). The positive side is to the host's right.";
CM_ SG_ 154 OBJ_Angle_Rate_V_27 "Validator for the angular speed.";
CM_ SG_ 154 OBJ_Angle_Right_27 "The angle between the host longitudinal axis and the right side of the front / rear of the target (the visible one). The positive side is to the host's right.";
CM_ SG_ 154 OBJ_Angle_Right_V_27 "Validator for angleRight";
CM_ SG_ 154 OBJ_Angle_Right_STD_27 "Standard deviation of angleRight";
CM_ SG_ 154 OBJ_Angle_Right_STD_V_27 "Validator for the standard deviation of angleRight.";
CM_ SG_ 154 OBJ_Angle_Left_27 "The angle between the host longitudinal axis and the left side of the front / rear of the target (the visible one). The positive side is to the host's right.";
CM_ SG_ 154 OBJ_Angle_Left_V_27 "Validator for angleLeft.";
CM_ SG_ 154 OBJ_Angle_Left_STD_27 "Standard deviation of angleLeft.";
CM_ SG_ 154 OBJ_Angle_Left_STD_V_27 "Validator for the standard deviation of angleLeft.";
CM_ SG_ 154 OBJ_Angle_Side_27 "The angle between the host longitudinal axis and the far visible edge - the visible edge of the front / rear of the target that is not visible. Currently supported for vehicles only.";
CM_ SG_ 154 OBJ_Angle_Side_V_27 "Validator for angleSide.";
CM_ SG_ 154 OBJ_Angle_Side_STD_27 "Standard deviation of angleSide.";
CM_ SG_ 154 OBJ_Angle_Side_STD_V_27 "Validator for the STD of angleSide.";
CM_ SG_ 154 OBJ_Angle_Mid_V_27 "Validator for angleMid.";
CM_ SG_ 154 OBJ_Angle_Mid_27 "The angle between the host longitudinal axis and the middle of the front / rear of the target (the visible one). The positive side is to the host's right.";
CM_ SG_ 154 OBJ_Angle_Mid_STD_27 "Standard deviation of angleMid.";
CM_ SG_ 154 OBJ_Angle_Mid_STD_V_27 "Validator for the STD of angleMid.";
CM_ SG_ 154 OBJ_Angle_Bottom_V_27 "Validator for OBJAngle_Bottom. ";
CM_ SG_ 154 OBJ_Angle_Bottom_27 "The angle between the longitudinal axis and the Bottom of the front / rear of the target (the visible one). The positive side is to the host's bottom";
CM_ SG_ 154 OBJ_Angle_Bottom_STD_27 "STD for OBJAngle_Bottom. ";
CM_ SG_ 154 OBJ_Angle_Bottom_STD_V_27 "Validator for OBJAngle_Bottom_STD. ";
CM_ SG_ 154 OBJ_Visibility_Side_V_27 "Currently Supported for VD only";
CM_ SG_ 154 OBJ_Visibility_Side_27 "From what car  side is the object visible";
CM_ SG_ 154 OBJ_Is_In_Drivable_Area_27 "Indicates whether the target is in a driveable area.";
CM_ SG_ 154 OBJ_Is_In_Drivable_Area_V_27 "Validator for OBJ_Is_In_Drivable_Area.";
CM_ SG_ 154 OBJ_Is_VeryClose_V_27 "Validator for OBJ_Is_VeryClose. ";
CM_ SG_ 154 OBJ_Is_VeryClose_27 "Indicates whether the target is very close to the host such that it is hard to measure its distance. Currently relevant for peds only";
CM_ SG_ 154 OBJ_OverlapAngleEgoLaneR_27 "Lateral distance to the middle of the RL and RR corners.";
CM_ SG_ 154 OBJ_OverlapAngleEgoLaneR_V_27 "Validator for OBJ_OverlapAngleEgoLaneR";
CM_ SG_ 154 OBJ_OverlapAngleEgoLaneL_27 "Lateral distance to the middle of the RL and RR corners.  ";
CM_ SG_ 154 OBJ_OverlapAngleEgoLaneL_V_27 "Validator for OBJ_OverlapAngleEgoLaneL";
CM_ SG_ 154 OBJ_Is_EMERGENCY_VCL_27 "Is Object an Emergency Vehicle";
CM_ SG_ 154 OBJ_EMERGENCY_LIGHT_COLOR_27 "Emergency Color";
CM_ SG_ 154 OBJ_EMERGENCY_V_27 "Are OBJ_Is_EMERGENCY_VCL and OBJ_EMERGENCY_LIGHT_COLOR Valid";
CM_ SG_ 154 OBJ_Angle_Top_27 "From VD touching point on the ground till the roof of the car";
CM_ SG_ 154 OBJ_Angle_Top_V_27 "Validator for OBJ_Angle_Top ";
CM_ SG_ 154 OBJ_Angle_Top_STD_27 "STD for OBJ_Angle_Top";
CM_ SG_ 154 OBJ_Angle_Top_STD_V_27 "Validator for OBJ_Angle_Top_STD. ";
CM_ SG_ 154 OBJ_Open_Door_Left_27 "Indicator if left door is open";
CM_ SG_ 154 OBJ_Open_Door_Right_27 "Indicator if right door is open";
CM_ SG_ 154 OBJ_Visible_Left_or_Right_27 "This signal describes the visible Left or Right side of the Target vehicle.";
CM_ SG_ 154 OBJ_Visible_Left_or_Right_V_27 "OBJ_Visible_Left_or_Right";
CM_ SG_ 154 OBJ_2W_Is_Motorbike_Probability_27 "The probability of the Two-wheeler reported object being a Motorbike";
CM_ SG_ 154 OBJ_2W_Is_Bicycle_Probability_27 "The probability of the Two-wheeler reported object being a Bicycle";
CM_ SG_ 154 OBJ_CRC_28 "Calculated over all element signals. From the signal after the CRC until the first signal in the next elements OBJ_CRC_N+1  not including";
CM_ SG_ 154 OBJ_ID_28 "The detected object ID. Range is 1-255, while 0 indicates that the field in unfilled.";
CM_ SG_ 154 OBJ_Existence_Probability_28 "The existence probability of the reported object";
CM_ SG_ 154 OBJ_Fusion_Source_28 "sources ids used for fusion";
CM_ SG_ 154 OBJ_Triggered_SDM_28 "Indicates whether the object has trigered the SDM (Safety Diagnostic Manager) alert.";
CM_ SG_ 154 OBJ_Motion_Category_28 "Relevant for VD only. Full description of values can be found at the ACC guide.";
CM_ SG_ 154 OBJ_Moving_IN_Probability_28 "The probability the object is eventually move into ego lane. (In case that the OBJ_Motion_Category signal is set to  MOVING_IN ";
CM_ SG_ 154 OBJ_Object_Age_28 "The number of frames in which the object was recognized.";
CM_ SG_ 154 OBJ_Measuring_Status_28 "Measurment status. Old vs New marks if this is the first frame in which the object is reported. Predicted vs Measured marks if the report is raw or has been predicted forward in time using the measured dynamics and ego motion.";
CM_ SG_ 154 OBJ_Object_Class_28 "Indicates the object type. Uncertain is outputted in case the probability that a vehicle is a truck is very similar to the probability that it is a car.";
CM_ SG_ 154 OBJ_Class_Probability_28 "The probability of this type classification.";
CM_ SG_ 154 OBJ_Car_Probability_28 "The probability the object is a car";
CM_ SG_ 154 OBJ_Truck_Probability_28 "The probability the object is a Truck";
CM_ SG_ 154 OBJ_Bike_Probability_28 "The probability the object is a Bike";
CM_ SG_ 154 OBJ_Camera_Source_28 "The camera in which this object was detected (best choice).";
CM_ SG_ 154 OBJ_Motion_Status_28 "MOVING - the object is moving STATIONARY - the object was never seen moving STOPPED -  the object was moving and has stopped MOVING_SLOWLY - the object is moving very slowly";
CM_ SG_ 154 OBJ_Motion_Orientation_28 "The direction of the targets heading compared to the host. ";
CM_ SG_ 154 OBJ_Has_Cut_Lane_28 "Indicates whether the object cut the host's (right or left) lane. In case there are no lanes, indicates whether the objects is at most 1 meters away from the host.";
CM_ SG_ 154 OBJ_Has_Cut_Path_28 "Indicates whether the object is in the host's path.";
CM_ SG_ 154 OBJ_Brake_Light_Validity_28 "Validator for braking light indicator";
CM_ SG_ 154 OBJ_Brake_Light_28 "Indication for brake lights ";
CM_ SG_ 154 OBJ_Turn_Indicator_Right_28 "Indication for blinking right light.";
CM_ SG_ 154 OBJ_Turn_Indicator_Left_28 "Indication for blinking left light ";
CM_ SG_ 154 OBJ_Turn_Indicator_Validity_28 "Validator for light indicators";
CM_ SG_ 154 OBJ_Right_Out_Of_Image_28 "Indicates whether the measurment are predicted out of the right side of the image bounderies.";
CM_ SG_ 154 OBJ_Left_Out_Of_Image_28 "Indicates whether if measurment are predicted out of  the left side of the image bounderies";
CM_ SG_ 154 OBJ_Right_Out_Of_Image_V_28 "validator";
CM_ SG_ 154 OBJ_Left_Out_Of_Image_V_28 "validator";
CM_ SG_ 154 OBJ_Top_Out_Of_Image_28 "Indicates whether if measurment are predicted out of  the top of the image bounderies";
CM_ SG_ 154 OBJ_Bottom_Out_Of_Image_28 "Indicates whether if measurment are predicted out of  the bottom of the image bounderies";
CM_ SG_ 154 OBJ_Top_Out_Of_Image_V_28 "validator";
CM_ SG_ 154 OBJ_Bottom_Out_Of_Image_V_28 "validator";
CM_ SG_ 154 OBJ_Lane_Assignment_28 "The object's lane relative to the host lane.";
CM_ SG_ 154 OBJ_Lane_Assignment_V_28 "Validator for lane assignment";
CM_ SG_ 154 OBJ_Age_Seconds_28 "Time in seconds in which the object was recognized. ";
CM_ SG_ 154 OBJ_Age_Seconds_V_28 "Validator for object age";
CM_ SG_ 154 OBJ_Width_28 "The width of the target vehicle in the world (not to be mistaken with the width of the visible part of the vehicle).";
CM_ SG_ 154 OBJ_Width_V_28 "Validator for object width";
CM_ SG_ 154 OBJ_Width_STD_28 "Standard deviation for object width";
CM_ SG_ 154 OBJ_Width_STD_V_28 "Validator for the standard deviation of object width";
CM_ SG_ 154 OBJ_Length_28 "The length of the vehicle in the world. For crossing bicycles it gives the viewed length of the bicycle.";
CM_ SG_ 154 OBJ_Length_V_28 "Validator for object length.";
CM_ SG_ 154 OBJ_Length_STD_28 "Standard deviation for object length.";
CM_ SG_ 154 OBJ_Length_STD_V_28 "Validator for the standard deviation of object length.";
CM_ SG_ 154 OBJ_Radar_ID_28 "Radar Object ID of the Fused Object, Only relvant when OBJ_Fusion_Source is not Camera only";
CM_ SG_ 154 OBJ_Height_28 "The height of the object in the world. ";
CM_ SG_ 154 OBJ_Height_V_28 "Validator for object height.";
CM_ SG_ 154 OBJ_Height_STD_28 "Standard deviation for object height.";
CM_ SG_ 154 OBJ_Height_STD_V_28 "Validator for the standard deviation of object height.";
CM_ SG_ 154 OBJ_Abs_Long_Velocity_28 "Absolute longitudinal velocity.";
CM_ SG_ 154 OBJ_Abs_Long_Velocity_V_28 "Validator for absolute longitudinal velocity.";
CM_ SG_ 154 OBJ_Abs_Long_Velocity_STD_28 "Standard deviation of absolute longitudinal velocity.";
CM_ SG_ 154 OBJ_Abs_Long_Vel_STD_V_28 "Validator for the standard deviation of the absolute longitudinal velocity.";
CM_ SG_ 154 OBJ_Abs_Lat_Velocity_28 "The lateral ground speed of the object.";
CM_ SG_ 154 OBJ_Abs_Lat_Velocity_V_28 "Validator for the lateral ground speed of the object.";
CM_ SG_ 154 OBJ_Abs_Lat_Velocity_STD_28 "STD of the lateral ground speed of the object.";
CM_ SG_ 154 OBJ_Abs_Lat_Vel_STD_V_28 "Validator for the STD of the lateral ground speed of the object.";
CM_ SG_ 154 OBJ_Abs_Long_Acc_28 "The longitudinal ground acceleration of the object.";
CM_ SG_ 154 OBJ_Abs_Long_Acc_V_28 "Validator for the longitudinal ground acceleration of the object.";
CM_ SG_ 154 OBJ_Abs_Long_Acc_STD_28 "STD of the longitudinal ground acceleration of the object.";
CM_ SG_ 154 OBJ_Abs_Long_Acc_STD_V_28 "Validator for the STD of the longitudinal ground acceleration of the object.";
CM_ SG_ 154 OBJ_Abs_Lat_Acc_28 "The lateral ground acceleration of the object.";
CM_ SG_ 154 OBJ_Abs_Lat_Acc_V_28 "Validator for the lateral ground acceleration of the object.";
CM_ SG_ 154 OBJ_Abs_Lat_Acc_STD_28 "STD of the lateral ground acceleration of the object.";
CM_ SG_ 154 OBJ_Abs_Lat_Acc_STD_V_28 "Validator for the STD of the lateral ground acceleration of the object.";
CM_ SG_ 154 OBJ_Abs_Acceleration_28 "The absolute ground acceleration in the target's heading direction.";
CM_ SG_ 154 OBJ_Abs_Acceleration_V_28 "Validator for the absolute ground acceleration.";
CM_ SG_ 154 OBJ_Abs_Acc_STD_28 "STD of the absolute ground acceleration.";
CM_ SG_ 154 OBJ_Abs_Acc_STD_V_28 "Validator for the STD of the absolute ground acceleration.";
CM_ SG_ 154 OBJ_Inv_TTC_28 "Inverse TTC (time to collision).";
CM_ SG_ 154 OBJ_Inv_TTC_STD_28 "STD for inverse TTC .";
CM_ SG_ 154 OBJ_Inv_TTC_STD_V_28 "Validator for the STD for inverse TTC .";
CM_ SG_ 154 OBJ_Relative_Long_Acc_28 "The relative longitudinal ground acceleration of the object.";
CM_ SG_ 154 OBJ_Relative_Long_Acc_V_28 "Validator for the relative longitudinal ground acceleration of the object.";
CM_ SG_ 154 OBJ_Relative_Long_Acc_STD_28 "STD of the relative longitudinal ground acceleration of the object.";
CM_ SG_ 154 OBJ_Rel_Long_Acc_STD_V_28 "Validator for the STD of the relative longitudinal ground acceleration.";
CM_ SG_ 154 OBJ_Relative_Long_Velocity_28 "The relative longtitudinal speed between the target and ego vehicle. ";
CM_ SG_ 154 OBJ_Relative_Long_Velocity_V_28 "Validator for the relative longtitudinal speed.";
CM_ SG_ 154 OBJ_Relative_Long_Vel_STD_28 "STD of the relative longtitudinal speed.";
CM_ SG_ 154 OBJ_Rel_Long_Vel_STD_V_28 "Validator for the STD of the relative longtitudinal speed.";
CM_ SG_ 154 OBJ_Relative_Lat_Velocity_28 "The relative lateral speed between the target and ego vehicle. ";
CM_ SG_ 154 OBJ_Relative_Lat_Velocity_V_28 "Validator for the relative lateral speed. ";
CM_ SG_ 154 OBJ_Relative_Lat_Velocity_STD_28 "STD of the relative lateral speed. ";
CM_ SG_ 154 OBJ_Rel_Lat_Vel_STD_V_28 "Validator for the STD of the relative lateral speed. ";
CM_ SG_ 154 OBJ_Long_Distance_28 "The longitudinal distance to middle of the rear bumper (middle of the RL and RR corners) of the target.";
CM_ SG_ 154 OBJ_Long_Distance_V_28 "Validator of the longtitudinal distance field";
CM_ SG_ 154 OBJ_Long_Distance_STD_28 "STD of the  longtitudinal distance.";
CM_ SG_ 154 OBJ_Long_Distance_STD_V_28 "Validator for the STD of the  longtitudinal distance.";
CM_ SG_ 154 OBJ_Lat_Distance_28 "Lateral distance to the middle of the RL and RR corners.  ";
CM_ SG_ 154 OBJ_Lat_Distance_V_28 "Validator for the lateral distance of the object.";
CM_ SG_ 154 OBJ_Lat_Distance_STD_28 "STD of the lateral distance of the object.";
CM_ SG_ 154 OBJ_Lat_Distance_STD_V_28 "Validator for the STD of the lateral distance of the object.";
CM_ SG_ 154 OBJ_Absolute_Speed_28 "The absolute ground speed in the targets' heading direction.";
CM_ SG_ 154 OBJ_Absolute_Speed_V_28 "Validator for the absolute ground speed.";
CM_ SG_ 154 OBJ_Absolute_Speed_STD_28 "STD of the absolute ground speed.";
BA_DEF_ SG_  "GenSigStartValue" INT 0 0;
BA_DEF_DEF_  "GenSigStartValue" 0;
BA_ "GenSigStartValue" SG_ 154 OBJ_Width_23 40;
BA_ "GenSigStartValue" SG_ 154 OBJ_Length_23 12;
BA_ "GenSigStartValue" SG_ 154 OBJ_Width_24 40;
BA_ "GenSigStartValue" SG_ 154 OBJ_Length_24 12;
BA_ "GenSigStartValue" SG_ 154 OBJ_Width_25 40;
BA_ "GenSigStartValue" SG_ 154 OBJ_Length_25 12;
BA_ "GenSigStartValue" SG_ 154 OBJ_Width_26 40;
BA_ "GenSigStartValue" SG_ 154 OBJ_Length_26 12;
BA_ "GenSigStartValue" SG_ 154 OBJ_Width_27 40;
BA_ "GenSigStartValue" SG_ 154 OBJ_Length_27 12;
BA_ "GenSigStartValue" SG_ 154 OBJ_Width_28 40;
BA_ "GenSigStartValue" SG_ 154 OBJ_Length_28 12;
VAL_ 154 OBJ_Angle_Top_V_22 1 "VALID" 0 "INVALID" ;
VAL_ 154 OBJ_Angle_Top_STD_V_22 1 "VALID" 0 "INVALID" ;
VAL_ 154 OBJ_Open_Door_Left_22 1 "TRUE" 0 "FALSE" ;
VAL_ 154 OBJ_Open_Door_Right_22 1 "TRUE" 0 "FALSE" ;
VAL_ 154 OBJ_Visible_Left_or_Right_22 2 "RIGHT" 1 "LEFT" 0 "NOT_VISIBLE" ;
VAL_ 154 OBJ_Visible_Left_or_Right_V_22 1 "VALID" 0 "INVALID" ;
VAL_ 154 OBJ_Fusion_Source_23 2 "(BIT_2)RADAR2" 1 "(BIT_1)RADAR1" 0 "(BIT_0)CAMERA" ;
VAL_ 154 OBJ_Triggered_SDM_23 2 "NOT_TRIGGERED" 1 "TRIGGERED" 0 "NOT_AVAILABLE" ;
VAL_ 154 OBJ_Motion_Category_23 13 "ONCOMING" 12 "PRECEEDING" 11 "MOVING" 10 "RTAP" 9 "LTAP" 8 "CROSSING" 7 "MOVING_OUT" 6 "MOVING_IN" 5 "CLOSE_CUT_IN" 4 "PASSING_OUT" 3 "PASSING_IN" 2 "PASSING" 1 "UNDEFINED" 0 "UNFILLED" ;
VAL_ 154 OBJ_Measuring_Status_23 2 "(BIT_2)NOT_VALID_OR_VALID" 1 "(BIT_1)PREDICTED_OR_MEASURED" 0 "(BIT_0)OLD_OR_NEW" ;
VAL_ 154 OBJ_Object_Class_23 9 "TWO_WHEELER" 8 "UNCERTAIN_VCL" 7 "ANIMAL" 6 "GENERAL_OBJECT" 5 "PEDESTRIAN" 4 "BICYCLE" 3 "MOTORBIKE" 2 "TRUCK" 1 "CAR" 0 "UNFILLED" ;
VAL_ 154 OBJ_Camera_Source_23 11 "PARKING_RIGHT" 10 "PARKING_LEFT" 9 "PARKING_REAR" 8 "PARKING_FRONT" 7 "FRONT_CORNER_RIGHT" 6 "FRONT_CORNER_LEFT" 5 "REAR_CORNER_RIGHT" 4 "REAR_CORNER_LEFT" 3 "REAR" 2 "FRONT_FISHEYE" 1 "FRONT_NARROW" 0 "FRONT_MAIN" ;
VAL_ 154 OBJ_Motion_Status_23 5 "MOVING_SLOWLY" 4 "STOPPED" 3 "STATIONARY" 2 "MOVING" 1 "UNKNOWN" 0 "INVALID" ;
VAL_ 154 OBJ_Motion_Orientation_23 13 "INVALID" 12 "NORTH" 11 "NORTH_WEST" 9 "WEST" 7 "SOUTH_WEST" 6 "SOUTH" 5 "SOUTH_EAST" 3 "EAST" 1 "NORTH_EAST" 0 "UNKNOWN" ;
VAL_ 154 OBJ_Has_Cut_Lane_23 1 "TRUE" 0 "FALSE" ;
VAL_ 154 OBJ_Has_Cut_Path_23 1 "TRUE" 0 "FALSE" ;
VAL_ 154 OBJ_Brake_Light_Validity_23 1 "TRUE" 0 "FALSE" ;
VAL_ 154 OBJ_Brake_Light_23 1 "TRUE" 0 "FALSE" ;
VAL_ 154 OBJ_Turn_Indicator_Right_23 1 "TRUE" 0 "FALSE" ;
VAL_ 154 OBJ_Turn_Indicator_Left_23 1 "TRUE" 0 "FALSE" ;
VAL_ 154 OBJ_Turn_Indicator_Validity_23 1 "TRUE" 0 "FALSE" ;
VAL_ 154 OBJ_Right_Out_Of_Image_23 1 "TRUE" 0 "FALSE" ;
VAL_ 154 OBJ_Left_Out_Of_Image_23 1 "TRUE" 0 "FALSE" ;
VAL_ 154 OBJ_Right_Out_Of_Image_V_23 1 "TRUE" 0 "FALSE" ;
VAL_ 154 OBJ_Left_Out_Of_Image_V_23 1 "TRUE" 0 "FALSE" ;
VAL_ 154 OBJ_Top_Out_Of_Image_23 1 "TRUE" 0 "FALSE" ;
VAL_ 154 OBJ_Bottom_Out_Of_Image_23 1 "TRUE" 0 "FALSE" ;
VAL_ 154 OBJ_Top_Out_Of_Image_V_23 1 "VALID" 0 "INVALID" ;
VAL_ 154 OBJ_Bottom_Out_Of_Image_V_23 1 "VALID" 0 "INVALID" ;
VAL_ 154 OBJ_Lane_Assignment_23 5 "RIGHT_RIGHT" 4 "RIGHT" 3 "HOST" 2 "LEFT" 1 "LEFT_LEFT" 0 "UNKNOWN" ;
VAL_ 154 OBJ_Lane_Assignment_V_23 1 "VALID" 0 "INVALID" ;
VAL_ 154 OBJ_Age_Seconds_V_23 1 "VALID" 0 "INVALID" ;
VAL_ 154 OBJ_Width_V_23 1 "VALID" 0 "INVALID" ;
VAL_ 154 OBJ_Width_STD_V_23 1 "VALID" 0 "INVALID" ;
VAL_ 154 OBJ_Length_V_23 1 "VALID" 0 "INVALID" ;
VAL_ 154 OBJ_Length_STD_V_23 1 "VALID" 0 "INVALID" ;
VAL_ 154 OBJ_Height_V_23 1 "VALID" 0 "INVALID" ;
VAL_ 154 OBJ_Height_STD_V_23 1 "VALID" 0 "INVALID" ;
VAL_ 154 OBJ_Abs_Long_Velocity_V_23 1 "VALID" 0 "INVALID" ;
VAL_ 154 OBJ_Abs_Long_Vel_STD_V_23 1 "VALID" 0 "INVALID" ;
VAL_ 154 OBJ_Abs_Lat_Velocity_V_23 1 "VALID" 0 "INVALID" ;
VAL_ 154 OBJ_Abs_Lat_Vel_STD_V_23 1 "VALID" 0 "INVALID" ;
VAL_ 154 OBJ_Abs_Long_Acc_V_23 1 "VALID" 0 "INVALID" ;
VAL_ 154 OBJ_Abs_Long_Acc_STD_V_23 1 "VALID" 0 "INVALID" ;
VAL_ 154 OBJ_Abs_Lat_Acc_V_23 1 "VALID" 0 "INVALID" ;
VAL_ 154 OBJ_Abs_Lat_Acc_STD_V_23 1 "VALID" 0 "INVALID" ;
VAL_ 154 OBJ_Abs_Acceleration_V_23 1 "VALID" 0 "INVALID" ;
VAL_ 154 OBJ_Abs_Acc_STD_V_23 1 "VALID" 0 "INVALID" ;
VAL_ 154 OBJ_Inv_TTC_V_23 1 "VALID" 0 "INVALID" ;
VAL_ 154 OBJ_Inv_TTC_STD_V_23 1 "VALID" 0 "INVALID" ;
VAL_ 154 OBJ_Relative_Long_Acc_V_23 1 "VALID" 0 "INVALID" ;
VAL_ 154 OBJ_Rel_Long_Acc_STD_V_23 1 "VALID" 0 "INVALID" ;
VAL_ 154 OBJ_Relative_Long_Velocity_V_23 1 "VALID" 0 "INVALID" ;
VAL_ 154 OBJ_Rel_Long_Vel_STD_V_23 1 "VALID" 0 "INVALID" ;
VAL_ 154 OBJ_Relative_Lat_Velocity_V_23 1 "VALID" 0 "INVALID" ;
VAL_ 154 OBJ_Rel_Lat_Vel_STD_V_23 1 "VALID" 0 "INVALID" ;
VAL_ 154 OBJ_Long_Distance_V_23 1 "VALID" 0 "INVALID" ;
VAL_ 154 OBJ_Long_Distance_STD_V_23 1 "VALID" 0 "INVALID" ;
VAL_ 154 OBJ_Lat_Distance_V_23 1 "VALID" 0 "INVALID" ;
VAL_ 154 OBJ_Lat_Distance_STD_V_23 1 "VALID" 0 "INVALID" ;
VAL_ 154 OBJ_Absolute_Speed_V_23 1 "VALID" 0 "INVALID" ;
VAL_ 154 OBJ_Absolute_Speed_STD_V_23 1 "VALID" 0 "INVALID" ;
VAL_ 154 OBJ_Heading_V_23 1 "VALID" 0 "INVALID" ;
VAL_ 154 OBJ_Heading_STD_V_23 1 "VALID" 0 "INVALID" ;
VAL_ 154 OBJ_Angle_Rate_STD_V_23 1 "VALID" 0 "INVALID" ;
VAL_ 154 OBJ_Angle_Rate_V_23 1 "VALID" 0 "INVALID" ;
VAL_ 154 OBJ_Angle_Right_V_23 1 "VALID" 0 "INVALID" ;
VAL_ 154 OBJ_Angle_Right_STD_V_23 1 "VALID" 0 "INVALID" ;
VAL_ 154 OBJ_Angle_Left_V_23 1 "VALID" 0 "INVALID" ;
VAL_ 154 OBJ_Angle_Left_STD_V_23 1 "VALID" 0 "INVALID" ;
VAL_ 154 OBJ_Angle_Side_V_23 1 "VALID" 0 "INVALID" ;
VAL_ 154 OBJ_Angle_Side_STD_V_23 1 "VALID" 0 "INVALID" ;
VAL_ 154 OBJ_Angle_Mid_V_23 1 "VALID" 0 "INVALID" ;
VAL_ 154 OBJ_Angle_Mid_STD_V_23 1 "VALID" 0 "INVALID" ;
VAL_ 154 OBJ_Angle_Bottom_V_23 1 "VALID" 0 "INVALID" ;
VAL_ 154 OBJ_Angle_Bottom_STD_V_23 1 "VALID" 0 "INVALID" ;
VAL_ 154 OBJ_Visibility_Side_V_23 1 "VALID" 0 "INVALID" ;
VAL_ 154 OBJ_Visibility_Side_23 2 "REAR" 1 "FRONT" 0 "NOT_VISIBLE" ;
VAL_ 154 OBJ_Is_In_Drivable_Area_23 1 "TRUE" 0 "FALSE" ;
VAL_ 154 OBJ_Is_In_Drivable_Area_V_23 1 "VALID" 0 "INVALID" ;
VAL_ 154 OBJ_Is_VeryClose_V_23 1 "VALID" 0 "INVALID" ;
VAL_ 154 OBJ_Is_VeryClose_23 1 "TRUE" 0 "FALSE" ;
VAL_ 154 OBJ_OverlapAngleEgoLaneR_V_23 1 "VALID" 0 "INVALID" ;
VAL_ 154 OBJ_OverlapAngleEgoLaneL_V_23 1 "VALID" 0 "INVALID" ;
VAL_ 154 OBJ_Is_EMERGENCY_VCL_23 1 "TRUE" 0 "FALSE" ;
VAL_ 154 OBJ_EMERGENCY_LIGHT_COLOR_23 3 "(1000)ORANGE" 2 "(0100)BLUE" 1 "(0010)RED" 0 "(0001)OTHER" ;
VAL_ 154 OBJ_EMERGENCY_V_23 1 "TRUE" 0 "FALSE" ;
VAL_ 154 OBJ_Angle_Top_V_23 1 "VALID" 0 "INVALID" ;
VAL_ 154 OBJ_Angle_Top_STD_V_23 1 "VALID" 0 "INVALID" ;
VAL_ 154 OBJ_Open_Door_Left_23 1 "TRUE" 0 "FALSE" ;
VAL_ 154 OBJ_Open_Door_Right_23 1 "TRUE" 0 "FALSE" ;
VAL_ 154 OBJ_Visible_Left_or_Right_23 2 "RIGHT" 1 "LEFT" 0 "NOT_VISIBLE" ;
VAL_ 154 OBJ_Visible_Left_or_Right_V_23 1 "VALID" 0 "INVALID" ;
VAL_ 154 OBJ_Fusion_Source_24 2 "(BIT_2)RADAR2" 1 "(BIT_1)RADAR1" 0 "(BIT_0)CAMERA" ;
VAL_ 154 OBJ_Triggered_SDM_24 2 "NOT_TRIGGERED" 1 "TRIGGERED" 0 "NOT_AVAILABLE" ;
VAL_ 154 OBJ_Motion_Category_24 13 "ONCOMING" 12 "PRECEEDING" 11 "MOVING" 10 "RTAP" 9 "LTAP" 8 "CROSSING" 7 "MOVING_OUT" 6 "MOVING_IN" 5 "CLOSE_CUT_IN" 4 "PASSING_OUT" 3 "PASSING_IN" 2 "PASSING" 1 "UNDEFINED" 0 "UNFILLED" ;
VAL_ 154 OBJ_Measuring_Status_24 2 "(BIT_2)NOT_VALID_OR_VALID" 1 "(BIT_1)PREDICTED_OR_MEASURED" 0 "(BIT_0)OLD_OR_NEW" ;
VAL_ 154 OBJ_Object_Class_24 9 "TWO_WHEELER" 8 "UNCERTAIN_VCL" 7 "ANIMAL" 6 "GENERAL_OBJECT" 5 "PEDESTRIAN" 4 "BICYCLE" 3 "MOTORBIKE" 2 "TRUCK" 1 "CAR" 0 "UNFILLED" ;
VAL_ 154 OBJ_Camera_Source_24 11 "PARKING_RIGHT" 10 "PARKING_LEFT" 9 "PARKING_REAR" 8 "PARKING_FRONT" 7 "FRONT_CORNER_RIGHT" 6 "FRONT_CORNER_LEFT" 5 "REAR_CORNER_RIGHT" 4 "REAR_CORNER_LEFT" 3 "REAR" 2 "FRONT_FISHEYE" 1 "FRONT_NARROW" 0 "FRONT_MAIN" ;
VAL_ 154 OBJ_Motion_Status_24 5 "MOVING_SLOWLY" 4 "STOPPED" 3 "STATIONARY" 2 "MOVING" 1 "UNKNOWN" 0 "INVALID" ;
VAL_ 154 OBJ_Motion_Orientation_24 13 "INVALID" 12 "NORTH" 11 "NORTH_WEST" 9 "WEST" 7 "SOUTH_WEST" 6 "SOUTH" 5 "SOUTH_EAST" 3 "EAST" 1 "NORTH_EAST" 0 "UNKNOWN" ;
VAL_ 154 OBJ_Has_Cut_Lane_24 1 "TRUE" 0 "FALSE" ;
VAL_ 154 OBJ_Has_Cut_Path_24 1 "TRUE" 0 "FALSE" ;
VAL_ 154 OBJ_Brake_Light_Validity_24 1 "TRUE" 0 "FALSE" ;
VAL_ 154 OBJ_Brake_Light_24 1 "TRUE" 0 "FALSE" ;
VAL_ 154 OBJ_Turn_Indicator_Right_24 1 "TRUE" 0 "FALSE" ;
VAL_ 154 OBJ_Turn_Indicator_Left_24 1 "TRUE" 0 "FALSE" ;
VAL_ 154 OBJ_Turn_Indicator_Validity_24 1 "TRUE" 0 "FALSE" ;
VAL_ 154 OBJ_Right_Out_Of_Image_24 1 "TRUE" 0 "FALSE" ;
VAL_ 154 OBJ_Left_Out_Of_Image_24 1 "TRUE" 0 "FALSE" ;
VAL_ 154 OBJ_Right_Out_Of_Image_V_24 1 "TRUE" 0 "FALSE" ;
VAL_ 154 OBJ_Left_Out_Of_Image_V_24 1 "TRUE" 0 "FALSE" ;
VAL_ 154 OBJ_Top_Out_Of_Image_24 1 "TRUE" 0 "FALSE" ;
VAL_ 154 OBJ_Bottom_Out_Of_Image_24 1 "TRUE" 0 "FALSE" ;
VAL_ 154 OBJ_Top_Out_Of_Image_V_24 1 "VALID" 0 "INVALID" ;
VAL_ 154 OBJ_Bottom_Out_Of_Image_V_24 1 "VALID" 0 "INVALID" ;
VAL_ 154 OBJ_Lane_Assignment_24 5 "RIGHT_RIGHT" 4 "RIGHT" 3 "HOST" 2 "LEFT" 1 "LEFT_LEFT" 0 "UNKNOWN" ;
VAL_ 154 OBJ_Lane_Assignment_V_24 1 "VALID" 0 "INVALID" ;
VAL_ 154 OBJ_Age_Seconds_V_24 1 "VALID" 0 "INVALID" ;
VAL_ 154 OBJ_Width_V_24 1 "VALID" 0 "INVALID" ;
VAL_ 154 OBJ_Width_STD_V_24 1 "VALID" 0 "INVALID" ;
VAL_ 154 OBJ_Length_V_24 1 "VALID" 0 "INVALID" ;
VAL_ 154 OBJ_Length_STD_V_24 1 "VALID" 0 "INVALID" ;
VAL_ 154 OBJ_Height_V_24 1 "VALID" 0 "INVALID" ;
VAL_ 154 OBJ_Height_STD_V_24 1 "VALID" 0 "INVALID" ;
VAL_ 154 OBJ_Abs_Long_Velocity_V_24 1 "VALID" 0 "INVALID" ;
VAL_ 154 OBJ_Abs_Long_Vel_STD_V_24 1 "VALID" 0 "INVALID" ;
VAL_ 154 OBJ_Abs_Lat_Velocity_V_24 1 "VALID" 0 "INVALID" ;
VAL_ 154 OBJ_Abs_Lat_Vel_STD_V_24 1 "VALID" 0 "INVALID" ;
VAL_ 154 OBJ_Abs_Long_Acc_V_24 1 "VALID" 0 "INVALID" ;
VAL_ 154 OBJ_Abs_Long_Acc_STD_V_24 1 "VALID" 0 "INVALID" ;
VAL_ 154 OBJ_Abs_Lat_Acc_V_24 1 "VALID" 0 "INVALID" ;
VAL_ 154 OBJ_Abs_Lat_Acc_STD_V_24 1 "VALID" 0 "INVALID" ;
VAL_ 154 OBJ_Abs_Acceleration_V_24 1 "VALID" 0 "INVALID" ;
VAL_ 154 OBJ_Abs_Acc_STD_V_24 1 "VALID" 0 "INVALID" ;
VAL_ 154 OBJ_Inv_TTC_V_24 1 "VALID" 0 "INVALID" ;
VAL_ 154 OBJ_Inv_TTC_STD_V_24 1 "VALID" 0 "INVALID" ;
VAL_ 154 OBJ_Relative_Long_Acc_V_24 1 "VALID" 0 "INVALID" ;
VAL_ 154 OBJ_Rel_Long_Acc_STD_V_24 1 "VALID" 0 "INVALID" ;
VAL_ 154 OBJ_Relative_Long_Velocity_V_24 1 "VALID" 0 "INVALID" ;
VAL_ 154 OBJ_Rel_Long_Vel_STD_V_24 1 "VALID" 0 "INVALID" ;
VAL_ 154 OBJ_Relative_Lat_Velocity_V_24 1 "VALID" 0 "INVALID" ;
VAL_ 154 OBJ_Rel_Lat_Vel_STD_V_24 1 "VALID" 0 "INVALID" ;
VAL_ 154 OBJ_Long_Distance_V_24 1 "VALID" 0 "INVALID" ;
VAL_ 154 OBJ_Long_Distance_STD_V_24 1 "VALID" 0 "INVALID" ;
VAL_ 154 OBJ_Lat_Distance_V_24 1 "VALID" 0 "INVALID" ;
VAL_ 154 OBJ_Lat_Distance_STD_V_24 1 "VALID" 0 "INVALID" ;
VAL_ 154 OBJ_Absolute_Speed_V_24 1 "VALID" 0 "INVALID" ;
VAL_ 154 OBJ_Absolute_Speed_STD_V_24 1 "VALID" 0 "INVALID" ;
VAL_ 154 OBJ_Heading_V_24 1 "VALID" 0 "INVALID" ;
VAL_ 154 OBJ_Heading_STD_V_24 1 "VALID" 0 "INVALID" ;
VAL_ 154 OBJ_Angle_Rate_STD_V_24 1 "VALID" 0 "INVALID" ;
VAL_ 154 OBJ_Angle_Rate_V_24 1 "VALID" 0 "INVALID" ;
VAL_ 154 OBJ_Angle_Right_V_24 1 "VALID" 0 "INVALID" ;
VAL_ 154 OBJ_Angle_Right_STD_V_24 1 "VALID" 0 "INVALID" ;
VAL_ 154 OBJ_Angle_Left_V_24 1 "VALID" 0 "INVALID" ;
VAL_ 154 OBJ_Angle_Left_STD_V_24 1 "VALID" 0 "INVALID" ;
VAL_ 154 OBJ_Angle_Side_V_24 1 "VALID" 0 "INVALID" ;
VAL_ 154 OBJ_Angle_Side_STD_V_24 1 "VALID" 0 "INVALID" ;
VAL_ 154 OBJ_Angle_Mid_V_24 1 "VALID" 0 "INVALID" ;
VAL_ 154 OBJ_Angle_Mid_STD_V_24 1 "VALID" 0 "INVALID" ;
VAL_ 154 OBJ_Angle_Bottom_V_24 1 "VALID" 0 "INVALID" ;
VAL_ 154 OBJ_Angle_Bottom_STD_V_24 1 "VALID" 0 "INVALID" ;
VAL_ 154 OBJ_Visibility_Side_V_24 1 "VALID" 0 "INVALID" ;
VAL_ 154 OBJ_Visibility_Side_24 2 "REAR" 1 "FRONT" 0 "NOT_VISIBLE" ;
VAL_ 154 OBJ_Is_In_Drivable_Area_24 1 "TRUE" 0 "FALSE" ;
VAL_ 154 OBJ_Is_In_Drivable_Area_V_24 1 "VALID" 0 "INVALID" ;
VAL_ 154 OBJ_Is_VeryClose_V_24 1 "VALID" 0 "INVALID" ;
VAL_ 154 OBJ_Is_VeryClose_24 1 "TRUE" 0 "FALSE" ;
VAL_ 154 OBJ_OverlapAngleEgoLaneR_V_24 1 "VALID" 0 "INVALID" ;
VAL_ 154 OBJ_OverlapAngleEgoLaneL_V_24 1 "VALID" 0 "INVALID" ;
VAL_ 154 OBJ_Is_EMERGENCY_VCL_24 1 "TRUE" 0 "FALSE" ;
VAL_ 154 OBJ_EMERGENCY_LIGHT_COLOR_24 3 "(1000)ORANGE" 2 "(0100)BLUE" 1 "(0010)RED" 0 "(0001)OTHER" ;
VAL_ 154 OBJ_EMERGENCY_V_24 1 "TRUE" 0 "FALSE" ;
VAL_ 154 OBJ_Angle_Top_V_24 1 "VALID" 0 "INVALID" ;
VAL_ 154 OBJ_Angle_Top_STD_V_24 1 "VALID" 0 "INVALID" ;
VAL_ 154 OBJ_Open_Door_Left_24 1 "TRUE" 0 "FALSE" ;
VAL_ 154 OBJ_Open_Door_Right_24 1 "TRUE" 0 "FALSE" ;
VAL_ 154 OBJ_Visible_Left_or_Right_24 2 "RIGHT" 1 "LEFT" 0 "NOT_VISIBLE" ;
VAL_ 154 OBJ_Visible_Left_or_Right_V_24 1 "VALID" 0 "INVALID" ;
VAL_ 154 OBJ_Fusion_Source_25 2 "(BIT_2)RADAR2" 1 "(BIT_1)RADAR1" 0 "(BIT_0)CAMERA" ;
VAL_ 154 OBJ_Triggered_SDM_25 2 "NOT_TRIGGERED" 1 "TRIGGERED" 0 "NOT_AVAILABLE" ;
VAL_ 154 OBJ_Motion_Category_25 13 "ONCOMING" 12 "PRECEEDING" 11 "MOVING" 10 "RTAP" 9 "LTAP" 8 "CROSSING" 7 "MOVING_OUT" 6 "MOVING_IN" 5 "CLOSE_CUT_IN" 4 "PASSING_OUT" 3 "PASSING_IN" 2 "PASSING" 1 "UNDEFINED" 0 "UNFILLED" ;
VAL_ 154 OBJ_Measuring_Status_25 2 "(BIT_2)NOT_VALID_OR_VALID" 1 "(BIT_1)PREDICTED_OR_MEASURED" 0 "(BIT_0)OLD_OR_NEW" ;
VAL_ 154 OBJ_Object_Class_25 9 "TWO_WHEELER" 8 "UNCERTAIN_VCL" 7 "ANIMAL" 6 "GENERAL_OBJECT" 5 "PEDESTRIAN" 4 "BICYCLE" 3 "MOTORBIKE" 2 "TRUCK" 1 "CAR" 0 "UNFILLED" ;
VAL_ 154 OBJ_Camera_Source_25 11 "PARKING_RIGHT" 10 "PARKING_LEFT" 9 "PARKING_REAR" 8 "PARKING_FRONT" 7 "FRONT_CORNER_RIGHT" 6 "FRONT_CORNER_LEFT" 5 "REAR_CORNER_RIGHT" 4 "REAR_CORNER_LEFT" 3 "REAR" 2 "FRONT_FISHEYE" 1 "FRONT_NARROW" 0 "FRONT_MAIN" ;
VAL_ 154 OBJ_Motion_Status_25 5 "MOVING_SLOWLY" 4 "STOPPED" 3 "STATIONARY" 2 "MOVING" 1 "UNKNOWN" 0 "INVALID" ;
VAL_ 154 OBJ_Motion_Orientation_25 13 "INVALID" 12 "NORTH" 11 "NORTH_WEST" 9 "WEST" 7 "SOUTH_WEST" 6 "SOUTH" 5 "SOUTH_EAST" 3 "EAST" 1 "NORTH_EAST" 0 "UNKNOWN" ;
VAL_ 154 OBJ_Has_Cut_Lane_25 1 "TRUE" 0 "FALSE" ;
VAL_ 154 OBJ_Has_Cut_Path_25 1 "TRUE" 0 "FALSE" ;
VAL_ 154 OBJ_Brake_Light_Validity_25 1 "TRUE" 0 "FALSE" ;
VAL_ 154 OBJ_Brake_Light_25 1 "TRUE" 0 "FALSE" ;
VAL_ 154 OBJ_Turn_Indicator_Right_25 1 "TRUE" 0 "FALSE" ;
VAL_ 154 OBJ_Turn_Indicator_Left_25 1 "TRUE" 0 "FALSE" ;
VAL_ 154 OBJ_Turn_Indicator_Validity_25 1 "TRUE" 0 "FALSE" ;
VAL_ 154 OBJ_Right_Out_Of_Image_25 1 "TRUE" 0 "FALSE" ;
VAL_ 154 OBJ_Left_Out_Of_Image_25 1 "TRUE" 0 "FALSE" ;
VAL_ 154 OBJ_Right_Out_Of_Image_V_25 1 "TRUE" 0 "FALSE" ;
VAL_ 154 OBJ_Left_Out_Of_Image_V_25 1 "TRUE" 0 "FALSE" ;
VAL_ 154 OBJ_Top_Out_Of_Image_25 1 "TRUE" 0 "FALSE" ;
VAL_ 154 OBJ_Bottom_Out_Of_Image_25 1 "TRUE" 0 "FALSE" ;
VAL_ 154 OBJ_Top_Out_Of_Image_V_25 1 "VALID" 0 "INVALID" ;
VAL_ 154 OBJ_Bottom_Out_Of_Image_V_25 1 "VALID" 0 "INVALID" ;
VAL_ 154 OBJ_Lane_Assignment_25 5 "RIGHT_RIGHT" 4 "RIGHT" 3 "HOST" 2 "LEFT" 1 "LEFT_LEFT" 0 "UNKNOWN" ;
VAL_ 154 OBJ_Lane_Assignment_V_25 1 "VALID" 0 "INVALID" ;
VAL_ 154 OBJ_Age_Seconds_V_25 1 "VALID" 0 "INVALID" ;
VAL_ 154 OBJ_Width_V_25 1 "VALID" 0 "INVALID" ;
VAL_ 154 OBJ_Width_STD_V_25 1 "VALID" 0 "INVALID" ;
VAL_ 154 OBJ_Length_V_25 1 "VALID" 0 "INVALID" ;
VAL_ 154 OBJ_Length_STD_V_25 1 "VALID" 0 "INVALID" ;
VAL_ 154 OBJ_Height_V_25 1 "VALID" 0 "INVALID" ;
VAL_ 154 OBJ_Height_STD_V_25 1 "VALID" 0 "INVALID" ;
VAL_ 154 OBJ_Abs_Long_Velocity_V_25 1 "VALID" 0 "INVALID" ;
VAL_ 154 OBJ_Abs_Long_Vel_STD_V_25 1 "VALID" 0 "INVALID" ;
VAL_ 154 OBJ_Abs_Lat_Velocity_V_25 1 "VALID" 0 "INVALID" ;
VAL_ 154 OBJ_Abs_Lat_Vel_STD_V_25 1 "VALID" 0 "INVALID" ;
VAL_ 154 OBJ_Abs_Long_Acc_V_25 1 "VALID" 0 "INVALID" ;
VAL_ 154 OBJ_Abs_Long_Acc_STD_V_25 1 "VALID" 0 "INVALID" ;
VAL_ 154 OBJ_Abs_Lat_Acc_V_25 1 "VALID" 0 "INVALID" ;
VAL_ 154 OBJ_Abs_Lat_Acc_STD_V_25 1 "VALID" 0 "INVALID" ;
VAL_ 154 OBJ_Abs_Acceleration_V_25 1 "VALID" 0 "INVALID" ;
VAL_ 154 OBJ_Abs_Acc_STD_V_25 1 "VALID" 0 "INVALID" ;
VAL_ 154 OBJ_Inv_TTC_V_25 1 "VALID" 0 "INVALID" ;
VAL_ 154 OBJ_Inv_TTC_STD_V_25 1 "VALID" 0 "INVALID" ;
VAL_ 154 OBJ_Relative_Long_Acc_V_25 1 "VALID" 0 "INVALID" ;
VAL_ 154 OBJ_Rel_Long_Acc_STD_V_25 1 "VALID" 0 "INVALID" ;
VAL_ 154 OBJ_Relative_Long_Velocity_V_25 1 "VALID" 0 "INVALID" ;
VAL_ 154 OBJ_Rel_Long_Vel_STD_V_25 1 "VALID" 0 "INVALID" ;
VAL_ 154 OBJ_Relative_Lat_Velocity_V_25 1 "VALID" 0 "INVALID" ;
VAL_ 154 OBJ_Rel_Lat_Vel_STD_V_25 1 "VALID" 0 "INVALID" ;
VAL_ 154 OBJ_Long_Distance_V_25 1 "VALID" 0 "INVALID" ;
VAL_ 154 OBJ_Long_Distance_STD_V_25 1 "VALID" 0 "INVALID" ;
VAL_ 154 OBJ_Lat_Distance_V_25 1 "VALID" 0 "INVALID" ;
VAL_ 154 OBJ_Lat_Distance_STD_V_25 1 "VALID" 0 "INVALID" ;
VAL_ 154 OBJ_Absolute_Speed_V_25 1 "VALID" 0 "INVALID" ;
VAL_ 154 OBJ_Absolute_Speed_STD_V_25 1 "VALID" 0 "INVALID" ;
VAL_ 154 OBJ_Heading_V_25 1 "VALID" 0 "INVALID" ;
VAL_ 154 OBJ_Heading_STD_V_25 1 "VALID" 0 "INVALID" ;
VAL_ 154 OBJ_Angle_Rate_STD_V_25 1 "VALID" 0 "INVALID" ;
VAL_ 154 OBJ_Angle_Rate_V_25 1 "VALID" 0 "INVALID" ;
VAL_ 154 OBJ_Angle_Right_V_25 1 "VALID" 0 "INVALID" ;
VAL_ 154 OBJ_Angle_Right_STD_V_25 1 "VALID" 0 "INVALID" ;
VAL_ 154 OBJ_Angle_Left_V_25 1 "VALID" 0 "INVALID" ;
VAL_ 154 OBJ_Angle_Left_STD_V_25 1 "VALID" 0 "INVALID" ;
VAL_ 154 OBJ_Angle_Side_V_25 1 "VALID" 0 "INVALID" ;
VAL_ 154 OBJ_Angle_Side_STD_V_25 1 "VALID" 0 "INVALID" ;
VAL_ 154 OBJ_Angle_Mid_V_25 1 "VALID" 0 "INVALID" ;
VAL_ 154 OBJ_Angle_Mid_STD_V_25 1 "VALID" 0 "INVALID" ;
VAL_ 154 OBJ_Angle_Bottom_V_25 1 "VALID" 0 "INVALID" ;
VAL_ 154 OBJ_Angle_Bottom_STD_V_25 1 "VALID" 0 "INVALID" ;
VAL_ 154 OBJ_Visibility_Side_V_25 1 "VALID" 0 "INVALID" ;
VAL_ 154 OBJ_Visibility_Side_25 2 "REAR" 1 "FRONT" 0 "NOT_VISIBLE" ;
VAL_ 154 OBJ_Is_In_Drivable_Area_25 1 "TRUE" 0 "FALSE" ;
VAL_ 154 OBJ_Is_In_Drivable_Area_V_25 1 "VALID" 0 "INVALID" ;
VAL_ 154 OBJ_Is_VeryClose_V_25 1 "VALID" 0 "INVALID" ;
VAL_ 154 OBJ_Is_VeryClose_25 1 "TRUE" 0 "FALSE" ;
VAL_ 154 OBJ_OverlapAngleEgoLaneR_V_25 1 "VALID" 0 "INVALID" ;
VAL_ 154 OBJ_OverlapAngleEgoLaneL_V_25 1 "VALID" 0 "INVALID" ;
VAL_ 154 OBJ_Is_EMERGENCY_VCL_25 1 "TRUE" 0 "FALSE" ;
VAL_ 154 OBJ_EMERGENCY_LIGHT_COLOR_25 3 "(1000)ORANGE" 2 "(0100)BLUE" 1 "(0010)RED" 0 "(0001)OTHER" ;
VAL_ 154 OBJ_EMERGENCY_V_25 1 "TRUE" 0 "FALSE" ;
VAL_ 154 OBJ_Angle_Top_V_25 1 "VALID" 0 "INVALID" ;
VAL_ 154 OBJ_Angle_Top_STD_V_25 1 "VALID" 0 "INVALID" ;
VAL_ 154 OBJ_Open_Door_Left_25 1 "TRUE" 0 "FALSE" ;
VAL_ 154 OBJ_Open_Door_Right_25 1 "TRUE" 0 "FALSE" ;
VAL_ 154 OBJ_Visible_Left_or_Right_25 2 "RIGHT" 1 "LEFT" 0 "NOT_VISIBLE" ;
VAL_ 154 OBJ_Visible_Left_or_Right_V_25 1 "VALID" 0 "INVALID" ;
VAL_ 154 OBJ_Fusion_Source_26 2 "(BIT_2)RADAR2" 1 "(BIT_1)RADAR1" 0 "(BIT_0)CAMERA" ;
VAL_ 154 OBJ_Triggered_SDM_26 2 "NOT_TRIGGERED" 1 "TRIGGERED" 0 "NOT_AVAILABLE" ;
VAL_ 154 OBJ_Motion_Category_26 13 "ONCOMING" 12 "PRECEEDING" 11 "MOVING" 10 "RTAP" 9 "LTAP" 8 "CROSSING" 7 "MOVING_OUT" 6 "MOVING_IN" 5 "CLOSE_CUT_IN" 4 "PASSING_OUT" 3 "PASSING_IN" 2 "PASSING" 1 "UNDEFINED" 0 "UNFILLED" ;
VAL_ 154 OBJ_Measuring_Status_26 2 "(BIT_2)NOT_VALID_OR_VALID" 1 "(BIT_1)PREDICTED_OR_MEASURED" 0 "(BIT_0)OLD_OR_NEW" ;
VAL_ 154 OBJ_Object_Class_26 9 "TWO_WHEELER" 8 "UNCERTAIN_VCL" 7 "ANIMAL" 6 "GENERAL_OBJECT" 5 "PEDESTRIAN" 4 "BICYCLE" 3 "MOTORBIKE" 2 "TRUCK" 1 "CAR" 0 "UNFILLED" ;
VAL_ 154 OBJ_Camera_Source_26 11 "PARKING_RIGHT" 10 "PARKING_LEFT" 9 "PARKING_REAR" 8 "PARKING_FRONT" 7 "FRONT_CORNER_RIGHT" 6 "FRONT_CORNER_LEFT" 5 "REAR_CORNER_RIGHT" 4 "REAR_CORNER_LEFT" 3 "REAR" 2 "FRONT_FISHEYE" 1 "FRONT_NARROW" 0 "FRONT_MAIN" ;
VAL_ 154 OBJ_Motion_Status_26 5 "MOVING_SLOWLY" 4 "STOPPED" 3 "STATIONARY" 2 "MOVING" 1 "UNKNOWN" 0 "INVALID" ;
VAL_ 154 OBJ_Motion_Orientation_26 13 "INVALID" 12 "NORTH" 11 "NORTH_WEST" 9 "WEST" 7 "SOUTH_WEST" 6 "SOUTH" 5 "SOUTH_EAST" 3 "EAST" 1 "NORTH_EAST" 0 "UNKNOWN" ;
VAL_ 154 OBJ_Has_Cut_Lane_26 1 "TRUE" 0 "FALSE" ;
VAL_ 154 OBJ_Has_Cut_Path_26 1 "TRUE" 0 "FALSE" ;
VAL_ 154 OBJ_Brake_Light_Validity_26 1 "TRUE" 0 "FALSE" ;
VAL_ 154 OBJ_Brake_Light_26 1 "TRUE" 0 "FALSE" ;
VAL_ 154 OBJ_Turn_Indicator_Right_26 1 "TRUE" 0 "FALSE" ;
VAL_ 154 OBJ_Turn_Indicator_Left_26 1 "TRUE" 0 "FALSE" ;
VAL_ 154 OBJ_Turn_Indicator_Validity_26 1 "TRUE" 0 "FALSE" ;
VAL_ 154 OBJ_Right_Out_Of_Image_26 1 "TRUE" 0 "FALSE" ;
VAL_ 154 OBJ_Left_Out_Of_Image_26 1 "TRUE" 0 "FALSE" ;
VAL_ 154 OBJ_Right_Out_Of_Image_V_26 1 "TRUE" 0 "FALSE" ;
VAL_ 154 OBJ_Left_Out_Of_Image_V_26 1 "TRUE" 0 "FALSE" ;
VAL_ 154 OBJ_Top_Out_Of_Image_26 1 "TRUE" 0 "FALSE" ;
VAL_ 154 OBJ_Bottom_Out_Of_Image_26 1 "TRUE" 0 "FALSE" ;
VAL_ 154 OBJ_Top_Out_Of_Image_V_26 1 "VALID" 0 "INVALID" ;
VAL_ 154 OBJ_Bottom_Out_Of_Image_V_26 1 "VALID" 0 "INVALID" ;
VAL_ 154 OBJ_Lane_Assignment_26 5 "RIGHT_RIGHT" 4 "RIGHT" 3 "HOST" 2 "LEFT" 1 "LEFT_LEFT" 0 "UNKNOWN" ;
VAL_ 154 OBJ_Lane_Assignment_V_26 1 "VALID" 0 "INVALID" ;
VAL_ 154 OBJ_Age_Seconds_V_26 1 "VALID" 0 "INVALID" ;
VAL_ 154 OBJ_Width_V_26 1 "VALID" 0 "INVALID" ;
VAL_ 154 OBJ_Width_STD_V_26 1 "VALID" 0 "INVALID" ;
VAL_ 154 OBJ_Length_V_26 1 "VALID" 0 "INVALID" ;
VAL_ 154 OBJ_Length_STD_V_26 1 "VALID" 0 "INVALID" ;
VAL_ 154 OBJ_Height_V_26 1 "VALID" 0 "INVALID" ;
VAL_ 154 OBJ_Height_STD_V_26 1 "VALID" 0 "INVALID" ;
VAL_ 154 OBJ_Abs_Long_Velocity_V_26 1 "VALID" 0 "INVALID" ;
VAL_ 154 OBJ_Abs_Long_Vel_STD_V_26 1 "VALID" 0 "INVALID" ;
VAL_ 154 OBJ_Abs_Lat_Velocity_V_26 1 "VALID" 0 "INVALID" ;
VAL_ 154 OBJ_Abs_Lat_Vel_STD_V_26 1 "VALID" 0 "INVALID" ;
VAL_ 154 OBJ_Abs_Long_Acc_V_26 1 "VALID" 0 "INVALID" ;
VAL_ 154 OBJ_Abs_Long_Acc_STD_V_26 1 "VALID" 0 "INVALID" ;
VAL_ 154 OBJ_Abs_Lat_Acc_V_26 1 "VALID" 0 "INVALID" ;
VAL_ 154 OBJ_Abs_Lat_Acc_STD_V_26 1 "VALID" 0 "INVALID" ;
VAL_ 154 OBJ_Abs_Acceleration_V_26 1 "VALID" 0 "INVALID" ;
VAL_ 154 OBJ_Abs_Acc_STD_V_26 1 "VALID" 0 "INVALID" ;
VAL_ 154 OBJ_Inv_TTC_V_26 1 "VALID" 0 "INVALID" ;
VAL_ 154 OBJ_Inv_TTC_STD_V_26 1 "VALID" 0 "INVALID" ;
VAL_ 154 OBJ_Relative_Long_Acc_V_26 1 "VALID" 0 "INVALID" ;
VAL_ 154 OBJ_Rel_Long_Acc_STD_V_26 1 "VALID" 0 "INVALID" ;
VAL_ 154 OBJ_Relative_Long_Velocity_V_26 1 "VALID" 0 "INVALID" ;
VAL_ 154 OBJ_Rel_Long_Vel_STD_V_26 1 "VALID" 0 "INVALID" ;
VAL_ 154 OBJ_Relative_Lat_Velocity_V_26 1 "VALID" 0 "INVALID" ;
VAL_ 154 OBJ_Rel_Lat_Vel_STD_V_26 1 "VALID" 0 "INVALID" ;
VAL_ 154 OBJ_Long_Distance_V_26 1 "VALID" 0 "INVALID" ;
VAL_ 154 OBJ_Long_Distance_STD_V_26 1 "VALID" 0 "INVALID" ;
VAL_ 154 OBJ_Lat_Distance_V_26 1 "VALID" 0 "INVALID" ;
VAL_ 154 OBJ_Lat_Distance_STD_V_26 1 "VALID" 0 "INVALID" ;
VAL_ 154 OBJ_Absolute_Speed_V_26 1 "VALID" 0 "INVALID" ;
VAL_ 154 OBJ_Absolute_Speed_STD_V_26 1 "VALID" 0 "INVALID" ;
VAL_ 154 OBJ_Heading_V_26 1 "VALID" 0 "INVALID" ;
VAL_ 154 OBJ_Heading_STD_V_26 1 "VALID" 0 "INVALID" ;
VAL_ 154 OBJ_Angle_Rate_STD_V_26 1 "VALID" 0 "INVALID" ;
VAL_ 154 OBJ_Angle_Rate_V_26 1 "VALID" 0 "INVALID" ;
VAL_ 154 OBJ_Angle_Right_V_26 1 "VALID" 0 "INVALID" ;
VAL_ 154 OBJ_Angle_Right_STD_V_26 1 "VALID" 0 "INVALID" ;
VAL_ 154 OBJ_Angle_Left_V_26 1 "VALID" 0 "INVALID" ;
VAL_ 154 OBJ_Angle_Left_STD_V_26 1 "VALID" 0 "INVALID" ;
VAL_ 154 OBJ_Angle_Side_V_26 1 "VALID" 0 "INVALID" ;
VAL_ 154 OBJ_Angle_Side_STD_V_26 1 "VALID" 0 "INVALID" ;
VAL_ 154 OBJ_Angle_Mid_V_26 1 "VALID" 0 "INVALID" ;
VAL_ 154 OBJ_Angle_Mid_STD_V_26 1 "VALID" 0 "INVALID" ;
VAL_ 154 OBJ_Angle_Bottom_V_26 1 "VALID" 0 "INVALID" ;
VAL_ 154 OBJ_Angle_Bottom_STD_V_26 1 "VALID" 0 "INVALID" ;
VAL_ 154 OBJ_Visibility_Side_V_26 1 "VALID" 0 "INVALID" ;
VAL_ 154 OBJ_Visibility_Side_26 2 "REAR" 1 "FRONT" 0 "NOT_VISIBLE" ;
VAL_ 154 OBJ_Is_In_Drivable_Area_26 1 "TRUE" 0 "FALSE" ;
VAL_ 154 OBJ_Is_In_Drivable_Area_V_26 1 "VALID" 0 "INVALID" ;
VAL_ 154 OBJ_Is_VeryClose_V_26 1 "VALID" 0 "INVALID" ;
VAL_ 154 OBJ_Is_VeryClose_26 1 "TRUE" 0 "FALSE" ;
VAL_ 154 OBJ_OverlapAngleEgoLaneR_V_26 1 "VALID" 0 "INVALID" ;
VAL_ 154 OBJ_OverlapAngleEgoLaneL_V_26 1 "VALID" 0 "INVALID" ;
VAL_ 154 OBJ_Is_EMERGENCY_VCL_26 1 "TRUE" 0 "FALSE" ;
VAL_ 154 OBJ_EMERGENCY_LIGHT_COLOR_26 3 "(1000)ORANGE" 2 "(0100)BLUE" 1 "(0010)RED" 0 "(0001)OTHER" ;
VAL_ 154 OBJ_EMERGENCY_V_26 1 "TRUE" 0 "FALSE" ;
VAL_ 154 OBJ_Angle_Top_V_26 1 "VALID" 0 "INVALID" ;
VAL_ 154 OBJ_Angle_Top_STD_V_26 1 "VALID" 0 "INVALID" ;
VAL_ 154 OBJ_Open_Door_Left_26 1 "TRUE" 0 "FALSE" ;
VAL_ 154 OBJ_Open_Door_Right_26 1 "TRUE" 0 "FALSE" ;
VAL_ 154 OBJ_Visible_Left_or_Right_26 2 "RIGHT" 1 "LEFT" 0 "NOT_VISIBLE" ;
VAL_ 154 OBJ_Visible_Left_or_Right_V_26 1 "VALID" 0 "INVALID" ;
VAL_ 154 OBJ_Fusion_Source_27 2 "(BIT_2)RADAR2" 1 "(BIT_1)RADAR1" 0 "(BIT_0)CAMERA" ;
VAL_ 154 OBJ_Triggered_SDM_27 2 "NOT_TRIGGERED" 1 "TRIGGERED" 0 "NOT_AVAILABLE" ;
VAL_ 154 OBJ_Motion_Category_27 13 "ONCOMING" 12 "PRECEEDING" 11 "MOVING" 10 "RTAP" 9 "LTAP" 8 "CROSSING" 7 "MOVING_OUT" 6 "MOVING_IN" 5 "CLOSE_CUT_IN" 4 "PASSING_OUT" 3 "PASSING_IN" 2 "PASSING" 1 "UNDEFINED" 0 "UNFILLED" ;
VAL_ 154 OBJ_Measuring_Status_27 2 "(BIT_2)NOT_VALID_OR_VALID" 1 "(BIT_1)PREDICTED_OR_MEASURED" 0 "(BIT_0)OLD_OR_NEW" ;
VAL_ 154 OBJ_Object_Class_27 9 "TWO_WHEELER" 8 "UNCERTAIN_VCL" 7 "ANIMAL" 6 "GENERAL_OBJECT" 5 "PEDESTRIAN" 4 "BICYCLE" 3 "MOTORBIKE" 2 "TRUCK" 1 "CAR" 0 "UNFILLED" ;
VAL_ 154 OBJ_Camera_Source_27 11 "PARKING_RIGHT" 10 "PARKING_LEFT" 9 "PARKING_REAR" 8 "PARKING_FRONT" 7 "FRONT_CORNER_RIGHT" 6 "FRONT_CORNER_LEFT" 5 "REAR_CORNER_RIGHT" 4 "REAR_CORNER_LEFT" 3 "REAR" 2 "FRONT_FISHEYE" 1 "FRONT_NARROW" 0 "FRONT_MAIN" ;
VAL_ 154 OBJ_Motion_Status_27 5 "MOVING_SLOWLY" 4 "STOPPED" 3 "STATIONARY" 2 "MOVING" 1 "UNKNOWN" 0 "INVALID" ;
VAL_ 154 OBJ_Motion_Orientation_27 13 "INVALID" 12 "NORTH" 11 "NORTH_WEST" 9 "WEST" 7 "SOUTH_WEST" 6 "SOUTH" 5 "SOUTH_EAST" 3 "EAST" 1 "NORTH_EAST" 0 "UNKNOWN" ;
VAL_ 154 OBJ_Has_Cut_Lane_27 1 "TRUE" 0 "FALSE" ;
VAL_ 154 OBJ_Has_Cut_Path_27 1 "TRUE" 0 "FALSE" ;
VAL_ 154 OBJ_Brake_Light_Validity_27 1 "TRUE" 0 "FALSE" ;
VAL_ 154 OBJ_Brake_Light_27 1 "TRUE" 0 "FALSE" ;
VAL_ 154 OBJ_Turn_Indicator_Right_27 1 "TRUE" 0 "FALSE" ;
VAL_ 154 OBJ_Turn_Indicator_Left_27 1 "TRUE" 0 "FALSE" ;
VAL_ 154 OBJ_Turn_Indicator_Validity_27 1 "TRUE" 0 "FALSE" ;
VAL_ 154 OBJ_Right_Out_Of_Image_27 1 "TRUE" 0 "FALSE" ;
VAL_ 154 OBJ_Left_Out_Of_Image_27 1 "TRUE" 0 "FALSE" ;
VAL_ 154 OBJ_Right_Out_Of_Image_V_27 1 "TRUE" 0 "FALSE" ;
VAL_ 154 OBJ_Left_Out_Of_Image_V_27 1 "TRUE" 0 "FALSE" ;
VAL_ 154 OBJ_Top_Out_Of_Image_27 1 "TRUE" 0 "FALSE" ;
VAL_ 154 OBJ_Bottom_Out_Of_Image_27 1 "TRUE" 0 "FALSE" ;
VAL_ 154 OBJ_Top_Out_Of_Image_V_27 1 "VALID" 0 "INVALID" ;
VAL_ 154 OBJ_Bottom_Out_Of_Image_V_27 1 "VALID" 0 "INVALID" ;
VAL_ 154 OBJ_Lane_Assignment_27 5 "RIGHT_RIGHT" 4 "RIGHT" 3 "HOST" 2 "LEFT" 1 "LEFT_LEFT" 0 "UNKNOWN" ;
VAL_ 154 OBJ_Lane_Assignment_V_27 1 "VALID" 0 "INVALID" ;
VAL_ 154 OBJ_Age_Seconds_V_27 1 "VALID" 0 "INVALID" ;
VAL_ 154 OBJ_Width_V_27 1 "VALID" 0 "INVALID" ;
VAL_ 154 OBJ_Width_STD_V_27 1 "VALID" 0 "INVALID" ;
VAL_ 154 OBJ_Length_V_27 1 "VALID" 0 "INVALID" ;
VAL_ 154 OBJ_Length_STD_V_27 1 "VALID" 0 "INVALID" ;
VAL_ 154 OBJ_Height_V_27 1 "VALID" 0 "INVALID" ;
VAL_ 154 OBJ_Height_STD_V_27 1 "VALID" 0 "INVALID" ;
VAL_ 154 OBJ_Abs_Long_Velocity_V_27 1 "VALID" 0 "INVALID" ;
VAL_ 154 OBJ_Abs_Long_Vel_STD_V_27 1 "VALID" 0 "INVALID" ;
VAL_ 154 OBJ_Abs_Lat_Velocity_V_27 1 "VALID" 0 "INVALID" ;
VAL_ 154 OBJ_Abs_Lat_Vel_STD_V_27 1 "VALID" 0 "INVALID" ;
VAL_ 154 OBJ_Abs_Long_Acc_V_27 1 "VALID" 0 "INVALID" ;
VAL_ 154 OBJ_Abs_Long_Acc_STD_V_27 1 "VALID" 0 "INVALID" ;
VAL_ 154 OBJ_Abs_Lat_Acc_V_27 1 "VALID" 0 "INVALID" ;
VAL_ 154 OBJ_Abs_Lat_Acc_STD_V_27 1 "VALID" 0 "INVALID" ;
VAL_ 154 OBJ_Abs_Acceleration_V_27 1 "VALID" 0 "INVALID" ;
VAL_ 154 OBJ_Abs_Acc_STD_V_27 1 "VALID" 0 "INVALID" ;
VAL_ 154 OBJ_Inv_TTC_V_27 1 "VALID" 0 "INVALID" ;
VAL_ 154 OBJ_Inv_TTC_STD_V_27 1 "VALID" 0 "INVALID" ;
VAL_ 154 OBJ_Relative_Long_Acc_V_27 1 "VALID" 0 "INVALID" ;
VAL_ 154 OBJ_Rel_Long_Acc_STD_V_27 1 "VALID" 0 "INVALID" ;
VAL_ 154 OBJ_Relative_Long_Velocity_V_27 1 "VALID" 0 "INVALID" ;
VAL_ 154 OBJ_Rel_Long_Vel_STD_V_27 1 "VALID" 0 "INVALID" ;
VAL_ 154 OBJ_Relative_Lat_Velocity_V_27 1 "VALID" 0 "INVALID" ;
VAL_ 154 OBJ_Rel_Lat_Vel_STD_V_27 1 "VALID" 0 "INVALID" ;
VAL_ 154 OBJ_Long_Distance_V_27 1 "VALID" 0 "INVALID" ;
VAL_ 154 OBJ_Long_Distance_STD_V_27 1 "VALID" 0 "INVALID" ;
VAL_ 154 OBJ_Lat_Distance_V_27 1 "VALID" 0 "INVALID" ;
VAL_ 154 OBJ_Lat_Distance_STD_V_27 1 "VALID" 0 "INVALID" ;
VAL_ 154 OBJ_Absolute_Speed_V_27 1 "VALID" 0 "INVALID" ;
VAL_ 154 OBJ_Absolute_Speed_STD_V_27 1 "VALID" 0 "INVALID" ;
VAL_ 154 OBJ_Heading_V_27 1 "VALID" 0 "INVALID" ;
VAL_ 154 OBJ_Heading_STD_V_27 1 "VALID" 0 "INVALID" ;
VAL_ 154 OBJ_Angle_Rate_STD_V_27 1 "VALID" 0 "INVALID" ;
VAL_ 154 OBJ_Angle_Rate_V_27 1 "VALID" 0 "INVALID" ;
VAL_ 154 OBJ_Angle_Right_V_27 1 "VALID" 0 "INVALID" ;
VAL_ 154 OBJ_Angle_Right_STD_V_27 1 "VALID" 0 "INVALID" ;
VAL_ 154 OBJ_Angle_Left_V_27 1 "VALID" 0 "INVALID" ;
VAL_ 154 OBJ_Angle_Left_STD_V_27 1 "VALID" 0 "INVALID" ;
VAL_ 154 OBJ_Angle_Side_V_27 1 "VALID" 0 "INVALID" ;
VAL_ 154 OBJ_Angle_Side_STD_V_27 1 "VALID" 0 "INVALID" ;
VAL_ 154 OBJ_Angle_Mid_V_27 1 "VALID" 0 "INVALID" ;
VAL_ 154 OBJ_Angle_Mid_STD_V_27 1 "VALID" 0 "INVALID" ;
VAL_ 154 OBJ_Angle_Bottom_V_27 1 "VALID" 0 "INVALID" ;
VAL_ 154 OBJ_Angle_Bottom_STD_V_27 1 "VALID" 0 "INVALID" ;
VAL_ 154 OBJ_Visibility_Side_V_27 1 "VALID" 0 "INVALID" ;
VAL_ 154 OBJ_Visibility_Side_27 2 "REAR" 1 "FRONT" 0 "NOT_VISIBLE" ;
VAL_ 154 OBJ_Is_In_Drivable_Area_27 1 "TRUE" 0 "FALSE" ;
VAL_ 154 OBJ_Is_In_Drivable_Area_V_27 1 "VALID" 0 "INVALID" ;
VAL_ 154 OBJ_Is_VeryClose_V_27 1 "VALID" 0 "INVALID" ;
VAL_ 154 OBJ_Is_VeryClose_27 1 "TRUE" 0 "FALSE" ;
VAL_ 154 OBJ_OverlapAngleEgoLaneR_V_27 1 "VALID" 0 "INVALID" ;
VAL_ 154 OBJ_OverlapAngleEgoLaneL_V_27 1 "VALID" 0 "INVALID" ;
VAL_ 154 OBJ_Is_EMERGENCY_VCL_27 1 "TRUE" 0 "FALSE" ;
VAL_ 154 OBJ_EMERGENCY_LIGHT_COLOR_27 3 "(1000)ORANGE" 2 "(0100)BLUE" 1 "(0010)RED" 0 "(0001)OTHER" ;
VAL_ 154 OBJ_EMERGENCY_V_27 1 "TRUE" 0 "FALSE" ;
VAL_ 154 OBJ_Angle_Top_V_27 1 "VALID" 0 "INVALID" ;
VAL_ 154 OBJ_Angle_Top_STD_V_27 1 "VALID" 0 "INVALID" ;
VAL_ 154 OBJ_Open_Door_Left_27 1 "TRUE" 0 "FALSE" ;
VAL_ 154 OBJ_Open_Door_Right_27 1 "TRUE" 0 "FALSE" ;
VAL_ 154 OBJ_Visible_Left_or_Right_27 2 "RIGHT" 1 "LEFT" 0 "NOT_VISIBLE" ;
VAL_ 154 OBJ_Visible_Left_or_Right_V_27 1 "VALID" 0 "INVALID" ;
VAL_ 154 OBJ_Fusion_Source_28 2 "(BIT_2)RADAR2" 1 "(BIT_1)RADAR1" 0 "(BIT_0)CAMERA" ;
VAL_ 154 OBJ_Triggered_SDM_28 2 "NOT_TRIGGERED" 1 "TRIGGERED" 0 "NOT_AVAILABLE" ;
VAL_ 154 OBJ_Motion_Category_28 13 "ONCOMING" 12 "PRECEEDING" 11 "MOVING" 10 "RTAP" 9 "LTAP" 8 "CROSSING" 7 "MOVING_OUT" 6 "MOVING_IN" 5 "CLOSE_CUT_IN" 4 "PASSING_OUT" 3 "PASSING_IN" 2 "PASSING" 1 "UNDEFINED" 0 "UNFILLED" ;
VAL_ 154 OBJ_Measuring_Status_28 2 "(BIT_2)NOT_VALID_OR_VALID" 1 "(BIT_1)PREDICTED_OR_MEASURED" 0 "(BIT_0)OLD_OR_NEW" ;
VAL_ 154 OBJ_Object_Class_28 9 "TWO_WHEELER" 8 "UNCERTAIN_VCL" 7 "ANIMAL" 6 "GENERAL_OBJECT" 5 "PEDESTRIAN" 4 "BICYCLE" 3 "MOTORBIKE" 2 "TRUCK" 1 "CAR" 0 "UNFILLED" ;
VAL_ 154 OBJ_Camera_Source_28 11 "PARKING_RIGHT" 10 "PARKING_LEFT" 9 "PARKING_REAR" 8 "PARKING_FRONT" 7 "FRONT_CORNER_RIGHT" 6 "FRONT_CORNER_LEFT" 5 "REAR_CORNER_RIGHT" 4 "REAR_CORNER_LEFT" 3 "REAR" 2 "FRONT_FISHEYE" 1 "FRONT_NARROW" 0 "FRONT_MAIN" ;
VAL_ 154 OBJ_Motion_Status_28 5 "MOVING_SLOWLY" 4 "STOPPED" 3 "STATIONARY" 2 "MOVING" 1 "UNKNOWN" 0 "INVALID" ;
VAL_ 154 OBJ_Motion_Orientation_28 13 "INVALID" 12 "NORTH" 11 "NORTH_WEST" 9 "WEST" 7 "SOUTH_WEST" 6 "SOUTH" 5 "SOUTH_EAST" 3 "EAST" 1 "NORTH_EAST" 0 "UNKNOWN" ;
VAL_ 154 OBJ_Has_Cut_Lane_28 1 "TRUE" 0 "FALSE" ;
VAL_ 154 OBJ_Has_Cut_Path_28 1 "TRUE" 0 "FALSE" ;
VAL_ 154 OBJ_Brake_Light_Validity_28 1 "TRUE" 0 "FALSE" ;
VAL_ 154 OBJ_Brake_Light_28 1 "TRUE" 0 "FALSE" ;
VAL_ 154 OBJ_Turn_Indicator_Right_28 1 "TRUE" 0 "FALSE" ;
VAL_ 154 OBJ_Turn_Indicator_Left_28 1 "TRUE" 0 "FALSE" ;
VAL_ 154 OBJ_Turn_Indicator_Validity_28 1 "TRUE" 0 "FALSE" ;
VAL_ 154 OBJ_Right_Out_Of_Image_28 1 "TRUE" 0 "FALSE" ;
VAL_ 154 OBJ_Left_Out_Of_Image_28 1 "TRUE" 0 "FALSE" ;
VAL_ 154 OBJ_Right_Out_Of_Image_V_28 1 "TRUE" 0 "FALSE" ;
VAL_ 154 OBJ_Left_Out_Of_Image_V_28 1 "TRUE" 0 "FALSE" ;
VAL_ 154 OBJ_Top_Out_Of_Image_28 1 "TRUE" 0 "FALSE" ;
VAL_ 154 OBJ_Bottom_Out_Of_Image_28 1 "TRUE" 0 "FALSE" ;
VAL_ 154 OBJ_Top_Out_Of_Image_V_28 1 "VALID" 0 "INVALID" ;
VAL_ 154 OBJ_Bottom_Out_Of_Image_V_28 1 "VALID" 0 "INVALID" ;
VAL_ 154 OBJ_Lane_Assignment_28 5 "RIGHT_RIGHT" 4 "RIGHT" 3 "HOST" 2 "LEFT" 1 "LEFT_LEFT" 0 "UNKNOWN" ;
VAL_ 154 OBJ_Lane_Assignment_V_28 1 "VALID" 0 "INVALID" ;
VAL_ 154 OBJ_Age_Seconds_V_28 1 "VALID" 0 "INVALID" ;
VAL_ 154 OBJ_Width_V_28 1 "VALID" 0 "INVALID" ;
VAL_ 154 OBJ_Width_STD_V_28 1 "VALID" 0 "INVALID" ;
VAL_ 154 OBJ_Length_V_28 1 "VALID" 0 "INVALID" ;
VAL_ 154 OBJ_Length_STD_V_28 1 "VALID" 0 "INVALID" ;
VAL_ 154 OBJ_Height_V_28 1 "VALID" 0 "INVALID" ;
VAL_ 154 OBJ_Height_STD_V_28 1 "VALID" 0 "INVALID" ;
VAL_ 154 OBJ_Abs_Long_Velocity_V_28 1 "VALID" 0 "INVALID" ;
VAL_ 154 OBJ_Abs_Long_Vel_STD_V_28 1 "VALID" 0 "INVALID" ;
VAL_ 154 OBJ_Abs_Lat_Velocity_V_28 1 "VALID" 0 "INVALID" ;
VAL_ 154 OBJ_Abs_Lat_Vel_STD_V_28 1 "VALID" 0 "INVALID" ;
VAL_ 154 OBJ_Abs_Long_Acc_V_28 1 "VALID" 0 "INVALID" ;
VAL_ 154 OBJ_Abs_Long_Acc_STD_V_28 1 "VALID" 0 "INVALID" ;
VAL_ 154 OBJ_Abs_Lat_Acc_V_28 1 "VALID" 0 "INVALID" ;
VAL_ 154 OBJ_Abs_Lat_Acc_STD_V_28 1 "VALID" 0 "INVALID" ;
VAL_ 154 OBJ_Abs_Acceleration_V_28 1 "VALID" 0 "INVALID" ;
VAL_ 154 OBJ_Abs_Acc_STD_V_28 1 "VALID" 0 "INVALID" ;
VAL_ 154 OBJ_Inv_TTC_V_28 1 "VALID" 0 "INVALID" ;
VAL_ 154 OBJ_Inv_TTC_STD_V_28 1 "VALID" 0 "INVALID" ;
VAL_ 154 OBJ_Relative_Long_Acc_V_28 1 "VALID" 0 "INVALID" ;
VAL_ 154 OBJ_Rel_Long_Acc_STD_V_28 1 "VALID" 0 "INVALID" ;
VAL_ 154 OBJ_Relative_Long_Velocity_V_28 1 "VALID" 0 "INVALID" ;
VAL_ 154 OBJ_Rel_Long_Vel_STD_V_28 1 "VALID" 0 "INVALID" ;
VAL_ 154 OBJ_Relative_Lat_Velocity_V_28 1 "VALID" 0 "INVALID" ;
VAL_ 154 OBJ_Rel_Lat_Vel_STD_V_28 1 "VALID" 0 "INVALID" ;
VAL_ 154 OBJ_Long_Distance_V_28 1 "VALID" 0 "INVALID" ;
VAL_ 154 OBJ_Long_Distance_STD_V_28 1 "VALID" 0 "INVALID" ;
VAL_ 154 OBJ_Lat_Distance_V_28 1 "VALID" 0 "INVALID" ;
VAL_ 154 OBJ_Lat_Distance_STD_V_28 1 "VALID" 0 "INVALID" ;
VAL_ 154 OBJ_Absolute_Speed_V_28 1 "VALID" 0 "INVALID" ;
