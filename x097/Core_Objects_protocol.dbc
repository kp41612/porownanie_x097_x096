VERSION "15"
// BundelVersion=v4.21.5_CF1
NS_ :

BS_:

BU_: EyeQ4 MCU

BO_ 154 Core_Objects_protocol: 4820 EyeQ4
 SG_ OBJ_Angle_Right_STD_5 : 5647|14@1+ (0.0001,0) [0|1.571] "rad" MCU
 SG_ OBJ_Angle_Right_STD_V_5 : 5661|1@1+ (1,0) [0|1] "bool" MCU
 SG_ Reserved_21_5 : 5662|2@1+ (1,0) [0|0] "NA" MCU
 SG_ OBJ_Angle_Left_5 : 5664|14@1+ (0.0002,-1.571) [-1.571|1.571] "rad" MCU
 SG_ OBJ_Angle_Left_V_5 : 5678|1@1+ (1,0) [0|1] "bool" MCU
 SG_ OBJ_Angle_Left_STD_5 : 5679|14@1+ (0.0001,0) [0|1.571] "rad" MCU
 SG_ OBJ_Angle_Left_STD_V_5 : 5693|1@1+ (1,0) [0|1] "bool" MCU
 SG_ Reserved_22_5 : 5694|2@1+ (1,0) [0|0] "NA" MCU
 SG_ OBJ_Angle_Side_5 : 5696|14@1+ (0.0002,-1.571) [-1.571|1.571] "rad" MCU
 SG_ OBJ_Angle_Side_V_5 : 5710|1@1+ (1,0) [0|1] "bool" MCU
 SG_ OBJ_Angle_Side_STD_5 : 5711|14@1+ (0.0001,0) [0|1.571] "rad" MCU
 SG_ OBJ_Angle_Side_STD_V_5 : 5725|1@1+ (1,0) [0|1] "bool" MCU
 SG_ OBJ_Angle_Mid_V_5 : 5726|1@1+ (1,0) [0|1] "bool" MCU
 SG_ Reserved_23_5 : 5727|1@1+ (1,0) [0|0] "NA" MCU
 SG_ OBJ_Angle_Mid_5 : 5728|14@1+ (0.0002,-1.571) [-1.571|1.571] "rad" MCU
 SG_ OBJ_Angle_Mid_STD_5 : 5742|14@1+ (0.0001,0) [0|1.571] "rad" MCU
 SG_ OBJ_Angle_Mid_STD_V_5 : 5756|1@1+ (1,0) [0|1] "bool" MCU
 SG_ OBJ_Angle_Bottom_V_5 : 5757|1@1+ (1,0) [0|1] "bool" MCU
 SG_ Reserved_24_5 : 5758|2@1+ (1,0) [0|0] "NA" MCU
 SG_ OBJ_Angle_Bottom_5 : 5760|14@1+ (0.0002,-1.571) [-1.571|1.571] "rad" MCU
 SG_ OBJ_Angle_Bottom_STD_5 : 5774|14@1+ (0.0001,0) [0|1.571] "rad" MCU
 SG_ OBJ_Angle_Bottom_STD_V_5 : 5788|1@1+ (1,0) [0|1] "bool" MCU
 SG_ OBJ_Visibility_Side_V_5 : 5789|1@1+ (1,0) [0|1] "bool" MCU
 SG_ OBJ_Visibility_Side_5 : 5790|2@1+ (1,0) [0|2] "ENUM" MCU
 SG_ OBJ_Is_In_Drivable_Area_5 : 5792|1@1+ (1,0) [0|1] "bool" MCU
 SG_ OBJ_Is_In_Drivable_Area_V_5 : 5793|1@1+ (1,0) [0|1] "bool" MCU
 SG_ OBJ_Is_VeryClose_V_5 : 5794|1@1+ (1,0) [0|1] "bool" MCU
 SG_ OBJ_Is_VeryClose_5 : 5795|1@1+ (1,0) [0|1] "bool" MCU
 SG_ OBJ_Buffer_C4_5 : 5796|2@1+ (1,0) [0|2] "NA" MCU
 SG_ OBJ_Buffer_C5_5 : 5798|2@1+ (1,0) [0|2] "NA" MCU
 SG_ OBJ_Buffer_C6_5 : 5800|2@1+ (1,0) [0|2] "NA" MCU
 SG_ OBJ_Buffer_C7_5 : 5802|2@1+ (1,0) [0|2] "NA" MCU
 SG_ OBJ_OverlapAngleEgoLaneR_5 : 5804|10@1+ (0.01,-3.14) [-3.14|3.14] "rad" MCU
 SG_ OBJ_OverlapAngleEgoLaneR_V_5 : 5814|1@1+ (1,0) [0|1] "bool" MCU
 SG_ Reserved_25_5 : 5815|9@1+ (1,0) [0|0] "NA" MCU
 SG_ OBJ_OverlapAngleEgoLaneL_5 : 5824|10@1+ (0.01,-3.14) [-3.14|3.14] "rad" MCU
 SG_ OBJ_OverlapAngleEgoLaneL_V_5 : 5834|1@1+ (1,0) [0|1] "bool" MCU
 SG_ OBJ_Is_EMERGENCY_VCL_5 : 5835|1@1+ (1,0) [0|1] "bool" MCU
 SG_ OBJ_EMERGENCY_LIGHT_COLOR_5 : 5836|4@1+ (1,0) [0|15] "BITWIZE" MCU
 SG_ OBJ_EMERGENCY_V_5 : 5840|1@1+ (1,0) [0|1] "bool" MCU
 SG_ OBJ_Angle_Top_5 : 5841|14@1+ (0.0002,0) [0|3.1415] "rad" MCU
 SG_ OBJ_Angle_Top_V_5 : 5855|1@1+ (1,0) [0|1] "bool" MCU
 SG_ OBJ_Angle_Top_STD_5 : 5856|15@1+ (0.0001,0) [0|3.1415] "rad" MCU
 SG_ OBJ_Angle_Top_STD_V_5 : 5871|1@1+ (1,0) [0|1] "bool" MCU
 SG_ OBJ_Open_Door_Left_5 : 5872|1@1+ (1,0) [0|1] "bool" MCU
 SG_ OBJ_Open_Door_Right_5 : 5873|1@1+ (1,0) [0|1] "bool" MCU
 SG_ OBJ_Visible_Left_or_Right_5 : 5874|2@1+ (1,0) [0|2] "ENUM" MCU
 SG_ OBJ_Visible_Left_or_Right_V_5 : 5876|1@1+ (1,0) [0|1] "bool" MCU
 SG_ OBJ_2W_Is_Motorbike_Probability_5 : 5877|8@1+ (0.01,0) [0|1] "NA" MCU
 SG_ Reserved_26_5 : 5885|3@1+ (1,0) [0|0] "NA" MCU
 SG_ OBJ_2W_Is_Bicycle_Probability_5 : 5888|8@1+ (0.01,0) [0|1] "NA" MCU
 SG_ Reserved_27_5 : 5896|24@1+ (1,0) [0|0] "NA" MCU
 SG_ OBJ_CRC_6 : 5920|32@1+ (1,0) [0|4294967295] "NA" MCU
 SG_ OBJ_ID_6 : 5952|8@1+ (1,0) [0|255] "counter" MCU
 SG_ OBJ_Existence_Probability_6 : 5960|8@1+ (0.01,0) [0|1] "NA" MCU
 SG_ OBJ_Fusion_Source_6 : 5968|16@1+ (1,0) [0|65535] "BITWIZE" MCU
 SG_ OBJ_Triggered_SDM_6 : 5984|2@1+ (1,0) [0|2] "ENUM" MCU
 SG_ OBJ_Motion_Category_6 : 5986|4@1+ (1,0) [0|13] "ENUM" MCU
 SG_ OBJ_Moving_IN_Probability_6 : 5990|7@1+ (0.01,0) [0|1] "NA" MCU
 SG_ OBJ_Object_Age_6 : 5997|11@1+ (1,0) [0|2047] "frames" MCU
 SG_ OBJ_Measuring_Status_6 : 6008|3@1+ (1,0) [0|7] "BITWIZE" MCU
 SG_ OBJ_Object_Class_6 : 6011|4@1+ (1,0) [0|9] "ENUM" MCU
 SG_ Reserved_4_6 : 6015|1@1+ (1,0) [0|0] "NA" MCU
 SG_ OBJ_Class_Probability_6 : 6016|7@1+ (0.01,0) [0|1] "NA" MCU
 SG_ OBJ_Car_Probability_6 : 6023|7@1+ (0.01,0) [0|1] "NA" MCU
 SG_ OBJ_Truck_Probability_6 : 6030|7@1+ (0.01,0) [0|1] "NA" MCU
 SG_ OBJ_Bike_Probability_6 : 6037|7@1+ (0.01,0) [0|1] "NA" MCU
 SG_ OBJ_Camera_Source_6 : 6044|4@1+ (1,0) [0|15] "ENUM" MCU
 SG_ OBJ_Motion_Status_6 : 6048|3@1+ (1,0) [0|5] "ENUM" MCU
 SG_ OBJ_Motion_Orientation_6 : 6051|4@1+ (1,0) [0|13] "ENUM" MCU
 SG_ OBJ_Has_Cut_Lane_6 : 6055|1@1+ (1,0) [0|1] "bool" MCU
 SG_ OBJ_Has_Cut_Path_6 : 6056|1@1+ (1,0) [0|1] "bool" MCU
 SG_ OBJ_Brake_Light_Validity_6 : 6057|1@1+ (1,0) [0|1] "bool" MCU
 SG_ OBJ_Brake_Light_6 : 6058|1@1+ (1,0) [0|1] "bool" MCU
 SG_ OBJ_Turn_Indicator_Right_6 : 6059|1@1+ (1,0) [0|1] "bool" MCU
 SG_ OBJ_Turn_Indicator_Left_6 : 6060|1@1+ (1,0) [0|1] "bool" MCU
 SG_ OBJ_Turn_Indicator_Validity_6 : 6061|1@1+ (1,0) [0|1] "bool" MCU
 SG_ OBJ_Right_Out_Of_Image_6 : 6062|1@1+ (1,0) [0|1] "bool" MCU
 SG_ OBJ_Left_Out_Of_Image_6 : 6063|1@1+ (1,0) [0|1] "bool" MCU
 SG_ OBJ_Right_Out_Of_Image_V_6 : 6064|1@1+ (1,0) [0|1] "bool" MCU
 SG_ OBJ_Left_Out_Of_Image_V_6 : 6065|1@1+ (1,0) [0|1] "bool" MCU
 SG_ OBJ_Top_Out_Of_Image_6 : 6066|1@1+ (1,0) [0|1] "bool" MCU
 SG_ OBJ_Bottom_Out_Of_Image_6 : 6067|1@1+ (1,0) [0|1] "bool" MCU
 SG_ OBJ_Top_Out_Of_Image_V_6 : 6068|1@1+ (1,0) [0|1] "bool" MCU
 SG_ OBJ_Bottom_Out_Of_Image_V_6 : 6069|1@1+ (1,0) [0|1] "bool" MCU
 SG_ OBJ_Lane_Assignment_6 : 6070|3@1+ (1,0) [0|5] "ENUM" MCU
 SG_ OBJ_Lane_Assignment_V_6 : 6073|1@1+ (1,0) [0|1] "bool" MCU
 SG_ Reserved_5_6 : 6074|6@1+ (1,0) [0|0] "NA" MCU
 SG_ OBJ_Age_Seconds_6 : 6080|7@1+ (1,0) [0|100] "s" MCU
 SG_ OBJ_Age_Seconds_V_6 : 6087|1@1+ (1,0) [0|1] "bool" MCU
 SG_ OBJ_Width_6 : 6088|9@1+ (0.01,0) [0.4|2.95] "m" MCU
 SG_ OBJ_Width_V_6 : 6097|1@1+ (1,0) [0|1] "bool" MCU
 SG_ OBJ_Width_STD_6 : 6098|11@1+ (0.001,0) [0|2] "m" MCU
 SG_ OBJ_Width_STD_V_6 : 6109|1@1+ (1,0) [0|1] "bool" MCU
 SG_ Reserved_6_6 : 6110|2@1+ (1,0) [0|0] "NA" MCU
 SG_ OBJ_Length_6 : 6112|9@1+ (0.05,0) [0.6|21] "m" MCU
 SG_ OBJ_Length_V_6 : 6121|1@1+ (1,0) [0|1] "bool" MCU
 SG_ OBJ_Length_STD_6 : 6122|10@1+ (0.01,0) [0|10] "m" MCU
 SG_ OBJ_Length_STD_V_6 : 6132|1@1+ (1,0) [0|1] "bool" MCU
 SG_ OBJ_Radar_ID_6 : 6133|8@1+ (1,0) [0|255] "counter" MCU
 SG_ Reserved_7_6 : 6141|3@1+ (1,0) [0|0] "NA" MCU
 SG_ OBJ_Height_6 : 6144|9@1+ (0.01,0) [0|2.95] "m" MCU
 SG_ OBJ_Height_V_6 : 6153|1@1+ (1,0) [0|1] "bool" MCU
 SG_ OBJ_Height_STD_6 : 6154|11@1+ (0.001,0) [0|2] "m" MCU
 SG_ OBJ_Height_STD_V_6 : 6165|1@1+ (1,0) [0|1] "bool" MCU
 SG_ Reserved_8_6 : 6166|10@1+ (1,0) [0|0] "NA" MCU
 SG_ OBJ_Abs_Long_Velocity_6 : 6176|12@1+ (0.05,-100) [-100|100] "m_per_s" MCU
 SG_ OBJ_Abs_Long_Velocity_V_6 : 6188|1@1+ (1,0) [0|1] "bool" MCU
 SG_ OBJ_Abs_Long_Velocity_STD_6 : 6189|13@1+ (0.01,0) [0|65] "m_per_s" MCU
 SG_ OBJ_Abs_Long_Vel_STD_V_6 : 6202|1@1+ (1,0) [0|1] "bool" MCU
 SG_ Reserved_9_6 : 6203|5@1+ (1,0) [0|0] "NA" MCU
 SG_ OBJ_Abs_Lat_Velocity_6 : 6208|11@1+ (0.05,-50) [-50|50] "m_per_s" MCU
 SG_ OBJ_Abs_Lat_Velocity_V_6 : 6219|1@1+ (1,0) [0|1] "bool" MCU
 SG_ OBJ_Abs_Lat_Velocity_STD_6 : 6220|13@1+ (0.01,0) [0|50] "m_per_s" MCU
 SG_ OBJ_Abs_Lat_Vel_STD_V_6 : 6233|1@1+ (1,0) [0|1] "bool" MCU
 SG_ Reserved_10_6 : 6234|6@1+ (1,0) [0|0] "NA" MCU
 SG_ OBJ_Abs_Long_Acc_6 : 6240|9@1+ (0.05,-10) [-10|10] "m_per_s2" MCU
 SG_ OBJ_Abs_Long_Acc_V_6 : 6249|1@1+ (1,0) [0|1] "bool" MCU
 SG_ OBJ_Abs_Long_Acc_STD_6 : 6250|10@1+ (0.01,0) [0|7.3] "m_per_s2" MCU
 SG_ OBJ_Abs_Long_Acc_STD_V_6 : 6260|1@1+ (1,0) [0|1] "bool" MCU
 SG_ OBJ_Abs_Lat_Acc_6 : 6261|9@1+ (0.05,-10) [-10|10] "m_per_s2" MCU
 SG_ OBJ_Abs_Lat_Acc_V_6 : 6270|1@1+ (1,0) [0|1] "bool" MCU
 SG_ Reserved_11_6 : 6271|1@1+ (1,0) [0|0] "NA" MCU
 SG_ OBJ_Abs_Lat_Acc_STD_6 : 6272|10@1+ (0.01,0) [0|7.3] "m_per_s2" MCU
 SG_ OBJ_Abs_Lat_Acc_STD_V_6 : 6282|1@1+ (1,0) [0|1] "bool" MCU
 SG_ OBJ_Abs_Acceleration_6 : 6283|9@1+ (0.05,-12.7) [-12.7|12.7] "m_per_s2" MCU
 SG_ OBJ_Abs_Acceleration_V_6 : 6292|1@1+ (1,0) [0|1] "bool" MCU
 SG_ OBJ_Abs_Acc_STD_6 : 6293|10@1+ (0.01,0) [0|7.3] "m_per_s2" MCU
 SG_ OBJ_Abs_Acc_STD_V_6 : 6303|1@1+ (1,0) [0|1] "bool" MCU
 SG_ OBJ_Inv_TTC_6 : 6304|11@1+ (0.01,-8) [-8|8] "INV(s)" MCU
 SG_ OBJ_Inv_TTC_V_6 : 6315|1@1+ (1,0) [0|1] "bool" MCU
 SG_ OBJ_Inv_TTC_STD_6 : 6316|12@1+ (0.001,0) [0|4] "INV(s)" MCU
 SG_ OBJ_Inv_TTC_STD_V_6 : 6328|1@1+ (1,0) [0|1] "bool" MCU
 SG_ Reserved_12_6 : 6329|7@1+ (1,0) [0|0] "NA" MCU
 SG_ OBJ_Relative_Long_Acc_6 : 6336|10@1+ (0.05,-20) [-20|20] "m_per_s2" MCU
 SG_ OBJ_Relative_Long_Acc_V_6 : 6346|1@1+ (1,0) [0|1] "bool" MCU
 SG_ OBJ_Relative_Long_Acc_STD_6 : 6347|10@1+ (0.01,0) [0|7.3] "m_per_s2" MCU
 SG_ OBJ_Rel_Long_Acc_STD_V_6 : 6357|1@1+ (1,0) [0|1] "bool" MCU
 SG_ Reserved_13_6 : 6358|10@1+ (1,0) [0|0] "NA" MCU
 SG_ OBJ_Relative_Long_Velocity_6 : 6368|13@1+ (0.05,-120) [-120|130] "m_per_s" MCU
 SG_ OBJ_Relative_Long_Velocity_V_6 : 6381|1@1+ (1,0) [0|1] "bool" MCU
 SG_ OBJ_Relative_Long_Vel_STD_6 : 6382|14@1+ (0.01,0) [0|130] "m_per_s" MCU
 SG_ OBJ_Rel_Long_Vel_STD_V_6 : 6396|1@1+ (1,0) [0|1] "bool" MCU
 SG_ Reserved_14_6 : 6397|3@1+ (1,0) [0|0] "NA" MCU
 SG_ OBJ_Relative_Lat_Velocity_6 : 6400|11@1+ (0.05,-50) [-50|50] "m_per_s" MCU
 SG_ OBJ_Relative_Lat_Velocity_V_6 : 6411|1@1+ (1,0) [0|1] "bool" MCU
 SG_ OBJ_Relative_Lat_Velocity_STD_6 : 6412|13@1+ (0.01,0) [0|50] "m_per_s" MCU
 SG_ OBJ_Rel_Lat_Vel_STD_V_6 : 6425|1@1+ (1,0) [0|1] "bool" MCU
 SG_ Reserved_15_6 : 6426|6@1+ (1,0) [0|0] "NA" MCU
 SG_ OBJ_Long_Distance_6 : 6432|14@1+ (0.05,-200) [-200|500] "m" MCU
 SG_ OBJ_Long_Distance_V_6 : 6446|1@1+ (1,0) [0|1] "bool" MCU
 SG_ OBJ_Long_Distance_STD_6 : 6447|15@1+ (0.01,0) [0|250] "m" MCU
 SG_ OBJ_Long_Distance_STD_V_6 : 6462|1@1+ (1,0) [0|1] "bool" MCU
 SG_ Reserved_16_6 : 6463|1@1+ (1,0) [0|0] "NA" MCU
 SG_ OBJ_Lat_Distance_6 : 6464|12@1+ (0.05,-100) [-100|100] "m" MCU
 SG_ OBJ_Lat_Distance_V_6 : 6476|1@1+ (1,0) [0|1] "bool" MCU
 SG_ OBJ_Lat_Distance_STD_6 : 6477|14@1+ (0.01,0) [0|100] "m" MCU
 SG_ OBJ_Lat_Distance_STD_V_6 : 6491|1@1+ (1,0) [0|1] "bool" MCU
 SG_ Reserved_17_6 : 6492|4@1+ (1,0) [0|0] "NA" MCU
 SG_ OBJ_Absolute_Speed_6 : 6496|12@1+ (0.05,-65) [-65|65] "m_per_s" MCU
 SG_ OBJ_Absolute_Speed_V_6 : 6508|1@1+ (1,0) [0|1] "bool" MCU
 SG_ OBJ_Absolute_Speed_STD_6 : 6509|13@1+ (0.01,0) [0|65] "m_per_s" MCU
 SG_ OBJ_Absolute_Speed_STD_V_6 : 6522|1@1+ (1,0) [0|1] "bool" MCU
 SG_ Reserved_18_6 : 6523|5@1+ (1,0) [0|0] "NA" MCU
 SG_ OBJ_Heading_6 : 6528|10@1+ (0.01,-3.14) [-3.14|3.14] "rad" MCU
 SG_ OBJ_Heading_V_6 : 6538|1@1+ (1,0) [0|1] "bool" MCU
 SG_ OBJ_Heading_STD_6 : 6539|15@1+ (0.0001,0) [0|3.14] "rad" MCU
 SG_ OBJ_Heading_STD_V_6 : 6554|1@1+ (1,0) [0|1] "bool" MCU
 SG_ Reserved_19_6 : 6555|5@1+ (1,0) [0|0] "NA" MCU
 SG_ OBJ_Angle_Rate_STD_6 : 6560|15@1+ (0.0001,0) [0|2.2318] "RPS" MCU
 SG_ OBJ_Angle_Rate_STD_V_6 : 6575|1@1+ (1,0) [0|1] "bool" MCU
 SG_ OBJ_Angle_Rate_6 : 6576|12@1+ (0.002,-2.234) [-2.234|2.2318] "RPS" MCU
 SG_ OBJ_Angle_Rate_V_6 : 6588|1@1+ (1,0) [0|1] "bool" MCU
 SG_ Reserved_20_6 : 6589|3@1+ (1,0) [0|0] "NA" MCU
 SG_ OBJ_Angle_Right_6 : 6592|14@1+ (0.0002,-1.571) [-1.571|1.571] "rad" MCU
 SG_ OBJ_Angle_Right_V_6 : 6606|1@1+ (1,0) [0|1] "bool" MCU
 SG_ OBJ_Angle_Right_STD_6 : 6607|14@1+ (0.0001,0) [0|1.571] "rad" MCU
 SG_ OBJ_Angle_Right_STD_V_6 : 6621|1@1+ (1,0) [0|1] "bool" MCU
 SG_ Reserved_21_6 : 6622|2@1+ (1,0) [0|0] "NA" MCU
 SG_ OBJ_Angle_Left_6 : 6624|14@1+ (0.0002,-1.571) [-1.571|1.571] "rad" MCU
 SG_ OBJ_Angle_Left_V_6 : 6638|1@1+ (1,0) [0|1] "bool" MCU
 SG_ OBJ_Angle_Left_STD_6 : 6639|14@1+ (0.0001,0) [0|1.571] "rad" MCU
 SG_ OBJ_Angle_Left_STD_V_6 : 6653|1@1+ (1,0) [0|1] "bool" MCU
 SG_ Reserved_22_6 : 6654|2@1+ (1,0) [0|0] "NA" MCU
 SG_ OBJ_Angle_Side_6 : 6656|14@1+ (0.0002,-1.571) [-1.571|1.571] "rad" MCU
 SG_ OBJ_Angle_Side_V_6 : 6670|1@1+ (1,0) [0|1] "bool" MCU
 SG_ OBJ_Angle_Side_STD_6 : 6671|14@1+ (0.0001,0) [0|1.571] "rad" MCU
 SG_ OBJ_Angle_Side_STD_V_6 : 6685|1@1+ (1,0) [0|1] "bool" MCU
 SG_ OBJ_Angle_Mid_V_6 : 6686|1@1+ (1,0) [0|1] "bool" MCU
 SG_ Reserved_23_6 : 6687|1@1+ (1,0) [0|0] "NA" MCU
 SG_ OBJ_Angle_Mid_6 : 6688|14@1+ (0.0002,-1.571) [-1.571|1.571] "rad" MCU
 SG_ OBJ_Angle_Mid_STD_6 : 6702|14@1+ (0.0001,0) [0|1.571] "rad" MCU
 SG_ OBJ_Angle_Mid_STD_V_6 : 6716|1@1+ (1,0) [0|1] "bool" MCU
 SG_ OBJ_Angle_Bottom_V_6 : 6717|1@1+ (1,0) [0|1] "bool" MCU
 SG_ Reserved_24_6 : 6718|2@1+ (1,0) [0|0] "NA" MCU
 SG_ OBJ_Angle_Bottom_6 : 6720|14@1+ (0.0002,-1.571) [-1.571|1.571] "rad" MCU
 SG_ OBJ_Angle_Bottom_STD_6 : 6734|14@1+ (0.0001,0) [0|1.571] "rad" MCU
 SG_ OBJ_Angle_Bottom_STD_V_6 : 6748|1@1+ (1,0) [0|1] "bool" MCU
 SG_ OBJ_Visibility_Side_V_6 : 6749|1@1+ (1,0) [0|1] "bool" MCU
 SG_ OBJ_Visibility_Side_6 : 6750|2@1+ (1,0) [0|2] "ENUM" MCU
 SG_ OBJ_Is_In_Drivable_Area_6 : 6752|1@1+ (1,0) [0|1] "bool" MCU
 SG_ OBJ_Is_In_Drivable_Area_V_6 : 6753|1@1+ (1,0) [0|1] "bool" MCU
 SG_ OBJ_Is_VeryClose_V_6 : 6754|1@1+ (1,0) [0|1] "bool" MCU
 SG_ OBJ_Is_VeryClose_6 : 6755|1@1+ (1,0) [0|1] "bool" MCU
 SG_ OBJ_Buffer_C4_6 : 6756|2@1+ (1,0) [0|2] "NA" MCU
 SG_ OBJ_Buffer_C5_6 : 6758|2@1+ (1,0) [0|2] "NA" MCU
 SG_ OBJ_Buffer_C6_6 : 6760|2@1+ (1,0) [0|2] "NA" MCU
 SG_ OBJ_Buffer_C7_6 : 6762|2@1+ (1,0) [0|2] "NA" MCU
 SG_ OBJ_OverlapAngleEgoLaneR_6 : 6764|10@1+ (0.01,-3.14) [-3.14|3.14] "rad" MCU
 SG_ OBJ_OverlapAngleEgoLaneR_V_6 : 6774|1@1+ (1,0) [0|1] "bool" MCU
 SG_ Reserved_25_6 : 6775|9@1+ (1,0) [0|0] "NA" MCU
 SG_ OBJ_OverlapAngleEgoLaneL_6 : 6784|10@1+ (0.01,-3.14) [-3.14|3.14] "rad" MCU
 SG_ OBJ_OverlapAngleEgoLaneL_V_6 : 6794|1@1+ (1,0) [0|1] "bool" MCU
 SG_ OBJ_Is_EMERGENCY_VCL_6 : 6795|1@1+ (1,0) [0|1] "bool" MCU
 SG_ OBJ_EMERGENCY_LIGHT_COLOR_6 : 6796|4@1+ (1,0) [0|15] "BITWIZE" MCU
 SG_ OBJ_EMERGENCY_V_6 : 6800|1@1+ (1,0) [0|1] "bool" MCU
 SG_ OBJ_Angle_Top_6 : 6801|14@1+ (0.0002,0) [0|3.1415] "rad" MCU
 SG_ OBJ_Angle_Top_V_6 : 6815|1@1+ (1,0) [0|1] "bool" MCU
 SG_ OBJ_Angle_Top_STD_6 : 6816|15@1+ (0.0001,0) [0|3.1415] "rad" MCU
 SG_ OBJ_Angle_Top_STD_V_6 : 6831|1@1+ (1,0) [0|1] "bool" MCU
 SG_ OBJ_Open_Door_Left_6 : 6832|1@1+ (1,0) [0|1] "bool" MCU
 SG_ OBJ_Open_Door_Right_6 : 6833|1@1+ (1,0) [0|1] "bool" MCU
 SG_ OBJ_Visible_Left_or_Right_6 : 6834|2@1+ (1,0) [0|2] "ENUM" MCU
 SG_ OBJ_Visible_Left_or_Right_V_6 : 6836|1@1+ (1,0) [0|1] "bool" MCU
 SG_ OBJ_2W_Is_Motorbike_Probability_6 : 6837|8@1+ (0.01,0) [0|1] "NA" MCU
 SG_ Reserved_26_6 : 6845|3@1+ (1,0) [0|0] "NA" MCU
 SG_ OBJ_2W_Is_Bicycle_Probability_6 : 6848|8@1+ (0.01,0) [0|1] "NA" MCU
 SG_ Reserved_27_6 : 6856|24@1+ (1,0) [0|0] "NA" MCU
 SG_ OBJ_CRC_7 : 6880|32@1+ (1,0) [0|4294967295] "NA" MCU
 SG_ OBJ_ID_7 : 6912|8@1+ (1,0) [0|255] "counter" MCU
 SG_ OBJ_Existence_Probability_7 : 6920|8@1+ (0.01,0) [0|1] "NA" MCU
 SG_ OBJ_Fusion_Source_7 : 6928|16@1+ (1,0) [0|65535] "BITWIZE" MCU
 SG_ OBJ_Triggered_SDM_7 : 6944|2@1+ (1,0) [0|2] "ENUM" MCU
 SG_ OBJ_Motion_Category_7 : 6946|4@1+ (1,0) [0|13] "ENUM" MCU
 SG_ OBJ_Moving_IN_Probability_7 : 6950|7@1+ (0.01,0) [0|1] "NA" MCU
 SG_ OBJ_Object_Age_7 : 6957|11@1+ (1,0) [0|2047] "frames" MCU
 SG_ OBJ_Measuring_Status_7 : 6968|3@1+ (1,0) [0|7] "BITWIZE" MCU
 SG_ OBJ_Object_Class_7 : 6971|4@1+ (1,0) [0|9] "ENUM" MCU
 SG_ Reserved_4_7 : 6975|1@1+ (1,0) [0|0] "NA" MCU
 SG_ OBJ_Class_Probability_7 : 6976|7@1+ (0.01,0) [0|1] "NA" MCU
 SG_ OBJ_Car_Probability_7 : 6983|7@1+ (0.01,0) [0|1] "NA" MCU
 SG_ OBJ_Truck_Probability_7 : 6990|7@1+ (0.01,0) [0|1] "NA" MCU
 SG_ OBJ_Bike_Probability_7 : 6997|7@1+ (0.01,0) [0|1] "NA" MCU
 SG_ OBJ_Camera_Source_7 : 7004|4@1+ (1,0) [0|15] "ENUM" MCU
 SG_ OBJ_Motion_Status_7 : 7008|3@1+ (1,0) [0|5] "ENUM" MCU
 SG_ OBJ_Motion_Orientation_7 : 7011|4@1+ (1,0) [0|13] "ENUM" MCU
 SG_ OBJ_Has_Cut_Lane_7 : 7015|1@1+ (1,0) [0|1] "bool" MCU
 SG_ OBJ_Has_Cut_Path_7 : 7016|1@1+ (1,0) [0|1] "bool" MCU
 SG_ OBJ_Brake_Light_Validity_7 : 7017|1@1+ (1,0) [0|1] "bool" MCU
 SG_ OBJ_Brake_Light_7 : 7018|1@1+ (1,0) [0|1] "bool" MCU
 SG_ OBJ_Turn_Indicator_Right_7 : 7019|1@1+ (1,0) [0|1] "bool" MCU
 SG_ OBJ_Turn_Indicator_Left_7 : 7020|1@1+ (1,0) [0|1] "bool" MCU
 SG_ OBJ_Turn_Indicator_Validity_7 : 7021|1@1+ (1,0) [0|1] "bool" MCU
 SG_ OBJ_Right_Out_Of_Image_7 : 7022|1@1+ (1,0) [0|1] "bool" MCU
 SG_ OBJ_Left_Out_Of_Image_7 : 7023|1@1+ (1,0) [0|1] "bool" MCU
 SG_ OBJ_Right_Out_Of_Image_V_7 : 7024|1@1+ (1,0) [0|1] "bool" MCU
 SG_ OBJ_Left_Out_Of_Image_V_7 : 7025|1@1+ (1,0) [0|1] "bool" MCU
 SG_ OBJ_Top_Out_Of_Image_7 : 7026|1@1+ (1,0) [0|1] "bool" MCU
 SG_ OBJ_Bottom_Out_Of_Image_7 : 7027|1@1+ (1,0) [0|1] "bool" MCU
 SG_ OBJ_Top_Out_Of_Image_V_7 : 7028|1@1+ (1,0) [0|1] "bool" MCU
 SG_ OBJ_Bottom_Out_Of_Image_V_7 : 7029|1@1+ (1,0) [0|1] "bool" MCU
 SG_ OBJ_Lane_Assignment_7 : 7030|3@1+ (1,0) [0|5] "ENUM" MCU
 SG_ OBJ_Lane_Assignment_V_7 : 7033|1@1+ (1,0) [0|1] "bool" MCU
 SG_ Reserved_5_7 : 7034|6@1+ (1,0) [0|0] "NA" MCU
 SG_ OBJ_Age_Seconds_7 : 7040|7@1+ (1,0) [0|100] "s" MCU
 SG_ OBJ_Age_Seconds_V_7 : 7047|1@1+ (1,0) [0|1] "bool" MCU
 SG_ OBJ_Width_7 : 7048|9@1+ (0.01,0) [0.4|2.95] "m" MCU
 SG_ OBJ_Width_V_7 : 7057|1@1+ (1,0) [0|1] "bool" MCU
 SG_ OBJ_Width_STD_7 : 7058|11@1+ (0.001,0) [0|2] "m" MCU
 SG_ OBJ_Width_STD_V_7 : 7069|1@1+ (1,0) [0|1] "bool" MCU
 SG_ Reserved_6_7 : 7070|2@1+ (1,0) [0|0] "NA" MCU
 SG_ OBJ_Length_7 : 7072|9@1+ (0.05,0) [0.6|21] "m" MCU
 SG_ OBJ_Length_V_7 : 7081|1@1+ (1,0) [0|1] "bool" MCU
 SG_ OBJ_Length_STD_7 : 7082|10@1+ (0.01,0) [0|10] "m" MCU
 SG_ OBJ_Length_STD_V_7 : 7092|1@1+ (1,0) [0|1] "bool" MCU
 SG_ OBJ_Radar_ID_7 : 7093|8@1+ (1,0) [0|255] "counter" MCU
 SG_ Reserved_7_7 : 7101|3@1+ (1,0) [0|0] "NA" MCU
 SG_ OBJ_Height_7 : 7104|9@1+ (0.01,0) [0|2.95] "m" MCU
 SG_ OBJ_Height_V_7 : 7113|1@1+ (1,0) [0|1] "bool" MCU
 SG_ OBJ_Height_STD_7 : 7114|11@1+ (0.001,0) [0|2] "m" MCU
 SG_ OBJ_Height_STD_V_7 : 7125|1@1+ (1,0) [0|1] "bool" MCU
 SG_ Reserved_8_7 : 7126|10@1+ (1,0) [0|0] "NA" MCU
 SG_ OBJ_Abs_Long_Velocity_7 : 7136|12@1+ (0.05,-100) [-100|100] "m_per_s" MCU
 SG_ OBJ_Abs_Long_Velocity_V_7 : 7148|1@1+ (1,0) [0|1] "bool" MCU
 SG_ OBJ_Abs_Long_Velocity_STD_7 : 7149|13@1+ (0.01,0) [0|65] "m_per_s" MCU
 SG_ OBJ_Abs_Long_Vel_STD_V_7 : 7162|1@1+ (1,0) [0|1] "bool" MCU
 SG_ Reserved_9_7 : 7163|5@1+ (1,0) [0|0] "NA" MCU
 SG_ OBJ_Abs_Lat_Velocity_7 : 7168|11@1+ (0.05,-50) [-50|50] "m_per_s" MCU
 SG_ OBJ_Abs_Lat_Velocity_V_7 : 7179|1@1+ (1,0) [0|1] "bool" MCU
 SG_ OBJ_Abs_Lat_Velocity_STD_7 : 7180|13@1+ (0.01,0) [0|50] "m_per_s" MCU
 SG_ OBJ_Abs_Lat_Vel_STD_V_7 : 7193|1@1+ (1,0) [0|1] "bool" MCU
 SG_ Reserved_10_7 : 7194|6@1+ (1,0) [0|0] "NA" MCU
 SG_ OBJ_Abs_Long_Acc_7 : 7200|9@1+ (0.05,-10) [-10|10] "m_per_s2" MCU
 SG_ OBJ_Abs_Long_Acc_V_7 : 7209|1@1+ (1,0) [0|1] "bool" MCU
 SG_ OBJ_Abs_Long_Acc_STD_7 : 7210|10@1+ (0.01,0) [0|7.3] "m_per_s2" MCU
 SG_ OBJ_Abs_Long_Acc_STD_V_7 : 7220|1@1+ (1,0) [0|1] "bool" MCU
 SG_ OBJ_Abs_Lat_Acc_7 : 7221|9@1+ (0.05,-10) [-10|10] "m_per_s2" MCU
 SG_ OBJ_Abs_Lat_Acc_V_7 : 7230|1@1+ (1,0) [0|1] "bool" MCU
 SG_ Reserved_11_7 : 7231|1@1+ (1,0) [0|0] "NA" MCU
 SG_ OBJ_Abs_Lat_Acc_STD_7 : 7232|10@1+ (0.01,0) [0|7.3] "m_per_s2" MCU
 SG_ OBJ_Abs_Lat_Acc_STD_V_7 : 7242|1@1+ (1,0) [0|1] "bool" MCU
 SG_ OBJ_Abs_Acceleration_7 : 7243|9@1+ (0.05,-12.7) [-12.7|12.7] "m_per_s2" MCU
 SG_ OBJ_Abs_Acceleration_V_7 : 7252|1@1+ (1,0) [0|1] "bool" MCU
 SG_ OBJ_Abs_Acc_STD_7 : 7253|10@1+ (0.01,0) [0|7.3] "m_per_s2" MCU
 SG_ OBJ_Abs_Acc_STD_V_7 : 7263|1@1+ (1,0) [0|1] "bool" MCU
 SG_ OBJ_Inv_TTC_7 : 7264|11@1+ (0.01,-8) [-8|8] "INV(s)" MCU
 SG_ OBJ_Inv_TTC_V_7 : 7275|1@1+ (1,0) [0|1] "bool" MCU
 SG_ OBJ_Inv_TTC_STD_7 : 7276|12@1+ (0.001,0) [0|4] "INV(s)" MCU
 SG_ OBJ_Inv_TTC_STD_V_7 : 7288|1@1+ (1,0) [0|1] "bool" MCU
 SG_ Reserved_12_7 : 7289|7@1+ (1,0) [0|0] "NA" MCU
 SG_ OBJ_Relative_Long_Acc_7 : 7296|10@1+ (0.05,-20) [-20|20] "m_per_s2" MCU
 SG_ OBJ_Relative_Long_Acc_V_7 : 7306|1@1+ (1,0) [0|1] "bool" MCU
 SG_ OBJ_Relative_Long_Acc_STD_7 : 7307|10@1+ (0.01,0) [0|7.3] "m_per_s2" MCU
 SG_ OBJ_Rel_Long_Acc_STD_V_7 : 7317|1@1+ (1,0) [0|1] "bool" MCU
 SG_ Reserved_13_7 : 7318|10@1+ (1,0) [0|0] "NA" MCU
 SG_ OBJ_Relative_Long_Velocity_7 : 7328|13@1+ (0.05,-120) [-120|130] "m_per_s" MCU
 SG_ OBJ_Relative_Long_Velocity_V_7 : 7341|1@1+ (1,0) [0|1] "bool" MCU
 SG_ OBJ_Relative_Long_Vel_STD_7 : 7342|14@1+ (0.01,0) [0|130] "m_per_s" MCU
 SG_ OBJ_Rel_Long_Vel_STD_V_7 : 7356|1@1+ (1,0) [0|1] "bool" MCU
 SG_ Reserved_14_7 : 7357|3@1+ (1,0) [0|0] "NA" MCU
 SG_ OBJ_Relative_Lat_Velocity_7 : 7360|11@1+ (0.05,-50) [-50|50] "m_per_s" MCU
 SG_ OBJ_Relative_Lat_Velocity_V_7 : 7371|1@1+ (1,0) [0|1] "bool" MCU
 SG_ OBJ_Relative_Lat_Velocity_STD_7 : 7372|13@1+ (0.01,0) [0|50] "m_per_s" MCU
 SG_ OBJ_Rel_Lat_Vel_STD_V_7 : 7385|1@1+ (1,0) [0|1] "bool" MCU
 SG_ Reserved_15_7 : 7386|6@1+ (1,0) [0|0] "NA" MCU
 SG_ OBJ_Long_Distance_7 : 7392|14@1+ (0.05,-200) [-200|500] "m" MCU
 SG_ OBJ_Long_Distance_V_7 : 7406|1@1+ (1,0) [0|1] "bool" MCU
 SG_ OBJ_Long_Distance_STD_7 : 7407|15@1+ (0.01,0) [0|250] "m" MCU
 SG_ OBJ_Long_Distance_STD_V_7 : 7422|1@1+ (1,0) [0|1] "bool" MCU
 SG_ Reserved_16_7 : 7423|1@1+ (1,0) [0|0] "NA" MCU
 SG_ OBJ_Lat_Distance_7 : 7424|12@1+ (0.05,-100) [-100|100] "m" MCU
 SG_ OBJ_Lat_Distance_V_7 : 7436|1@1+ (1,0) [0|1] "bool" MCU
 SG_ OBJ_Lat_Distance_STD_7 : 7437|14@1+ (0.01,0) [0|100] "m" MCU
 SG_ OBJ_Lat_Distance_STD_V_7 : 7451|1@1+ (1,0) [0|1] "bool" MCU
 SG_ Reserved_17_7 : 7452|4@1+ (1,0) [0|0] "NA" MCU
 SG_ OBJ_Absolute_Speed_7 : 7456|12@1+ (0.05,-65) [-65|65] "m_per_s" MCU
 SG_ OBJ_Absolute_Speed_V_7 : 7468|1@1+ (1,0) [0|1] "bool" MCU
 SG_ OBJ_Absolute_Speed_STD_7 : 7469|13@1+ (0.01,0) [0|65] "m_per_s" MCU
 SG_ OBJ_Absolute_Speed_STD_V_7 : 7482|1@1+ (1,0) [0|1] "bool" MCU
 SG_ Reserved_18_7 : 7483|5@1+ (1,0) [0|0] "NA" MCU
 SG_ OBJ_Heading_7 : 7488|10@1+ (0.01,-3.14) [-3.14|3.14] "rad" MCU
 SG_ OBJ_Heading_V_7 : 7498|1@1+ (1,0) [0|1] "bool" MCU
 SG_ OBJ_Heading_STD_7 : 7499|15@1+ (0.0001,0) [0|3.14] "rad" MCU
 SG_ OBJ_Heading_STD_V_7 : 7514|1@1+ (1,0) [0|1] "bool" MCU
 SG_ Reserved_19_7 : 7515|5@1+ (1,0) [0|0] "NA" MCU
 SG_ OBJ_Angle_Rate_STD_7 : 7520|15@1+ (0.0001,0) [0|2.2318] "RPS" MCU
 SG_ OBJ_Angle_Rate_STD_V_7 : 7535|1@1+ (1,0) [0|1] "bool" MCU
 SG_ OBJ_Angle_Rate_7 : 7536|12@1+ (0.002,-2.234) [-2.234|2.2318] "RPS" MCU
 SG_ OBJ_Angle_Rate_V_7 : 7548|1@1+ (1,0) [0|1] "bool" MCU
 SG_ Reserved_20_7 : 7549|3@1+ (1,0) [0|0] "NA" MCU
 SG_ OBJ_Angle_Right_7 : 7552|14@1+ (0.0002,-1.571) [-1.571|1.571] "rad" MCU
 SG_ OBJ_Angle_Right_V_7 : 7566|1@1+ (1,0) [0|1] "bool" MCU
 SG_ OBJ_Angle_Right_STD_7 : 7567|14@1+ (0.0001,0) [0|1.571] "rad" MCU
 SG_ OBJ_Angle_Right_STD_V_7 : 7581|1@1+ (1,0) [0|1] "bool" MCU
 SG_ Reserved_21_7 : 7582|2@1+ (1,0) [0|0] "NA" MCU
 SG_ OBJ_Angle_Left_7 : 7584|14@1+ (0.0002,-1.571) [-1.571|1.571] "rad" MCU
 SG_ OBJ_Angle_Left_V_7 : 7598|1@1+ (1,0) [0|1] "bool" MCU
 SG_ OBJ_Angle_Left_STD_7 : 7599|14@1+ (0.0001,0) [0|1.571] "rad" MCU
 SG_ OBJ_Angle_Left_STD_V_7 : 7613|1@1+ (1,0) [0|1] "bool" MCU
 SG_ Reserved_22_7 : 7614|2@1+ (1,0) [0|0] "NA" MCU
 SG_ OBJ_Angle_Side_7 : 7616|14@1+ (0.0002,-1.571) [-1.571|1.571] "rad" MCU
 SG_ OBJ_Angle_Side_V_7 : 7630|1@1+ (1,0) [0|1] "bool" MCU
 SG_ OBJ_Angle_Side_STD_7 : 7631|14@1+ (0.0001,0) [0|1.571] "rad" MCU
 SG_ OBJ_Angle_Side_STD_V_7 : 7645|1@1+ (1,0) [0|1] "bool" MCU
 SG_ OBJ_Angle_Mid_V_7 : 7646|1@1+ (1,0) [0|1] "bool" MCU
 SG_ Reserved_23_7 : 7647|1@1+ (1,0) [0|0] "NA" MCU
 SG_ OBJ_Angle_Mid_7 : 7648|14@1+ (0.0002,-1.571) [-1.571|1.571] "rad" MCU
 SG_ OBJ_Angle_Mid_STD_7 : 7662|14@1+ (0.0001,0) [0|1.571] "rad" MCU
 SG_ OBJ_Angle_Mid_STD_V_7 : 7676|1@1+ (1,0) [0|1] "bool" MCU
 SG_ OBJ_Angle_Bottom_V_7 : 7677|1@1+ (1,0) [0|1] "bool" MCU
 SG_ Reserved_24_7 : 7678|2@1+ (1,0) [0|0] "NA" MCU
 SG_ OBJ_Angle_Bottom_7 : 7680|14@1+ (0.0002,-1.571) [-1.571|1.571] "rad" MCU
 SG_ OBJ_Angle_Bottom_STD_7 : 7694|14@1+ (0.0001,0) [0|1.571] "rad" MCU
 SG_ OBJ_Angle_Bottom_STD_V_7 : 7708|1@1+ (1,0) [0|1] "bool" MCU
 SG_ OBJ_Visibility_Side_V_7 : 7709|1@1+ (1,0) [0|1] "bool" MCU
 SG_ OBJ_Visibility_Side_7 : 7710|2@1+ (1,0) [0|2] "ENUM" MCU
 SG_ OBJ_Is_In_Drivable_Area_7 : 7712|1@1+ (1,0) [0|1] "bool" MCU
 SG_ OBJ_Is_In_Drivable_Area_V_7 : 7713|1@1+ (1,0) [0|1] "bool" MCU
 SG_ OBJ_Is_VeryClose_V_7 : 7714|1@1+ (1,0) [0|1] "bool" MCU
 SG_ OBJ_Is_VeryClose_7 : 7715|1@1+ (1,0) [0|1] "bool" MCU
 SG_ OBJ_Buffer_C4_7 : 7716|2@1+ (1,0) [0|2] "NA" MCU
 SG_ OBJ_Buffer_C5_7 : 7718|2@1+ (1,0) [0|2] "NA" MCU
 SG_ OBJ_Buffer_C6_7 : 7720|2@1+ (1,0) [0|2] "NA" MCU
 SG_ OBJ_Buffer_C7_7 : 7722|2@1+ (1,0) [0|2] "NA" MCU
 SG_ OBJ_OverlapAngleEgoLaneR_7 : 7724|10@1+ (0.01,-3.14) [-3.14|3.14] "rad" MCU
 SG_ OBJ_OverlapAngleEgoLaneR_V_7 : 7734|1@1+ (1,0) [0|1] "bool" MCU
 SG_ Reserved_25_7 : 7735|9@1+ (1,0) [0|0] "NA" MCU
 SG_ OBJ_OverlapAngleEgoLaneL_7 : 7744|10@1+ (0.01,-3.14) [-3.14|3.14] "rad" MCU
 SG_ OBJ_OverlapAngleEgoLaneL_V_7 : 7754|1@1+ (1,0) [0|1] "bool" MCU
 SG_ OBJ_Is_EMERGENCY_VCL_7 : 7755|1@1+ (1,0) [0|1] "bool" MCU
 SG_ OBJ_EMERGENCY_LIGHT_COLOR_7 : 7756|4@1+ (1,0) [0|15] "BITWIZE" MCU
 SG_ OBJ_EMERGENCY_V_7 : 7760|1@1+ (1,0) [0|1] "bool" MCU
 SG_ OBJ_Angle_Top_7 : 7761|14@1+ (0.0002,0) [0|3.1415] "rad" MCU
 SG_ OBJ_Angle_Top_V_7 : 7775|1@1+ (1,0) [0|1] "bool" MCU
 SG_ OBJ_Angle_Top_STD_7 : 7776|15@1+ (0.0001,0) [0|3.1415] "rad" MCU
 SG_ OBJ_Angle_Top_STD_V_7 : 7791|1@1+ (1,0) [0|1] "bool" MCU
 SG_ OBJ_Open_Door_Left_7 : 7792|1@1+ (1,0) [0|1] "bool" MCU
 SG_ OBJ_Open_Door_Right_7 : 7793|1@1+ (1,0) [0|1] "bool" MCU
 SG_ OBJ_Visible_Left_or_Right_7 : 7794|2@1+ (1,0) [0|2] "ENUM" MCU
 SG_ OBJ_Visible_Left_or_Right_V_7 : 7796|1@1+ (1,0) [0|1] "bool" MCU
 SG_ OBJ_2W_Is_Motorbike_Probability_7 : 7797|8@1+ (0.01,0) [0|1] "NA" MCU
 SG_ Reserved_26_7 : 7805|3@1+ (1,0) [0|0] "NA" MCU
 SG_ OBJ_2W_Is_Bicycle_Probability_7 : 7808|8@1+ (0.01,0) [0|1] "NA" MCU
 SG_ Reserved_27_7 : 7816|24@1+ (1,0) [0|0] "NA" MCU
 SG_ OBJ_CRC_8 : 7840|32@1+ (1,0) [0|4294967295] "NA" MCU
 SG_ OBJ_ID_8 : 7872|8@1+ (1,0) [0|255] "counter" MCU
 SG_ OBJ_Existence_Probability_8 : 7880|8@1+ (0.01,0) [0|1] "NA" MCU
 SG_ OBJ_Fusion_Source_8 : 7888|16@1+ (1,0) [0|65535] "BITWIZE" MCU
 SG_ OBJ_Triggered_SDM_8 : 7904|2@1+ (1,0) [0|2] "ENUM" MCU
 SG_ OBJ_Motion_Category_8 : 7906|4@1+ (1,0) [0|13] "ENUM" MCU
 SG_ OBJ_Moving_IN_Probability_8 : 7910|7@1+ (0.01,0) [0|1] "NA" MCU
 SG_ OBJ_Object_Age_8 : 7917|11@1+ (1,0) [0|2047] "frames" MCU
 SG_ OBJ_Measuring_Status_8 : 7928|3@1+ (1,0) [0|7] "BITWIZE" MCU
 SG_ OBJ_Object_Class_8 : 7931|4@1+ (1,0) [0|9] "ENUM" MCU
 SG_ Reserved_4_8 : 7935|1@1+ (1,0) [0|0] "NA" MCU
 SG_ OBJ_Class_Probability_8 : 7936|7@1+ (0.01,0) [0|1] "NA" MCU
 SG_ OBJ_Car_Probability_8 : 7943|7@1+ (0.01,0) [0|1] "NA" MCU
 SG_ OBJ_Truck_Probability_8 : 7950|7@1+ (0.01,0) [0|1] "NA" MCU
 SG_ OBJ_Bike_Probability_8 : 7957|7@1+ (0.01,0) [0|1] "NA" MCU
 SG_ OBJ_Camera_Source_8 : 7964|4@1+ (1,0) [0|15] "ENUM" MCU
 SG_ OBJ_Motion_Status_8 : 7968|3@1+ (1,0) [0|5] "ENUM" MCU
 SG_ OBJ_Motion_Orientation_8 : 7971|4@1+ (1,0) [0|13] "ENUM" MCU
 SG_ OBJ_Has_Cut_Lane_8 : 7975|1@1+ (1,0) [0|1] "bool" MCU
 SG_ OBJ_Has_Cut_Path_8 : 7976|1@1+ (1,0) [0|1] "bool" MCU
 SG_ OBJ_Brake_Light_Validity_8 : 7977|1@1+ (1,0) [0|1] "bool" MCU
 SG_ OBJ_Brake_Light_8 : 7978|1@1+ (1,0) [0|1] "bool" MCU
 SG_ OBJ_Turn_Indicator_Right_8 : 7979|1@1+ (1,0) [0|1] "bool" MCU
 SG_ OBJ_Turn_Indicator_Left_8 : 7980|1@1+ (1,0) [0|1] "bool" MCU
 SG_ OBJ_Turn_Indicator_Validity_8 : 7981|1@1+ (1,0) [0|1] "bool" MCU
 SG_ OBJ_Right_Out_Of_Image_8 : 7982|1@1+ (1,0) [0|1] "bool" MCU
 SG_ OBJ_Left_Out_Of_Image_8 : 7983|1@1+ (1,0) [0|1] "bool" MCU
 SG_ OBJ_Right_Out_Of_Image_V_8 : 7984|1@1+ (1,0) [0|1] "bool" MCU
 SG_ OBJ_Left_Out_Of_Image_V_8 : 7985|1@1+ (1,0) [0|1] "bool" MCU
 SG_ OBJ_Top_Out_Of_Image_8 : 7986|1@1+ (1,0) [0|1] "bool" MCU
 SG_ OBJ_Bottom_Out_Of_Image_8 : 7987|1@1+ (1,0) [0|1] "bool" MCU
 SG_ OBJ_Top_Out_Of_Image_V_8 : 7988|1@1+ (1,0) [0|1] "bool" MCU
 SG_ OBJ_Bottom_Out_Of_Image_V_8 : 7989|1@1+ (1,0) [0|1] "bool" MCU
 SG_ OBJ_Lane_Assignment_8 : 7990|3@1+ (1,0) [0|5] "ENUM" MCU
 SG_ OBJ_Lane_Assignment_V_8 : 7993|1@1+ (1,0) [0|1] "bool" MCU
 SG_ Reserved_5_8 : 7994|6@1+ (1,0) [0|0] "NA" MCU
 SG_ OBJ_Age_Seconds_8 : 8000|7@1+ (1,0) [0|100] "s" MCU
 SG_ OBJ_Age_Seconds_V_8 : 8007|1@1+ (1,0) [0|1] "bool" MCU
 SG_ OBJ_Width_8 : 8008|9@1+ (0.01,0) [0.4|2.95] "m" MCU
 SG_ OBJ_Width_V_8 : 8017|1@1+ (1,0) [0|1] "bool" MCU
 SG_ OBJ_Width_STD_8 : 8018|11@1+ (0.001,0) [0|2] "m" MCU
 SG_ OBJ_Width_STD_V_8 : 8029|1@1+ (1,0) [0|1] "bool" MCU
 SG_ Reserved_6_8 : 8030|2@1+ (1,0) [0|0] "NA" MCU
 SG_ OBJ_Length_8 : 8032|9@1+ (0.05,0) [0.6|21] "m" MCU
 SG_ OBJ_Length_V_8 : 8041|1@1+ (1,0) [0|1] "bool" MCU
 SG_ OBJ_Length_STD_8 : 8042|10@1+ (0.01,0) [0|10] "m" MCU
 SG_ OBJ_Length_STD_V_8 : 8052|1@1+ (1,0) [0|1] "bool" MCU
 SG_ OBJ_Radar_ID_8 : 8053|8@1+ (1,0) [0|255] "counter" MCU
 SG_ Reserved_7_8 : 8061|3@1+ (1,0) [0|0] "NA" MCU
 SG_ OBJ_Height_8 : 8064|9@1+ (0.01,0) [0|2.95] "m" MCU
 SG_ OBJ_Height_V_8 : 8073|1@1+ (1,0) [0|1] "bool" MCU
 SG_ OBJ_Height_STD_8 : 8074|11@1+ (0.001,0) [0|2] "m" MCU
 SG_ OBJ_Height_STD_V_8 : 8085|1@1+ (1,0) [0|1] "bool" MCU
 SG_ Reserved_8_8 : 8086|10@1+ (1,0) [0|0] "NA" MCU
 SG_ OBJ_Abs_Long_Velocity_8 : 8096|12@1+ (0.05,-100) [-100|100] "m_per_s" MCU
 SG_ OBJ_Abs_Long_Velocity_V_8 : 8108|1@1+ (1,0) [0|1] "bool" MCU
 SG_ OBJ_Abs_Long_Velocity_STD_8 : 8109|13@1+ (0.01,0) [0|65] "m_per_s" MCU
 SG_ OBJ_Abs_Long_Vel_STD_V_8 : 8122|1@1+ (1,0) [0|1] "bool" MCU
 SG_ Reserved_9_8 : 8123|5@1+ (1,0) [0|0] "NA" MCU
 SG_ OBJ_Abs_Lat_Velocity_8 : 8128|11@1+ (0.05,-50) [-50|50] "m_per_s" MCU
 SG_ OBJ_Abs_Lat_Velocity_V_8 : 8139|1@1+ (1,0) [0|1] "bool" MCU
 SG_ OBJ_Abs_Lat_Velocity_STD_8 : 8140|13@1+ (0.01,0) [0|50] "m_per_s" MCU
 SG_ OBJ_Abs_Lat_Vel_STD_V_8 : 8153|1@1+ (1,0) [0|1] "bool" MCU
 SG_ Reserved_10_8 : 8154|6@1+ (1,0) [0|0] "NA" MCU
 SG_ OBJ_Abs_Long_Acc_8 : 8160|9@1+ (0.05,-10) [-10|10] "m_per_s2" MCU
 SG_ OBJ_Abs_Long_Acc_V_8 : 8169|1@1+ (1,0) [0|1] "bool" MCU
 SG_ OBJ_Abs_Long_Acc_STD_8 : 8170|10@1+ (0.01,0) [0|7.3] "m_per_s2" MCU
 SG_ OBJ_Abs_Long_Acc_STD_V_8 : 8180|1@1+ (1,0) [0|1] "bool" MCU
 SG_ OBJ_Abs_Lat_Acc_8 : 8181|9@1+ (0.05,-10) [-10|10] "m_per_s2" MCU
 SG_ OBJ_Abs_Lat_Acc_V_8 : 8190|1@1+ (1,0) [0|1] "bool" MCU
 SG_ Reserved_11_8 : 8191|1@1+ (1,0) [0|0] "NA" MCU
 SG_ OBJ_Abs_Lat_Acc_STD_8 : 8192|10@1+ (0.01,0) [0|7.3] "m_per_s2" MCU
 SG_ OBJ_Abs_Lat_Acc_STD_V_8 : 8202|1@1+ (1,0) [0|1] "bool" MCU
 SG_ OBJ_Abs_Acceleration_8 : 8203|9@1+ (0.05,-12.7) [-12.7|12.7] "m_per_s2" MCU
 SG_ OBJ_Abs_Acceleration_V_8 : 8212|1@1+ (1,0) [0|1] "bool" MCU
 SG_ OBJ_Abs_Acc_STD_8 : 8213|10@1+ (0.01,0) [0|7.3] "m_per_s2" MCU
 SG_ OBJ_Abs_Acc_STD_V_8 : 8223|1@1+ (1,0) [0|1] "bool" MCU
 SG_ OBJ_Inv_TTC_8 : 8224|11@1+ (0.01,-8) [-8|8] "INV(s)" MCU
 SG_ OBJ_Inv_TTC_V_8 : 8235|1@1+ (1,0) [0|1] "bool" MCU
 SG_ OBJ_Inv_TTC_STD_8 : 8236|12@1+ (0.001,0) [0|4] "INV(s)" MCU
 SG_ OBJ_Inv_TTC_STD_V_8 : 8248|1@1+ (1,0) [0|1] "bool" MCU
 SG_ Reserved_12_8 : 8249|7@1+ (1,0) [0|0] "NA" MCU
 SG_ OBJ_Relative_Long_Acc_8 : 8256|10@1+ (0.05,-20) [-20|20] "m_per_s2" MCU
 SG_ OBJ_Relative_Long_Acc_V_8 : 8266|1@1+ (1,0) [0|1] "bool" MCU
 SG_ OBJ_Relative_Long_Acc_STD_8 : 8267|10@1+ (0.01,0) [0|7.3] "m_per_s2" MCU
 SG_ OBJ_Rel_Long_Acc_STD_V_8 : 8277|1@1+ (1,0) [0|1] "bool" MCU
 SG_ Reserved_13_8 : 8278|10@1+ (1,0) [0|0] "NA" MCU
 SG_ OBJ_Relative_Long_Velocity_8 : 8288|13@1+ (0.05,-120) [-120|130] "m_per_s" MCU
 SG_ OBJ_Relative_Long_Velocity_V_8 : 8301|1@1+ (1,0) [0|1] "bool" MCU
 SG_ OBJ_Relative_Long_Vel_STD_8 : 8302|14@1+ (0.01,0) [0|130] "m_per_s" MCU
 SG_ OBJ_Rel_Long_Vel_STD_V_8 : 8316|1@1+ (1,0) [0|1] "bool" MCU
 SG_ Reserved_14_8 : 8317|3@1+ (1,0) [0|0] "NA" MCU
 SG_ OBJ_Relative_Lat_Velocity_8 : 8320|11@1+ (0.05,-50) [-50|50] "m_per_s" MCU
 SG_ OBJ_Relative_Lat_Velocity_V_8 : 8331|1@1+ (1,0) [0|1] "bool" MCU
 SG_ OBJ_Relative_Lat_Velocity_STD_8 : 8332|13@1+ (0.01,0) [0|50] "m_per_s" MCU
 SG_ OBJ_Rel_Lat_Vel_STD_V_8 : 8345|1@1+ (1,0) [0|1] "bool" MCU
 SG_ Reserved_15_8 : 8346|6@1+ (1,0) [0|0] "NA" MCU
 SG_ OBJ_Long_Distance_8 : 8352|14@1+ (0.05,-200) [-200|500] "m" MCU
 SG_ OBJ_Long_Distance_V_8 : 8366|1@1+ (1,0) [0|1] "bool" MCU
 SG_ OBJ_Long_Distance_STD_8 : 8367|15@1+ (0.01,0) [0|250] "m" MCU
 SG_ OBJ_Long_Distance_STD_V_8 : 8382|1@1+ (1,0) [0|1] "bool" MCU
 SG_ Reserved_16_8 : 8383|1@1+ (1,0) [0|0] "NA" MCU
 SG_ OBJ_Lat_Distance_8 : 8384|12@1+ (0.05,-100) [-100|100] "m" MCU
 SG_ OBJ_Lat_Distance_V_8 : 8396|1@1+ (1,0) [0|1] "bool" MCU
 SG_ OBJ_Lat_Distance_STD_8 : 8397|14@1+ (0.01,0) [0|100] "m" MCU
 SG_ OBJ_Lat_Distance_STD_V_8 : 8411|1@1+ (1,0) [0|1] "bool" MCU
 SG_ Reserved_17_8 : 8412|4@1+ (1,0) [0|0] "NA" MCU
 SG_ OBJ_Absolute_Speed_8 : 8416|12@1+ (0.05,-65) [-65|65] "m_per_s" MCU
 SG_ OBJ_Absolute_Speed_V_8 : 8428|1@1+ (1,0) [0|1] "bool" MCU
 SG_ OBJ_Absolute_Speed_STD_8 : 8429|13@1+ (0.01,0) [0|65] "m_per_s" MCU
 SG_ OBJ_Absolute_Speed_STD_V_8 : 8442|1@1+ (1,0) [0|1] "bool" MCU
 SG_ Reserved_18_8 : 8443|5@1+ (1,0) [0|0] "NA" MCU
 SG_ OBJ_Heading_8 : 8448|10@1+ (0.01,-3.14) [-3.14|3.14] "rad" MCU
 SG_ OBJ_Heading_V_8 : 8458|1@1+ (1,0) [0|1] "bool" MCU
 SG_ OBJ_Heading_STD_8 : 8459|15@1+ (0.0001,0) [0|3.14] "rad" MCU
 SG_ OBJ_Heading_STD_V_8 : 8474|1@1+ (1,0) [0|1] "bool" MCU
 SG_ Reserved_19_8 : 8475|5@1+ (1,0) [0|0] "NA" MCU
 SG_ OBJ_Angle_Rate_STD_8 : 8480|15@1+ (0.0001,0) [0|2.2318] "RPS" MCU
 SG_ OBJ_Angle_Rate_STD_V_8 : 8495|1@1+ (1,0) [0|1] "bool" MCU
 SG_ OBJ_Angle_Rate_8 : 8496|12@1+ (0.002,-2.234) [-2.234|2.2318] "RPS" MCU
 SG_ OBJ_Angle_Rate_V_8 : 8508|1@1+ (1,0) [0|1] "bool" MCU
 SG_ Reserved_20_8 : 8509|3@1+ (1,0) [0|0] "NA" MCU
 SG_ OBJ_Angle_Right_8 : 8512|14@1+ (0.0002,-1.571) [-1.571|1.571] "rad" MCU
 SG_ OBJ_Angle_Right_V_8 : 8526|1@1+ (1,0) [0|1] "bool" MCU
 SG_ OBJ_Angle_Right_STD_8 : 8527|14@1+ (0.0001,0) [0|1.571] "rad" MCU
 SG_ OBJ_Angle_Right_STD_V_8 : 8541|1@1+ (1,0) [0|1] "bool" MCU
 SG_ Reserved_21_8 : 8542|2@1+ (1,0) [0|0] "NA" MCU
 SG_ OBJ_Angle_Left_8 : 8544|14@1+ (0.0002,-1.571) [-1.571|1.571] "rad" MCU
 SG_ OBJ_Angle_Left_V_8 : 8558|1@1+ (1,0) [0|1] "bool" MCU
 SG_ OBJ_Angle_Left_STD_8 : 8559|14@1+ (0.0001,0) [0|1.571] "rad" MCU
 SG_ OBJ_Angle_Left_STD_V_8 : 8573|1@1+ (1,0) [0|1] "bool" MCU
 SG_ Reserved_22_8 : 8574|2@1+ (1,0) [0|0] "NA" MCU
 SG_ OBJ_Angle_Side_8 : 8576|14@1+ (0.0002,-1.571) [-1.571|1.571] "rad" MCU
 SG_ OBJ_Angle_Side_V_8 : 8590|1@1+ (1,0) [0|1] "bool" MCU
 SG_ OBJ_Angle_Side_STD_8 : 8591|14@1+ (0.0001,0) [0|1.571] "rad" MCU
 SG_ OBJ_Angle_Side_STD_V_8 : 8605|1@1+ (1,0) [0|1] "bool" MCU
 SG_ OBJ_Angle_Mid_V_8 : 8606|1@1+ (1,0) [0|1] "bool" MCU
 SG_ Reserved_23_8 : 8607|1@1+ (1,0) [0|0] "NA" MCU
 SG_ OBJ_Angle_Mid_8 : 8608|14@1+ (0.0002,-1.571) [-1.571|1.571] "rad" MCU
 SG_ OBJ_Angle_Mid_STD_8 : 8622|14@1+ (0.0001,0) [0|1.571] "rad" MCU
 SG_ OBJ_Angle_Mid_STD_V_8 : 8636|1@1+ (1,0) [0|1] "bool" MCU
 SG_ OBJ_Angle_Bottom_V_8 : 8637|1@1+ (1,0) [0|1] "bool" MCU
 SG_ Reserved_24_8 : 8638|2@1+ (1,0) [0|0] "NA" MCU
 SG_ OBJ_Angle_Bottom_8 : 8640|14@1+ (0.0002,-1.571) [-1.571|1.571] "rad" MCU
 SG_ OBJ_Angle_Bottom_STD_8 : 8654|14@1+ (0.0001,0) [0|1.571] "rad" MCU
 SG_ OBJ_Angle_Bottom_STD_V_8 : 8668|1@1+ (1,0) [0|1] "bool" MCU
 SG_ OBJ_Visibility_Side_V_8 : 8669|1@1+ (1,0) [0|1] "bool" MCU
 SG_ OBJ_Visibility_Side_8 : 8670|2@1+ (1,0) [0|2] "ENUM" MCU
 SG_ OBJ_Is_In_Drivable_Area_8 : 8672|1@1+ (1,0) [0|1] "bool" MCU
 SG_ OBJ_Is_In_Drivable_Area_V_8 : 8673|1@1+ (1,0) [0|1] "bool" MCU
 SG_ OBJ_Is_VeryClose_V_8 : 8674|1@1+ (1,0) [0|1] "bool" MCU
 SG_ OBJ_Is_VeryClose_8 : 8675|1@1+ (1,0) [0|1] "bool" MCU
 SG_ OBJ_Buffer_C4_8 : 8676|2@1+ (1,0) [0|2] "NA" MCU
 SG_ OBJ_Buffer_C5_8 : 8678|2@1+ (1,0) [0|2] "NA" MCU
 SG_ OBJ_Buffer_C6_8 : 8680|2@1+ (1,0) [0|2] "NA" MCU
 SG_ OBJ_Buffer_C7_8 : 8682|2@1+ (1,0) [0|2] "NA" MCU
 SG_ OBJ_OverlapAngleEgoLaneR_8 : 8684|10@1+ (0.01,-3.14) [-3.14|3.14] "rad" MCU
 SG_ OBJ_OverlapAngleEgoLaneR_V_8 : 8694|1@1+ (1,0) [0|1] "bool" MCU
 SG_ Reserved_25_8 : 8695|9@1+ (1,0) [0|0] "NA" MCU
 SG_ OBJ_OverlapAngleEgoLaneL_8 : 8704|10@1+ (0.01,-3.14) [-3.14|3.14] "rad" MCU
 SG_ OBJ_OverlapAngleEgoLaneL_V_8 : 8714|1@1+ (1,0) [0|1] "bool" MCU
 SG_ OBJ_Is_EMERGENCY_VCL_8 : 8715|1@1+ (1,0) [0|1] "bool" MCU
 SG_ OBJ_EMERGENCY_LIGHT_COLOR_8 : 8716|4@1+ (1,0) [0|15] "BITWIZE" MCU
 SG_ OBJ_EMERGENCY_V_8 : 8720|1@1+ (1,0) [0|1] "bool" MCU
 SG_ OBJ_Angle_Top_8 : 8721|14@1+ (0.0002,0) [0|3.1415] "rad" MCU
 SG_ OBJ_Angle_Top_V_8 : 8735|1@1+ (1,0) [0|1] "bool" MCU
 SG_ OBJ_Angle_Top_STD_8 : 8736|15@1+ (0.0001,0) [0|3.1415] "rad" MCU
 SG_ OBJ_Angle_Top_STD_V_8 : 8751|1@1+ (1,0) [0|1] "bool" MCU
 SG_ OBJ_Open_Door_Left_8 : 8752|1@1+ (1,0) [0|1] "bool" MCU
 SG_ OBJ_Open_Door_Right_8 : 8753|1@1+ (1,0) [0|1] "bool" MCU
 SG_ OBJ_Visible_Left_or_Right_8 : 8754|2@1+ (1,0) [0|2] "ENUM" MCU
 SG_ OBJ_Visible_Left_or_Right_V_8 : 8756|1@1+ (1,0) [0|1] "bool" MCU
 SG_ OBJ_2W_Is_Motorbike_Probability_8 : 8757|8@1+ (0.01,0) [0|1] "NA" MCU
 SG_ Reserved_26_8 : 8765|3@1+ (1,0) [0|0] "NA" MCU
 SG_ OBJ_2W_Is_Bicycle_Probability_8 : 8768|8@1+ (0.01,0) [0|1] "NA" MCU
 SG_ Reserved_27_8 : 8776|24@1+ (1,0) [0|0] "NA" MCU
 SG_ OBJ_CRC_9 : 8800|32@1+ (1,0) [0|4294967295] "NA" MCU
 SG_ OBJ_ID_9 : 8832|8@1+ (1,0) [0|255] "counter" MCU
 SG_ OBJ_Existence_Probability_9 : 8840|8@1+ (0.01,0) [0|1] "NA" MCU
 SG_ OBJ_Fusion_Source_9 : 8848|16@1+ (1,0) [0|65535] "BITWIZE" MCU
 SG_ OBJ_Triggered_SDM_9 : 8864|2@1+ (1,0) [0|2] "ENUM" MCU
 SG_ OBJ_Motion_Category_9 : 8866|4@1+ (1,0) [0|13] "ENUM" MCU
 SG_ OBJ_Moving_IN_Probability_9 : 8870|7@1+ (0.01,0) [0|1] "NA" MCU
 SG_ OBJ_Object_Age_9 : 8877|11@1+ (1,0) [0|2047] "frames" MCU
 SG_ OBJ_Measuring_Status_9 : 8888|3@1+ (1,0) [0|7] "BITWIZE" MCU
 SG_ OBJ_Object_Class_9 : 8891|4@1+ (1,0) [0|9] "ENUM" MCU
 SG_ Reserved_4_9 : 8895|1@1+ (1,0) [0|0] "NA" MCU
 SG_ OBJ_Class_Probability_9 : 8896|7@1+ (0.01,0) [0|1] "NA" MCU
 SG_ OBJ_Car_Probability_9 : 8903|7@1+ (0.01,0) [0|1] "NA" MCU
 SG_ OBJ_Truck_Probability_9 : 8910|7@1+ (0.01,0) [0|1] "NA" MCU
 SG_ OBJ_Bike_Probability_9 : 8917|7@1+ (0.01,0) [0|1] "NA" MCU
 SG_ OBJ_Camera_Source_9 : 8924|4@1+ (1,0) [0|15] "ENUM" MCU
 SG_ OBJ_Motion_Status_9 : 8928|3@1+ (1,0) [0|5] "ENUM" MCU
 SG_ OBJ_Motion_Orientation_9 : 8931|4@1+ (1,0) [0|13] "ENUM" MCU
 SG_ OBJ_Has_Cut_Lane_9 : 8935|1@1+ (1,0) [0|1] "bool" MCU
 SG_ OBJ_Has_Cut_Path_9 : 8936|1@1+ (1,0) [0|1] "bool" MCU
 SG_ OBJ_Brake_Light_Validity_9 : 8937|1@1+ (1,0) [0|1] "bool" MCU
 SG_ OBJ_Brake_Light_9 : 8938|1@1+ (1,0) [0|1] "bool" MCU
 SG_ OBJ_Turn_Indicator_Right_9 : 8939|1@1+ (1,0) [0|1] "bool" MCU
 SG_ OBJ_Turn_Indicator_Left_9 : 8940|1@1+ (1,0) [0|1] "bool" MCU
 SG_ OBJ_Turn_Indicator_Validity_9 : 8941|1@1+ (1,0) [0|1] "bool" MCU
 SG_ OBJ_Right_Out_Of_Image_9 : 8942|1@1+ (1,0) [0|1] "bool" MCU
 SG_ OBJ_Left_Out_Of_Image_9 : 8943|1@1+ (1,0) [0|1] "bool" MCU
 SG_ OBJ_Right_Out_Of_Image_V_9 : 8944|1@1+ (1,0) [0|1] "bool" MCU
 SG_ OBJ_Left_Out_Of_Image_V_9 : 8945|1@1+ (1,0) [0|1] "bool" MCU
 SG_ OBJ_Top_Out_Of_Image_9 : 8946|1@1+ (1,0) [0|1] "bool" MCU
 SG_ OBJ_Bottom_Out_Of_Image_9 : 8947|1@1+ (1,0) [0|1] "bool" MCU
 SG_ OBJ_Top_Out_Of_Image_V_9 : 8948|1@1+ (1,0) [0|1] "bool" MCU
 SG_ OBJ_Bottom_Out_Of_Image_V_9 : 8949|1@1+ (1,0) [0|1] "bool" MCU
 SG_ OBJ_Lane_Assignment_9 : 8950|3@1+ (1,0) [0|5] "ENUM" MCU
 SG_ OBJ_Lane_Assignment_V_9 : 8953|1@1+ (1,0) [0|1] "bool" MCU
 SG_ Reserved_5_9 : 8954|6@1+ (1,0) [0|0] "NA" MCU
 SG_ OBJ_Age_Seconds_9 : 8960|7@1+ (1,0) [0|100] "s" MCU
 SG_ OBJ_Age_Seconds_V_9 : 8967|1@1+ (1,0) [0|1] "bool" MCU
 SG_ OBJ_Width_9 : 8968|9@1+ (0.01,0) [0.4|2.95] "m" MCU
 SG_ OBJ_Width_V_9 : 8977|1@1+ (1,0) [0|1] "bool" MCU
 SG_ OBJ_Width_STD_9 : 8978|11@1+ (0.001,0) [0|2] "m" MCU
 SG_ OBJ_Width_STD_V_9 : 8989|1@1+ (1,0) [0|1] "bool" MCU
 SG_ Reserved_6_9 : 8990|2@1+ (1,0) [0|0] "NA" MCU
 SG_ OBJ_Length_9 : 8992|9@1+ (0.05,0) [0.6|21] "m" MCU
 SG_ OBJ_Length_V_9 : 9001|1@1+ (1,0) [0|1] "bool" MCU
 SG_ OBJ_Length_STD_9 : 9002|10@1+ (0.01,0) [0|10] "m" MCU
 SG_ OBJ_Length_STD_V_9 : 9012|1@1+ (1,0) [0|1] "bool" MCU
 SG_ OBJ_Radar_ID_9 : 9013|8@1+ (1,0) [0|255] "counter" MCU
 SG_ Reserved_7_9 : 9021|3@1+ (1,0) [0|0] "NA" MCU
 SG_ OBJ_Height_9 : 9024|9@1+ (0.01,0) [0|2.95] "m" MCU
 SG_ OBJ_Height_V_9 : 9033|1@1+ (1,0) [0|1] "bool" MCU
 SG_ OBJ_Height_STD_9 : 9034|11@1+ (0.001,0) [0|2] "m" MCU
 SG_ OBJ_Height_STD_V_9 : 9045|1@1+ (1,0) [0|1] "bool" MCU
 SG_ Reserved_8_9 : 9046|10@1+ (1,0) [0|0] "NA" MCU
 SG_ OBJ_Abs_Long_Velocity_9 : 9056|12@1+ (0.05,-100) [-100|100] "m_per_s" MCU
 SG_ OBJ_Abs_Long_Velocity_V_9 : 9068|1@1+ (1,0) [0|1] "bool" MCU
 SG_ OBJ_Abs_Long_Velocity_STD_9 : 9069|13@1+ (0.01,0) [0|65] "m_per_s" MCU
 SG_ OBJ_Abs_Long_Vel_STD_V_9 : 9082|1@1+ (1,0) [0|1] "bool" MCU
 SG_ Reserved_9_9 : 9083|5@1+ (1,0) [0|0] "NA" MCU
 SG_ OBJ_Abs_Lat_Velocity_9 : 9088|11@1+ (0.05,-50) [-50|50] "m_per_s" MCU
 SG_ OBJ_Abs_Lat_Velocity_V_9 : 9099|1@1+ (1,0) [0|1] "bool" MCU
 SG_ OBJ_Abs_Lat_Velocity_STD_9 : 9100|13@1+ (0.01,0) [0|50] "m_per_s" MCU
 SG_ OBJ_Abs_Lat_Vel_STD_V_9 : 9113|1@1+ (1,0) [0|1] "bool" MCU
 SG_ Reserved_10_9 : 9114|6@1+ (1,0) [0|0] "NA" MCU
 SG_ OBJ_Abs_Long_Acc_9 : 9120|9@1+ (0.05,-10) [-10|10] "m_per_s2" MCU
 SG_ OBJ_Abs_Long_Acc_V_9 : 9129|1@1+ (1,0) [0|1] "bool" MCU
 SG_ OBJ_Abs_Long_Acc_STD_9 : 9130|10@1+ (0.01,0) [0|7.3] "m_per_s2" MCU
 SG_ OBJ_Abs_Long_Acc_STD_V_9 : 9140|1@1+ (1,0) [0|1] "bool" MCU
 SG_ OBJ_Abs_Lat_Acc_9 : 9141|9@1+ (0.05,-10) [-10|10] "m_per_s2" MCU
 SG_ OBJ_Abs_Lat_Acc_V_9 : 9150|1@1+ (1,0) [0|1] "bool" MCU
 SG_ Reserved_11_9 : 9151|1@1+ (1,0) [0|0] "NA" MCU
 SG_ OBJ_Abs_Lat_Acc_STD_9 : 9152|10@1+ (0.01,0) [0|7.3] "m_per_s2" MCU
 SG_ OBJ_Abs_Lat_Acc_STD_V_9 : 9162|1@1+ (1,0) [0|1] "bool" MCU
 SG_ OBJ_Abs_Acceleration_9 : 9163|9@1+ (0.05,-12.7) [-12.7|12.7] "m_per_s2" MCU
 SG_ OBJ_Abs_Acceleration_V_9 : 9172|1@1+ (1,0) [0|1] "bool" MCU
 SG_ OBJ_Abs_Acc_STD_9 : 9173|10@1+ (0.01,0) [0|7.3] "m_per_s2" MCU
 SG_ OBJ_Abs_Acc_STD_V_9 : 9183|1@1+ (1,0) [0|1] "bool" MCU
 SG_ OBJ_Inv_TTC_9 : 9184|11@1+ (0.01,-8) [-8|8] "INV(s)" MCU
 SG_ OBJ_Inv_TTC_V_9 : 9195|1@1+ (1,0) [0|1] "bool" MCU
 SG_ OBJ_Inv_TTC_STD_9 : 9196|12@1+ (0.001,0) [0|4] "INV(s)" MCU
 SG_ OBJ_Inv_TTC_STD_V_9 : 9208|1@1+ (1,0) [0|1] "bool" MCU
 SG_ Reserved_12_9 : 9209|7@1+ (1,0) [0|0] "NA" MCU
 SG_ OBJ_Relative_Long_Acc_9 : 9216|10@1+ (0.05,-20) [-20|20] "m_per_s2" MCU
 SG_ OBJ_Relative_Long_Acc_V_9 : 9226|1@1+ (1,0) [0|1] "bool" MCU
 SG_ OBJ_Relative_Long_Acc_STD_9 : 9227|10@1+ (0.01,0) [0|7.3] "m_per_s2" MCU
 SG_ OBJ_Rel_Long_Acc_STD_V_9 : 9237|1@1+ (1,0) [0|1] "bool" MCU
 SG_ Reserved_13_9 : 9238|10@1+ (1,0) [0|0] "NA" MCU
 SG_ OBJ_Relative_Long_Velocity_9 : 9248|13@1+ (0.05,-120) [-120|130] "m_per_s" MCU
 SG_ OBJ_Relative_Long_Velocity_V_9 : 9261|1@1+ (1,0) [0|1] "bool" MCU
 SG_ OBJ_Relative_Long_Vel_STD_9 : 9262|14@1+ (0.01,0) [0|130] "m_per_s" MCU
 SG_ OBJ_Rel_Long_Vel_STD_V_9 : 9276|1@1+ (1,0) [0|1] "bool" MCU
 SG_ Reserved_14_9 : 9277|3@1+ (1,0) [0|0] "NA" MCU
 SG_ OBJ_Relative_Lat_Velocity_9 : 9280|11@1+ (0.05,-50) [-50|50] "m_per_s" MCU
 SG_ OBJ_Relative_Lat_Velocity_V_9 : 9291|1@1+ (1,0) [0|1] "bool" MCU
 SG_ OBJ_Relative_Lat_Velocity_STD_9 : 9292|13@1+ (0.01,0) [0|50] "m_per_s" MCU
 SG_ OBJ_Rel_Lat_Vel_STD_V_9 : 9305|1@1+ (1,0) [0|1] "bool" MCU
 SG_ Reserved_15_9 : 9306|6@1+ (1,0) [0|0] "NA" MCU
 SG_ OBJ_Long_Distance_9 : 9312|14@1+ (0.05,-200) [-200|500] "m" MCU
 SG_ OBJ_Long_Distance_V_9 : 9326|1@1+ (1,0) [0|1] "bool" MCU
 SG_ OBJ_Long_Distance_STD_9 : 9327|15@1+ (0.01,0) [0|250] "m" MCU
 SG_ OBJ_Long_Distance_STD_V_9 : 9342|1@1+ (1,0) [0|1] "bool" MCU
 SG_ Reserved_16_9 : 9343|1@1+ (1,0) [0|0] "NA" MCU
 SG_ OBJ_Lat_Distance_9 : 9344|12@1+ (0.05,-100) [-100|100] "m" MCU
 SG_ OBJ_Lat_Distance_V_9 : 9356|1@1+ (1,0) [0|1] "bool" MCU
 SG_ OBJ_Lat_Distance_STD_9 : 9357|14@1+ (0.01,0) [0|100] "m" MCU
 SG_ OBJ_Lat_Distance_STD_V_9 : 9371|1@1+ (1,0) [0|1] "bool" MCU
 SG_ Reserved_17_9 : 9372|4@1+ (1,0) [0|0] "NA" MCU
 SG_ OBJ_Absolute_Speed_9 : 9376|12@1+ (0.05,-65) [-65|65] "m_per_s" MCU
 SG_ OBJ_Absolute_Speed_V_9 : 9388|1@1+ (1,0) [0|1] "bool" MCU
 SG_ OBJ_Absolute_Speed_STD_9 : 9389|13@1+ (0.01,0) [0|65] "m_per_s" MCU
 SG_ OBJ_Absolute_Speed_STD_V_9 : 9402|1@1+ (1,0) [0|1] "bool" MCU
 SG_ Reserved_18_9 : 9403|5@1+ (1,0) [0|0] "NA" MCU
 SG_ OBJ_Heading_9 : 9408|10@1+ (0.01,-3.14) [-3.14|3.14] "rad" MCU
 SG_ OBJ_Heading_V_9 : 9418|1@1+ (1,0) [0|1] "bool" MCU
 SG_ OBJ_Heading_STD_9 : 9419|15@1+ (0.0001,0) [0|3.14] "rad" MCU
 SG_ OBJ_Heading_STD_V_9 : 9434|1@1+ (1,0) [0|1] "bool" MCU
 SG_ Reserved_19_9 : 9435|5@1+ (1,0) [0|0] "NA" MCU
 SG_ OBJ_Angle_Rate_STD_9 : 9440|15@1+ (0.0001,0) [0|2.2318] "RPS" MCU
 SG_ OBJ_Angle_Rate_STD_V_9 : 9455|1@1+ (1,0) [0|1] "bool" MCU
 SG_ OBJ_Angle_Rate_9 : 9456|12@1+ (0.002,-2.234) [-2.234|2.2318] "RPS" MCU
 SG_ OBJ_Angle_Rate_V_9 : 9468|1@1+ (1,0) [0|1] "bool" MCU
 SG_ Reserved_20_9 : 9469|3@1+ (1,0) [0|0] "NA" MCU
 SG_ OBJ_Angle_Right_9 : 9472|14@1+ (0.0002,-1.571) [-1.571|1.571] "rad" MCU
 SG_ OBJ_Angle_Right_V_9 : 9486|1@1+ (1,0) [0|1] "bool" MCU
 SG_ OBJ_Angle_Right_STD_9 : 9487|14@1+ (0.0001,0) [0|1.571] "rad" MCU
 SG_ OBJ_Angle_Right_STD_V_9 : 9501|1@1+ (1,0) [0|1] "bool" MCU
 SG_ Reserved_21_9 : 9502|2@1+ (1,0) [0|0] "NA" MCU
 SG_ OBJ_Angle_Left_9 : 9504|14@1+ (0.0002,-1.571) [-1.571|1.571] "rad" MCU
 SG_ OBJ_Angle_Left_V_9 : 9518|1@1+ (1,0) [0|1] "bool" MCU
 SG_ OBJ_Angle_Left_STD_9 : 9519|14@1+ (0.0001,0) [0|1.571] "rad" MCU
 SG_ OBJ_Angle_Left_STD_V_9 : 9533|1@1+ (1,0) [0|1] "bool" MCU
 SG_ Reserved_22_9 : 9534|2@1+ (1,0) [0|0] "NA" MCU
 SG_ OBJ_Angle_Side_9 : 9536|14@1+ (0.0002,-1.571) [-1.571|1.571] "rad" MCU
 SG_ OBJ_Angle_Side_V_9 : 9550|1@1+ (1,0) [0|1] "bool" MCU
 SG_ OBJ_Angle_Side_STD_9 : 9551|14@1+ (0.0001,0) [0|1.571] "rad" MCU
 SG_ OBJ_Angle_Side_STD_V_9 : 9565|1@1+ (1,0) [0|1] "bool" MCU
 SG_ OBJ_Angle_Mid_V_9 : 9566|1@1+ (1,0) [0|1] "bool" MCU
 SG_ Reserved_23_9 : 9567|1@1+ (1,0) [0|0] "NA" MCU
 SG_ OBJ_Angle_Mid_9 : 9568|14@1+ (0.0002,-1.571) [-1.571|1.571] "rad" MCU
 SG_ OBJ_Angle_Mid_STD_9 : 9582|14@1+ (0.0001,0) [0|1.571] "rad" MCU
 SG_ OBJ_Angle_Mid_STD_V_9 : 9596|1@1+ (1,0) [0|1] "bool" MCU
 SG_ OBJ_Angle_Bottom_V_9 : 9597|1@1+ (1,0) [0|1] "bool" MCU
 SG_ Reserved_24_9 : 9598|2@1+ (1,0) [0|0] "NA" MCU
 SG_ OBJ_Angle_Bottom_9 : 9600|14@1+ (0.0002,-1.571) [-1.571|1.571] "rad" MCU
 SG_ OBJ_Angle_Bottom_STD_9 : 9614|14@1+ (0.0001,0) [0|1.571] "rad" MCU
 SG_ OBJ_Angle_Bottom_STD_V_9 : 9628|1@1+ (1,0) [0|1] "bool" MCU
 SG_ OBJ_Visibility_Side_V_9 : 9629|1@1+ (1,0) [0|1] "bool" MCU
 SG_ OBJ_Visibility_Side_9 : 9630|2@1+ (1,0) [0|2] "ENUM" MCU
 SG_ OBJ_Is_In_Drivable_Area_9 : 9632|1@1+ (1,0) [0|1] "bool" MCU
 SG_ OBJ_Is_In_Drivable_Area_V_9 : 9633|1@1+ (1,0) [0|1] "bool" MCU
 SG_ OBJ_Is_VeryClose_V_9 : 9634|1@1+ (1,0) [0|1] "bool" MCU
 SG_ OBJ_Is_VeryClose_9 : 9635|1@1+ (1,0) [0|1] "bool" MCU
 SG_ OBJ_Buffer_C4_9 : 9636|2@1+ (1,0) [0|2] "NA" MCU
 SG_ OBJ_Buffer_C5_9 : 9638|2@1+ (1,0) [0|2] "NA" MCU
 SG_ OBJ_Buffer_C6_9 : 9640|2@1+ (1,0) [0|2] "NA" MCU
 SG_ OBJ_Buffer_C7_9 : 9642|2@1+ (1,0) [0|2] "NA" MCU
 SG_ OBJ_OverlapAngleEgoLaneR_9 : 9644|10@1+ (0.01,-3.14) [-3.14|3.14] "rad" MCU
 SG_ OBJ_OverlapAngleEgoLaneR_V_9 : 9654|1@1+ (1,0) [0|1] "bool" MCU
 SG_ Reserved_25_9 : 9655|9@1+ (1,0) [0|0] "NA" MCU
 SG_ OBJ_OverlapAngleEgoLaneL_9 : 9664|10@1+ (0.01,-3.14) [-3.14|3.14] "rad" MCU
 SG_ OBJ_OverlapAngleEgoLaneL_V_9 : 9674|1@1+ (1,0) [0|1] "bool" MCU
 SG_ OBJ_Is_EMERGENCY_VCL_9 : 9675|1@1+ (1,0) [0|1] "bool" MCU
 SG_ OBJ_EMERGENCY_LIGHT_COLOR_9 : 9676|4@1+ (1,0) [0|15] "BITWIZE" MCU
 SG_ OBJ_EMERGENCY_V_9 : 9680|1@1+ (1,0) [0|1] "bool" MCU
 SG_ OBJ_Angle_Top_9 : 9681|14@1+ (0.0002,0) [0|3.1415] "rad" MCU
 SG_ OBJ_Angle_Top_V_9 : 9695|1@1+ (1,0) [0|1] "bool" MCU
 SG_ OBJ_Angle_Top_STD_9 : 9696|15@1+ (0.0001,0) [0|3.1415] "rad" MCU
 SG_ OBJ_Angle_Top_STD_V_9 : 9711|1@1+ (1,0) [0|1] "bool" MCU
 SG_ OBJ_Open_Door_Left_9 : 9712|1@1+ (1,0) [0|1] "bool" MCU
 SG_ OBJ_Open_Door_Right_9 : 9713|1@1+ (1,0) [0|1] "bool" MCU
 SG_ OBJ_Visible_Left_or_Right_9 : 9714|2@1+ (1,0) [0|2] "ENUM" MCU
 SG_ OBJ_Visible_Left_or_Right_V_9 : 9716|1@1+ (1,0) [0|1] "bool" MCU
 SG_ OBJ_2W_Is_Motorbike_Probability_9 : 9717|8@1+ (0.01,0) [0|1] "NA" MCU
 SG_ Reserved_26_9 : 9725|3@1+ (1,0) [0|0] "NA" MCU
 SG_ OBJ_2W_Is_Bicycle_Probability_9 : 9728|8@1+ (0.01,0) [0|1] "NA" MCU
 SG_ Reserved_27_9 : 9736|24@1+ (1,0) [0|0] "NA" MCU
 SG_ OBJ_CRC_10 : 9760|32@1+ (1,0) [0|4294967295] "NA" MCU
 SG_ OBJ_ID_10 : 9792|8@1+ (1,0) [0|255] "counter" MCU
 SG_ OBJ_Existence_Probability_10 : 9800|8@1+ (0.01,0) [0|1] "NA" MCU
 SG_ OBJ_Fusion_Source_10 : 9808|16@1+ (1,0) [0|65535] "BITWIZE" MCU
 SG_ OBJ_Triggered_SDM_10 : 9824|2@1+ (1,0) [0|2] "ENUM" MCU
 SG_ OBJ_Motion_Category_10 : 9826|4@1+ (1,0) [0|13] "ENUM" MCU
 SG_ OBJ_Moving_IN_Probability_10 : 9830|7@1+ (0.01,0) [0|1] "NA" MCU
 SG_ OBJ_Object_Age_10 : 9837|11@1+ (1,0) [0|2047] "frames" MCU
 SG_ OBJ_Measuring_Status_10 : 9848|3@1+ (1,0) [0|7] "BITWIZE" MCU
 SG_ OBJ_Object_Class_10 : 9851|4@1+ (1,0) [0|9] "ENUM" MCU
 SG_ Reserved_4_10 : 9855|1@1+ (1,0) [0|0] "NA" MCU
 SG_ OBJ_Class_Probability_10 : 9856|7@1+ (0.01,0) [0|1] "NA" MCU
 SG_ OBJ_Car_Probability_10 : 9863|7@1+ (0.01,0) [0|1] "NA" MCU
 SG_ OBJ_Truck_Probability_10 : 9870|7@1+ (0.01,0) [0|1] "NA" MCU
 SG_ OBJ_Bike_Probability_10 : 9877|7@1+ (0.01,0) [0|1] "NA" MCU
 SG_ OBJ_Camera_Source_10 : 9884|4@1+ (1,0) [0|15] "ENUM" MCU
 SG_ OBJ_Motion_Status_10 : 9888|3@1+ (1,0) [0|5] "ENUM" MCU
 SG_ OBJ_Motion_Orientation_10 : 9891|4@1+ (1,0) [0|13] "ENUM" MCU
 SG_ OBJ_Has_Cut_Lane_10 : 9895|1@1+ (1,0) [0|1] "bool" MCU
 SG_ OBJ_Has_Cut_Path_10 : 9896|1@1+ (1,0) [0|1] "bool" MCU
 SG_ OBJ_Brake_Light_Validity_10 : 9897|1@1+ (1,0) [0|1] "bool" MCU
 SG_ OBJ_Brake_Light_10 : 9898|1@1+ (1,0) [0|1] "bool" MCU
 SG_ OBJ_Turn_Indicator_Right_10 : 9899|1@1+ (1,0) [0|1] "bool" MCU
 SG_ OBJ_Turn_Indicator_Left_10 : 9900|1@1+ (1,0) [0|1] "bool" MCU
 SG_ OBJ_Turn_Indicator_Validity_10 : 9901|1@1+ (1,0) [0|1] "bool" MCU
 SG_ OBJ_Right_Out_Of_Image_10 : 9902|1@1+ (1,0) [0|1] "bool" MCU
 SG_ OBJ_Left_Out_Of_Image_10 : 9903|1@1+ (1,0) [0|1] "bool" MCU
 SG_ OBJ_Right_Out_Of_Image_V_10 : 9904|1@1+ (1,0) [0|1] "bool" MCU
 SG_ OBJ_Left_Out_Of_Image_V_10 : 9905|1@1+ (1,0) [0|1] "bool" MCU
 SG_ OBJ_Top_Out_Of_Image_10 : 9906|1@1+ (1,0) [0|1] "bool" MCU
 SG_ OBJ_Bottom_Out_Of_Image_10 : 9907|1@1+ (1,0) [0|1] "bool" MCU
 SG_ OBJ_Top_Out_Of_Image_V_10 : 9908|1@1+ (1,0) [0|1] "bool" MCU
 SG_ OBJ_Bottom_Out_Of_Image_V_10 : 9909|1@1+ (1,0) [0|1] "bool" MCU
 SG_ OBJ_Lane_Assignment_10 : 9910|3@1+ (1,0) [0|5] "ENUM" MCU
 SG_ OBJ_Lane_Assignment_V_10 : 9913|1@1+ (1,0) [0|1] "bool" MCU
 SG_ Reserved_5_10 : 9914|6@1+ (1,0) [0|0] "NA" MCU
 SG_ OBJ_Age_Seconds_10 : 9920|7@1+ (1,0) [0|100] "s" MCU
 SG_ OBJ_Age_Seconds_V_10 : 9927|1@1+ (1,0) [0|1] "bool" MCU
 SG_ OBJ_Width_10 : 9928|9@1+ (0.01,0) [0.4|2.95] "m" MCU
 SG_ OBJ_Width_V_10 : 9937|1@1+ (1,0) [0|1] "bool" MCU
 SG_ OBJ_Width_STD_10 : 9938|11@1+ (0.001,0) [0|2] "m" MCU
 SG_ OBJ_Width_STD_V_10 : 9949|1@1+ (1,0) [0|1] "bool" MCU
 SG_ Reserved_6_10 : 9950|2@1+ (1,0) [0|0] "NA" MCU
 SG_ OBJ_Length_10 : 9952|9@1+ (0.05,0) [0.6|21] "m" MCU
 SG_ OBJ_Length_V_10 : 9961|1@1+ (1,0) [0|1] "bool" MCU
 SG_ OBJ_Length_STD_10 : 9962|10@1+ (0.01,0) [0|10] "m" MCU
 SG_ OBJ_Length_STD_V_10 : 9972|1@1+ (1,0) [0|1] "bool" MCU
 SG_ OBJ_Radar_ID_10 : 9973|8@1+ (1,0) [0|255] "counter" MCU
 SG_ Reserved_7_10 : 9981|3@1+ (1,0) [0|0] "NA" MCU
 SG_ OBJ_Height_10 : 9984|9@1+ (0.01,0) [0|2.95] "m" MCU
 SG_ OBJ_Height_V_10 : 9993|1@1+ (1,0) [0|1] "bool" MCU
 SG_ OBJ_Height_STD_10 : 9994|11@1+ (0.001,0) [0|2] "m" MCU
 SG_ OBJ_Height_STD_V_10 : 10005|1@1+ (1,0) [0|1] "bool" MCU
 SG_ Reserved_8_10 : 10006|10@1+ (1,0) [0|0] "NA" MCU
 SG_ OBJ_Abs_Long_Velocity_10 : 10016|12@1+ (0.05,-100) [-100|100] "m_per_s" MCU
 SG_ OBJ_Abs_Long_Velocity_V_10 : 10028|1@1+ (1,0) [0|1] "bool" MCU
 SG_ OBJ_Abs_Long_Velocity_STD_10 : 10029|13@1+ (0.01,0) [0|65] "m_per_s" MCU
 SG_ OBJ_Abs_Long_Vel_STD_V_10 : 10042|1@1+ (1,0) [0|1] "bool" MCU
 SG_ Reserved_9_10 : 10043|5@1+ (1,0) [0|0] "NA" MCU
 SG_ OBJ_Abs_Lat_Velocity_10 : 10048|11@1+ (0.05,-50) [-50|50] "m_per_s" MCU
 SG_ OBJ_Abs_Lat_Velocity_V_10 : 10059|1@1+ (1,0) [0|1] "bool" MCU
 SG_ OBJ_Abs_Lat_Velocity_STD_10 : 10060|13@1+ (0.01,0) [0|50] "m_per_s" MCU
 SG_ OBJ_Abs_Lat_Vel_STD_V_10 : 10073|1@1+ (1,0) [0|1] "bool" MCU
 SG_ Reserved_10_10 : 10074|6@1+ (1,0) [0|0] "NA" MCU
 SG_ OBJ_Abs_Long_Acc_10 : 10080|9@1+ (0.05,-10) [-10|10] "m_per_s2" MCU
 SG_ OBJ_Abs_Long_Acc_V_10 : 10089|1@1+ (1,0) [0|1] "bool" MCU
 SG_ OBJ_Abs_Long_Acc_STD_10 : 10090|10@1+ (0.01,0) [0|7.3] "m_per_s2" MCU
 SG_ OBJ_Abs_Long_Acc_STD_V_10 : 10100|1@1+ (1,0) [0|1] "bool" MCU
 SG_ OBJ_Abs_Lat_Acc_10 : 10101|9@1+ (0.05,-10) [-10|10] "m_per_s2" MCU
 SG_ OBJ_Abs_Lat_Acc_V_10 : 10110|1@1+ (1,0) [0|1] "bool" MCU
 SG_ Reserved_11_10 : 10111|1@1+ (1,0) [0|0] "NA" MCU
 SG_ OBJ_Abs_Lat_Acc_STD_10 : 10112|10@1+ (0.01,0) [0|7.3] "m_per_s2" MCU
 SG_ OBJ_Abs_Lat_Acc_STD_V_10 : 10122|1@1+ (1,0) [0|1] "bool" MCU
 SG_ OBJ_Abs_Acceleration_10 : 10123|9@1+ (0.05,-12.7) [-12.7|12.7] "m_per_s2" MCU
 SG_ OBJ_Abs_Acceleration_V_10 : 10132|1@1+ (1,0) [0|1] "bool" MCU
 SG_ OBJ_Abs_Acc_STD_10 : 10133|10@1+ (0.01,0) [0|7.3] "m_per_s2" MCU
 SG_ OBJ_Abs_Acc_STD_V_10 : 10143|1@1+ (1,0) [0|1] "bool" MCU
 SG_ OBJ_Inv_TTC_10 : 10144|11@1+ (0.01,-8) [-8|8] "INV(s)" MCU
 SG_ OBJ_Inv_TTC_V_10 : 10155|1@1+ (1,0) [0|1] "bool" MCU
 SG_ OBJ_Inv_TTC_STD_10 : 10156|12@1+ (0.001,0) [0|4] "INV(s)" MCU
 SG_ OBJ_Inv_TTC_STD_V_10 : 10168|1@1+ (1,0) [0|1] "bool" MCU
 SG_ Reserved_12_10 : 10169|7@1+ (1,0) [0|0] "NA" MCU
 SG_ OBJ_Relative_Long_Acc_10 : 10176|10@1+ (0.05,-20) [-20|20] "m_per_s2" MCU
 SG_ OBJ_Relative_Long_Acc_V_10 : 10186|1@1+ (1,0) [0|1] "bool" MCU
 SG_ OBJ_Relative_Long_Acc_STD_10 : 10187|10@1+ (0.01,0) [0|7.3] "m_per_s2" MCU
 SG_ OBJ_Rel_Long_Acc_STD_V_10 : 10197|1@1+ (1,0) [0|1] "bool" MCU
 SG_ Reserved_13_10 : 10198|10@1+ (1,0) [0|0] "NA" MCU
 SG_ OBJ_Relative_Long_Velocity_10 : 10208|13@1+ (0.05,-120) [-120|130] "m_per_s" MCU
 SG_ OBJ_Relative_Long_Velocity_V_10 : 10221|1@1+ (1,0) [0|1] "bool" MCU
 SG_ OBJ_Relative_Long_Vel_STD_10 : 10222|14@1+ (0.01,0) [0|130] "m_per_s" MCU
 SG_ OBJ_Rel_Long_Vel_STD_V_10 : 10236|1@1+ (1,0) [0|1] "bool" MCU
 SG_ Reserved_14_10 : 10237|3@1+ (1,0) [0|0] "NA" MCU
 SG_ OBJ_Relative_Lat_Velocity_10 : 10240|11@1+ (0.05,-50) [-50|50] "m_per_s" MCU
 SG_ OBJ_Relative_Lat_Velocity_V_10 : 10251|1@1+ (1,0) [0|1] "bool" MCU
 SG_ OBJ_Relative_Lat_Velocity_STD_10 : 10252|13@1+ (0.01,0) [0|50] "m_per_s" MCU
 SG_ OBJ_Rel_Lat_Vel_STD_V_10 : 10265|1@1+ (1,0) [0|1] "bool" MCU
 SG_ Reserved_15_10 : 10266|6@1+ (1,0) [0|0] "NA" MCU
 SG_ OBJ_Long_Distance_10 : 10272|14@1+ (0.05,-200) [-200|500] "m" MCU
 SG_ OBJ_Long_Distance_V_10 : 10286|1@1+ (1,0) [0|1] "bool" MCU
 SG_ OBJ_Long_Distance_STD_10 : 10287|15@1+ (0.01,0) [0|250] "m" MCU
 SG_ OBJ_Long_Distance_STD_V_10 : 10302|1@1+ (1,0) [0|1] "bool" MCU
 SG_ Reserved_16_10 : 10303|1@1+ (1,0) [0|0] "NA" MCU
 SG_ OBJ_Lat_Distance_10 : 10304|12@1+ (0.05,-100) [-100|100] "m" MCU
 SG_ OBJ_Lat_Distance_V_10 : 10316|1@1+ (1,0) [0|1] "bool" MCU
 SG_ OBJ_Lat_Distance_STD_10 : 10317|14@1+ (0.01,0) [0|100] "m" MCU
 SG_ OBJ_Lat_Distance_STD_V_10 : 10331|1@1+ (1,0) [0|1] "bool" MCU
 SG_ Reserved_17_10 : 10332|4@1+ (1,0) [0|0] "NA" MCU
 SG_ OBJ_Absolute_Speed_10 : 10336|12@1+ (0.05,-65) [-65|65] "m_per_s" MCU
 SG_ OBJ_Absolute_Speed_V_10 : 10348|1@1+ (1,0) [0|1] "bool" MCU
 SG_ OBJ_Absolute_Speed_STD_10 : 10349|13@1+ (0.01,0) [0|65] "m_per_s" MCU
 SG_ OBJ_Absolute_Speed_STD_V_10 : 10362|1@1+ (1,0) [0|1] "bool" MCU
 SG_ Reserved_18_10 : 10363|5@1+ (1,0) [0|0] "NA" MCU
 SG_ OBJ_Heading_10 : 10368|10@1+ (0.01,-3.14) [-3.14|3.14] "rad" MCU
 SG_ OBJ_Heading_V_10 : 10378|1@1+ (1,0) [0|1] "bool" MCU
 SG_ OBJ_Heading_STD_10 : 10379|15@1+ (0.0001,0) [0|3.14] "rad" MCU
 SG_ OBJ_Heading_STD_V_10 : 10394|1@1+ (1,0) [0|1] "bool" MCU
 SG_ Reserved_19_10 : 10395|5@1+ (1,0) [0|0] "NA" MCU
 SG_ OBJ_Angle_Rate_STD_10 : 10400|15@1+ (0.0001,0) [0|2.2318] "RPS" MCU
 SG_ OBJ_Angle_Rate_STD_V_10 : 10415|1@1+ (1,0) [0|1] "bool" MCU
 SG_ OBJ_Angle_Rate_10 : 10416|12@1+ (0.002,-2.234) [-2.234|2.2318] "RPS" MCU
 SG_ OBJ_Angle_Rate_V_10 : 10428|1@1+ (1,0) [0|1] "bool" MCU
 SG_ Reserved_20_10 : 10429|3@1+ (1,0) [0|0] "NA" MCU
 SG_ OBJ_Angle_Right_10 : 10432|14@1+ (0.0002,-1.571) [-1.571|1.571] "rad" MCU
 SG_ OBJ_Angle_Right_V_10 : 10446|1@1+ (1,0) [0|1] "bool" MCU
 SG_ OBJ_Angle_Right_STD_10 : 10447|14@1+ (0.0001,0) [0|1.571] "rad" MCU
 SG_ OBJ_Angle_Right_STD_V_10 : 10461|1@1+ (1,0) [0|1] "bool" MCU
 SG_ Reserved_21_10 : 10462|2@1+ (1,0) [0|0] "NA" MCU
 SG_ OBJ_Angle_Left_10 : 10464|14@1+ (0.0002,-1.571) [-1.571|1.571] "rad" MCU
 SG_ OBJ_Angle_Left_V_10 : 10478|1@1+ (1,0) [0|1] "bool" MCU
 SG_ OBJ_Angle_Left_STD_10 : 10479|14@1+ (0.0001,0) [0|1.571] "rad" MCU
 SG_ OBJ_Angle_Left_STD_V_10 : 10493|1@1+ (1,0) [0|1] "bool" MCU
 SG_ Reserved_22_10 : 10494|2@1+ (1,0) [0|0] "NA" MCU
 SG_ OBJ_Angle_Side_10 : 10496|14@1+ (0.0002,-1.571) [-1.571|1.571] "rad" MCU
 SG_ OBJ_Angle_Side_V_10 : 10510|1@1+ (1,0) [0|1] "bool" MCU
 SG_ OBJ_Angle_Side_STD_10 : 10511|14@1+ (0.0001,0) [0|1.571] "rad" MCU
 SG_ OBJ_Angle_Side_STD_V_10 : 10525|1@1+ (1,0) [0|1] "bool" MCU
 SG_ OBJ_Angle_Mid_V_10 : 10526|1@1+ (1,0) [0|1] "bool" MCU
 SG_ Reserved_23_10 : 10527|1@1+ (1,0) [0|0] "NA" MCU
 SG_ OBJ_Angle_Mid_10 : 10528|14@1+ (0.0002,-1.571) [-1.571|1.571] "rad" MCU
 SG_ OBJ_Angle_Mid_STD_10 : 10542|14@1+ (0.0001,0) [0|1.571] "rad" MCU
 SG_ OBJ_Angle_Mid_STD_V_10 : 10556|1@1+ (1,0) [0|1] "bool" MCU
 SG_ OBJ_Angle_Bottom_V_10 : 10557|1@1+ (1,0) [0|1] "bool" MCU
 SG_ Reserved_24_10 : 10558|2@1+ (1,0) [0|0] "NA" MCU
 SG_ OBJ_Angle_Bottom_10 : 10560|14@1+ (0.0002,-1.571) [-1.571|1.571] "rad" MCU
 SG_ OBJ_Angle_Bottom_STD_10 : 10574|14@1+ (0.0001,0) [0|1.571] "rad" MCU
 SG_ OBJ_Angle_Bottom_STD_V_10 : 10588|1@1+ (1,0) [0|1] "bool" MCU
 SG_ OBJ_Visibility_Side_V_10 : 10589|1@1+ (1,0) [0|1] "bool" MCU
 SG_ OBJ_Visibility_Side_10 : 10590|2@1+ (1,0) [0|2] "ENUM" MCU
 SG_ OBJ_Is_In_Drivable_Area_10 : 10592|1@1+ (1,0) [0|1] "bool" MCU
 SG_ OBJ_Is_In_Drivable_Area_V_10 : 10593|1@1+ (1,0) [0|1] "bool" MCU
 SG_ OBJ_Is_VeryClose_V_10 : 10594|1@1+ (1,0) [0|1] "bool" MCU
 SG_ OBJ_Is_VeryClose_10 : 10595|1@1+ (1,0) [0|1] "bool" MCU
 SG_ OBJ_Buffer_C4_10 : 10596|2@1+ (1,0) [0|2] "NA" MCU
 SG_ OBJ_Buffer_C5_10 : 10598|2@1+ (1,0) [0|2] "NA" MCU
 SG_ OBJ_Buffer_C6_10 : 10600|2@1+ (1,0) [0|2] "NA" MCU
 SG_ OBJ_Buffer_C7_10 : 10602|2@1+ (1,0) [0|2] "NA" MCU
 SG_ OBJ_OverlapAngleEgoLaneR_10 : 10604|10@1+ (0.01,-3.14) [-3.14|3.14] "rad" MCU
 SG_ OBJ_OverlapAngleEgoLaneR_V_10 : 10614|1@1+ (1,0) [0|1] "bool" MCU
 SG_ Reserved_25_10 : 10615|9@1+ (1,0) [0|0] "NA" MCU
 SG_ OBJ_OverlapAngleEgoLaneL_10 : 10624|10@1+ (0.01,-3.14) [-3.14|3.14] "rad" MCU
 SG_ OBJ_OverlapAngleEgoLaneL_V_10 : 10634|1@1+ (1,0) [0|1] "bool" MCU
 SG_ OBJ_Is_EMERGENCY_VCL_10 : 10635|1@1+ (1,0) [0|1] "bool" MCU
 SG_ OBJ_EMERGENCY_LIGHT_COLOR_10 : 10636|4@1+ (1,0) [0|15] "BITWIZE" MCU
 SG_ OBJ_EMERGENCY_V_10 : 10640|1@1+ (1,0) [0|1] "bool" MCU
 SG_ OBJ_Angle_Top_10 : 10641|14@1+ (0.0002,0) [0|3.1415] "rad" MCU
 SG_ OBJ_Angle_Top_V_10 : 10655|1@1+ (1,0) [0|1] "bool" MCU
 SG_ OBJ_Angle_Top_STD_10 : 10656|15@1+ (0.0001,0) [0|3.1415] "rad" MCU
 SG_ OBJ_Angle_Top_STD_V_10 : 10671|1@1+ (1,0) [0|1] "bool" MCU
 SG_ OBJ_Open_Door_Left_10 : 10672|1@1+ (1,0) [0|1] "bool" MCU
 SG_ OBJ_Open_Door_Right_10 : 10673|1@1+ (1,0) [0|1] "bool" MCU
 SG_ OBJ_Visible_Left_or_Right_10 : 10674|2@1+ (1,0) [0|2] "ENUM" MCU
 SG_ OBJ_Visible_Left_or_Right_V_10 : 10676|1@1+ (1,0) [0|1] "bool" MCU
 SG_ OBJ_2W_Is_Motorbike_Probability_10 : 10677|8@1+ (0.01,0) [0|1] "NA" MCU
 SG_ Reserved_26_10 : 10685|3@1+ (1,0) [0|0] "NA" MCU
 SG_ OBJ_2W_Is_Bicycle_Probability_10 : 10688|8@1+ (0.01,0) [0|1] "NA" MCU
 SG_ Reserved_27_10 : 10696|24@1+ (1,0) [0|0] "NA" MCU
 SG_ OBJ_CRC_11 : 10720|32@1+ (1,0) [0|4294967295] "NA" MCU
 SG_ OBJ_ID_11 : 10752|8@1+ (1,0) [0|255] "counter" MCU
 SG_ OBJ_Existence_Probability_11 : 10760|8@1+ (0.01,0) [0|1] "NA" MCU
 SG_ OBJ_Fusion_Source_11 : 10768|16@1+ (1,0) [0|65535] "BITWIZE" MCU
 SG_ OBJ_Triggered_SDM_11 : 10784|2@1+ (1,0) [0|2] "ENUM" MCU
 SG_ OBJ_Motion_Category_11 : 10786|4@1+ (1,0) [0|13] "ENUM" MCU
 SG_ OBJ_Moving_IN_Probability_11 : 10790|7@1+ (0.01,0) [0|1] "NA" MCU
 SG_ OBJ_Object_Age_11 : 10797|11@1+ (1,0) [0|2047] "frames" MCU
 SG_ OBJ_Measuring_Status_11 : 10808|3@1+ (1,0) [0|7] "BITWIZE" MCU
 SG_ OBJ_Object_Class_11 : 10811|4@1+ (1,0) [0|9] "ENUM" MCU
 SG_ Reserved_4_11 : 10815|1@1+ (1,0) [0|0] "NA" MCU
 SG_ OBJ_Class_Probability_11 : 10816|7@1+ (0.01,0) [0|1] "NA" MCU
 SG_ OBJ_Car_Probability_11 : 10823|7@1+ (0.01,0) [0|1] "NA" MCU
 SG_ OBJ_Truck_Probability_11 : 10830|7@1+ (0.01,0) [0|1] "NA" MCU
 SG_ OBJ_Bike_Probability_11 : 10837|7@1+ (0.01,0) [0|1] "NA" MCU
 SG_ OBJ_Camera_Source_11 : 10844|4@1+ (1,0) [0|15] "ENUM" MCU
 SG_ OBJ_Motion_Status_11 : 10848|3@1+ (1,0) [0|5] "ENUM" MCU
 SG_ OBJ_Motion_Orientation_11 : 10851|4@1+ (1,0) [0|13] "ENUM" MCU
 SG_ OBJ_Has_Cut_Lane_11 : 10855|1@1+ (1,0) [0|1] "bool" MCU
 SG_ OBJ_Has_Cut_Path_11 : 10856|1@1+ (1,0) [0|1] "bool" MCU
 SG_ OBJ_Brake_Light_Validity_11 : 10857|1@1+ (1,0) [0|1] "bool" MCU
 SG_ OBJ_Brake_Light_11 : 10858|1@1+ (1,0) [0|1] "bool" MCU
 SG_ OBJ_Turn_Indicator_Right_11 : 10859|1@1+ (1,0) [0|1] "bool" MCU
 SG_ OBJ_Turn_Indicator_Left_11 : 10860|1@1+ (1,0) [0|1] "bool" MCU
 SG_ OBJ_Turn_Indicator_Validity_11 : 10861|1@1+ (1,0) [0|1] "bool" MCU
 SG_ OBJ_Right_Out_Of_Image_11 : 10862|1@1+ (1,0) [0|1] "bool" MCU
 SG_ OBJ_Left_Out_Of_Image_11 : 10863|1@1+ (1,0) [0|1] "bool" MCU
 SG_ OBJ_Right_Out_Of_Image_V_11 : 10864|1@1+ (1,0) [0|1] "bool" MCU
 SG_ OBJ_Left_Out_Of_Image_V_11 : 10865|1@1+ (1,0) [0|1] "bool" MCU
 SG_ OBJ_Top_Out_Of_Image_11 : 10866|1@1+ (1,0) [0|1] "bool" MCU
 SG_ OBJ_Bottom_Out_Of_Image_11 : 10867|1@1+ (1,0) [0|1] "bool" MCU
 SG_ OBJ_Top_Out_Of_Image_V_11 : 10868|1@1+ (1,0) [0|1] "bool" MCU
 SG_ OBJ_Bottom_Out_Of_Image_V_11 : 10869|1@1+ (1,0) [0|1] "bool" MCU
 SG_ OBJ_Lane_Assignment_11 : 10870|3@1+ (1,0) [0|5] "ENUM" MCU
 SG_ OBJ_Lane_Assignment_V_11 : 10873|1@1+ (1,0) [0|1] "bool" MCU
 SG_ Reserved_5_11 : 10874|6@1+ (1,0) [0|0] "NA" MCU
 SG_ OBJ_Age_Seconds_11 : 10880|7@1+ (1,0) [0|100] "s" MCU
 SG_ OBJ_Age_Seconds_V_11 : 10887|1@1+ (1,0) [0|1] "bool" MCU
 SG_ OBJ_Width_11 : 10888|9@1+ (0.01,0) [0.4|2.95] "m" MCU
 SG_ OBJ_Width_V_11 : 10897|1@1+ (1,0) [0|1] "bool" MCU
 SG_ OBJ_Width_STD_11 : 10898|11@1+ (0.001,0) [0|2] "m" MCU
 SG_ OBJ_Width_STD_V_11 : 10909|1@1+ (1,0) [0|1] "bool" MCU
 SG_ Reserved_6_11 : 10910|2@1+ (1,0) [0|0] "NA" MCU
 SG_ OBJ_Length_11 : 10912|9@1+ (0.05,0) [0.6|21] "m" MCU
 SG_ OBJ_Length_V_11 : 10921|1@1+ (1,0) [0|1] "bool" MCU
 SG_ OBJ_Length_STD_11 : 10922|10@1+ (0.01,0) [0|10] "m" MCU
 SG_ OBJ_Length_STD_V_11 : 10932|1@1+ (1,0) [0|1] "bool" MCU
 SG_ OBJ_Radar_ID_11 : 10933|8@1+ (1,0) [0|255] "counter" MCU
 SG_ Reserved_7_11 : 10941|3@1+ (1,0) [0|0] "NA" MCU
 SG_ OBJ_Height_11 : 10944|9@1+ (0.01,0) [0|2.95] "m" MCU
 SG_ OBJ_Height_V_11 : 10953|1@1+ (1,0) [0|1] "bool" MCU
 SG_ OBJ_Height_STD_11 : 10954|11@1+ (0.001,0) [0|2] "m" MCU
 SG_ OBJ_Height_STD_V_11 : 10965|1@1+ (1,0) [0|1] "bool" MCU
 SG_ Reserved_8_11 : 10966|10@1+ (1,0) [0|0] "NA" MCU
 SG_ OBJ_Abs_Long_Velocity_11 : 10976|12@1+ (0.05,-100) [-100|100] "m_per_s" MCU
 SG_ OBJ_Abs_Long_Velocity_V_11 : 10988|1@1+ (1,0) [0|1] "bool" MCU
 SG_ OBJ_Abs_Long_Velocity_STD_11 : 10989|13@1+ (0.01,0) [0|65] "m_per_s" MCU
 SG_ OBJ_Abs_Long_Vel_STD_V_11 : 11002|1@1+ (1,0) [0|1] "bool" MCU
 SG_ Reserved_9_11 : 11003|5@1+ (1,0) [0|0] "NA" MCU
 SG_ OBJ_Abs_Lat_Velocity_11 : 11008|11@1+ (0.05,-50) [-50|50] "m_per_s" MCU
 SG_ OBJ_Abs_Lat_Velocity_V_11 : 11019|1@1+ (1,0) [0|1] "bool" MCU
 SG_ OBJ_Abs_Lat_Velocity_STD_11 : 11020|13@1+ (0.01,0) [0|50] "m_per_s" MCU
 SG_ OBJ_Abs_Lat_Vel_STD_V_11 : 11033|1@1+ (1,0) [0|1] "bool" MCU
 SG_ Reserved_10_11 : 11034|6@1+ (1,0) [0|0] "NA" MCU
 SG_ OBJ_Abs_Long_Acc_11 : 11040|9@1+ (0.05,-10) [-10|10] "m_per_s2" MCU
 SG_ OBJ_Abs_Long_Acc_V_11 : 11049|1@1+ (1,0) [0|1] "bool" MCU
 SG_ OBJ_Abs_Long_Acc_STD_11 : 11050|10@1+ (0.01,0) [0|7.3] "m_per_s2" MCU
 SG_ OBJ_Abs_Long_Acc_STD_V_11 : 11060|1@1+ (1,0) [0|1] "bool" MCU
 SG_ OBJ_Abs_Lat_Acc_11 : 11061|9@1+ (0.05,-10) [-10|10] "m_per_s2" MCU
 SG_ OBJ_Abs_Lat_Acc_V_11 : 11070|1@1+ (1,0) [0|1] "bool" MCU
 SG_ Reserved_11_11 : 11071|1@1+ (1,0) [0|0] "NA" MCU
 SG_ OBJ_Abs_Lat_Acc_STD_11 : 11072|10@1+ (0.01,0) [0|7.3] "m_per_s2" MCU
 SG_ OBJ_Abs_Lat_Acc_STD_V_11 : 11082|1@1+ (1,0) [0|1] "bool" MCU
 SG_ OBJ_Abs_Acceleration_11 : 11083|9@1+ (0.05,-12.7) [-12.7|12.7] "m_per_s2" MCU
 SG_ OBJ_Abs_Acceleration_V_11 : 11092|1@1+ (1,0) [0|1] "bool" MCU
 SG_ OBJ_Abs_Acc_STD_11 : 11093|10@1+ (0.01,0) [0|7.3] "m_per_s2" MCU
 SG_ OBJ_Abs_Acc_STD_V_11 : 11103|1@1+ (1,0) [0|1] "bool" MCU
 SG_ OBJ_Inv_TTC_11 : 11104|11@1+ (0.01,-8) [-8|8] "INV(s)" MCU
 SG_ OBJ_Inv_TTC_V_11 : 11115|1@1+ (1,0) [0|1] "bool" MCU
 SG_ OBJ_Inv_TTC_STD_11 : 11116|12@1+ (0.001,0) [0|4] "INV(s)" MCU
 SG_ OBJ_Inv_TTC_STD_V_11 : 11128|1@1+ (1,0) [0|1] "bool" MCU
 SG_ Reserved_12_11 : 11129|7@1+ (1,0) [0|0] "NA" MCU
 SG_ OBJ_Relative_Long_Acc_11 : 11136|10@1+ (0.05,-20) [-20|20] "m_per_s2" MCU
 SG_ OBJ_Relative_Long_Acc_V_11 : 11146|1@1+ (1,0) [0|1] "bool" MCU
 SG_ OBJ_Relative_Long_Acc_STD_11 : 11147|10@1+ (0.01,0) [0|7.3] "m_per_s2" MCU

CM_ SG_ 154 OBJ_Angle_Right_STD_5 "Standard deviation of angleRight";
CM_ SG_ 154 OBJ_Angle_Right_STD_V_5 "Validator for the standard deviation of angleRight.";
CM_ SG_ 154 OBJ_Angle_Left_5 "The angle between the host longitudinal axis and the left side of the front / rear of the target (the visible one). The positive side is to the host's right.";
CM_ SG_ 154 OBJ_Angle_Left_V_5 "Validator for angleLeft.";
CM_ SG_ 154 OBJ_Angle_Left_STD_5 "Standard deviation of angleLeft.";
CM_ SG_ 154 OBJ_Angle_Left_STD_V_5 "Validator for the standard deviation of angleLeft.";
CM_ SG_ 154 OBJ_Angle_Side_5 "The angle between the host longitudinal axis and the far visible edge - the visible edge of the front / rear of the target that is not visible. Currently supported for vehicles only.";
CM_ SG_ 154 OBJ_Angle_Side_V_5 "Validator for angleSide.";
CM_ SG_ 154 OBJ_Angle_Side_STD_5 "Standard deviation of angleSide.";
CM_ SG_ 154 OBJ_Angle_Side_STD_V_5 "Validator for the STD of angleSide.";
CM_ SG_ 154 OBJ_Angle_Mid_V_5 "Validator for angleMid.";
CM_ SG_ 154 OBJ_Angle_Mid_5 "The angle between the host longitudinal axis and the middle of the front / rear of the target (the visible one). The positive side is to the host's right.";
CM_ SG_ 154 OBJ_Angle_Mid_STD_5 "Standard deviation of angleMid.";
CM_ SG_ 154 OBJ_Angle_Mid_STD_V_5 "Validator for the STD of angleMid.";
CM_ SG_ 154 OBJ_Angle_Bottom_V_5 "Validator for OBJAngle_Bottom. ";
CM_ SG_ 154 OBJ_Angle_Bottom_5 "The angle between the longitudinal axis and the Bottom of the front / rear of the target (the visible one). The positive side is to the host's bottom";
CM_ SG_ 154 OBJ_Angle_Bottom_STD_5 "STD for OBJAngle_Bottom. ";
CM_ SG_ 154 OBJ_Angle_Bottom_STD_V_5 "Validator for OBJAngle_Bottom_STD. ";
CM_ SG_ 154 OBJ_Visibility_Side_V_5 "Currently Supported for VD only";
CM_ SG_ 154 OBJ_Visibility_Side_5 "From what car  side is the object visible";
CM_ SG_ 154 OBJ_Is_In_Drivable_Area_5 "Indicates whether the target is in a driveable area.";
CM_ SG_ 154 OBJ_Is_In_Drivable_Area_V_5 "Validator for OBJ_Is_In_Drivable_Area.";
CM_ SG_ 154 OBJ_Is_VeryClose_V_5 "Validator for OBJ_Is_VeryClose. ";
CM_ SG_ 154 OBJ_Is_VeryClose_5 "Indicates whether the target is very close to the host such that it is hard to measure its distance. Currently relevant for peds only";
CM_ SG_ 154 OBJ_OverlapAngleEgoLaneR_5 "Lateral distance to the middle of the RL and RR corners.";
CM_ SG_ 154 OBJ_OverlapAngleEgoLaneR_V_5 "Validator for OBJ_OverlapAngleEgoLaneR";
CM_ SG_ 154 OBJ_OverlapAngleEgoLaneL_5 "Lateral distance to the middle of the RL and RR corners.  ";
CM_ SG_ 154 OBJ_OverlapAngleEgoLaneL_V_5 "Validator for OBJ_OverlapAngleEgoLaneL";
CM_ SG_ 154 OBJ_Is_EMERGENCY_VCL_5 "Is Object an Emergency Vehicle";
CM_ SG_ 154 OBJ_EMERGENCY_LIGHT_COLOR_5 "Emergency Color";
CM_ SG_ 154 OBJ_EMERGENCY_V_5 "Are OBJ_Is_EMERGENCY_VCL and OBJ_EMERGENCY_LIGHT_COLOR Valid";
CM_ SG_ 154 OBJ_Angle_Top_5 "From VD touching point on the ground till the roof of the car";
CM_ SG_ 154 OBJ_Angle_Top_V_5 "Validator for OBJ_Angle_Top ";
CM_ SG_ 154 OBJ_Angle_Top_STD_5 "STD for OBJ_Angle_Top";
CM_ SG_ 154 OBJ_Angle_Top_STD_V_5 "Validator for OBJ_Angle_Top_STD. ";
CM_ SG_ 154 OBJ_Open_Door_Left_5 "Indicator if left door is open";
CM_ SG_ 154 OBJ_Open_Door_Right_5 "Indicator if right door is open";
CM_ SG_ 154 OBJ_Visible_Left_or_Right_5 "This signal describes the visible Left or Right side of the Target vehicle.";
CM_ SG_ 154 OBJ_Visible_Left_or_Right_V_5 "OBJ_Visible_Left_or_Right";
CM_ SG_ 154 OBJ_2W_Is_Motorbike_Probability_5 "The probability of the Two-wheeler reported object being a Motorbike";
CM_ SG_ 154 OBJ_2W_Is_Bicycle_Probability_5 "The probability of the Two-wheeler reported object being a Bicycle";
CM_ SG_ 154 OBJ_CRC_6 "Calculated over all element signals. From the signal after the CRC until the first signal in the next elements OBJ_CRC_N+1  not including";
CM_ SG_ 154 OBJ_ID_6 "The detected object ID. Range is 1-255, while 0 indicates that the field in unfilled.";
CM_ SG_ 154 OBJ_Existence_Probability_6 "The existence probability of the reported object";
CM_ SG_ 154 OBJ_Fusion_Source_6 "sources ids used for fusion";
CM_ SG_ 154 OBJ_Triggered_SDM_6 "Indicates whether the object has trigered the SDM (Safety Diagnostic Manager) alert.";
CM_ SG_ 154 OBJ_Motion_Category_6 "Relevant for VD only. Full description of values can be found at the ACC guide.";
CM_ SG_ 154 OBJ_Moving_IN_Probability_6 "The probability the object is eventually move into ego lane. (In case that the OBJ_Motion_Category signal is set to  MOVING_IN ";
CM_ SG_ 154 OBJ_Object_Age_6 "The number of frames in which the object was recognized.";
CM_ SG_ 154 OBJ_Measuring_Status_6 "Measurment status. Old vs New marks if this is the first frame in which the object is reported. Predicted vs Measured marks if the report is raw or has been predicted forward in time using the measured dynamics and ego motion.";
CM_ SG_ 154 OBJ_Object_Class_6 "Indicates the object type. Uncertain is outputted in case the probability that a vehicle is a truck is very similar to the probability that it is a car.";
CM_ SG_ 154 OBJ_Class_Probability_6 "The probability of this type classification.";
CM_ SG_ 154 OBJ_Car_Probability_6 "The probability the object is a car";
CM_ SG_ 154 OBJ_Truck_Probability_6 "The probability the object is a Truck";
CM_ SG_ 154 OBJ_Bike_Probability_6 "The probability the object is a Bike";
CM_ SG_ 154 OBJ_Camera_Source_6 "The camera in which this object was detected (best choice).";
CM_ SG_ 154 OBJ_Motion_Status_6 "MOVING - the object is moving STATIONARY - the object was never seen moving STOPPED -  the object was moving and has stopped MOVING_SLOWLY - the object is moving very slowly";
CM_ SG_ 154 OBJ_Motion_Orientation_6 "The direction of the targets heading compared to the host. ";
CM_ SG_ 154 OBJ_Has_Cut_Lane_6 "Indicates whether the object cut the host's (right or left) lane. In case there are no lanes, indicates whether the objects is at most 1 meters away from the host.";
CM_ SG_ 154 OBJ_Has_Cut_Path_6 "Indicates whether the object is in the host's path.";
CM_ SG_ 154 OBJ_Brake_Light_Validity_6 "Validator for braking light indicator";
CM_ SG_ 154 OBJ_Brake_Light_6 "Indication for brake lights ";
CM_ SG_ 154 OBJ_Turn_Indicator_Right_6 "Indication for blinking right light.";
CM_ SG_ 154 OBJ_Turn_Indicator_Left_6 "Indication for blinking left light ";
CM_ SG_ 154 OBJ_Turn_Indicator_Validity_6 "Validator for light indicators";
CM_ SG_ 154 OBJ_Right_Out_Of_Image_6 "Indicates whether the measurment are predicted out of the right side of the image bounderies.";
CM_ SG_ 154 OBJ_Left_Out_Of_Image_6 "Indicates whether if measurment are predicted out of  the left side of the image bounderies";
CM_ SG_ 154 OBJ_Right_Out_Of_Image_V_6 "validator";
CM_ SG_ 154 OBJ_Left_Out_Of_Image_V_6 "validator";
CM_ SG_ 154 OBJ_Top_Out_Of_Image_6 "Indicates whether if measurment are predicted out of  the top of the image bounderies";
CM_ SG_ 154 OBJ_Bottom_Out_Of_Image_6 "Indicates whether if measurment are predicted out of  the bottom of the image bounderies";
CM_ SG_ 154 OBJ_Top_Out_Of_Image_V_6 "validator";
CM_ SG_ 154 OBJ_Bottom_Out_Of_Image_V_6 "validator";
CM_ SG_ 154 OBJ_Lane_Assignment_6 "The object's lane relative to the host lane.";
CM_ SG_ 154 OBJ_Lane_Assignment_V_6 "Validator for lane assignment";
CM_ SG_ 154 OBJ_Age_Seconds_6 "Time in seconds in which the object was recognized. ";
CM_ SG_ 154 OBJ_Age_Seconds_V_6 "Validator for object age";
CM_ SG_ 154 OBJ_Width_6 "The width of the target vehicle in the world (not to be mistaken with the width of the visible part of the vehicle).";
CM_ SG_ 154 OBJ_Width_V_6 "Validator for object width";
CM_ SG_ 154 OBJ_Width_STD_6 "Standard deviation for object width";
CM_ SG_ 154 OBJ_Width_STD_V_6 "Validator for the standard deviation of object width";
CM_ SG_ 154 OBJ_Length_6 "The length of the vehicle in the world. For crossing bicycles it gives the viewed length of the bicycle.";
CM_ SG_ 154 OBJ_Length_V_6 "Validator for object length.";
CM_ SG_ 154 OBJ_Length_STD_6 "Standard deviation for object length.";
CM_ SG_ 154 OBJ_Length_STD_V_6 "Validator for the standard deviation of object length.";
CM_ SG_ 154 OBJ_Radar_ID_6 "Radar Object ID of the Fused Object, Only relvant when OBJ_Fusion_Source is not Camera only";
CM_ SG_ 154 OBJ_Height_6 "The height of the object in the world. ";
CM_ SG_ 154 OBJ_Height_V_6 "Validator for object height.";
CM_ SG_ 154 OBJ_Height_STD_6 "Standard deviation for object height.";
CM_ SG_ 154 OBJ_Height_STD_V_6 "Validator for the standard deviation of object height.";
CM_ SG_ 154 OBJ_Abs_Long_Velocity_6 "Absolute longitudinal velocity.";
CM_ SG_ 154 OBJ_Abs_Long_Velocity_V_6 "Validator for absolute longitudinal velocity.";
CM_ SG_ 154 OBJ_Abs_Long_Velocity_STD_6 "Standard deviation of absolute longitudinal velocity.";
CM_ SG_ 154 OBJ_Abs_Long_Vel_STD_V_6 "Validator for the standard deviation of the absolute longitudinal velocity.";
CM_ SG_ 154 OBJ_Abs_Lat_Velocity_6 "The lateral ground speed of the object.";
CM_ SG_ 154 OBJ_Abs_Lat_Velocity_V_6 "Validator for the lateral ground speed of the object.";
CM_ SG_ 154 OBJ_Abs_Lat_Velocity_STD_6 "STD of the lateral ground speed of the object.";
CM_ SG_ 154 OBJ_Abs_Lat_Vel_STD_V_6 "Validator for the STD of the lateral ground speed of the object.";
CM_ SG_ 154 OBJ_Abs_Long_Acc_6 "The longitudinal ground acceleration of the object.";
CM_ SG_ 154 OBJ_Abs_Long_Acc_V_6 "Validator for the longitudinal ground acceleration of the object.";
CM_ SG_ 154 OBJ_Abs_Long_Acc_STD_6 "STD of the longitudinal ground acceleration of the object.";
CM_ SG_ 154 OBJ_Abs_Long_Acc_STD_V_6 "Validator for the STD of the longitudinal ground acceleration of the object.";
CM_ SG_ 154 OBJ_Abs_Lat_Acc_6 "The lateral ground acceleration of the object.";
CM_ SG_ 154 OBJ_Abs_Lat_Acc_V_6 "Validator for the lateral ground acceleration of the object.";
CM_ SG_ 154 OBJ_Abs_Lat_Acc_STD_6 "STD of the lateral ground acceleration of the object.";
CM_ SG_ 154 OBJ_Abs_Lat_Acc_STD_V_6 "Validator for the STD of the lateral ground acceleration of the object.";
CM_ SG_ 154 OBJ_Abs_Acceleration_6 "The absolute ground acceleration in the target's heading direction.";
CM_ SG_ 154 OBJ_Abs_Acceleration_V_6 "Validator for the absolute ground acceleration.";
CM_ SG_ 154 OBJ_Abs_Acc_STD_6 "STD of the absolute ground acceleration.";
CM_ SG_ 154 OBJ_Abs_Acc_STD_V_6 "Validator for the STD of the absolute ground acceleration.";
CM_ SG_ 154 OBJ_Inv_TTC_6 "Inverse TTC (time to collision).";
CM_ SG_ 154 OBJ_Inv_TTC_STD_6 "STD for inverse TTC .";
CM_ SG_ 154 OBJ_Inv_TTC_STD_V_6 "Validator for the STD for inverse TTC .";
CM_ SG_ 154 OBJ_Relative_Long_Acc_6 "The relative longitudinal ground acceleration of the object.";
CM_ SG_ 154 OBJ_Relative_Long_Acc_V_6 "Validator for the relative longitudinal ground acceleration of the object.";
CM_ SG_ 154 OBJ_Relative_Long_Acc_STD_6 "STD of the relative longitudinal ground acceleration of the object.";
CM_ SG_ 154 OBJ_Rel_Long_Acc_STD_V_6 "Validator for the STD of the relative longitudinal ground acceleration.";
CM_ SG_ 154 OBJ_Relative_Long_Velocity_6 "The relative longtitudinal speed between the target and ego vehicle. ";
CM_ SG_ 154 OBJ_Relative_Long_Velocity_V_6 "Validator for the relative longtitudinal speed.";
CM_ SG_ 154 OBJ_Relative_Long_Vel_STD_6 "STD of the relative longtitudinal speed.";
CM_ SG_ 154 OBJ_Rel_Long_Vel_STD_V_6 "Validator for the STD of the relative longtitudinal speed.";
CM_ SG_ 154 OBJ_Relative_Lat_Velocity_6 "The relative lateral speed between the target and ego vehicle. ";
CM_ SG_ 154 OBJ_Relative_Lat_Velocity_V_6 "Validator for the relative lateral speed. ";
CM_ SG_ 154 OBJ_Relative_Lat_Velocity_STD_6 "STD of the relative lateral speed. ";
CM_ SG_ 154 OBJ_Rel_Lat_Vel_STD_V_6 "Validator for the STD of the relative lateral speed. ";
CM_ SG_ 154 OBJ_Long_Distance_6 "The longitudinal distance to middle of the rear bumper (middle of the RL and RR corners) of the target.";
CM_ SG_ 154 OBJ_Long_Distance_V_6 "Validator of the longtitudinal distance field";
CM_ SG_ 154 OBJ_Long_Distance_STD_6 "STD of the  longtitudinal distance.";
CM_ SG_ 154 OBJ_Long_Distance_STD_V_6 "Validator for the STD of the  longtitudinal distance.";
CM_ SG_ 154 OBJ_Lat_Distance_6 "Lateral distance to the middle of the RL and RR corners.  ";
CM_ SG_ 154 OBJ_Lat_Distance_V_6 "Validator for the lateral distance of the object.";
CM_ SG_ 154 OBJ_Lat_Distance_STD_6 "STD of the lateral distance of the object.";
CM_ SG_ 154 OBJ_Lat_Distance_STD_V_6 "Validator for the STD of the lateral distance of the object.";
CM_ SG_ 154 OBJ_Absolute_Speed_6 "The absolute ground speed in the targets' heading direction.";
CM_ SG_ 154 OBJ_Absolute_Speed_V_6 "Validator for the absolute ground speed.";
CM_ SG_ 154 OBJ_Absolute_Speed_STD_6 "STD of the absolute ground speed.";
CM_ SG_ 154 OBJ_Absolute_Speed_STD_V_6 "Validator for the STD of the absolute ground speed.";
CM_ SG_ 154 OBJ_Heading_6 "The angle beetweenthe host longitudinal axis and target's heading (clockwise, e.g. PI/2 is a target crossing from left to right).";
CM_ SG_ 154 OBJ_Heading_V_6 "Validator for the object heading.";
CM_ SG_ 154 OBJ_Heading_STD_6 "STD of the object heading.";
CM_ SG_ 154 OBJ_Heading_STD_V_6 "Validator for the STD of the object heading.";
CM_ SG_ 154 OBJ_Angle_Rate_STD_6 "Standard deviation of the angular speed. (radians)";
CM_ SG_ 154 OBJ_Angle_Rate_STD_V_6 "Validator for the STD of the angular speed.";
CM_ SG_ 154 OBJ_Angle_Rate_6 "The momentary angular speed of the object (radians). The positive side is to the host's right.";
CM_ SG_ 154 OBJ_Angle_Rate_V_6 "Validator for the angular speed.";
CM_ SG_ 154 OBJ_Angle_Right_6 "The angle between the host longitudinal axis and the right side of the front / rear of the target (the visible one). The positive side is to the host's right.";
CM_ SG_ 154 OBJ_Angle_Right_V_6 "Validator for angleRight";
CM_ SG_ 154 OBJ_Angle_Right_STD_6 "Standard deviation of angleRight";
CM_ SG_ 154 OBJ_Angle_Right_STD_V_6 "Validator for the standard deviation of angleRight.";
CM_ SG_ 154 OBJ_Angle_Left_6 "The angle between the host longitudinal axis and the left side of the front / rear of the target (the visible one). The positive side is to the host's right.";
CM_ SG_ 154 OBJ_Angle_Left_V_6 "Validator for angleLeft.";
CM_ SG_ 154 OBJ_Angle_Left_STD_6 "Standard deviation of angleLeft.";
CM_ SG_ 154 OBJ_Angle_Left_STD_V_6 "Validator for the standard deviation of angleLeft.";
CM_ SG_ 154 OBJ_Angle_Side_6 "The angle between the host longitudinal axis and the far visible edge - the visible edge of the front / rear of the target that is not visible. Currently supported for vehicles only.";
CM_ SG_ 154 OBJ_Angle_Side_V_6 "Validator for angleSide.";
CM_ SG_ 154 OBJ_Angle_Side_STD_6 "Standard deviation of angleSide.";
CM_ SG_ 154 OBJ_Angle_Side_STD_V_6 "Validator for the STD of angleSide.";
CM_ SG_ 154 OBJ_Angle_Mid_V_6 "Validator for angleMid.";
CM_ SG_ 154 OBJ_Angle_Mid_6 "The angle between the host longitudinal axis and the middle of the front / rear of the target (the visible one). The positive side is to the host's right.";
CM_ SG_ 154 OBJ_Angle_Mid_STD_6 "Standard deviation of angleMid.";
CM_ SG_ 154 OBJ_Angle_Mid_STD_V_6 "Validator for the STD of angleMid.";
CM_ SG_ 154 OBJ_Angle_Bottom_V_6 "Validator for OBJAngle_Bottom. ";
CM_ SG_ 154 OBJ_Angle_Bottom_6 "The angle between the longitudinal axis and the Bottom of the front / rear of the target (the visible one). The positive side is to the host's bottom";
CM_ SG_ 154 OBJ_Angle_Bottom_STD_6 "STD for OBJAngle_Bottom. ";
CM_ SG_ 154 OBJ_Angle_Bottom_STD_V_6 "Validator for OBJAngle_Bottom_STD. ";
CM_ SG_ 154 OBJ_Visibility_Side_V_6 "Currently Supported for VD only";
CM_ SG_ 154 OBJ_Visibility_Side_6 "From what car  side is the object visible";
CM_ SG_ 154 OBJ_Is_In_Drivable_Area_6 "Indicates whether the target is in a driveable area.";
CM_ SG_ 154 OBJ_Is_In_Drivable_Area_V_6 "Validator for OBJ_Is_In_Drivable_Area.";
CM_ SG_ 154 OBJ_Is_VeryClose_V_6 "Validator for OBJ_Is_VeryClose. ";
CM_ SG_ 154 OBJ_Is_VeryClose_6 "Indicates whether the target is very close to the host such that it is hard to measure its distance. Currently relevant for peds only";
CM_ SG_ 154 OBJ_OverlapAngleEgoLaneR_6 "Lateral distance to the middle of the RL and RR corners.";
CM_ SG_ 154 OBJ_OverlapAngleEgoLaneR_V_6 "Validator for OBJ_OverlapAngleEgoLaneR";
CM_ SG_ 154 OBJ_OverlapAngleEgoLaneL_6 "Lateral distance to the middle of the RL and RR corners.  ";
CM_ SG_ 154 OBJ_OverlapAngleEgoLaneL_V_6 "Validator for OBJ_OverlapAngleEgoLaneL";
CM_ SG_ 154 OBJ_Is_EMERGENCY_VCL_6 "Is Object an Emergency Vehicle";
CM_ SG_ 154 OBJ_EMERGENCY_LIGHT_COLOR_6 "Emergency Color";
CM_ SG_ 154 OBJ_EMERGENCY_V_6 "Are OBJ_Is_EMERGENCY_VCL and OBJ_EMERGENCY_LIGHT_COLOR Valid";
CM_ SG_ 154 OBJ_Angle_Top_6 "From VD touching point on the ground till the roof of the car";
CM_ SG_ 154 OBJ_Angle_Top_V_6 "Validator for OBJ_Angle_Top ";
CM_ SG_ 154 OBJ_Angle_Top_STD_6 "STD for OBJ_Angle_Top";
CM_ SG_ 154 OBJ_Angle_Top_STD_V_6 "Validator for OBJ_Angle_Top_STD. ";
CM_ SG_ 154 OBJ_Open_Door_Left_6 "Indicator if left door is open";
CM_ SG_ 154 OBJ_Open_Door_Right_6 "Indicator if right door is open";
CM_ SG_ 154 OBJ_Visible_Left_or_Right_6 "This signal describes the visible Left or Right side of the Target vehicle.";
CM_ SG_ 154 OBJ_Visible_Left_or_Right_V_6 "OBJ_Visible_Left_or_Right";
CM_ SG_ 154 OBJ_2W_Is_Motorbike_Probability_6 "The probability of the Two-wheeler reported object being a Motorbike";
CM_ SG_ 154 OBJ_2W_Is_Bicycle_Probability_6 "The probability of the Two-wheeler reported object being a Bicycle";
CM_ SG_ 154 OBJ_CRC_7 "Calculated over all element signals. From the signal after the CRC until the first signal in the next elements OBJ_CRC_N+1  not including";
CM_ SG_ 154 OBJ_ID_7 "The detected object ID. Range is 1-255, while 0 indicates that the field in unfilled.";
CM_ SG_ 154 OBJ_Existence_Probability_7 "The existence probability of the reported object";
CM_ SG_ 154 OBJ_Fusion_Source_7 "sources ids used for fusion";
CM_ SG_ 154 OBJ_Triggered_SDM_7 "Indicates whether the object has trigered the SDM (Safety Diagnostic Manager) alert.";
CM_ SG_ 154 OBJ_Motion_Category_7 "Relevant for VD only. Full description of values can be found at the ACC guide.";
CM_ SG_ 154 OBJ_Moving_IN_Probability_7 "The probability the object is eventually move into ego lane. (In case that the OBJ_Motion_Category signal is set to  MOVING_IN ";
CM_ SG_ 154 OBJ_Object_Age_7 "The number of frames in which the object was recognized.";
CM_ SG_ 154 OBJ_Measuring_Status_7 "Measurment status. Old vs New marks if this is the first frame in which the object is reported. Predicted vs Measured marks if the report is raw or has been predicted forward in time using the measured dynamics and ego motion.";
CM_ SG_ 154 OBJ_Object_Class_7 "Indicates the object type. Uncertain is outputted in case the probability that a vehicle is a truck is very similar to the probability that it is a car.";
CM_ SG_ 154 OBJ_Class_Probability_7 "The probability of this type classification.";
CM_ SG_ 154 OBJ_Car_Probability_7 "The probability the object is a car";
CM_ SG_ 154 OBJ_Truck_Probability_7 "The probability the object is a Truck";
CM_ SG_ 154 OBJ_Bike_Probability_7 "The probability the object is a Bike";
CM_ SG_ 154 OBJ_Camera_Source_7 "The camera in which this object was detected (best choice).";
CM_ SG_ 154 OBJ_Motion_Status_7 "MOVING - the object is moving STATIONARY - the object was never seen moving STOPPED -  the object was moving and has stopped MOVING_SLOWLY - the object is moving very slowly";
CM_ SG_ 154 OBJ_Motion_Orientation_7 "The direction of the targets heading compared to the host. ";
CM_ SG_ 154 OBJ_Has_Cut_Lane_7 "Indicates whether the object cut the host's (right or left) lane. In case there are no lanes, indicates whether the objects is at most 1 meters away from the host.";
CM_ SG_ 154 OBJ_Has_Cut_Path_7 "Indicates whether the object is in the host's path.";
CM_ SG_ 154 OBJ_Brake_Light_Validity_7 "Validator for braking light indicator";
CM_ SG_ 154 OBJ_Brake_Light_7 "Indication for brake lights ";
CM_ SG_ 154 OBJ_Turn_Indicator_Right_7 "Indication for blinking right light.";
CM_ SG_ 154 OBJ_Turn_Indicator_Left_7 "Indication for blinking left light ";
CM_ SG_ 154 OBJ_Turn_Indicator_Validity_7 "Validator for light indicators";
CM_ SG_ 154 OBJ_Right_Out_Of_Image_7 "Indicates whether the measurment are predicted out of the right side of the image bounderies.";
CM_ SG_ 154 OBJ_Left_Out_Of_Image_7 "Indicates whether if measurment are predicted out of  the left side of the image bounderies";
CM_ SG_ 154 OBJ_Right_Out_Of_Image_V_7 "validator";
CM_ SG_ 154 OBJ_Left_Out_Of_Image_V_7 "validator";
CM_ SG_ 154 OBJ_Top_Out_Of_Image_7 "Indicates whether if measurment are predicted out of  the top of the image bounderies";
CM_ SG_ 154 OBJ_Bottom_Out_Of_Image_7 "Indicates whether if measurment are predicted out of  the bottom of the image bounderies";
CM_ SG_ 154 OBJ_Top_Out_Of_Image_V_7 "validator";
CM_ SG_ 154 OBJ_Bottom_Out_Of_Image_V_7 "validator";
CM_ SG_ 154 OBJ_Lane_Assignment_7 "The object's lane relative to the host lane.";
CM_ SG_ 154 OBJ_Lane_Assignment_V_7 "Validator for lane assignment";
CM_ SG_ 154 OBJ_Age_Seconds_7 "Time in seconds in which the object was recognized. ";
CM_ SG_ 154 OBJ_Age_Seconds_V_7 "Validator for object age";
CM_ SG_ 154 OBJ_Width_7 "The width of the target vehicle in the world (not to be mistaken with the width of the visible part of the vehicle).";
CM_ SG_ 154 OBJ_Width_V_7 "Validator for object width";
CM_ SG_ 154 OBJ_Width_STD_7 "Standard deviation for object width";
CM_ SG_ 154 OBJ_Width_STD_V_7 "Validator for the standard deviation of object width";
CM_ SG_ 154 OBJ_Length_7 "The length of the vehicle in the world. For crossing bicycles it gives the viewed length of the bicycle.";
CM_ SG_ 154 OBJ_Length_V_7 "Validator for object length.";
CM_ SG_ 154 OBJ_Length_STD_7 "Standard deviation for object length.";
CM_ SG_ 154 OBJ_Length_STD_V_7 "Validator for the standard deviation of object length.";
CM_ SG_ 154 OBJ_Radar_ID_7 "Radar Object ID of the Fused Object, Only relvant when OBJ_Fusion_Source is not Camera only";
CM_ SG_ 154 OBJ_Height_7 "The height of the object in the world. ";
CM_ SG_ 154 OBJ_Height_V_7 "Validator for object height.";
CM_ SG_ 154 OBJ_Height_STD_7 "Standard deviation for object height.";
CM_ SG_ 154 OBJ_Height_STD_V_7 "Validator for the standard deviation of object height.";
CM_ SG_ 154 OBJ_Abs_Long_Velocity_7 "Absolute longitudinal velocity.";
CM_ SG_ 154 OBJ_Abs_Long_Velocity_V_7 "Validator for absolute longitudinal velocity.";
CM_ SG_ 154 OBJ_Abs_Long_Velocity_STD_7 "Standard deviation of absolute longitudinal velocity.";
CM_ SG_ 154 OBJ_Abs_Long_Vel_STD_V_7 "Validator for the standard deviation of the absolute longitudinal velocity.";
CM_ SG_ 154 OBJ_Abs_Lat_Velocity_7 "The lateral ground speed of the object.";
CM_ SG_ 154 OBJ_Abs_Lat_Velocity_V_7 "Validator for the lateral ground speed of the object.";
CM_ SG_ 154 OBJ_Abs_Lat_Velocity_STD_7 "STD of the lateral ground speed of the object.";
CM_ SG_ 154 OBJ_Abs_Lat_Vel_STD_V_7 "Validator for the STD of the lateral ground speed of the object.";
CM_ SG_ 154 OBJ_Abs_Long_Acc_7 "The longitudinal ground acceleration of the object.";
CM_ SG_ 154 OBJ_Abs_Long_Acc_V_7 "Validator for the longitudinal ground acceleration of the object.";
CM_ SG_ 154 OBJ_Abs_Long_Acc_STD_7 "STD of the longitudinal ground acceleration of the object.";
CM_ SG_ 154 OBJ_Abs_Long_Acc_STD_V_7 "Validator for the STD of the longitudinal ground acceleration of the object.";
CM_ SG_ 154 OBJ_Abs_Lat_Acc_7 "The lateral ground acceleration of the object.";
CM_ SG_ 154 OBJ_Abs_Lat_Acc_V_7 "Validator for the lateral ground acceleration of the object.";
CM_ SG_ 154 OBJ_Abs_Lat_Acc_STD_7 "STD of the lateral ground acceleration of the object.";
CM_ SG_ 154 OBJ_Abs_Lat_Acc_STD_V_7 "Validator for the STD of the lateral ground acceleration of the object.";
CM_ SG_ 154 OBJ_Abs_Acceleration_7 "The absolute ground acceleration in the target's heading direction.";
CM_ SG_ 154 OBJ_Abs_Acceleration_V_7 "Validator for the absolute ground acceleration.";
CM_ SG_ 154 OBJ_Abs_Acc_STD_7 "STD of the absolute ground acceleration.";
CM_ SG_ 154 OBJ_Abs_Acc_STD_V_7 "Validator for the STD of the absolute ground acceleration.";
CM_ SG_ 154 OBJ_Inv_TTC_7 "Inverse TTC (time to collision).";
CM_ SG_ 154 OBJ_Inv_TTC_STD_7 "STD for inverse TTC .";
CM_ SG_ 154 OBJ_Inv_TTC_STD_V_7 "Validator for the STD for inverse TTC .";
CM_ SG_ 154 OBJ_Relative_Long_Acc_7 "The relative longitudinal ground acceleration of the object.";
CM_ SG_ 154 OBJ_Relative_Long_Acc_V_7 "Validator for the relative longitudinal ground acceleration of the object.";
CM_ SG_ 154 OBJ_Relative_Long_Acc_STD_7 "STD of the relative longitudinal ground acceleration of the object.";
CM_ SG_ 154 OBJ_Rel_Long_Acc_STD_V_7 "Validator for the STD of the relative longitudinal ground acceleration.";
CM_ SG_ 154 OBJ_Relative_Long_Velocity_7 "The relative longtitudinal speed between the target and ego vehicle. ";
CM_ SG_ 154 OBJ_Relative_Long_Velocity_V_7 "Validator for the relative longtitudinal speed.";
CM_ SG_ 154 OBJ_Relative_Long_Vel_STD_7 "STD of the relative longtitudinal speed.";
CM_ SG_ 154 OBJ_Rel_Long_Vel_STD_V_7 "Validator for the STD of the relative longtitudinal speed.";
CM_ SG_ 154 OBJ_Relative_Lat_Velocity_7 "The relative lateral speed between the target and ego vehicle. ";
CM_ SG_ 154 OBJ_Relative_Lat_Velocity_V_7 "Validator for the relative lateral speed. ";
CM_ SG_ 154 OBJ_Relative_Lat_Velocity_STD_7 "STD of the relative lateral speed. ";
CM_ SG_ 154 OBJ_Rel_Lat_Vel_STD_V_7 "Validator for the STD of the relative lateral speed. ";
CM_ SG_ 154 OBJ_Long_Distance_7 "The longitudinal distance to middle of the rear bumper (middle of the RL and RR corners) of the target.";
CM_ SG_ 154 OBJ_Long_Distance_V_7 "Validator of the longtitudinal distance field";
CM_ SG_ 154 OBJ_Long_Distance_STD_7 "STD of the  longtitudinal distance.";
CM_ SG_ 154 OBJ_Long_Distance_STD_V_7 "Validator for the STD of the  longtitudinal distance.";
CM_ SG_ 154 OBJ_Lat_Distance_7 "Lateral distance to the middle of the RL and RR corners.  ";
CM_ SG_ 154 OBJ_Lat_Distance_V_7 "Validator for the lateral distance of the object.";
CM_ SG_ 154 OBJ_Lat_Distance_STD_7 "STD of the lateral distance of the object.";
CM_ SG_ 154 OBJ_Lat_Distance_STD_V_7 "Validator for the STD of the lateral distance of the object.";
CM_ SG_ 154 OBJ_Absolute_Speed_7 "The absolute ground speed in the targets' heading direction.";
CM_ SG_ 154 OBJ_Absolute_Speed_V_7 "Validator for the absolute ground speed.";
CM_ SG_ 154 OBJ_Absolute_Speed_STD_7 "STD of the absolute ground speed.";
CM_ SG_ 154 OBJ_Absolute_Speed_STD_V_7 "Validator for the STD of the absolute ground speed.";
CM_ SG_ 154 OBJ_Heading_7 "The angle beetweenthe host longitudinal axis and target's heading (clockwise, e.g. PI/2 is a target crossing from left to right).";
CM_ SG_ 154 OBJ_Heading_V_7 "Validator for the object heading.";
CM_ SG_ 154 OBJ_Heading_STD_7 "STD of the object heading.";
CM_ SG_ 154 OBJ_Heading_STD_V_7 "Validator for the STD of the object heading.";
CM_ SG_ 154 OBJ_Angle_Rate_STD_7 "Standard deviation of the angular speed. (radians)";
CM_ SG_ 154 OBJ_Angle_Rate_STD_V_7 "Validator for the STD of the angular speed.";
CM_ SG_ 154 OBJ_Angle_Rate_7 "The momentary angular speed of the object (radians). The positive side is to the host's right.";
CM_ SG_ 154 OBJ_Angle_Rate_V_7 "Validator for the angular speed.";
CM_ SG_ 154 OBJ_Angle_Right_7 "The angle between the host longitudinal axis and the right side of the front / rear of the target (the visible one). The positive side is to the host's right.";
CM_ SG_ 154 OBJ_Angle_Right_V_7 "Validator for angleRight";
CM_ SG_ 154 OBJ_Angle_Right_STD_7 "Standard deviation of angleRight";
CM_ SG_ 154 OBJ_Angle_Right_STD_V_7 "Validator for the standard deviation of angleRight.";
CM_ SG_ 154 OBJ_Angle_Left_7 "The angle between the host longitudinal axis and the left side of the front / rear of the target (the visible one). The positive side is to the host's right.";
CM_ SG_ 154 OBJ_Angle_Left_V_7 "Validator for angleLeft.";
CM_ SG_ 154 OBJ_Angle_Left_STD_7 "Standard deviation of angleLeft.";
CM_ SG_ 154 OBJ_Angle_Left_STD_V_7 "Validator for the standard deviation of angleLeft.";
CM_ SG_ 154 OBJ_Angle_Side_7 "The angle between the host longitudinal axis and the far visible edge - the visible edge of the front / rear of the target that is not visible. Currently supported for vehicles only.";
CM_ SG_ 154 OBJ_Angle_Side_V_7 "Validator for angleSide.";
CM_ SG_ 154 OBJ_Angle_Side_STD_7 "Standard deviation of angleSide.";
CM_ SG_ 154 OBJ_Angle_Side_STD_V_7 "Validator for the STD of angleSide.";
CM_ SG_ 154 OBJ_Angle_Mid_V_7 "Validator for angleMid.";
CM_ SG_ 154 OBJ_Angle_Mid_7 "The angle between the host longitudinal axis and the middle of the front / rear of the target (the visible one). The positive side is to the host's right.";
CM_ SG_ 154 OBJ_Angle_Mid_STD_7 "Standard deviation of angleMid.";
CM_ SG_ 154 OBJ_Angle_Mid_STD_V_7 "Validator for the STD of angleMid.";
CM_ SG_ 154 OBJ_Angle_Bottom_V_7 "Validator for OBJAngle_Bottom. ";
CM_ SG_ 154 OBJ_Angle_Bottom_7 "The angle between the longitudinal axis and the Bottom of the front / rear of the target (the visible one). The positive side is to the host's bottom";
CM_ SG_ 154 OBJ_Angle_Bottom_STD_7 "STD for OBJAngle_Bottom. ";
CM_ SG_ 154 OBJ_Angle_Bottom_STD_V_7 "Validator for OBJAngle_Bottom_STD. ";
CM_ SG_ 154 OBJ_Visibility_Side_V_7 "Currently Supported for VD only";
CM_ SG_ 154 OBJ_Visibility_Side_7 "From what car  side is the object visible";
CM_ SG_ 154 OBJ_Is_In_Drivable_Area_7 "Indicates whether the target is in a driveable area.";
CM_ SG_ 154 OBJ_Is_In_Drivable_Area_V_7 "Validator for OBJ_Is_In_Drivable_Area.";
CM_ SG_ 154 OBJ_Is_VeryClose_V_7 "Validator for OBJ_Is_VeryClose. ";
CM_ SG_ 154 OBJ_Is_VeryClose_7 "Indicates whether the target is very close to the host such that it is hard to measure its distance. Currently relevant for peds only";
CM_ SG_ 154 OBJ_OverlapAngleEgoLaneR_7 "Lateral distance to the middle of the RL and RR corners.";
CM_ SG_ 154 OBJ_OverlapAngleEgoLaneR_V_7 "Validator for OBJ_OverlapAngleEgoLaneR";
CM_ SG_ 154 OBJ_OverlapAngleEgoLaneL_7 "Lateral distance to the middle of the RL and RR corners.  ";
CM_ SG_ 154 OBJ_OverlapAngleEgoLaneL_V_7 "Validator for OBJ_OverlapAngleEgoLaneL";
CM_ SG_ 154 OBJ_Is_EMERGENCY_VCL_7 "Is Object an Emergency Vehicle";
CM_ SG_ 154 OBJ_EMERGENCY_LIGHT_COLOR_7 "Emergency Color";
CM_ SG_ 154 OBJ_EMERGENCY_V_7 "Are OBJ_Is_EMERGENCY_VCL and OBJ_EMERGENCY_LIGHT_COLOR Valid";
CM_ SG_ 154 OBJ_Angle_Top_7 "From VD touching point on the ground till the roof of the car";
CM_ SG_ 154 OBJ_Angle_Top_V_7 "Validator for OBJ_Angle_Top ";
CM_ SG_ 154 OBJ_Angle_Top_STD_7 "STD for OBJ_Angle_Top";
CM_ SG_ 154 OBJ_Angle_Top_STD_V_7 "Validator for OBJ_Angle_Top_STD. ";
CM_ SG_ 154 OBJ_Open_Door_Left_7 "Indicator if left door is open";
CM_ SG_ 154 OBJ_Open_Door_Right_7 "Indicator if right door is open";
CM_ SG_ 154 OBJ_Visible_Left_or_Right_7 "This signal describes the visible Left or Right side of the Target vehicle.";
CM_ SG_ 154 OBJ_Visible_Left_or_Right_V_7 "OBJ_Visible_Left_or_Right";
CM_ SG_ 154 OBJ_2W_Is_Motorbike_Probability_7 "The probability of the Two-wheeler reported object being a Motorbike";
CM_ SG_ 154 OBJ_2W_Is_Bicycle_Probability_7 "The probability of the Two-wheeler reported object being a Bicycle";
CM_ SG_ 154 OBJ_CRC_8 "Calculated over all element signals. From the signal after the CRC until the first signal in the next elements OBJ_CRC_N+1  not including";
CM_ SG_ 154 OBJ_ID_8 "The detected object ID. Range is 1-255, while 0 indicates that the field in unfilled.";
CM_ SG_ 154 OBJ_Existence_Probability_8 "The existence probability of the reported object";
CM_ SG_ 154 OBJ_Fusion_Source_8 "sources ids used for fusion";
CM_ SG_ 154 OBJ_Triggered_SDM_8 "Indicates whether the object has trigered the SDM (Safety Diagnostic Manager) alert.";
CM_ SG_ 154 OBJ_Motion_Category_8 "Relevant for VD only. Full description of values can be found at the ACC guide.";
CM_ SG_ 154 OBJ_Moving_IN_Probability_8 "The probability the object is eventually move into ego lane. (In case that the OBJ_Motion_Category signal is set to  MOVING_IN ";
CM_ SG_ 154 OBJ_Object_Age_8 "The number of frames in which the object was recognized.";
CM_ SG_ 154 OBJ_Measuring_Status_8 "Measurment status. Old vs New marks if this is the first frame in which the object is reported. Predicted vs Measured marks if the report is raw or has been predicted forward in time using the measured dynamics and ego motion.";
CM_ SG_ 154 OBJ_Object_Class_8 "Indicates the object type. Uncertain is outputted in case the probability that a vehicle is a truck is very similar to the probability that it is a car.";
CM_ SG_ 154 OBJ_Class_Probability_8 "The probability of this type classification.";
CM_ SG_ 154 OBJ_Car_Probability_8 "The probability the object is a car";
CM_ SG_ 154 OBJ_Truck_Probability_8 "The probability the object is a Truck";
CM_ SG_ 154 OBJ_Bike_Probability_8 "The probability the object is a Bike";
CM_ SG_ 154 OBJ_Camera_Source_8 "The camera in which this object was detected (best choice).";
CM_ SG_ 154 OBJ_Motion_Status_8 "MOVING - the object is moving STATIONARY - the object was never seen moving STOPPED -  the object was moving and has stopped MOVING_SLOWLY - the object is moving very slowly";
CM_ SG_ 154 OBJ_Motion_Orientation_8 "The direction of the targets heading compared to the host. ";
CM_ SG_ 154 OBJ_Has_Cut_Lane_8 "Indicates whether the object cut the host's (right or left) lane. In case there are no lanes, indicates whether the objects is at most 1 meters away from the host.";
CM_ SG_ 154 OBJ_Has_Cut_Path_8 "Indicates whether the object is in the host's path.";
CM_ SG_ 154 OBJ_Brake_Light_Validity_8 "Validator for braking light indicator";
CM_ SG_ 154 OBJ_Brake_Light_8 "Indication for brake lights ";
CM_ SG_ 154 OBJ_Turn_Indicator_Right_8 "Indication for blinking right light.";
CM_ SG_ 154 OBJ_Turn_Indicator_Left_8 "Indication for blinking left light ";
CM_ SG_ 154 OBJ_Turn_Indicator_Validity_8 "Validator for light indicators";
CM_ SG_ 154 OBJ_Right_Out_Of_Image_8 "Indicates whether the measurment are predicted out of the right side of the image bounderies.";
CM_ SG_ 154 OBJ_Left_Out_Of_Image_8 "Indicates whether if measurment are predicted out of  the left side of the image bounderies";
CM_ SG_ 154 OBJ_Right_Out_Of_Image_V_8 "validator";
CM_ SG_ 154 OBJ_Left_Out_Of_Image_V_8 "validator";
CM_ SG_ 154 OBJ_Top_Out_Of_Image_8 "Indicates whether if measurment are predicted out of  the top of the image bounderies";
CM_ SG_ 154 OBJ_Bottom_Out_Of_Image_8 "Indicates whether if measurment are predicted out of  the bottom of the image bounderies";
CM_ SG_ 154 OBJ_Top_Out_Of_Image_V_8 "validator";
CM_ SG_ 154 OBJ_Bottom_Out_Of_Image_V_8 "validator";
CM_ SG_ 154 OBJ_Lane_Assignment_8 "The object's lane relative to the host lane.";
CM_ SG_ 154 OBJ_Lane_Assignment_V_8 "Validator for lane assignment";
CM_ SG_ 154 OBJ_Age_Seconds_8 "Time in seconds in which the object was recognized. ";
CM_ SG_ 154 OBJ_Age_Seconds_V_8 "Validator for object age";
CM_ SG_ 154 OBJ_Width_8 "The width of the target vehicle in the world (not to be mistaken with the width of the visible part of the vehicle).";
CM_ SG_ 154 OBJ_Width_V_8 "Validator for object width";
CM_ SG_ 154 OBJ_Width_STD_8 "Standard deviation for object width";
CM_ SG_ 154 OBJ_Width_STD_V_8 "Validator for the standard deviation of object width";
CM_ SG_ 154 OBJ_Length_8 "The length of the vehicle in the world. For crossing bicycles it gives the viewed length of the bicycle.";
CM_ SG_ 154 OBJ_Length_V_8 "Validator for object length.";
CM_ SG_ 154 OBJ_Length_STD_8 "Standard deviation for object length.";
CM_ SG_ 154 OBJ_Length_STD_V_8 "Validator for the standard deviation of object length.";
CM_ SG_ 154 OBJ_Radar_ID_8 "Radar Object ID of the Fused Object, Only relvant when OBJ_Fusion_Source is not Camera only";
CM_ SG_ 154 OBJ_Height_8 "The height of the object in the world. ";
CM_ SG_ 154 OBJ_Height_V_8 "Validator for object height.";
CM_ SG_ 154 OBJ_Height_STD_8 "Standard deviation for object height.";
CM_ SG_ 154 OBJ_Height_STD_V_8 "Validator for the standard deviation of object height.";
CM_ SG_ 154 OBJ_Abs_Long_Velocity_8 "Absolute longitudinal velocity.";
CM_ SG_ 154 OBJ_Abs_Long_Velocity_V_8 "Validator for absolute longitudinal velocity.";
CM_ SG_ 154 OBJ_Abs_Long_Velocity_STD_8 "Standard deviation of absolute longitudinal velocity.";
CM_ SG_ 154 OBJ_Abs_Long_Vel_STD_V_8 "Validator for the standard deviation of the absolute longitudinal velocity.";
CM_ SG_ 154 OBJ_Abs_Lat_Velocity_8 "The lateral ground speed of the object.";
CM_ SG_ 154 OBJ_Abs_Lat_Velocity_V_8 "Validator for the lateral ground speed of the object.";
CM_ SG_ 154 OBJ_Abs_Lat_Velocity_STD_8 "STD of the lateral ground speed of the object.";
CM_ SG_ 154 OBJ_Abs_Lat_Vel_STD_V_8 "Validator for the STD of the lateral ground speed of the object.";
CM_ SG_ 154 OBJ_Abs_Long_Acc_8 "The longitudinal ground acceleration of the object.";
CM_ SG_ 154 OBJ_Abs_Long_Acc_V_8 "Validator for the longitudinal ground acceleration of the object.";
CM_ SG_ 154 OBJ_Abs_Long_Acc_STD_8 "STD of the longitudinal ground acceleration of the object.";
CM_ SG_ 154 OBJ_Abs_Long_Acc_STD_V_8 "Validator for the STD of the longitudinal ground acceleration of the object.";
CM_ SG_ 154 OBJ_Abs_Lat_Acc_8 "The lateral ground acceleration of the object.";
CM_ SG_ 154 OBJ_Abs_Lat_Acc_V_8 "Validator for the lateral ground acceleration of the object.";
CM_ SG_ 154 OBJ_Abs_Lat_Acc_STD_8 "STD of the lateral ground acceleration of the object.";
CM_ SG_ 154 OBJ_Abs_Lat_Acc_STD_V_8 "Validator for the STD of the lateral ground acceleration of the object.";
CM_ SG_ 154 OBJ_Abs_Acceleration_8 "The absolute ground acceleration in the target's heading direction.";
CM_ SG_ 154 OBJ_Abs_Acceleration_V_8 "Validator for the absolute ground acceleration.";
CM_ SG_ 154 OBJ_Abs_Acc_STD_8 "STD of the absolute ground acceleration.";
CM_ SG_ 154 OBJ_Abs_Acc_STD_V_8 "Validator for the STD of the absolute ground acceleration.";
CM_ SG_ 154 OBJ_Inv_TTC_8 "Inverse TTC (time to collision).";
CM_ SG_ 154 OBJ_Inv_TTC_STD_8 "STD for inverse TTC .";
CM_ SG_ 154 OBJ_Inv_TTC_STD_V_8 "Validator for the STD for inverse TTC .";
CM_ SG_ 154 OBJ_Relative_Long_Acc_8 "The relative longitudinal ground acceleration of the object.";
CM_ SG_ 154 OBJ_Relative_Long_Acc_V_8 "Validator for the relative longitudinal ground acceleration of the object.";
CM_ SG_ 154 OBJ_Relative_Long_Acc_STD_8 "STD of the relative longitudinal ground acceleration of the object.";
CM_ SG_ 154 OBJ_Rel_Long_Acc_STD_V_8 "Validator for the STD of the relative longitudinal ground acceleration.";
CM_ SG_ 154 OBJ_Relative_Long_Velocity_8 "The relative longtitudinal speed between the target and ego vehicle. ";
CM_ SG_ 154 OBJ_Relative_Long_Velocity_V_8 "Validator for the relative longtitudinal speed.";
CM_ SG_ 154 OBJ_Relative_Long_Vel_STD_8 "STD of the relative longtitudinal speed.";
CM_ SG_ 154 OBJ_Rel_Long_Vel_STD_V_8 "Validator for the STD of the relative longtitudinal speed.";
CM_ SG_ 154 OBJ_Relative_Lat_Velocity_8 "The relative lateral speed between the target and ego vehicle. ";
CM_ SG_ 154 OBJ_Relative_Lat_Velocity_V_8 "Validator for the relative lateral speed. ";
CM_ SG_ 154 OBJ_Relative_Lat_Velocity_STD_8 "STD of the relative lateral speed. ";
CM_ SG_ 154 OBJ_Rel_Lat_Vel_STD_V_8 "Validator for the STD of the relative lateral speed. ";
CM_ SG_ 154 OBJ_Long_Distance_8 "The longitudinal distance to middle of the rear bumper (middle of the RL and RR corners) of the target.";
CM_ SG_ 154 OBJ_Long_Distance_V_8 "Validator of the longtitudinal distance field";
CM_ SG_ 154 OBJ_Long_Distance_STD_8 "STD of the  longtitudinal distance.";
CM_ SG_ 154 OBJ_Long_Distance_STD_V_8 "Validator for the STD of the  longtitudinal distance.";
CM_ SG_ 154 OBJ_Lat_Distance_8 "Lateral distance to the middle of the RL and RR corners.  ";
CM_ SG_ 154 OBJ_Lat_Distance_V_8 "Validator for the lateral distance of the object.";
CM_ SG_ 154 OBJ_Lat_Distance_STD_8 "STD of the lateral distance of the object.";
CM_ SG_ 154 OBJ_Lat_Distance_STD_V_8 "Validator for the STD of the lateral distance of the object.";
CM_ SG_ 154 OBJ_Absolute_Speed_8 "The absolute ground speed in the targets' heading direction.";
CM_ SG_ 154 OBJ_Absolute_Speed_V_8 "Validator for the absolute ground speed.";
CM_ SG_ 154 OBJ_Absolute_Speed_STD_8 "STD of the absolute ground speed.";
CM_ SG_ 154 OBJ_Absolute_Speed_STD_V_8 "Validator for the STD of the absolute ground speed.";
CM_ SG_ 154 OBJ_Heading_8 "The angle beetweenthe host longitudinal axis and target's heading (clockwise, e.g. PI/2 is a target crossing from left to right).";
CM_ SG_ 154 OBJ_Heading_V_8 "Validator for the object heading.";
CM_ SG_ 154 OBJ_Heading_STD_8 "STD of the object heading.";
CM_ SG_ 154 OBJ_Heading_STD_V_8 "Validator for the STD of the object heading.";
CM_ SG_ 154 OBJ_Angle_Rate_STD_8 "Standard deviation of the angular speed. (radians)";
CM_ SG_ 154 OBJ_Angle_Rate_STD_V_8 "Validator for the STD of the angular speed.";
CM_ SG_ 154 OBJ_Angle_Rate_8 "The momentary angular speed of the object (radians). The positive side is to the host's right.";
CM_ SG_ 154 OBJ_Angle_Rate_V_8 "Validator for the angular speed.";
CM_ SG_ 154 OBJ_Angle_Right_8 "The angle between the host longitudinal axis and the right side of the front / rear of the target (the visible one). The positive side is to the host's right.";
CM_ SG_ 154 OBJ_Angle_Right_V_8 "Validator for angleRight";
CM_ SG_ 154 OBJ_Angle_Right_STD_8 "Standard deviation of angleRight";
CM_ SG_ 154 OBJ_Angle_Right_STD_V_8 "Validator for the standard deviation of angleRight.";
CM_ SG_ 154 OBJ_Angle_Left_8 "The angle between the host longitudinal axis and the left side of the front / rear of the target (the visible one). The positive side is to the host's right.";
CM_ SG_ 154 OBJ_Angle_Left_V_8 "Validator for angleLeft.";
CM_ SG_ 154 OBJ_Angle_Left_STD_8 "Standard deviation of angleLeft.";
CM_ SG_ 154 OBJ_Angle_Left_STD_V_8 "Validator for the standard deviation of angleLeft.";
CM_ SG_ 154 OBJ_Angle_Side_8 "The angle between the host longitudinal axis and the far visible edge - the visible edge of the front / rear of the target that is not visible. Currently supported for vehicles only.";
CM_ SG_ 154 OBJ_Angle_Side_V_8 "Validator for angleSide.";
CM_ SG_ 154 OBJ_Angle_Side_STD_8 "Standard deviation of angleSide.";
CM_ SG_ 154 OBJ_Angle_Side_STD_V_8 "Validator for the STD of angleSide.";
CM_ SG_ 154 OBJ_Angle_Mid_V_8 "Validator for angleMid.";
CM_ SG_ 154 OBJ_Angle_Mid_8 "The angle between the host longitudinal axis and the middle of the front / rear of the target (the visible one). The positive side is to the host's right.";
CM_ SG_ 154 OBJ_Angle_Mid_STD_8 "Standard deviation of angleMid.";
CM_ SG_ 154 OBJ_Angle_Mid_STD_V_8 "Validator for the STD of angleMid.";
CM_ SG_ 154 OBJ_Angle_Bottom_V_8 "Validator for OBJAngle_Bottom. ";
CM_ SG_ 154 OBJ_Angle_Bottom_8 "The angle between the longitudinal axis and the Bottom of the front / rear of the target (the visible one). The positive side is to the host's bottom";
CM_ SG_ 154 OBJ_Angle_Bottom_STD_8 "STD for OBJAngle_Bottom. ";
CM_ SG_ 154 OBJ_Angle_Bottom_STD_V_8 "Validator for OBJAngle_Bottom_STD. ";
CM_ SG_ 154 OBJ_Visibility_Side_V_8 "Currently Supported for VD only";
CM_ SG_ 154 OBJ_Visibility_Side_8 "From what car  side is the object visible";
CM_ SG_ 154 OBJ_Is_In_Drivable_Area_8 "Indicates whether the target is in a driveable area.";
CM_ SG_ 154 OBJ_Is_In_Drivable_Area_V_8 "Validator for OBJ_Is_In_Drivable_Area.";
CM_ SG_ 154 OBJ_Is_VeryClose_V_8 "Validator for OBJ_Is_VeryClose. ";
CM_ SG_ 154 OBJ_Is_VeryClose_8 "Indicates whether the target is very close to the host such that it is hard to measure its distance. Currently relevant for peds only";
CM_ SG_ 154 OBJ_OverlapAngleEgoLaneR_8 "Lateral distance to the middle of the RL and RR corners.";
CM_ SG_ 154 OBJ_OverlapAngleEgoLaneR_V_8 "Validator for OBJ_OverlapAngleEgoLaneR";
CM_ SG_ 154 OBJ_OverlapAngleEgoLaneL_8 "Lateral distance to the middle of the RL and RR corners.  ";
CM_ SG_ 154 OBJ_OverlapAngleEgoLaneL_V_8 "Validator for OBJ_OverlapAngleEgoLaneL";
CM_ SG_ 154 OBJ_Is_EMERGENCY_VCL_8 "Is Object an Emergency Vehicle";
CM_ SG_ 154 OBJ_EMERGENCY_LIGHT_COLOR_8 "Emergency Color";
CM_ SG_ 154 OBJ_EMERGENCY_V_8 "Are OBJ_Is_EMERGENCY_VCL and OBJ_EMERGENCY_LIGHT_COLOR Valid";
CM_ SG_ 154 OBJ_Angle_Top_8 "From VD touching point on the ground till the roof of the car";
CM_ SG_ 154 OBJ_Angle_Top_V_8 "Validator for OBJ_Angle_Top ";
CM_ SG_ 154 OBJ_Angle_Top_STD_8 "STD for OBJ_Angle_Top";
CM_ SG_ 154 OBJ_Angle_Top_STD_V_8 "Validator for OBJ_Angle_Top_STD. ";
CM_ SG_ 154 OBJ_Open_Door_Left_8 "Indicator if left door is open";
CM_ SG_ 154 OBJ_Open_Door_Right_8 "Indicator if right door is open";
CM_ SG_ 154 OBJ_Visible_Left_or_Right_8 "This signal describes the visible Left or Right side of the Target vehicle.";
CM_ SG_ 154 OBJ_Visible_Left_or_Right_V_8 "OBJ_Visible_Left_or_Right";
CM_ SG_ 154 OBJ_2W_Is_Motorbike_Probability_8 "The probability of the Two-wheeler reported object being a Motorbike";
CM_ SG_ 154 OBJ_2W_Is_Bicycle_Probability_8 "The probability of the Two-wheeler reported object being a Bicycle";
CM_ SG_ 154 OBJ_CRC_9 "Calculated over all element signals. From the signal after the CRC until the first signal in the next elements OBJ_CRC_N+1  not including";
CM_ SG_ 154 OBJ_ID_9 "The detected object ID. Range is 1-255, while 0 indicates that the field in unfilled.";
CM_ SG_ 154 OBJ_Existence_Probability_9 "The existence probability of the reported object";
CM_ SG_ 154 OBJ_Fusion_Source_9 "sources ids used for fusion";
CM_ SG_ 154 OBJ_Triggered_SDM_9 "Indicates whether the object has trigered the SDM (Safety Diagnostic Manager) alert.";
CM_ SG_ 154 OBJ_Motion_Category_9 "Relevant for VD only. Full description of values can be found at the ACC guide.";
CM_ SG_ 154 OBJ_Moving_IN_Probability_9 "The probability the object is eventually move into ego lane. (In case that the OBJ_Motion_Category signal is set to  MOVING_IN ";
CM_ SG_ 154 OBJ_Object_Age_9 "The number of frames in which the object was recognized.";
CM_ SG_ 154 OBJ_Measuring_Status_9 "Measurment status. Old vs New marks if this is the first frame in which the object is reported. Predicted vs Measured marks if the report is raw or has been predicted forward in time using the measured dynamics and ego motion.";
CM_ SG_ 154 OBJ_Object_Class_9 "Indicates the object type. Uncertain is outputted in case the probability that a vehicle is a truck is very similar to the probability that it is a car.";
CM_ SG_ 154 OBJ_Class_Probability_9 "The probability of this type classification.";
CM_ SG_ 154 OBJ_Car_Probability_9 "The probability the object is a car";
CM_ SG_ 154 OBJ_Truck_Probability_9 "The probability the object is a Truck";
CM_ SG_ 154 OBJ_Bike_Probability_9 "The probability the object is a Bike";
CM_ SG_ 154 OBJ_Camera_Source_9 "The camera in which this object was detected (best choice).";
CM_ SG_ 154 OBJ_Motion_Status_9 "MOVING - the object is moving STATIONARY - the object was never seen moving STOPPED -  the object was moving and has stopped MOVING_SLOWLY - the object is moving very slowly";
CM_ SG_ 154 OBJ_Motion_Orientation_9 "The direction of the targets heading compared to the host. ";
CM_ SG_ 154 OBJ_Has_Cut_Lane_9 "Indicates whether the object cut the host's (right or left) lane. In case there are no lanes, indicates whether the objects is at most 1 meters away from the host.";
CM_ SG_ 154 OBJ_Has_Cut_Path_9 "Indicates whether the object is in the host's path.";
CM_ SG_ 154 OBJ_Brake_Light_Validity_9 "Validator for braking light indicator";
CM_ SG_ 154 OBJ_Brake_Light_9 "Indication for brake lights ";
CM_ SG_ 154 OBJ_Turn_Indicator_Right_9 "Indication for blinking right light.";
CM_ SG_ 154 OBJ_Turn_Indicator_Left_9 "Indication for blinking left light ";
CM_ SG_ 154 OBJ_Turn_Indicator_Validity_9 "Validator for light indicators";
CM_ SG_ 154 OBJ_Right_Out_Of_Image_9 "Indicates whether the measurment are predicted out of the right side of the image bounderies.";
CM_ SG_ 154 OBJ_Left_Out_Of_Image_9 "Indicates whether if measurment are predicted out of  the left side of the image bounderies";
CM_ SG_ 154 OBJ_Right_Out_Of_Image_V_9 "validator";
CM_ SG_ 154 OBJ_Left_Out_Of_Image_V_9 "validator";
CM_ SG_ 154 OBJ_Top_Out_Of_Image_9 "Indicates whether if measurment are predicted out of  the top of the image bounderies";
CM_ SG_ 154 OBJ_Bottom_Out_Of_Image_9 "Indicates whether if measurment are predicted out of  the bottom of the image bounderies";
CM_ SG_ 154 OBJ_Top_Out_Of_Image_V_9 "validator";
CM_ SG_ 154 OBJ_Bottom_Out_Of_Image_V_9 "validator";
CM_ SG_ 154 OBJ_Lane_Assignment_9 "The object's lane relative to the host lane.";
CM_ SG_ 154 OBJ_Lane_Assignment_V_9 "Validator for lane assignment";
CM_ SG_ 154 OBJ_Age_Seconds_9 "Time in seconds in which the object was recognized. ";
CM_ SG_ 154 OBJ_Age_Seconds_V_9 "Validator for object age";
CM_ SG_ 154 OBJ_Width_9 "The width of the target vehicle in the world (not to be mistaken with the width of the visible part of the vehicle).";
CM_ SG_ 154 OBJ_Width_V_9 "Validator for object width";
CM_ SG_ 154 OBJ_Width_STD_9 "Standard deviation for object width";
CM_ SG_ 154 OBJ_Width_STD_V_9 "Validator for the standard deviation of object width";
CM_ SG_ 154 OBJ_Length_9 "The length of the vehicle in the world. For crossing bicycles it gives the viewed length of the bicycle.";
CM_ SG_ 154 OBJ_Length_V_9 "Validator for object length.";
CM_ SG_ 154 OBJ_Length_STD_9 "Standard deviation for object length.";
CM_ SG_ 154 OBJ_Length_STD_V_9 "Validator for the standard deviation of object length.";
CM_ SG_ 154 OBJ_Radar_ID_9 "Radar Object ID of the Fused Object, Only relvant when OBJ_Fusion_Source is not Camera only";
CM_ SG_ 154 OBJ_Height_9 "The height of the object in the world. ";
CM_ SG_ 154 OBJ_Height_V_9 "Validator for object height.";
CM_ SG_ 154 OBJ_Height_STD_9 "Standard deviation for object height.";
CM_ SG_ 154 OBJ_Height_STD_V_9 "Validator for the standard deviation of object height.";
CM_ SG_ 154 OBJ_Abs_Long_Velocity_9 "Absolute longitudinal velocity.";
CM_ SG_ 154 OBJ_Abs_Long_Velocity_V_9 "Validator for absolute longitudinal velocity.";
CM_ SG_ 154 OBJ_Abs_Long_Velocity_STD_9 "Standard deviation of absolute longitudinal velocity.";
CM_ SG_ 154 OBJ_Abs_Long_Vel_STD_V_9 "Validator for the standard deviation of the absolute longitudinal velocity.";
CM_ SG_ 154 OBJ_Abs_Lat_Velocity_9 "The lateral ground speed of the object.";
CM_ SG_ 154 OBJ_Abs_Lat_Velocity_V_9 "Validator for the lateral ground speed of the object.";
CM_ SG_ 154 OBJ_Abs_Lat_Velocity_STD_9 "STD of the lateral ground speed of the object.";
CM_ SG_ 154 OBJ_Abs_Lat_Vel_STD_V_9 "Validator for the STD of the lateral ground speed of the object.";
CM_ SG_ 154 OBJ_Abs_Long_Acc_9 "The longitudinal ground acceleration of the object.";
CM_ SG_ 154 OBJ_Abs_Long_Acc_V_9 "Validator for the longitudinal ground acceleration of the object.";
CM_ SG_ 154 OBJ_Abs_Long_Acc_STD_9 "STD of the longitudinal ground acceleration of the object.";
CM_ SG_ 154 OBJ_Abs_Long_Acc_STD_V_9 "Validator for the STD of the longitudinal ground acceleration of the object.";
CM_ SG_ 154 OBJ_Abs_Lat_Acc_9 "The lateral ground acceleration of the object.";
CM_ SG_ 154 OBJ_Abs_Lat_Acc_V_9 "Validator for the lateral ground acceleration of the object.";
CM_ SG_ 154 OBJ_Abs_Lat_Acc_STD_9 "STD of the lateral ground acceleration of the object.";
CM_ SG_ 154 OBJ_Abs_Lat_Acc_STD_V_9 "Validator for the STD of the lateral ground acceleration of the object.";
CM_ SG_ 154 OBJ_Abs_Acceleration_9 "The absolute ground acceleration in the target's heading direction.";
CM_ SG_ 154 OBJ_Abs_Acceleration_V_9 "Validator for the absolute ground acceleration.";
CM_ SG_ 154 OBJ_Abs_Acc_STD_9 "STD of the absolute ground acceleration.";
CM_ SG_ 154 OBJ_Abs_Acc_STD_V_9 "Validator for the STD of the absolute ground acceleration.";
CM_ SG_ 154 OBJ_Inv_TTC_9 "Inverse TTC (time to collision).";
CM_ SG_ 154 OBJ_Inv_TTC_STD_9 "STD for inverse TTC .";
CM_ SG_ 154 OBJ_Inv_TTC_STD_V_9 "Validator for the STD for inverse TTC .";
CM_ SG_ 154 OBJ_Relative_Long_Acc_9 "The relative longitudinal ground acceleration of the object.";
CM_ SG_ 154 OBJ_Relative_Long_Acc_V_9 "Validator for the relative longitudinal ground acceleration of the object.";
CM_ SG_ 154 OBJ_Relative_Long_Acc_STD_9 "STD of the relative longitudinal ground acceleration of the object.";
CM_ SG_ 154 OBJ_Rel_Long_Acc_STD_V_9 "Validator for the STD of the relative longitudinal ground acceleration.";
CM_ SG_ 154 OBJ_Relative_Long_Velocity_9 "The relative longtitudinal speed between the target and ego vehicle. ";
CM_ SG_ 154 OBJ_Relative_Long_Velocity_V_9 "Validator for the relative longtitudinal speed.";
CM_ SG_ 154 OBJ_Relative_Long_Vel_STD_9 "STD of the relative longtitudinal speed.";
CM_ SG_ 154 OBJ_Rel_Long_Vel_STD_V_9 "Validator for the STD of the relative longtitudinal speed.";
CM_ SG_ 154 OBJ_Relative_Lat_Velocity_9 "The relative lateral speed between the target and ego vehicle. ";
CM_ SG_ 154 OBJ_Relative_Lat_Velocity_V_9 "Validator for the relative lateral speed. ";
CM_ SG_ 154 OBJ_Relative_Lat_Velocity_STD_9 "STD of the relative lateral speed. ";
CM_ SG_ 154 OBJ_Rel_Lat_Vel_STD_V_9 "Validator for the STD of the relative lateral speed. ";
CM_ SG_ 154 OBJ_Long_Distance_9 "The longitudinal distance to middle of the rear bumper (middle of the RL and RR corners) of the target.";
CM_ SG_ 154 OBJ_Long_Distance_V_9 "Validator of the longtitudinal distance field";
CM_ SG_ 154 OBJ_Long_Distance_STD_9 "STD of the  longtitudinal distance.";
CM_ SG_ 154 OBJ_Long_Distance_STD_V_9 "Validator for the STD of the  longtitudinal distance.";
CM_ SG_ 154 OBJ_Lat_Distance_9 "Lateral distance to the middle of the RL and RR corners.  ";
CM_ SG_ 154 OBJ_Lat_Distance_V_9 "Validator for the lateral distance of the object.";
CM_ SG_ 154 OBJ_Lat_Distance_STD_9 "STD of the lateral distance of the object.";
CM_ SG_ 154 OBJ_Lat_Distance_STD_V_9 "Validator for the STD of the lateral distance of the object.";
CM_ SG_ 154 OBJ_Absolute_Speed_9 "The absolute ground speed in the targets' heading direction.";
CM_ SG_ 154 OBJ_Absolute_Speed_V_9 "Validator for the absolute ground speed.";
CM_ SG_ 154 OBJ_Absolute_Speed_STD_9 "STD of the absolute ground speed.";
CM_ SG_ 154 OBJ_Absolute_Speed_STD_V_9 "Validator for the STD of the absolute ground speed.";
CM_ SG_ 154 OBJ_Heading_9 "The angle beetweenthe host longitudinal axis and target's heading (clockwise, e.g. PI/2 is a target crossing from left to right).";
CM_ SG_ 154 OBJ_Heading_V_9 "Validator for the object heading.";
CM_ SG_ 154 OBJ_Heading_STD_9 "STD of the object heading.";
CM_ SG_ 154 OBJ_Heading_STD_V_9 "Validator for the STD of the object heading.";
CM_ SG_ 154 OBJ_Angle_Rate_STD_9 "Standard deviation of the angular speed. (radians)";
CM_ SG_ 154 OBJ_Angle_Rate_STD_V_9 "Validator for the STD of the angular speed.";
CM_ SG_ 154 OBJ_Angle_Rate_9 "The momentary angular speed of the object (radians). The positive side is to the host's right.";
CM_ SG_ 154 OBJ_Angle_Rate_V_9 "Validator for the angular speed.";
CM_ SG_ 154 OBJ_Angle_Right_9 "The angle between the host longitudinal axis and the right side of the front / rear of the target (the visible one). The positive side is to the host's right.";
CM_ SG_ 154 OBJ_Angle_Right_V_9 "Validator for angleRight";
CM_ SG_ 154 OBJ_Angle_Right_STD_9 "Standard deviation of angleRight";
CM_ SG_ 154 OBJ_Angle_Right_STD_V_9 "Validator for the standard deviation of angleRight.";
CM_ SG_ 154 OBJ_Angle_Left_9 "The angle between the host longitudinal axis and the left side of the front / rear of the target (the visible one). The positive side is to the host's right.";
CM_ SG_ 154 OBJ_Angle_Left_V_9 "Validator for angleLeft.";
CM_ SG_ 154 OBJ_Angle_Left_STD_9 "Standard deviation of angleLeft.";
CM_ SG_ 154 OBJ_Angle_Left_STD_V_9 "Validator for the standard deviation of angleLeft.";
CM_ SG_ 154 OBJ_Angle_Side_9 "The angle between the host longitudinal axis and the far visible edge - the visible edge of the front / rear of the target that is not visible. Currently supported for vehicles only.";
CM_ SG_ 154 OBJ_Angle_Side_V_9 "Validator for angleSide.";
CM_ SG_ 154 OBJ_Angle_Side_STD_9 "Standard deviation of angleSide.";
CM_ SG_ 154 OBJ_Angle_Side_STD_V_9 "Validator for the STD of angleSide.";
CM_ SG_ 154 OBJ_Angle_Mid_V_9 "Validator for angleMid.";
CM_ SG_ 154 OBJ_Angle_Mid_9 "The angle between the host longitudinal axis and the middle of the front / rear of the target (the visible one). The positive side is to the host's right.";
CM_ SG_ 154 OBJ_Angle_Mid_STD_9 "Standard deviation of angleMid.";
CM_ SG_ 154 OBJ_Angle_Mid_STD_V_9 "Validator for the STD of angleMid.";
CM_ SG_ 154 OBJ_Angle_Bottom_V_9 "Validator for OBJAngle_Bottom. ";
CM_ SG_ 154 OBJ_Angle_Bottom_9 "The angle between the longitudinal axis and the Bottom of the front / rear of the target (the visible one). The positive side is to the host's bottom";
CM_ SG_ 154 OBJ_Angle_Bottom_STD_9 "STD for OBJAngle_Bottom. ";
CM_ SG_ 154 OBJ_Angle_Bottom_STD_V_9 "Validator for OBJAngle_Bottom_STD. ";
CM_ SG_ 154 OBJ_Visibility_Side_V_9 "Currently Supported for VD only";
CM_ SG_ 154 OBJ_Visibility_Side_9 "From what car  side is the object visible";
CM_ SG_ 154 OBJ_Is_In_Drivable_Area_9 "Indicates whether the target is in a driveable area.";
CM_ SG_ 154 OBJ_Is_In_Drivable_Area_V_9 "Validator for OBJ_Is_In_Drivable_Area.";
CM_ SG_ 154 OBJ_Is_VeryClose_V_9 "Validator for OBJ_Is_VeryClose. ";
CM_ SG_ 154 OBJ_Is_VeryClose_9 "Indicates whether the target is very close to the host such that it is hard to measure its distance. Currently relevant for peds only";
CM_ SG_ 154 OBJ_OverlapAngleEgoLaneR_9 "Lateral distance to the middle of the RL and RR corners.";
CM_ SG_ 154 OBJ_OverlapAngleEgoLaneR_V_9 "Validator for OBJ_OverlapAngleEgoLaneR";
CM_ SG_ 154 OBJ_OverlapAngleEgoLaneL_9 "Lateral distance to the middle of the RL and RR corners.  ";
CM_ SG_ 154 OBJ_OverlapAngleEgoLaneL_V_9 "Validator for OBJ_OverlapAngleEgoLaneL";
CM_ SG_ 154 OBJ_Is_EMERGENCY_VCL_9 "Is Object an Emergency Vehicle";
CM_ SG_ 154 OBJ_EMERGENCY_LIGHT_COLOR_9 "Emergency Color";
CM_ SG_ 154 OBJ_EMERGENCY_V_9 "Are OBJ_Is_EMERGENCY_VCL and OBJ_EMERGENCY_LIGHT_COLOR Valid";
CM_ SG_ 154 OBJ_Angle_Top_9 "From VD touching point on the ground till the roof of the car";
CM_ SG_ 154 OBJ_Angle_Top_V_9 "Validator for OBJ_Angle_Top ";
CM_ SG_ 154 OBJ_Angle_Top_STD_9 "STD for OBJ_Angle_Top";
CM_ SG_ 154 OBJ_Angle_Top_STD_V_9 "Validator for OBJ_Angle_Top_STD. ";
CM_ SG_ 154 OBJ_Open_Door_Left_9 "Indicator if left door is open";
CM_ SG_ 154 OBJ_Open_Door_Right_9 "Indicator if right door is open";
CM_ SG_ 154 OBJ_Visible_Left_or_Right_9 "This signal describes the visible Left or Right side of the Target vehicle.";
CM_ SG_ 154 OBJ_Visible_Left_or_Right_V_9 "OBJ_Visible_Left_or_Right";
CM_ SG_ 154 OBJ_2W_Is_Motorbike_Probability_9 "The probability of the Two-wheeler reported object being a Motorbike";
CM_ SG_ 154 OBJ_2W_Is_Bicycle_Probability_9 "The probability of the Two-wheeler reported object being a Bicycle";
CM_ SG_ 154 OBJ_CRC_10 "Calculated over all element signals. From the signal after the CRC until the first signal in the next elements OBJ_CRC_N+1  not including";
CM_ SG_ 154 OBJ_ID_10 "The detected object ID. Range is 1-255, while 0 indicates that the field in unfilled.";
CM_ SG_ 154 OBJ_Existence_Probability_10 "The existence probability of the reported object";
CM_ SG_ 154 OBJ_Fusion_Source_10 "sources ids used for fusion";
CM_ SG_ 154 OBJ_Triggered_SDM_10 "Indicates whether the object has trigered the SDM (Safety Diagnostic Manager) alert.";
CM_ SG_ 154 OBJ_Motion_Category_10 "Relevant for VD only. Full description of values can be found at the ACC guide.";
CM_ SG_ 154 OBJ_Moving_IN_Probability_10 "The probability the object is eventually move into ego lane. (In case that the OBJ_Motion_Category signal is set to  MOVING_IN ";
CM_ SG_ 154 OBJ_Object_Age_10 "The number of frames in which the object was recognized.";
CM_ SG_ 154 OBJ_Measuring_Status_10 "Measurment status. Old vs New marks if this is the first frame in which the object is reported. Predicted vs Measured marks if the report is raw or has been predicted forward in time using the measured dynamics and ego motion.";
CM_ SG_ 154 OBJ_Object_Class_10 "Indicates the object type. Uncertain is outputted in case the probability that a vehicle is a truck is very similar to the probability that it is a car.";
CM_ SG_ 154 OBJ_Class_Probability_10 "The probability of this type classification.";
CM_ SG_ 154 OBJ_Car_Probability_10 "The probability the object is a car";
CM_ SG_ 154 OBJ_Truck_Probability_10 "The probability the object is a Truck";
CM_ SG_ 154 OBJ_Bike_Probability_10 "The probability the object is a Bike";
CM_ SG_ 154 OBJ_Camera_Source_10 "The camera in which this object was detected (best choice).";
CM_ SG_ 154 OBJ_Motion_Status_10 "MOVING - the object is moving STATIONARY - the object was never seen moving STOPPED -  the object was moving and has stopped MOVING_SLOWLY - the object is moving very slowly";
CM_ SG_ 154 OBJ_Motion_Orientation_10 "The direction of the targets heading compared to the host. ";
CM_ SG_ 154 OBJ_Has_Cut_Lane_10 "Indicates whether the object cut the host's (right or left) lane. In case there are no lanes, indicates whether the objects is at most 1 meters away from the host.";
CM_ SG_ 154 OBJ_Has_Cut_Path_10 "Indicates whether the object is in the host's path.";
CM_ SG_ 154 OBJ_Brake_Light_Validity_10 "Validator for braking light indicator";
CM_ SG_ 154 OBJ_Brake_Light_10 "Indication for brake lights ";
CM_ SG_ 154 OBJ_Turn_Indicator_Right_10 "Indication for blinking right light.";
CM_ SG_ 154 OBJ_Turn_Indicator_Left_10 "Indication for blinking left light ";
CM_ SG_ 154 OBJ_Turn_Indicator_Validity_10 "Validator for light indicators";
CM_ SG_ 154 OBJ_Right_Out_Of_Image_10 "Indicates whether the measurment are predicted out of the right side of the image bounderies.";
CM_ SG_ 154 OBJ_Left_Out_Of_Image_10 "Indicates whether if measurment are predicted out of  the left side of the image bounderies";
CM_ SG_ 154 OBJ_Right_Out_Of_Image_V_10 "validator";
CM_ SG_ 154 OBJ_Left_Out_Of_Image_V_10 "validator";
CM_ SG_ 154 OBJ_Top_Out_Of_Image_10 "Indicates whether if measurment are predicted out of  the top of the image bounderies";
CM_ SG_ 154 OBJ_Bottom_Out_Of_Image_10 "Indicates whether if measurment are predicted out of  the bottom of the image bounderies";
CM_ SG_ 154 OBJ_Top_Out_Of_Image_V_10 "validator";
CM_ SG_ 154 OBJ_Bottom_Out_Of_Image_V_10 "validator";
CM_ SG_ 154 OBJ_Lane_Assignment_10 "The object's lane relative to the host lane.";
CM_ SG_ 154 OBJ_Lane_Assignment_V_10 "Validator for lane assignment";
CM_ SG_ 154 OBJ_Age_Seconds_10 "Time in seconds in which the object was recognized. ";
CM_ SG_ 154 OBJ_Age_Seconds_V_10 "Validator for object age";
CM_ SG_ 154 OBJ_Width_10 "The width of the target vehicle in the world (not to be mistaken with the width of the visible part of the vehicle).";
CM_ SG_ 154 OBJ_Width_V_10 "Validator for object width";
CM_ SG_ 154 OBJ_Width_STD_10 "Standard deviation for object width";
CM_ SG_ 154 OBJ_Width_STD_V_10 "Validator for the standard deviation of object width";
CM_ SG_ 154 OBJ_Length_10 "The length of the vehicle in the world. For crossing bicycles it gives the viewed length of the bicycle.";
CM_ SG_ 154 OBJ_Length_V_10 "Validator for object length.";
CM_ SG_ 154 OBJ_Length_STD_10 "Standard deviation for object length.";
CM_ SG_ 154 OBJ_Length_STD_V_10 "Validator for the standard deviation of object length.";
CM_ SG_ 154 OBJ_Radar_ID_10 "Radar Object ID of the Fused Object, Only relvant when OBJ_Fusion_Source is not Camera only";
CM_ SG_ 154 OBJ_Height_10 "The height of the object in the world. ";
CM_ SG_ 154 OBJ_Height_V_10 "Validator for object height.";
CM_ SG_ 154 OBJ_Height_STD_10 "Standard deviation for object height.";
CM_ SG_ 154 OBJ_Height_STD_V_10 "Validator for the standard deviation of object height.";
CM_ SG_ 154 OBJ_Abs_Long_Velocity_10 "Absolute longitudinal velocity.";
CM_ SG_ 154 OBJ_Abs_Long_Velocity_V_10 "Validator for absolute longitudinal velocity.";
CM_ SG_ 154 OBJ_Abs_Long_Velocity_STD_10 "Standard deviation of absolute longitudinal velocity.";
CM_ SG_ 154 OBJ_Abs_Long_Vel_STD_V_10 "Validator for the standard deviation of the absolute longitudinal velocity.";
CM_ SG_ 154 OBJ_Abs_Lat_Velocity_10 "The lateral ground speed of the object.";
CM_ SG_ 154 OBJ_Abs_Lat_Velocity_V_10 "Validator for the lateral ground speed of the object.";
CM_ SG_ 154 OBJ_Abs_Lat_Velocity_STD_10 "STD of the lateral ground speed of the object.";
CM_ SG_ 154 OBJ_Abs_Lat_Vel_STD_V_10 "Validator for the STD of the lateral ground speed of the object.";
CM_ SG_ 154 OBJ_Abs_Long_Acc_10 "The longitudinal ground acceleration of the object.";
CM_ SG_ 154 OBJ_Abs_Long_Acc_V_10 "Validator for the longitudinal ground acceleration of the object.";
CM_ SG_ 154 OBJ_Abs_Long_Acc_STD_10 "STD of the longitudinal ground acceleration of the object.";
CM_ SG_ 154 OBJ_Abs_Long_Acc_STD_V_10 "Validator for the STD of the longitudinal ground acceleration of the object.";
CM_ SG_ 154 OBJ_Abs_Lat_Acc_10 "The lateral ground acceleration of the object.";
CM_ SG_ 154 OBJ_Abs_Lat_Acc_V_10 "Validator for the lateral ground acceleration of the object.";
CM_ SG_ 154 OBJ_Abs_Lat_Acc_STD_10 "STD of the lateral ground acceleration of the object.";
CM_ SG_ 154 OBJ_Abs_Lat_Acc_STD_V_10 "Validator for the STD of the lateral ground acceleration of the object.";
CM_ SG_ 154 OBJ_Abs_Acceleration_10 "The absolute ground acceleration in the target's heading direction.";
CM_ SG_ 154 OBJ_Abs_Acceleration_V_10 "Validator for the absolute ground acceleration.";
CM_ SG_ 154 OBJ_Abs_Acc_STD_10 "STD of the absolute ground acceleration.";
CM_ SG_ 154 OBJ_Abs_Acc_STD_V_10 "Validator for the STD of the absolute ground acceleration.";
CM_ SG_ 154 OBJ_Inv_TTC_10 "Inverse TTC (time to collision).";
CM_ SG_ 154 OBJ_Inv_TTC_STD_10 "STD for inverse TTC .";
CM_ SG_ 154 OBJ_Inv_TTC_STD_V_10 "Validator for the STD for inverse TTC .";
CM_ SG_ 154 OBJ_Relative_Long_Acc_10 "The relative longitudinal ground acceleration of the object.";
CM_ SG_ 154 OBJ_Relative_Long_Acc_V_10 "Validator for the relative longitudinal ground acceleration of the object.";
CM_ SG_ 154 OBJ_Relative_Long_Acc_STD_10 "STD of the relative longitudinal ground acceleration of the object.";
CM_ SG_ 154 OBJ_Rel_Long_Acc_STD_V_10 "Validator for the STD of the relative longitudinal ground acceleration.";
CM_ SG_ 154 OBJ_Relative_Long_Velocity_10 "The relative longtitudinal speed between the target and ego vehicle. ";
CM_ SG_ 154 OBJ_Relative_Long_Velocity_V_10 "Validator for the relative longtitudinal speed.";
CM_ SG_ 154 OBJ_Relative_Long_Vel_STD_10 "STD of the relative longtitudinal speed.";
CM_ SG_ 154 OBJ_Rel_Long_Vel_STD_V_10 "Validator for the STD of the relative longtitudinal speed.";
CM_ SG_ 154 OBJ_Relative_Lat_Velocity_10 "The relative lateral speed between the target and ego vehicle. ";
CM_ SG_ 154 OBJ_Relative_Lat_Velocity_V_10 "Validator for the relative lateral speed. ";
CM_ SG_ 154 OBJ_Relative_Lat_Velocity_STD_10 "STD of the relative lateral speed. ";
CM_ SG_ 154 OBJ_Rel_Lat_Vel_STD_V_10 "Validator for the STD of the relative lateral speed. ";
CM_ SG_ 154 OBJ_Long_Distance_10 "The longitudinal distance to middle of the rear bumper (middle of the RL and RR corners) of the target.";
CM_ SG_ 154 OBJ_Long_Distance_V_10 "Validator of the longtitudinal distance field";
CM_ SG_ 154 OBJ_Long_Distance_STD_10 "STD of the  longtitudinal distance.";
CM_ SG_ 154 OBJ_Long_Distance_STD_V_10 "Validator for the STD of the  longtitudinal distance.";
CM_ SG_ 154 OBJ_Lat_Distance_10 "Lateral distance to the middle of the RL and RR corners.  ";
CM_ SG_ 154 OBJ_Lat_Distance_V_10 "Validator for the lateral distance of the object.";
CM_ SG_ 154 OBJ_Lat_Distance_STD_10 "STD of the lateral distance of the object.";
CM_ SG_ 154 OBJ_Lat_Distance_STD_V_10 "Validator for the STD of the lateral distance of the object.";
CM_ SG_ 154 OBJ_Absolute_Speed_10 "The absolute ground speed in the targets' heading direction.";
CM_ SG_ 154 OBJ_Absolute_Speed_V_10 "Validator for the absolute ground speed.";
CM_ SG_ 154 OBJ_Absolute_Speed_STD_10 "STD of the absolute ground speed.";
CM_ SG_ 154 OBJ_Absolute_Speed_STD_V_10 "Validator for the STD of the absolute ground speed.";
CM_ SG_ 154 OBJ_Heading_10 "The angle beetweenthe host longitudinal axis and target's heading (clockwise, e.g. PI/2 is a target crossing from left to right).";
CM_ SG_ 154 OBJ_Heading_V_10 "Validator for the object heading.";
CM_ SG_ 154 OBJ_Heading_STD_10 "STD of the object heading.";
CM_ SG_ 154 OBJ_Heading_STD_V_10 "Validator for the STD of the object heading.";
CM_ SG_ 154 OBJ_Angle_Rate_STD_10 "Standard deviation of the angular speed. (radians)";
CM_ SG_ 154 OBJ_Angle_Rate_STD_V_10 "Validator for the STD of the angular speed.";
CM_ SG_ 154 OBJ_Angle_Rate_10 "The momentary angular speed of the object (radians). The positive side is to the host's right.";
CM_ SG_ 154 OBJ_Angle_Rate_V_10 "Validator for the angular speed.";
CM_ SG_ 154 OBJ_Angle_Right_10 "The angle between the host longitudinal axis and the right side of the front / rear of the target (the visible one). The positive side is to the host's right.";
CM_ SG_ 154 OBJ_Angle_Right_V_10 "Validator for angleRight";
CM_ SG_ 154 OBJ_Angle_Right_STD_10 "Standard deviation of angleRight";
CM_ SG_ 154 OBJ_Angle_Right_STD_V_10 "Validator for the standard deviation of angleRight.";
CM_ SG_ 154 OBJ_Angle_Left_10 "The angle between the host longitudinal axis and the left side of the front / rear of the target (the visible one). The positive side is to the host's right.";
CM_ SG_ 154 OBJ_Angle_Left_V_10 "Validator for angleLeft.";
CM_ SG_ 154 OBJ_Angle_Left_STD_10 "Standard deviation of angleLeft.";
CM_ SG_ 154 OBJ_Angle_Left_STD_V_10 "Validator for the standard deviation of angleLeft.";
CM_ SG_ 154 OBJ_Angle_Side_10 "The angle between the host longitudinal axis and the far visible edge - the visible edge of the front / rear of the target that is not visible. Currently supported for vehicles only.";
CM_ SG_ 154 OBJ_Angle_Side_V_10 "Validator for angleSide.";
CM_ SG_ 154 OBJ_Angle_Side_STD_10 "Standard deviation of angleSide.";
CM_ SG_ 154 OBJ_Angle_Side_STD_V_10 "Validator for the STD of angleSide.";
CM_ SG_ 154 OBJ_Angle_Mid_V_10 "Validator for angleMid.";
CM_ SG_ 154 OBJ_Angle_Mid_10 "The angle between the host longitudinal axis and the middle of the front / rear of the target (the visible one). The positive side is to the host's right.";
CM_ SG_ 154 OBJ_Angle_Mid_STD_10 "Standard deviation of angleMid.";
CM_ SG_ 154 OBJ_Angle_Mid_STD_V_10 "Validator for the STD of angleMid.";
CM_ SG_ 154 OBJ_Angle_Bottom_V_10 "Validator for OBJAngle_Bottom. ";
CM_ SG_ 154 OBJ_Angle_Bottom_10 "The angle between the longitudinal axis and the Bottom of the front / rear of the target (the visible one). The positive side is to the host's bottom";
CM_ SG_ 154 OBJ_Angle_Bottom_STD_10 "STD for OBJAngle_Bottom. ";
CM_ SG_ 154 OBJ_Angle_Bottom_STD_V_10 "Validator for OBJAngle_Bottom_STD. ";
CM_ SG_ 154 OBJ_Visibility_Side_V_10 "Currently Supported for VD only";
CM_ SG_ 154 OBJ_Visibility_Side_10 "From what car  side is the object visible";
CM_ SG_ 154 OBJ_Is_In_Drivable_Area_10 "Indicates whether the target is in a driveable area.";
CM_ SG_ 154 OBJ_Is_In_Drivable_Area_V_10 "Validator for OBJ_Is_In_Drivable_Area.";
CM_ SG_ 154 OBJ_Is_VeryClose_V_10 "Validator for OBJ_Is_VeryClose. ";
CM_ SG_ 154 OBJ_Is_VeryClose_10 "Indicates whether the target is very close to the host such that it is hard to measure its distance. Currently relevant for peds only";
CM_ SG_ 154 OBJ_OverlapAngleEgoLaneR_10 "Lateral distance to the middle of the RL and RR corners.";
CM_ SG_ 154 OBJ_OverlapAngleEgoLaneR_V_10 "Validator for OBJ_OverlapAngleEgoLaneR";
CM_ SG_ 154 OBJ_OverlapAngleEgoLaneL_10 "Lateral distance to the middle of the RL and RR corners.  ";
CM_ SG_ 154 OBJ_OverlapAngleEgoLaneL_V_10 "Validator for OBJ_OverlapAngleEgoLaneL";
CM_ SG_ 154 OBJ_Is_EMERGENCY_VCL_10 "Is Object an Emergency Vehicle";
CM_ SG_ 154 OBJ_EMERGENCY_LIGHT_COLOR_10 "Emergency Color";
CM_ SG_ 154 OBJ_EMERGENCY_V_10 "Are OBJ_Is_EMERGENCY_VCL and OBJ_EMERGENCY_LIGHT_COLOR Valid";
CM_ SG_ 154 OBJ_Angle_Top_10 "From VD touching point on the ground till the roof of the car";
CM_ SG_ 154 OBJ_Angle_Top_V_10 "Validator for OBJ_Angle_Top ";
CM_ SG_ 154 OBJ_Angle_Top_STD_10 "STD for OBJ_Angle_Top";
CM_ SG_ 154 OBJ_Angle_Top_STD_V_10 "Validator for OBJ_Angle_Top_STD. ";
CM_ SG_ 154 OBJ_Open_Door_Left_10 "Indicator if left door is open";
CM_ SG_ 154 OBJ_Open_Door_Right_10 "Indicator if right door is open";
CM_ SG_ 154 OBJ_Visible_Left_or_Right_10 "This signal describes the visible Left or Right side of the Target vehicle.";
CM_ SG_ 154 OBJ_Visible_Left_or_Right_V_10 "OBJ_Visible_Left_or_Right";
CM_ SG_ 154 OBJ_2W_Is_Motorbike_Probability_10 "The probability of the Two-wheeler reported object being a Motorbike";
CM_ SG_ 154 OBJ_2W_Is_Bicycle_Probability_10 "The probability of the Two-wheeler reported object being a Bicycle";
CM_ SG_ 154 OBJ_CRC_11 "Calculated over all element signals. From the signal after the CRC until the first signal in the next elements OBJ_CRC_N+1  not including";
CM_ SG_ 154 OBJ_ID_11 "The detected object ID. Range is 1-255, while 0 indicates that the field in unfilled.";
CM_ SG_ 154 OBJ_Existence_Probability_11 "The existence probability of the reported object";
CM_ SG_ 154 OBJ_Fusion_Source_11 "sources ids used for fusion";
CM_ SG_ 154 OBJ_Triggered_SDM_11 "Indicates whether the object has trigered the SDM (Safety Diagnostic Manager) alert.";
CM_ SG_ 154 OBJ_Motion_Category_11 "Relevant for VD only. Full description of values can be found at the ACC guide.";
CM_ SG_ 154 OBJ_Moving_IN_Probability_11 "The probability the object is eventually move into ego lane. (In case that the OBJ_Motion_Category signal is set to  MOVING_IN ";
CM_ SG_ 154 OBJ_Object_Age_11 "The number of frames in which the object was recognized.";
CM_ SG_ 154 OBJ_Measuring_Status_11 "Measurment status. Old vs New marks if this is the first frame in which the object is reported. Predicted vs Measured marks if the report is raw or has been predicted forward in time using the measured dynamics and ego motion.";
CM_ SG_ 154 OBJ_Object_Class_11 "Indicates the object type. Uncertain is outputted in case the probability that a vehicle is a truck is very similar to the probability that it is a car.";
CM_ SG_ 154 OBJ_Class_Probability_11 "The probability of this type classification.";
CM_ SG_ 154 OBJ_Car_Probability_11 "The probability the object is a car";
CM_ SG_ 154 OBJ_Truck_Probability_11 "The probability the object is a Truck";
CM_ SG_ 154 OBJ_Bike_Probability_11 "The probability the object is a Bike";
CM_ SG_ 154 OBJ_Camera_Source_11 "The camera in which this object was detected (best choice).";
CM_ SG_ 154 OBJ_Motion_Status_11 "MOVING - the object is moving STATIONARY - the object was never seen moving STOPPED -  the object was moving and has stopped MOVING_SLOWLY - the object is moving very slowly";
CM_ SG_ 154 OBJ_Motion_Orientation_11 "The direction of the targets heading compared to the host. ";
CM_ SG_ 154 OBJ_Has_Cut_Lane_11 "Indicates whether the object cut the host's (right or left) lane. In case there are no lanes, indicates whether the objects is at most 1 meters away from the host.";
CM_ SG_ 154 OBJ_Has_Cut_Path_11 "Indicates whether the object is in the host's path.";
CM_ SG_ 154 OBJ_Brake_Light_Validity_11 "Validator for braking light indicator";
CM_ SG_ 154 OBJ_Brake_Light_11 "Indication for brake lights ";
CM_ SG_ 154 OBJ_Turn_Indicator_Right_11 "Indication for blinking right light.";
CM_ SG_ 154 OBJ_Turn_Indicator_Left_11 "Indication for blinking left light ";
CM_ SG_ 154 OBJ_Turn_Indicator_Validity_11 "Validator for light indicators";
CM_ SG_ 154 OBJ_Right_Out_Of_Image_11 "Indicates whether the measurment are predicted out of the right side of the image bounderies.";
CM_ SG_ 154 OBJ_Left_Out_Of_Image_11 "Indicates whether if measurment are predicted out of  the left side of the image bounderies";
CM_ SG_ 154 OBJ_Right_Out_Of_Image_V_11 "validator";
CM_ SG_ 154 OBJ_Left_Out_Of_Image_V_11 "validator";
CM_ SG_ 154 OBJ_Top_Out_Of_Image_11 "Indicates whether if measurment are predicted out of  the top of the image bounderies";
CM_ SG_ 154 OBJ_Bottom_Out_Of_Image_11 "Indicates whether if measurment are predicted out of  the bottom of the image bounderies";
CM_ SG_ 154 OBJ_Top_Out_Of_Image_V_11 "validator";
CM_ SG_ 154 OBJ_Bottom_Out_Of_Image_V_11 "validator";
CM_ SG_ 154 OBJ_Lane_Assignment_11 "The object's lane relative to the host lane.";
CM_ SG_ 154 OBJ_Lane_Assignment_V_11 "Validator for lane assignment";
CM_ SG_ 154 OBJ_Age_Seconds_11 "Time in seconds in which the object was recognized. ";
CM_ SG_ 154 OBJ_Age_Seconds_V_11 "Validator for object age";
CM_ SG_ 154 OBJ_Width_11 "The width of the target vehicle in the world (not to be mistaken with the width of the visible part of the vehicle).";
CM_ SG_ 154 OBJ_Width_V_11 "Validator for object width";
CM_ SG_ 154 OBJ_Width_STD_11 "Standard deviation for object width";
CM_ SG_ 154 OBJ_Width_STD_V_11 "Validator for the standard deviation of object width";
CM_ SG_ 154 OBJ_Length_11 "The length of the vehicle in the world. For crossing bicycles it gives the viewed length of the bicycle.";
CM_ SG_ 154 OBJ_Length_V_11 "Validator for object length.";
CM_ SG_ 154 OBJ_Length_STD_11 "Standard deviation for object length.";
CM_ SG_ 154 OBJ_Length_STD_V_11 "Validator for the standard deviation of object length.";
CM_ SG_ 154 OBJ_Radar_ID_11 "Radar Object ID of the Fused Object, Only relvant when OBJ_Fusion_Source is not Camera only";
CM_ SG_ 154 OBJ_Height_11 "The height of the object in the world. ";
CM_ SG_ 154 OBJ_Height_V_11 "Validator for object height.";
CM_ SG_ 154 OBJ_Height_STD_11 "Standard deviation for object height.";
CM_ SG_ 154 OBJ_Height_STD_V_11 "Validator for the standard deviation of object height.";
CM_ SG_ 154 OBJ_Abs_Long_Velocity_11 "Absolute longitudinal velocity.";
CM_ SG_ 154 OBJ_Abs_Long_Velocity_V_11 "Validator for absolute longitudinal velocity.";
CM_ SG_ 154 OBJ_Abs_Long_Velocity_STD_11 "Standard deviation of absolute longitudinal velocity.";
CM_ SG_ 154 OBJ_Abs_Long_Vel_STD_V_11 "Validator for the standard deviation of the absolute longitudinal velocity.";
CM_ SG_ 154 OBJ_Abs_Lat_Velocity_11 "The lateral ground speed of the object.";
CM_ SG_ 154 OBJ_Abs_Lat_Velocity_V_11 "Validator for the lateral ground speed of the object.";
CM_ SG_ 154 OBJ_Abs_Lat_Velocity_STD_11 "STD of the lateral ground speed of the object.";
CM_ SG_ 154 OBJ_Abs_Lat_Vel_STD_V_11 "Validator for the STD of the lateral ground speed of the object.";
CM_ SG_ 154 OBJ_Abs_Long_Acc_11 "The longitudinal ground acceleration of the object.";
CM_ SG_ 154 OBJ_Abs_Long_Acc_V_11 "Validator for the longitudinal ground acceleration of the object.";
CM_ SG_ 154 OBJ_Abs_Long_Acc_STD_11 "STD of the longitudinal ground acceleration of the object.";
CM_ SG_ 154 OBJ_Abs_Long_Acc_STD_V_11 "Validator for the STD of the longitudinal ground acceleration of the object.";
CM_ SG_ 154 OBJ_Abs_Lat_Acc_11 "The lateral ground acceleration of the object.";
CM_ SG_ 154 OBJ_Abs_Lat_Acc_V_11 "Validator for the lateral ground acceleration of the object.";
CM_ SG_ 154 OBJ_Abs_Lat_Acc_STD_11 "STD of the lateral ground acceleration of the object.";
CM_ SG_ 154 OBJ_Abs_Lat_Acc_STD_V_11 "Validator for the STD of the lateral ground acceleration of the object.";
CM_ SG_ 154 OBJ_Abs_Acceleration_11 "The absolute ground acceleration in the target's heading direction.";
CM_ SG_ 154 OBJ_Abs_Acceleration_V_11 "Validator for the absolute ground acceleration.";
CM_ SG_ 154 OBJ_Abs_Acc_STD_11 "STD of the absolute ground acceleration.";
CM_ SG_ 154 OBJ_Abs_Acc_STD_V_11 "Validator for the STD of the absolute ground acceleration.";
CM_ SG_ 154 OBJ_Inv_TTC_11 "Inverse TTC (time to collision).";
CM_ SG_ 154 OBJ_Inv_TTC_STD_11 "STD for inverse TTC .";
CM_ SG_ 154 OBJ_Inv_TTC_STD_V_11 "Validator for the STD for inverse TTC .";
CM_ SG_ 154 OBJ_Relative_Long_Acc_11 "The relative longitudinal ground acceleration of the object.";
CM_ SG_ 154 OBJ_Relative_Long_Acc_V_11 "Validator for the relative longitudinal ground acceleration of the object.";
CM_ SG_ 154 OBJ_Relative_Long_Acc_STD_11 "STD of the relative longitudinal ground acceleration of the object.";
BA_DEF_ SG_  "GenSigStartValue" INT 0 0;
BA_DEF_DEF_  "GenSigStartValue" 0;
BA_ "GenSigStartValue" SG_ 154 OBJ_Width_6 40;
BA_ "GenSigStartValue" SG_ 154 OBJ_Length_6 12;
BA_ "GenSigStartValue" SG_ 154 OBJ_Width_7 40;
BA_ "GenSigStartValue" SG_ 154 OBJ_Length_7 12;
BA_ "GenSigStartValue" SG_ 154 OBJ_Width_8 40;
BA_ "GenSigStartValue" SG_ 154 OBJ_Length_8 12;
BA_ "GenSigStartValue" SG_ 154 OBJ_Width_9 40;
BA_ "GenSigStartValue" SG_ 154 OBJ_Length_9 12;
BA_ "GenSigStartValue" SG_ 154 OBJ_Width_10 40;
BA_ "GenSigStartValue" SG_ 154 OBJ_Length_10 12;
BA_ "GenSigStartValue" SG_ 154 OBJ_Width_11 40;
BA_ "GenSigStartValue" SG_ 154 OBJ_Length_11 12;
VAL_ 154 OBJ_Angle_Right_STD_V_5 1 "VALID" 0 "INVALID" ;
VAL_ 154 OBJ_Angle_Left_V_5 1 "VALID" 0 "INVALID" ;
VAL_ 154 OBJ_Angle_Left_STD_V_5 1 "VALID" 0 "INVALID" ;
VAL_ 154 OBJ_Angle_Side_V_5 1 "VALID" 0 "INVALID" ;
VAL_ 154 OBJ_Angle_Side_STD_V_5 1 "VALID" 0 "INVALID" ;
VAL_ 154 OBJ_Angle_Mid_V_5 1 "VALID" 0 "INVALID" ;
VAL_ 154 OBJ_Angle_Mid_STD_V_5 1 "VALID" 0 "INVALID" ;
VAL_ 154 OBJ_Angle_Bottom_V_5 1 "VALID" 0 "INVALID" ;
VAL_ 154 OBJ_Angle_Bottom_STD_V_5 1 "VALID" 0 "INVALID" ;
VAL_ 154 OBJ_Visibility_Side_V_5 1 "VALID" 0 "INVALID" ;
VAL_ 154 OBJ_Visibility_Side_5 2 "REAR" 1 "FRONT" 0 "NOT_VISIBLE" ;
VAL_ 154 OBJ_Is_In_Drivable_Area_5 1 "TRUE" 0 "FALSE" ;
VAL_ 154 OBJ_Is_In_Drivable_Area_V_5 1 "VALID" 0 "INVALID" ;
VAL_ 154 OBJ_Is_VeryClose_V_5 1 "VALID" 0 "INVALID" ;
VAL_ 154 OBJ_Is_VeryClose_5 1 "TRUE" 0 "FALSE" ;
VAL_ 154 OBJ_OverlapAngleEgoLaneR_V_5 1 "VALID" 0 "INVALID" ;
VAL_ 154 OBJ_OverlapAngleEgoLaneL_V_5 1 "VALID" 0 "INVALID" ;
VAL_ 154 OBJ_Is_EMERGENCY_VCL_5 1 "TRUE" 0 "FALSE" ;
VAL_ 154 OBJ_EMERGENCY_LIGHT_COLOR_5 3 "(1000)ORANGE" 2 "(0100)BLUE" 1 "(0010)RED" 0 "(0001)OTHER" ;
VAL_ 154 OBJ_EMERGENCY_V_5 1 "TRUE" 0 "FALSE" ;
VAL_ 154 OBJ_Angle_Top_V_5 1 "VALID" 0 "INVALID" ;
VAL_ 154 OBJ_Angle_Top_STD_V_5 1 "VALID" 0 "INVALID" ;
VAL_ 154 OBJ_Open_Door_Left_5 1 "TRUE" 0 "FALSE" ;
VAL_ 154 OBJ_Open_Door_Right_5 1 "TRUE" 0 "FALSE" ;
VAL_ 154 OBJ_Visible_Left_or_Right_5 2 "RIGHT" 1 "LEFT" 0 "NOT_VISIBLE" ;
VAL_ 154 OBJ_Visible_Left_or_Right_V_5 1 "VALID" 0 "INVALID" ;
VAL_ 154 OBJ_Fusion_Source_6 2 "(BIT_2)RADAR2" 1 "(BIT_1)RADAR1" 0 "(BIT_0)CAMERA" ;
VAL_ 154 OBJ_Triggered_SDM_6 2 "NOT_TRIGGERED" 1 "TRIGGERED" 0 "NOT_AVAILABLE" ;
VAL_ 154 OBJ_Motion_Category_6 13 "ONCOMING" 12 "PRECEEDING" 11 "MOVING" 10 "RTAP" 9 "LTAP" 8 "CROSSING" 7 "MOVING_OUT" 6 "MOVING_IN" 5 "CLOSE_CUT_IN" 4 "PASSING_OUT" 3 "PASSING_IN" 2 "PASSING" 1 "UNDEFINED" 0 "UNFILLED" ;
VAL_ 154 OBJ_Measuring_Status_6 2 "(BIT_2)NOT_VALID_OR_VALID" 1 "(BIT_1)PREDICTED_OR_MEASURED" 0 "(BIT_0)OLD_OR_NEW" ;
VAL_ 154 OBJ_Object_Class_6 9 "TWO_WHEELER" 8 "UNCERTAIN_VCL" 7 "ANIMAL" 6 "GENERAL_OBJECT" 5 "PEDESTRIAN" 4 "BICYCLE" 3 "MOTORBIKE" 2 "TRUCK" 1 "CAR" 0 "UNFILLED" ;
VAL_ 154 OBJ_Camera_Source_6 11 "PARKING_RIGHT" 10 "PARKING_LEFT" 9 "PARKING_REAR" 8 "PARKING_FRONT" 7 "FRONT_CORNER_RIGHT" 6 "FRONT_CORNER_LEFT" 5 "REAR_CORNER_RIGHT" 4 "REAR_CORNER_LEFT" 3 "REAR" 2 "FRONT_FISHEYE" 1 "FRONT_NARROW" 0 "FRONT_MAIN" ;
VAL_ 154 OBJ_Motion_Status_6 5 "MOVING_SLOWLY" 4 "STOPPED" 3 "STATIONARY" 2 "MOVING" 1 "UNKNOWN" 0 "INVALID" ;
VAL_ 154 OBJ_Motion_Orientation_6 13 "INVALID" 12 "NORTH" 11 "NORTH_WEST" 9 "WEST" 7 "SOUTH_WEST" 6 "SOUTH" 5 "SOUTH_EAST" 3 "EAST" 1 "NORTH_EAST" 0 "UNKNOWN" ;
VAL_ 154 OBJ_Has_Cut_Lane_6 1 "TRUE" 0 "FALSE" ;
VAL_ 154 OBJ_Has_Cut_Path_6 1 "TRUE" 0 "FALSE" ;
VAL_ 154 OBJ_Brake_Light_Validity_6 1 "TRUE" 0 "FALSE" ;
VAL_ 154 OBJ_Brake_Light_6 1 "TRUE" 0 "FALSE" ;
VAL_ 154 OBJ_Turn_Indicator_Right_6 1 "TRUE" 0 "FALSE" ;
VAL_ 154 OBJ_Turn_Indicator_Left_6 1 "TRUE" 0 "FALSE" ;
VAL_ 154 OBJ_Turn_Indicator_Validity_6 1 "TRUE" 0 "FALSE" ;
VAL_ 154 OBJ_Right_Out_Of_Image_6 1 "TRUE" 0 "FALSE" ;
VAL_ 154 OBJ_Left_Out_Of_Image_6 1 "TRUE" 0 "FALSE" ;
VAL_ 154 OBJ_Right_Out_Of_Image_V_6 1 "TRUE" 0 "FALSE" ;
VAL_ 154 OBJ_Left_Out_Of_Image_V_6 1 "TRUE" 0 "FALSE" ;
VAL_ 154 OBJ_Top_Out_Of_Image_6 1 "TRUE" 0 "FALSE" ;
VAL_ 154 OBJ_Bottom_Out_Of_Image_6 1 "TRUE" 0 "FALSE" ;
VAL_ 154 OBJ_Top_Out_Of_Image_V_6 1 "VALID" 0 "INVALID" ;
VAL_ 154 OBJ_Bottom_Out_Of_Image_V_6 1 "VALID" 0 "INVALID" ;
VAL_ 154 OBJ_Lane_Assignment_6 5 "RIGHT_RIGHT" 4 "RIGHT" 3 "HOST" 2 "LEFT" 1 "LEFT_LEFT" 0 "UNKNOWN" ;
VAL_ 154 OBJ_Lane_Assignment_V_6 1 "VALID" 0 "INVALID" ;
VAL_ 154 OBJ_Age_Seconds_V_6 1 "VALID" 0 "INVALID" ;
VAL_ 154 OBJ_Width_V_6 1 "VALID" 0 "INVALID" ;
VAL_ 154 OBJ_Width_STD_V_6 1 "VALID" 0 "INVALID" ;
VAL_ 154 OBJ_Length_V_6 1 "VALID" 0 "INVALID" ;
VAL_ 154 OBJ_Length_STD_V_6 1 "VALID" 0 "INVALID" ;
VAL_ 154 OBJ_Height_V_6 1 "VALID" 0 "INVALID" ;
VAL_ 154 OBJ_Height_STD_V_6 1 "VALID" 0 "INVALID" ;
VAL_ 154 OBJ_Abs_Long_Velocity_V_6 1 "VALID" 0 "INVALID" ;
VAL_ 154 OBJ_Abs_Long_Vel_STD_V_6 1 "VALID" 0 "INVALID" ;
VAL_ 154 OBJ_Abs_Lat_Velocity_V_6 1 "VALID" 0 "INVALID" ;
VAL_ 154 OBJ_Abs_Lat_Vel_STD_V_6 1 "VALID" 0 "INVALID" ;
VAL_ 154 OBJ_Abs_Long_Acc_V_6 1 "VALID" 0 "INVALID" ;
VAL_ 154 OBJ_Abs_Long_Acc_STD_V_6 1 "VALID" 0 "INVALID" ;
VAL_ 154 OBJ_Abs_Lat_Acc_V_6 1 "VALID" 0 "INVALID" ;
VAL_ 154 OBJ_Abs_Lat_Acc_STD_V_6 1 "VALID" 0 "INVALID" ;
VAL_ 154 OBJ_Abs_Acceleration_V_6 1 "VALID" 0 "INVALID" ;
VAL_ 154 OBJ_Abs_Acc_STD_V_6 1 "VALID" 0 "INVALID" ;
VAL_ 154 OBJ_Inv_TTC_V_6 1 "VALID" 0 "INVALID" ;
VAL_ 154 OBJ_Inv_TTC_STD_V_6 1 "VALID" 0 "INVALID" ;
VAL_ 154 OBJ_Relative_Long_Acc_V_6 1 "VALID" 0 "INVALID" ;
VAL_ 154 OBJ_Rel_Long_Acc_STD_V_6 1 "VALID" 0 "INVALID" ;
VAL_ 154 OBJ_Relative_Long_Velocity_V_6 1 "VALID" 0 "INVALID" ;
VAL_ 154 OBJ_Rel_Long_Vel_STD_V_6 1 "VALID" 0 "INVALID" ;
VAL_ 154 OBJ_Relative_Lat_Velocity_V_6 1 "VALID" 0 "INVALID" ;
VAL_ 154 OBJ_Rel_Lat_Vel_STD_V_6 1 "VALID" 0 "INVALID" ;
VAL_ 154 OBJ_Long_Distance_V_6 1 "VALID" 0 "INVALID" ;
VAL_ 154 OBJ_Long_Distance_STD_V_6 1 "VALID" 0 "INVALID" ;
VAL_ 154 OBJ_Lat_Distance_V_6 1 "VALID" 0 "INVALID" ;
VAL_ 154 OBJ_Lat_Distance_STD_V_6 1 "VALID" 0 "INVALID" ;
VAL_ 154 OBJ_Absolute_Speed_V_6 1 "VALID" 0 "INVALID" ;
VAL_ 154 OBJ_Absolute_Speed_STD_V_6 1 "VALID" 0 "INVALID" ;
VAL_ 154 OBJ_Heading_V_6 1 "VALID" 0 "INVALID" ;
VAL_ 154 OBJ_Heading_STD_V_6 1 "VALID" 0 "INVALID" ;
VAL_ 154 OBJ_Angle_Rate_STD_V_6 1 "VALID" 0 "INVALID" ;
VAL_ 154 OBJ_Angle_Rate_V_6 1 "VALID" 0 "INVALID" ;
VAL_ 154 OBJ_Angle_Right_V_6 1 "VALID" 0 "INVALID" ;
VAL_ 154 OBJ_Angle_Right_STD_V_6 1 "VALID" 0 "INVALID" ;
VAL_ 154 OBJ_Angle_Left_V_6 1 "VALID" 0 "INVALID" ;
VAL_ 154 OBJ_Angle_Left_STD_V_6 1 "VALID" 0 "INVALID" ;
VAL_ 154 OBJ_Angle_Side_V_6 1 "VALID" 0 "INVALID" ;
VAL_ 154 OBJ_Angle_Side_STD_V_6 1 "VALID" 0 "INVALID" ;
VAL_ 154 OBJ_Angle_Mid_V_6 1 "VALID" 0 "INVALID" ;
VAL_ 154 OBJ_Angle_Mid_STD_V_6 1 "VALID" 0 "INVALID" ;
VAL_ 154 OBJ_Angle_Bottom_V_6 1 "VALID" 0 "INVALID" ;
VAL_ 154 OBJ_Angle_Bottom_STD_V_6 1 "VALID" 0 "INVALID" ;
VAL_ 154 OBJ_Visibility_Side_V_6 1 "VALID" 0 "INVALID" ;
VAL_ 154 OBJ_Visibility_Side_6 2 "REAR" 1 "FRONT" 0 "NOT_VISIBLE" ;
VAL_ 154 OBJ_Is_In_Drivable_Area_6 1 "TRUE" 0 "FALSE" ;
VAL_ 154 OBJ_Is_In_Drivable_Area_V_6 1 "VALID" 0 "INVALID" ;
VAL_ 154 OBJ_Is_VeryClose_V_6 1 "VALID" 0 "INVALID" ;
VAL_ 154 OBJ_Is_VeryClose_6 1 "TRUE" 0 "FALSE" ;
VAL_ 154 OBJ_OverlapAngleEgoLaneR_V_6 1 "VALID" 0 "INVALID" ;
VAL_ 154 OBJ_OverlapAngleEgoLaneL_V_6 1 "VALID" 0 "INVALID" ;
VAL_ 154 OBJ_Is_EMERGENCY_VCL_6 1 "TRUE" 0 "FALSE" ;
VAL_ 154 OBJ_EMERGENCY_LIGHT_COLOR_6 3 "(1000)ORANGE" 2 "(0100)BLUE" 1 "(0010)RED" 0 "(0001)OTHER" ;
VAL_ 154 OBJ_EMERGENCY_V_6 1 "TRUE" 0 "FALSE" ;
VAL_ 154 OBJ_Angle_Top_V_6 1 "VALID" 0 "INVALID" ;
VAL_ 154 OBJ_Angle_Top_STD_V_6 1 "VALID" 0 "INVALID" ;
VAL_ 154 OBJ_Open_Door_Left_6 1 "TRUE" 0 "FALSE" ;
VAL_ 154 OBJ_Open_Door_Right_6 1 "TRUE" 0 "FALSE" ;
VAL_ 154 OBJ_Visible_Left_or_Right_6 2 "RIGHT" 1 "LEFT" 0 "NOT_VISIBLE" ;
VAL_ 154 OBJ_Visible_Left_or_Right_V_6 1 "VALID" 0 "INVALID" ;
VAL_ 154 OBJ_Fusion_Source_7 2 "(BIT_2)RADAR2" 1 "(BIT_1)RADAR1" 0 "(BIT_0)CAMERA" ;
VAL_ 154 OBJ_Triggered_SDM_7 2 "NOT_TRIGGERED" 1 "TRIGGERED" 0 "NOT_AVAILABLE" ;
VAL_ 154 OBJ_Motion_Category_7 13 "ONCOMING" 12 "PRECEEDING" 11 "MOVING" 10 "RTAP" 9 "LTAP" 8 "CROSSING" 7 "MOVING_OUT" 6 "MOVING_IN" 5 "CLOSE_CUT_IN" 4 "PASSING_OUT" 3 "PASSING_IN" 2 "PASSING" 1 "UNDEFINED" 0 "UNFILLED" ;
VAL_ 154 OBJ_Measuring_Status_7 2 "(BIT_2)NOT_VALID_OR_VALID" 1 "(BIT_1)PREDICTED_OR_MEASURED" 0 "(BIT_0)OLD_OR_NEW" ;
VAL_ 154 OBJ_Object_Class_7 9 "TWO_WHEELER" 8 "UNCERTAIN_VCL" 7 "ANIMAL" 6 "GENERAL_OBJECT" 5 "PEDESTRIAN" 4 "BICYCLE" 3 "MOTORBIKE" 2 "TRUCK" 1 "CAR" 0 "UNFILLED" ;
VAL_ 154 OBJ_Camera_Source_7 11 "PARKING_RIGHT" 10 "PARKING_LEFT" 9 "PARKING_REAR" 8 "PARKING_FRONT" 7 "FRONT_CORNER_RIGHT" 6 "FRONT_CORNER_LEFT" 5 "REAR_CORNER_RIGHT" 4 "REAR_CORNER_LEFT" 3 "REAR" 2 "FRONT_FISHEYE" 1 "FRONT_NARROW" 0 "FRONT_MAIN" ;
VAL_ 154 OBJ_Motion_Status_7 5 "MOVING_SLOWLY" 4 "STOPPED" 3 "STATIONARY" 2 "MOVING" 1 "UNKNOWN" 0 "INVALID" ;
VAL_ 154 OBJ_Motion_Orientation_7 13 "INVALID" 12 "NORTH" 11 "NORTH_WEST" 9 "WEST" 7 "SOUTH_WEST" 6 "SOUTH" 5 "SOUTH_EAST" 3 "EAST" 1 "NORTH_EAST" 0 "UNKNOWN" ;
VAL_ 154 OBJ_Has_Cut_Lane_7 1 "TRUE" 0 "FALSE" ;
VAL_ 154 OBJ_Has_Cut_Path_7 1 "TRUE" 0 "FALSE" ;
VAL_ 154 OBJ_Brake_Light_Validity_7 1 "TRUE" 0 "FALSE" ;
VAL_ 154 OBJ_Brake_Light_7 1 "TRUE" 0 "FALSE" ;
VAL_ 154 OBJ_Turn_Indicator_Right_7 1 "TRUE" 0 "FALSE" ;
VAL_ 154 OBJ_Turn_Indicator_Left_7 1 "TRUE" 0 "FALSE" ;
VAL_ 154 OBJ_Turn_Indicator_Validity_7 1 "TRUE" 0 "FALSE" ;
VAL_ 154 OBJ_Right_Out_Of_Image_7 1 "TRUE" 0 "FALSE" ;
VAL_ 154 OBJ_Left_Out_Of_Image_7 1 "TRUE" 0 "FALSE" ;
VAL_ 154 OBJ_Right_Out_Of_Image_V_7 1 "TRUE" 0 "FALSE" ;
VAL_ 154 OBJ_Left_Out_Of_Image_V_7 1 "TRUE" 0 "FALSE" ;
VAL_ 154 OBJ_Top_Out_Of_Image_7 1 "TRUE" 0 "FALSE" ;
VAL_ 154 OBJ_Bottom_Out_Of_Image_7 1 "TRUE" 0 "FALSE" ;
VAL_ 154 OBJ_Top_Out_Of_Image_V_7 1 "VALID" 0 "INVALID" ;
VAL_ 154 OBJ_Bottom_Out_Of_Image_V_7 1 "VALID" 0 "INVALID" ;
VAL_ 154 OBJ_Lane_Assignment_7 5 "RIGHT_RIGHT" 4 "RIGHT" 3 "HOST" 2 "LEFT" 1 "LEFT_LEFT" 0 "UNKNOWN" ;
VAL_ 154 OBJ_Lane_Assignment_V_7 1 "VALID" 0 "INVALID" ;
VAL_ 154 OBJ_Age_Seconds_V_7 1 "VALID" 0 "INVALID" ;
VAL_ 154 OBJ_Width_V_7 1 "VALID" 0 "INVALID" ;
VAL_ 154 OBJ_Width_STD_V_7 1 "VALID" 0 "INVALID" ;
VAL_ 154 OBJ_Length_V_7 1 "VALID" 0 "INVALID" ;
VAL_ 154 OBJ_Length_STD_V_7 1 "VALID" 0 "INVALID" ;
VAL_ 154 OBJ_Height_V_7 1 "VALID" 0 "INVALID" ;
VAL_ 154 OBJ_Height_STD_V_7 1 "VALID" 0 "INVALID" ;
VAL_ 154 OBJ_Abs_Long_Velocity_V_7 1 "VALID" 0 "INVALID" ;
VAL_ 154 OBJ_Abs_Long_Vel_STD_V_7 1 "VALID" 0 "INVALID" ;
VAL_ 154 OBJ_Abs_Lat_Velocity_V_7 1 "VALID" 0 "INVALID" ;
VAL_ 154 OBJ_Abs_Lat_Vel_STD_V_7 1 "VALID" 0 "INVALID" ;
VAL_ 154 OBJ_Abs_Long_Acc_V_7 1 "VALID" 0 "INVALID" ;
VAL_ 154 OBJ_Abs_Long_Acc_STD_V_7 1 "VALID" 0 "INVALID" ;
VAL_ 154 OBJ_Abs_Lat_Acc_V_7 1 "VALID" 0 "INVALID" ;
VAL_ 154 OBJ_Abs_Lat_Acc_STD_V_7 1 "VALID" 0 "INVALID" ;
VAL_ 154 OBJ_Abs_Acceleration_V_7 1 "VALID" 0 "INVALID" ;
VAL_ 154 OBJ_Abs_Acc_STD_V_7 1 "VALID" 0 "INVALID" ;
VAL_ 154 OBJ_Inv_TTC_V_7 1 "VALID" 0 "INVALID" ;
VAL_ 154 OBJ_Inv_TTC_STD_V_7 1 "VALID" 0 "INVALID" ;
VAL_ 154 OBJ_Relative_Long_Acc_V_7 1 "VALID" 0 "INVALID" ;
VAL_ 154 OBJ_Rel_Long_Acc_STD_V_7 1 "VALID" 0 "INVALID" ;
VAL_ 154 OBJ_Relative_Long_Velocity_V_7 1 "VALID" 0 "INVALID" ;
VAL_ 154 OBJ_Rel_Long_Vel_STD_V_7 1 "VALID" 0 "INVALID" ;
VAL_ 154 OBJ_Relative_Lat_Velocity_V_7 1 "VALID" 0 "INVALID" ;
VAL_ 154 OBJ_Rel_Lat_Vel_STD_V_7 1 "VALID" 0 "INVALID" ;
VAL_ 154 OBJ_Long_Distance_V_7 1 "VALID" 0 "INVALID" ;
VAL_ 154 OBJ_Long_Distance_STD_V_7 1 "VALID" 0 "INVALID" ;
VAL_ 154 OBJ_Lat_Distance_V_7 1 "VALID" 0 "INVALID" ;
VAL_ 154 OBJ_Lat_Distance_STD_V_7 1 "VALID" 0 "INVALID" ;
VAL_ 154 OBJ_Absolute_Speed_V_7 1 "VALID" 0 "INVALID" ;
VAL_ 154 OBJ_Absolute_Speed_STD_V_7 1 "VALID" 0 "INVALID" ;
VAL_ 154 OBJ_Heading_V_7 1 "VALID" 0 "INVALID" ;
VAL_ 154 OBJ_Heading_STD_V_7 1 "VALID" 0 "INVALID" ;
VAL_ 154 OBJ_Angle_Rate_STD_V_7 1 "VALID" 0 "INVALID" ;
VAL_ 154 OBJ_Angle_Rate_V_7 1 "VALID" 0 "INVALID" ;
VAL_ 154 OBJ_Angle_Right_V_7 1 "VALID" 0 "INVALID" ;
VAL_ 154 OBJ_Angle_Right_STD_V_7 1 "VALID" 0 "INVALID" ;
VAL_ 154 OBJ_Angle_Left_V_7 1 "VALID" 0 "INVALID" ;
VAL_ 154 OBJ_Angle_Left_STD_V_7 1 "VALID" 0 "INVALID" ;
VAL_ 154 OBJ_Angle_Side_V_7 1 "VALID" 0 "INVALID" ;
VAL_ 154 OBJ_Angle_Side_STD_V_7 1 "VALID" 0 "INVALID" ;
VAL_ 154 OBJ_Angle_Mid_V_7 1 "VALID" 0 "INVALID" ;
VAL_ 154 OBJ_Angle_Mid_STD_V_7 1 "VALID" 0 "INVALID" ;
VAL_ 154 OBJ_Angle_Bottom_V_7 1 "VALID" 0 "INVALID" ;
VAL_ 154 OBJ_Angle_Bottom_STD_V_7 1 "VALID" 0 "INVALID" ;
VAL_ 154 OBJ_Visibility_Side_V_7 1 "VALID" 0 "INVALID" ;
VAL_ 154 OBJ_Visibility_Side_7 2 "REAR" 1 "FRONT" 0 "NOT_VISIBLE" ;
VAL_ 154 OBJ_Is_In_Drivable_Area_7 1 "TRUE" 0 "FALSE" ;
VAL_ 154 OBJ_Is_In_Drivable_Area_V_7 1 "VALID" 0 "INVALID" ;
VAL_ 154 OBJ_Is_VeryClose_V_7 1 "VALID" 0 "INVALID" ;
VAL_ 154 OBJ_Is_VeryClose_7 1 "TRUE" 0 "FALSE" ;
VAL_ 154 OBJ_OverlapAngleEgoLaneR_V_7 1 "VALID" 0 "INVALID" ;
VAL_ 154 OBJ_OverlapAngleEgoLaneL_V_7 1 "VALID" 0 "INVALID" ;
VAL_ 154 OBJ_Is_EMERGENCY_VCL_7 1 "TRUE" 0 "FALSE" ;
VAL_ 154 OBJ_EMERGENCY_LIGHT_COLOR_7 3 "(1000)ORANGE" 2 "(0100)BLUE" 1 "(0010)RED" 0 "(0001)OTHER" ;
VAL_ 154 OBJ_EMERGENCY_V_7 1 "TRUE" 0 "FALSE" ;
VAL_ 154 OBJ_Angle_Top_V_7 1 "VALID" 0 "INVALID" ;
VAL_ 154 OBJ_Angle_Top_STD_V_7 1 "VALID" 0 "INVALID" ;
VAL_ 154 OBJ_Open_Door_Left_7 1 "TRUE" 0 "FALSE" ;
VAL_ 154 OBJ_Open_Door_Right_7 1 "TRUE" 0 "FALSE" ;
VAL_ 154 OBJ_Visible_Left_or_Right_7 2 "RIGHT" 1 "LEFT" 0 "NOT_VISIBLE" ;
VAL_ 154 OBJ_Visible_Left_or_Right_V_7 1 "VALID" 0 "INVALID" ;
VAL_ 154 OBJ_Fusion_Source_8 2 "(BIT_2)RADAR2" 1 "(BIT_1)RADAR1" 0 "(BIT_0)CAMERA" ;
VAL_ 154 OBJ_Triggered_SDM_8 2 "NOT_TRIGGERED" 1 "TRIGGERED" 0 "NOT_AVAILABLE" ;
VAL_ 154 OBJ_Motion_Category_8 13 "ONCOMING" 12 "PRECEEDING" 11 "MOVING" 10 "RTAP" 9 "LTAP" 8 "CROSSING" 7 "MOVING_OUT" 6 "MOVING_IN" 5 "CLOSE_CUT_IN" 4 "PASSING_OUT" 3 "PASSING_IN" 2 "PASSING" 1 "UNDEFINED" 0 "UNFILLED" ;
VAL_ 154 OBJ_Measuring_Status_8 2 "(BIT_2)NOT_VALID_OR_VALID" 1 "(BIT_1)PREDICTED_OR_MEASURED" 0 "(BIT_0)OLD_OR_NEW" ;
VAL_ 154 OBJ_Object_Class_8 9 "TWO_WHEELER" 8 "UNCERTAIN_VCL" 7 "ANIMAL" 6 "GENERAL_OBJECT" 5 "PEDESTRIAN" 4 "BICYCLE" 3 "MOTORBIKE" 2 "TRUCK" 1 "CAR" 0 "UNFILLED" ;
VAL_ 154 OBJ_Camera_Source_8 11 "PARKING_RIGHT" 10 "PARKING_LEFT" 9 "PARKING_REAR" 8 "PARKING_FRONT" 7 "FRONT_CORNER_RIGHT" 6 "FRONT_CORNER_LEFT" 5 "REAR_CORNER_RIGHT" 4 "REAR_CORNER_LEFT" 3 "REAR" 2 "FRONT_FISHEYE" 1 "FRONT_NARROW" 0 "FRONT_MAIN" ;
VAL_ 154 OBJ_Motion_Status_8 5 "MOVING_SLOWLY" 4 "STOPPED" 3 "STATIONARY" 2 "MOVING" 1 "UNKNOWN" 0 "INVALID" ;
VAL_ 154 OBJ_Motion_Orientation_8 13 "INVALID" 12 "NORTH" 11 "NORTH_WEST" 9 "WEST" 7 "SOUTH_WEST" 6 "SOUTH" 5 "SOUTH_EAST" 3 "EAST" 1 "NORTH_EAST" 0 "UNKNOWN" ;
VAL_ 154 OBJ_Has_Cut_Lane_8 1 "TRUE" 0 "FALSE" ;
VAL_ 154 OBJ_Has_Cut_Path_8 1 "TRUE" 0 "FALSE" ;
VAL_ 154 OBJ_Brake_Light_Validity_8 1 "TRUE" 0 "FALSE" ;
VAL_ 154 OBJ_Brake_Light_8 1 "TRUE" 0 "FALSE" ;
VAL_ 154 OBJ_Turn_Indicator_Right_8 1 "TRUE" 0 "FALSE" ;
VAL_ 154 OBJ_Turn_Indicator_Left_8 1 "TRUE" 0 "FALSE" ;
VAL_ 154 OBJ_Turn_Indicator_Validity_8 1 "TRUE" 0 "FALSE" ;
VAL_ 154 OBJ_Right_Out_Of_Image_8 1 "TRUE" 0 "FALSE" ;
VAL_ 154 OBJ_Left_Out_Of_Image_8 1 "TRUE" 0 "FALSE" ;
VAL_ 154 OBJ_Right_Out_Of_Image_V_8 1 "TRUE" 0 "FALSE" ;
VAL_ 154 OBJ_Left_Out_Of_Image_V_8 1 "TRUE" 0 "FALSE" ;
VAL_ 154 OBJ_Top_Out_Of_Image_8 1 "TRUE" 0 "FALSE" ;
VAL_ 154 OBJ_Bottom_Out_Of_Image_8 1 "TRUE" 0 "FALSE" ;
VAL_ 154 OBJ_Top_Out_Of_Image_V_8 1 "VALID" 0 "INVALID" ;
VAL_ 154 OBJ_Bottom_Out_Of_Image_V_8 1 "VALID" 0 "INVALID" ;
VAL_ 154 OBJ_Lane_Assignment_8 5 "RIGHT_RIGHT" 4 "RIGHT" 3 "HOST" 2 "LEFT" 1 "LEFT_LEFT" 0 "UNKNOWN" ;
VAL_ 154 OBJ_Lane_Assignment_V_8 1 "VALID" 0 "INVALID" ;
VAL_ 154 OBJ_Age_Seconds_V_8 1 "VALID" 0 "INVALID" ;
VAL_ 154 OBJ_Width_V_8 1 "VALID" 0 "INVALID" ;
VAL_ 154 OBJ_Width_STD_V_8 1 "VALID" 0 "INVALID" ;
VAL_ 154 OBJ_Length_V_8 1 "VALID" 0 "INVALID" ;
VAL_ 154 OBJ_Length_STD_V_8 1 "VALID" 0 "INVALID" ;
VAL_ 154 OBJ_Height_V_8 1 "VALID" 0 "INVALID" ;
VAL_ 154 OBJ_Height_STD_V_8 1 "VALID" 0 "INVALID" ;
VAL_ 154 OBJ_Abs_Long_Velocity_V_8 1 "VALID" 0 "INVALID" ;
VAL_ 154 OBJ_Abs_Long_Vel_STD_V_8 1 "VALID" 0 "INVALID" ;
VAL_ 154 OBJ_Abs_Lat_Velocity_V_8 1 "VALID" 0 "INVALID" ;
VAL_ 154 OBJ_Abs_Lat_Vel_STD_V_8 1 "VALID" 0 "INVALID" ;
VAL_ 154 OBJ_Abs_Long_Acc_V_8 1 "VALID" 0 "INVALID" ;
VAL_ 154 OBJ_Abs_Long_Acc_STD_V_8 1 "VALID" 0 "INVALID" ;
VAL_ 154 OBJ_Abs_Lat_Acc_V_8 1 "VALID" 0 "INVALID" ;
VAL_ 154 OBJ_Abs_Lat_Acc_STD_V_8 1 "VALID" 0 "INVALID" ;
VAL_ 154 OBJ_Abs_Acceleration_V_8 1 "VALID" 0 "INVALID" ;
VAL_ 154 OBJ_Abs_Acc_STD_V_8 1 "VALID" 0 "INVALID" ;
VAL_ 154 OBJ_Inv_TTC_V_8 1 "VALID" 0 "INVALID" ;
VAL_ 154 OBJ_Inv_TTC_STD_V_8 1 "VALID" 0 "INVALID" ;
VAL_ 154 OBJ_Relative_Long_Acc_V_8 1 "VALID" 0 "INVALID" ;
VAL_ 154 OBJ_Rel_Long_Acc_STD_V_8 1 "VALID" 0 "INVALID" ;
VAL_ 154 OBJ_Relative_Long_Velocity_V_8 1 "VALID" 0 "INVALID" ;
VAL_ 154 OBJ_Rel_Long_Vel_STD_V_8 1 "VALID" 0 "INVALID" ;
VAL_ 154 OBJ_Relative_Lat_Velocity_V_8 1 "VALID" 0 "INVALID" ;
VAL_ 154 OBJ_Rel_Lat_Vel_STD_V_8 1 "VALID" 0 "INVALID" ;
VAL_ 154 OBJ_Long_Distance_V_8 1 "VALID" 0 "INVALID" ;
VAL_ 154 OBJ_Long_Distance_STD_V_8 1 "VALID" 0 "INVALID" ;
VAL_ 154 OBJ_Lat_Distance_V_8 1 "VALID" 0 "INVALID" ;
VAL_ 154 OBJ_Lat_Distance_STD_V_8 1 "VALID" 0 "INVALID" ;
VAL_ 154 OBJ_Absolute_Speed_V_8 1 "VALID" 0 "INVALID" ;
VAL_ 154 OBJ_Absolute_Speed_STD_V_8 1 "VALID" 0 "INVALID" ;
VAL_ 154 OBJ_Heading_V_8 1 "VALID" 0 "INVALID" ;
VAL_ 154 OBJ_Heading_STD_V_8 1 "VALID" 0 "INVALID" ;
VAL_ 154 OBJ_Angle_Rate_STD_V_8 1 "VALID" 0 "INVALID" ;
VAL_ 154 OBJ_Angle_Rate_V_8 1 "VALID" 0 "INVALID" ;
VAL_ 154 OBJ_Angle_Right_V_8 1 "VALID" 0 "INVALID" ;
VAL_ 154 OBJ_Angle_Right_STD_V_8 1 "VALID" 0 "INVALID" ;
VAL_ 154 OBJ_Angle_Left_V_8 1 "VALID" 0 "INVALID" ;
VAL_ 154 OBJ_Angle_Left_STD_V_8 1 "VALID" 0 "INVALID" ;
VAL_ 154 OBJ_Angle_Side_V_8 1 "VALID" 0 "INVALID" ;
VAL_ 154 OBJ_Angle_Side_STD_V_8 1 "VALID" 0 "INVALID" ;
VAL_ 154 OBJ_Angle_Mid_V_8 1 "VALID" 0 "INVALID" ;
VAL_ 154 OBJ_Angle_Mid_STD_V_8 1 "VALID" 0 "INVALID" ;
VAL_ 154 OBJ_Angle_Bottom_V_8 1 "VALID" 0 "INVALID" ;
VAL_ 154 OBJ_Angle_Bottom_STD_V_8 1 "VALID" 0 "INVALID" ;
VAL_ 154 OBJ_Visibility_Side_V_8 1 "VALID" 0 "INVALID" ;
VAL_ 154 OBJ_Visibility_Side_8 2 "REAR" 1 "FRONT" 0 "NOT_VISIBLE" ;
VAL_ 154 OBJ_Is_In_Drivable_Area_8 1 "TRUE" 0 "FALSE" ;
VAL_ 154 OBJ_Is_In_Drivable_Area_V_8 1 "VALID" 0 "INVALID" ;
VAL_ 154 OBJ_Is_VeryClose_V_8 1 "VALID" 0 "INVALID" ;
VAL_ 154 OBJ_Is_VeryClose_8 1 "TRUE" 0 "FALSE" ;
VAL_ 154 OBJ_OverlapAngleEgoLaneR_V_8 1 "VALID" 0 "INVALID" ;
VAL_ 154 OBJ_OverlapAngleEgoLaneL_V_8 1 "VALID" 0 "INVALID" ;
VAL_ 154 OBJ_Is_EMERGENCY_VCL_8 1 "TRUE" 0 "FALSE" ;
VAL_ 154 OBJ_EMERGENCY_LIGHT_COLOR_8 3 "(1000)ORANGE" 2 "(0100)BLUE" 1 "(0010)RED" 0 "(0001)OTHER" ;
VAL_ 154 OBJ_EMERGENCY_V_8 1 "TRUE" 0 "FALSE" ;
VAL_ 154 OBJ_Angle_Top_V_8 1 "VALID" 0 "INVALID" ;
VAL_ 154 OBJ_Angle_Top_STD_V_8 1 "VALID" 0 "INVALID" ;
VAL_ 154 OBJ_Open_Door_Left_8 1 "TRUE" 0 "FALSE" ;
VAL_ 154 OBJ_Open_Door_Right_8 1 "TRUE" 0 "FALSE" ;
VAL_ 154 OBJ_Visible_Left_or_Right_8 2 "RIGHT" 1 "LEFT" 0 "NOT_VISIBLE" ;
VAL_ 154 OBJ_Visible_Left_or_Right_V_8 1 "VALID" 0 "INVALID" ;
VAL_ 154 OBJ_Fusion_Source_9 2 "(BIT_2)RADAR2" 1 "(BIT_1)RADAR1" 0 "(BIT_0)CAMERA" ;
VAL_ 154 OBJ_Triggered_SDM_9 2 "NOT_TRIGGERED" 1 "TRIGGERED" 0 "NOT_AVAILABLE" ;
VAL_ 154 OBJ_Motion_Category_9 13 "ONCOMING" 12 "PRECEEDING" 11 "MOVING" 10 "RTAP" 9 "LTAP" 8 "CROSSING" 7 "MOVING_OUT" 6 "MOVING_IN" 5 "CLOSE_CUT_IN" 4 "PASSING_OUT" 3 "PASSING_IN" 2 "PASSING" 1 "UNDEFINED" 0 "UNFILLED" ;
VAL_ 154 OBJ_Measuring_Status_9 2 "(BIT_2)NOT_VALID_OR_VALID" 1 "(BIT_1)PREDICTED_OR_MEASURED" 0 "(BIT_0)OLD_OR_NEW" ;
VAL_ 154 OBJ_Object_Class_9 9 "TWO_WHEELER" 8 "UNCERTAIN_VCL" 7 "ANIMAL" 6 "GENERAL_OBJECT" 5 "PEDESTRIAN" 4 "BICYCLE" 3 "MOTORBIKE" 2 "TRUCK" 1 "CAR" 0 "UNFILLED" ;
VAL_ 154 OBJ_Camera_Source_9 11 "PARKING_RIGHT" 10 "PARKING_LEFT" 9 "PARKING_REAR" 8 "PARKING_FRONT" 7 "FRONT_CORNER_RIGHT" 6 "FRONT_CORNER_LEFT" 5 "REAR_CORNER_RIGHT" 4 "REAR_CORNER_LEFT" 3 "REAR" 2 "FRONT_FISHEYE" 1 "FRONT_NARROW" 0 "FRONT_MAIN" ;
VAL_ 154 OBJ_Motion_Status_9 5 "MOVING_SLOWLY" 4 "STOPPED" 3 "STATIONARY" 2 "MOVING" 1 "UNKNOWN" 0 "INVALID" ;
VAL_ 154 OBJ_Motion_Orientation_9 13 "INVALID" 12 "NORTH" 11 "NORTH_WEST" 9 "WEST" 7 "SOUTH_WEST" 6 "SOUTH" 5 "SOUTH_EAST" 3 "EAST" 1 "NORTH_EAST" 0 "UNKNOWN" ;
VAL_ 154 OBJ_Has_Cut_Lane_9 1 "TRUE" 0 "FALSE" ;
VAL_ 154 OBJ_Has_Cut_Path_9 1 "TRUE" 0 "FALSE" ;
VAL_ 154 OBJ_Brake_Light_Validity_9 1 "TRUE" 0 "FALSE" ;
VAL_ 154 OBJ_Brake_Light_9 1 "TRUE" 0 "FALSE" ;
VAL_ 154 OBJ_Turn_Indicator_Right_9 1 "TRUE" 0 "FALSE" ;
VAL_ 154 OBJ_Turn_Indicator_Left_9 1 "TRUE" 0 "FALSE" ;
VAL_ 154 OBJ_Turn_Indicator_Validity_9 1 "TRUE" 0 "FALSE" ;
VAL_ 154 OBJ_Right_Out_Of_Image_9 1 "TRUE" 0 "FALSE" ;
VAL_ 154 OBJ_Left_Out_Of_Image_9 1 "TRUE" 0 "FALSE" ;
VAL_ 154 OBJ_Right_Out_Of_Image_V_9 1 "TRUE" 0 "FALSE" ;
VAL_ 154 OBJ_Left_Out_Of_Image_V_9 1 "TRUE" 0 "FALSE" ;
VAL_ 154 OBJ_Top_Out_Of_Image_9 1 "TRUE" 0 "FALSE" ;
VAL_ 154 OBJ_Bottom_Out_Of_Image_9 1 "TRUE" 0 "FALSE" ;
VAL_ 154 OBJ_Top_Out_Of_Image_V_9 1 "VALID" 0 "INVALID" ;
VAL_ 154 OBJ_Bottom_Out_Of_Image_V_9 1 "VALID" 0 "INVALID" ;
VAL_ 154 OBJ_Lane_Assignment_9 5 "RIGHT_RIGHT" 4 "RIGHT" 3 "HOST" 2 "LEFT" 1 "LEFT_LEFT" 0 "UNKNOWN" ;
VAL_ 154 OBJ_Lane_Assignment_V_9 1 "VALID" 0 "INVALID" ;
VAL_ 154 OBJ_Age_Seconds_V_9 1 "VALID" 0 "INVALID" ;
VAL_ 154 OBJ_Width_V_9 1 "VALID" 0 "INVALID" ;
VAL_ 154 OBJ_Width_STD_V_9 1 "VALID" 0 "INVALID" ;
VAL_ 154 OBJ_Length_V_9 1 "VALID" 0 "INVALID" ;
VAL_ 154 OBJ_Length_STD_V_9 1 "VALID" 0 "INVALID" ;
VAL_ 154 OBJ_Height_V_9 1 "VALID" 0 "INVALID" ;
VAL_ 154 OBJ_Height_STD_V_9 1 "VALID" 0 "INVALID" ;
VAL_ 154 OBJ_Abs_Long_Velocity_V_9 1 "VALID" 0 "INVALID" ;
VAL_ 154 OBJ_Abs_Long_Vel_STD_V_9 1 "VALID" 0 "INVALID" ;
VAL_ 154 OBJ_Abs_Lat_Velocity_V_9 1 "VALID" 0 "INVALID" ;
VAL_ 154 OBJ_Abs_Lat_Vel_STD_V_9 1 "VALID" 0 "INVALID" ;
VAL_ 154 OBJ_Abs_Long_Acc_V_9 1 "VALID" 0 "INVALID" ;
VAL_ 154 OBJ_Abs_Long_Acc_STD_V_9 1 "VALID" 0 "INVALID" ;
VAL_ 154 OBJ_Abs_Lat_Acc_V_9 1 "VALID" 0 "INVALID" ;
VAL_ 154 OBJ_Abs_Lat_Acc_STD_V_9 1 "VALID" 0 "INVALID" ;
VAL_ 154 OBJ_Abs_Acceleration_V_9 1 "VALID" 0 "INVALID" ;
VAL_ 154 OBJ_Abs_Acc_STD_V_9 1 "VALID" 0 "INVALID" ;
VAL_ 154 OBJ_Inv_TTC_V_9 1 "VALID" 0 "INVALID" ;
VAL_ 154 OBJ_Inv_TTC_STD_V_9 1 "VALID" 0 "INVALID" ;
VAL_ 154 OBJ_Relative_Long_Acc_V_9 1 "VALID" 0 "INVALID" ;
VAL_ 154 OBJ_Rel_Long_Acc_STD_V_9 1 "VALID" 0 "INVALID" ;
VAL_ 154 OBJ_Relative_Long_Velocity_V_9 1 "VALID" 0 "INVALID" ;
VAL_ 154 OBJ_Rel_Long_Vel_STD_V_9 1 "VALID" 0 "INVALID" ;
VAL_ 154 OBJ_Relative_Lat_Velocity_V_9 1 "VALID" 0 "INVALID" ;
VAL_ 154 OBJ_Rel_Lat_Vel_STD_V_9 1 "VALID" 0 "INVALID" ;
VAL_ 154 OBJ_Long_Distance_V_9 1 "VALID" 0 "INVALID" ;
VAL_ 154 OBJ_Long_Distance_STD_V_9 1 "VALID" 0 "INVALID" ;
VAL_ 154 OBJ_Lat_Distance_V_9 1 "VALID" 0 "INVALID" ;
VAL_ 154 OBJ_Lat_Distance_STD_V_9 1 "VALID" 0 "INVALID" ;
VAL_ 154 OBJ_Absolute_Speed_V_9 1 "VALID" 0 "INVALID" ;
VAL_ 154 OBJ_Absolute_Speed_STD_V_9 1 "VALID" 0 "INVALID" ;
VAL_ 154 OBJ_Heading_V_9 1 "VALID" 0 "INVALID" ;
VAL_ 154 OBJ_Heading_STD_V_9 1 "VALID" 0 "INVALID" ;
VAL_ 154 OBJ_Angle_Rate_STD_V_9 1 "VALID" 0 "INVALID" ;
VAL_ 154 OBJ_Angle_Rate_V_9 1 "VALID" 0 "INVALID" ;
VAL_ 154 OBJ_Angle_Right_V_9 1 "VALID" 0 "INVALID" ;
VAL_ 154 OBJ_Angle_Right_STD_V_9 1 "VALID" 0 "INVALID" ;
VAL_ 154 OBJ_Angle_Left_V_9 1 "VALID" 0 "INVALID" ;
VAL_ 154 OBJ_Angle_Left_STD_V_9 1 "VALID" 0 "INVALID" ;
VAL_ 154 OBJ_Angle_Side_V_9 1 "VALID" 0 "INVALID" ;
VAL_ 154 OBJ_Angle_Side_STD_V_9 1 "VALID" 0 "INVALID" ;
VAL_ 154 OBJ_Angle_Mid_V_9 1 "VALID" 0 "INVALID" ;
VAL_ 154 OBJ_Angle_Mid_STD_V_9 1 "VALID" 0 "INVALID" ;
VAL_ 154 OBJ_Angle_Bottom_V_9 1 "VALID" 0 "INVALID" ;
VAL_ 154 OBJ_Angle_Bottom_STD_V_9 1 "VALID" 0 "INVALID" ;
VAL_ 154 OBJ_Visibility_Side_V_9 1 "VALID" 0 "INVALID" ;
VAL_ 154 OBJ_Visibility_Side_9 2 "REAR" 1 "FRONT" 0 "NOT_VISIBLE" ;
VAL_ 154 OBJ_Is_In_Drivable_Area_9 1 "TRUE" 0 "FALSE" ;
VAL_ 154 OBJ_Is_In_Drivable_Area_V_9 1 "VALID" 0 "INVALID" ;
VAL_ 154 OBJ_Is_VeryClose_V_9 1 "VALID" 0 "INVALID" ;
VAL_ 154 OBJ_Is_VeryClose_9 1 "TRUE" 0 "FALSE" ;
VAL_ 154 OBJ_OverlapAngleEgoLaneR_V_9 1 "VALID" 0 "INVALID" ;
VAL_ 154 OBJ_OverlapAngleEgoLaneL_V_9 1 "VALID" 0 "INVALID" ;
VAL_ 154 OBJ_Is_EMERGENCY_VCL_9 1 "TRUE" 0 "FALSE" ;
VAL_ 154 OBJ_EMERGENCY_LIGHT_COLOR_9 3 "(1000)ORANGE" 2 "(0100)BLUE" 1 "(0010)RED" 0 "(0001)OTHER" ;
VAL_ 154 OBJ_EMERGENCY_V_9 1 "TRUE" 0 "FALSE" ;
VAL_ 154 OBJ_Angle_Top_V_9 1 "VALID" 0 "INVALID" ;
VAL_ 154 OBJ_Angle_Top_STD_V_9 1 "VALID" 0 "INVALID" ;
VAL_ 154 OBJ_Open_Door_Left_9 1 "TRUE" 0 "FALSE" ;
VAL_ 154 OBJ_Open_Door_Right_9 1 "TRUE" 0 "FALSE" ;
VAL_ 154 OBJ_Visible_Left_or_Right_9 2 "RIGHT" 1 "LEFT" 0 "NOT_VISIBLE" ;
VAL_ 154 OBJ_Visible_Left_or_Right_V_9 1 "VALID" 0 "INVALID" ;
VAL_ 154 OBJ_Fusion_Source_10 2 "(BIT_2)RADAR2" 1 "(BIT_1)RADAR1" 0 "(BIT_0)CAMERA" ;
VAL_ 154 OBJ_Triggered_SDM_10 2 "NOT_TRIGGERED" 1 "TRIGGERED" 0 "NOT_AVAILABLE" ;
VAL_ 154 OBJ_Motion_Category_10 13 "ONCOMING" 12 "PRECEEDING" 11 "MOVING" 10 "RTAP" 9 "LTAP" 8 "CROSSING" 7 "MOVING_OUT" 6 "MOVING_IN" 5 "CLOSE_CUT_IN" 4 "PASSING_OUT" 3 "PASSING_IN" 2 "PASSING" 1 "UNDEFINED" 0 "UNFILLED" ;
VAL_ 154 OBJ_Measuring_Status_10 2 "(BIT_2)NOT_VALID_OR_VALID" 1 "(BIT_1)PREDICTED_OR_MEASURED" 0 "(BIT_0)OLD_OR_NEW" ;
VAL_ 154 OBJ_Object_Class_10 9 "TWO_WHEELER" 8 "UNCERTAIN_VCL" 7 "ANIMAL" 6 "GENERAL_OBJECT" 5 "PEDESTRIAN" 4 "BICYCLE" 3 "MOTORBIKE" 2 "TRUCK" 1 "CAR" 0 "UNFILLED" ;
VAL_ 154 OBJ_Camera_Source_10 11 "PARKING_RIGHT" 10 "PARKING_LEFT" 9 "PARKING_REAR" 8 "PARKING_FRONT" 7 "FRONT_CORNER_RIGHT" 6 "FRONT_CORNER_LEFT" 5 "REAR_CORNER_RIGHT" 4 "REAR_CORNER_LEFT" 3 "REAR" 2 "FRONT_FISHEYE" 1 "FRONT_NARROW" 0 "FRONT_MAIN" ;
VAL_ 154 OBJ_Motion_Status_10 5 "MOVING_SLOWLY" 4 "STOPPED" 3 "STATIONARY" 2 "MOVING" 1 "UNKNOWN" 0 "INVALID" ;
VAL_ 154 OBJ_Motion_Orientation_10 13 "INVALID" 12 "NORTH" 11 "NORTH_WEST" 9 "WEST" 7 "SOUTH_WEST" 6 "SOUTH" 5 "SOUTH_EAST" 3 "EAST" 1 "NORTH_EAST" 0 "UNKNOWN" ;
VAL_ 154 OBJ_Has_Cut_Lane_10 1 "TRUE" 0 "FALSE" ;
VAL_ 154 OBJ_Has_Cut_Path_10 1 "TRUE" 0 "FALSE" ;
VAL_ 154 OBJ_Brake_Light_Validity_10 1 "TRUE" 0 "FALSE" ;
VAL_ 154 OBJ_Brake_Light_10 1 "TRUE" 0 "FALSE" ;
VAL_ 154 OBJ_Turn_Indicator_Right_10 1 "TRUE" 0 "FALSE" ;
VAL_ 154 OBJ_Turn_Indicator_Left_10 1 "TRUE" 0 "FALSE" ;
VAL_ 154 OBJ_Turn_Indicator_Validity_10 1 "TRUE" 0 "FALSE" ;
VAL_ 154 OBJ_Right_Out_Of_Image_10 1 "TRUE" 0 "FALSE" ;
VAL_ 154 OBJ_Left_Out_Of_Image_10 1 "TRUE" 0 "FALSE" ;
VAL_ 154 OBJ_Right_Out_Of_Image_V_10 1 "TRUE" 0 "FALSE" ;
VAL_ 154 OBJ_Left_Out_Of_Image_V_10 1 "TRUE" 0 "FALSE" ;
VAL_ 154 OBJ_Top_Out_Of_Image_10 1 "TRUE" 0 "FALSE" ;
VAL_ 154 OBJ_Bottom_Out_Of_Image_10 1 "TRUE" 0 "FALSE" ;
VAL_ 154 OBJ_Top_Out_Of_Image_V_10 1 "VALID" 0 "INVALID" ;
VAL_ 154 OBJ_Bottom_Out_Of_Image_V_10 1 "VALID" 0 "INVALID" ;
VAL_ 154 OBJ_Lane_Assignment_10 5 "RIGHT_RIGHT" 4 "RIGHT" 3 "HOST" 2 "LEFT" 1 "LEFT_LEFT" 0 "UNKNOWN" ;
VAL_ 154 OBJ_Lane_Assignment_V_10 1 "VALID" 0 "INVALID" ;
VAL_ 154 OBJ_Age_Seconds_V_10 1 "VALID" 0 "INVALID" ;
VAL_ 154 OBJ_Width_V_10 1 "VALID" 0 "INVALID" ;
VAL_ 154 OBJ_Width_STD_V_10 1 "VALID" 0 "INVALID" ;
VAL_ 154 OBJ_Length_V_10 1 "VALID" 0 "INVALID" ;
VAL_ 154 OBJ_Length_STD_V_10 1 "VALID" 0 "INVALID" ;
VAL_ 154 OBJ_Height_V_10 1 "VALID" 0 "INVALID" ;
VAL_ 154 OBJ_Height_STD_V_10 1 "VALID" 0 "INVALID" ;
VAL_ 154 OBJ_Abs_Long_Velocity_V_10 1 "VALID" 0 "INVALID" ;
VAL_ 154 OBJ_Abs_Long_Vel_STD_V_10 1 "VALID" 0 "INVALID" ;
VAL_ 154 OBJ_Abs_Lat_Velocity_V_10 1 "VALID" 0 "INVALID" ;
VAL_ 154 OBJ_Abs_Lat_Vel_STD_V_10 1 "VALID" 0 "INVALID" ;
VAL_ 154 OBJ_Abs_Long_Acc_V_10 1 "VALID" 0 "INVALID" ;
VAL_ 154 OBJ_Abs_Long_Acc_STD_V_10 1 "VALID" 0 "INVALID" ;
VAL_ 154 OBJ_Abs_Lat_Acc_V_10 1 "VALID" 0 "INVALID" ;
VAL_ 154 OBJ_Abs_Lat_Acc_STD_V_10 1 "VALID" 0 "INVALID" ;
VAL_ 154 OBJ_Abs_Acceleration_V_10 1 "VALID" 0 "INVALID" ;
VAL_ 154 OBJ_Abs_Acc_STD_V_10 1 "VALID" 0 "INVALID" ;
VAL_ 154 OBJ_Inv_TTC_V_10 1 "VALID" 0 "INVALID" ;
VAL_ 154 OBJ_Inv_TTC_STD_V_10 1 "VALID" 0 "INVALID" ;
VAL_ 154 OBJ_Relative_Long_Acc_V_10 1 "VALID" 0 "INVALID" ;
VAL_ 154 OBJ_Rel_Long_Acc_STD_V_10 1 "VALID" 0 "INVALID" ;
VAL_ 154 OBJ_Relative_Long_Velocity_V_10 1 "VALID" 0 "INVALID" ;
VAL_ 154 OBJ_Rel_Long_Vel_STD_V_10 1 "VALID" 0 "INVALID" ;
VAL_ 154 OBJ_Relative_Lat_Velocity_V_10 1 "VALID" 0 "INVALID" ;
VAL_ 154 OBJ_Rel_Lat_Vel_STD_V_10 1 "VALID" 0 "INVALID" ;
VAL_ 154 OBJ_Long_Distance_V_10 1 "VALID" 0 "INVALID" ;
VAL_ 154 OBJ_Long_Distance_STD_V_10 1 "VALID" 0 "INVALID" ;
VAL_ 154 OBJ_Lat_Distance_V_10 1 "VALID" 0 "INVALID" ;
VAL_ 154 OBJ_Lat_Distance_STD_V_10 1 "VALID" 0 "INVALID" ;
VAL_ 154 OBJ_Absolute_Speed_V_10 1 "VALID" 0 "INVALID" ;
VAL_ 154 OBJ_Absolute_Speed_STD_V_10 1 "VALID" 0 "INVALID" ;
VAL_ 154 OBJ_Heading_V_10 1 "VALID" 0 "INVALID" ;
VAL_ 154 OBJ_Heading_STD_V_10 1 "VALID" 0 "INVALID" ;
VAL_ 154 OBJ_Angle_Rate_STD_V_10 1 "VALID" 0 "INVALID" ;
VAL_ 154 OBJ_Angle_Rate_V_10 1 "VALID" 0 "INVALID" ;
VAL_ 154 OBJ_Angle_Right_V_10 1 "VALID" 0 "INVALID" ;
VAL_ 154 OBJ_Angle_Right_STD_V_10 1 "VALID" 0 "INVALID" ;
VAL_ 154 OBJ_Angle_Left_V_10 1 "VALID" 0 "INVALID" ;
VAL_ 154 OBJ_Angle_Left_STD_V_10 1 "VALID" 0 "INVALID" ;
VAL_ 154 OBJ_Angle_Side_V_10 1 "VALID" 0 "INVALID" ;
VAL_ 154 OBJ_Angle_Side_STD_V_10 1 "VALID" 0 "INVALID" ;
VAL_ 154 OBJ_Angle_Mid_V_10 1 "VALID" 0 "INVALID" ;
VAL_ 154 OBJ_Angle_Mid_STD_V_10 1 "VALID" 0 "INVALID" ;
VAL_ 154 OBJ_Angle_Bottom_V_10 1 "VALID" 0 "INVALID" ;
VAL_ 154 OBJ_Angle_Bottom_STD_V_10 1 "VALID" 0 "INVALID" ;
VAL_ 154 OBJ_Visibility_Side_V_10 1 "VALID" 0 "INVALID" ;
VAL_ 154 OBJ_Visibility_Side_10 2 "REAR" 1 "FRONT" 0 "NOT_VISIBLE" ;
VAL_ 154 OBJ_Is_In_Drivable_Area_10 1 "TRUE" 0 "FALSE" ;
VAL_ 154 OBJ_Is_In_Drivable_Area_V_10 1 "VALID" 0 "INVALID" ;
VAL_ 154 OBJ_Is_VeryClose_V_10 1 "VALID" 0 "INVALID" ;
VAL_ 154 OBJ_Is_VeryClose_10 1 "TRUE" 0 "FALSE" ;
VAL_ 154 OBJ_OverlapAngleEgoLaneR_V_10 1 "VALID" 0 "INVALID" ;
VAL_ 154 OBJ_OverlapAngleEgoLaneL_V_10 1 "VALID" 0 "INVALID" ;
VAL_ 154 OBJ_Is_EMERGENCY_VCL_10 1 "TRUE" 0 "FALSE" ;
VAL_ 154 OBJ_EMERGENCY_LIGHT_COLOR_10 3 "(1000)ORANGE" 2 "(0100)BLUE" 1 "(0010)RED" 0 "(0001)OTHER" ;
VAL_ 154 OBJ_EMERGENCY_V_10 1 "TRUE" 0 "FALSE" ;
VAL_ 154 OBJ_Angle_Top_V_10 1 "VALID" 0 "INVALID" ;
VAL_ 154 OBJ_Angle_Top_STD_V_10 1 "VALID" 0 "INVALID" ;
VAL_ 154 OBJ_Open_Door_Left_10 1 "TRUE" 0 "FALSE" ;
VAL_ 154 OBJ_Open_Door_Right_10 1 "TRUE" 0 "FALSE" ;
VAL_ 154 OBJ_Visible_Left_or_Right_10 2 "RIGHT" 1 "LEFT" 0 "NOT_VISIBLE" ;
VAL_ 154 OBJ_Visible_Left_or_Right_V_10 1 "VALID" 0 "INVALID" ;
VAL_ 154 OBJ_Fusion_Source_11 2 "(BIT_2)RADAR2" 1 "(BIT_1)RADAR1" 0 "(BIT_0)CAMERA" ;
VAL_ 154 OBJ_Triggered_SDM_11 2 "NOT_TRIGGERED" 1 "TRIGGERED" 0 "NOT_AVAILABLE" ;
VAL_ 154 OBJ_Motion_Category_11 13 "ONCOMING" 12 "PRECEEDING" 11 "MOVING" 10 "RTAP" 9 "LTAP" 8 "CROSSING" 7 "MOVING_OUT" 6 "MOVING_IN" 5 "CLOSE_CUT_IN" 4 "PASSING_OUT" 3 "PASSING_IN" 2 "PASSING" 1 "UNDEFINED" 0 "UNFILLED" ;
VAL_ 154 OBJ_Measuring_Status_11 2 "(BIT_2)NOT_VALID_OR_VALID" 1 "(BIT_1)PREDICTED_OR_MEASURED" 0 "(BIT_0)OLD_OR_NEW" ;
VAL_ 154 OBJ_Object_Class_11 9 "TWO_WHEELER" 8 "UNCERTAIN_VCL" 7 "ANIMAL" 6 "GENERAL_OBJECT" 5 "PEDESTRIAN" 4 "BICYCLE" 3 "MOTORBIKE" 2 "TRUCK" 1 "CAR" 0 "UNFILLED" ;
VAL_ 154 OBJ_Camera_Source_11 11 "PARKING_RIGHT" 10 "PARKING_LEFT" 9 "PARKING_REAR" 8 "PARKING_FRONT" 7 "FRONT_CORNER_RIGHT" 6 "FRONT_CORNER_LEFT" 5 "REAR_CORNER_RIGHT" 4 "REAR_CORNER_LEFT" 3 "REAR" 2 "FRONT_FISHEYE" 1 "FRONT_NARROW" 0 "FRONT_MAIN" ;
VAL_ 154 OBJ_Motion_Status_11 5 "MOVING_SLOWLY" 4 "STOPPED" 3 "STATIONARY" 2 "MOVING" 1 "UNKNOWN" 0 "INVALID" ;
VAL_ 154 OBJ_Motion_Orientation_11 13 "INVALID" 12 "NORTH" 11 "NORTH_WEST" 9 "WEST" 7 "SOUTH_WEST" 6 "SOUTH" 5 "SOUTH_EAST" 3 "EAST" 1 "NORTH_EAST" 0 "UNKNOWN" ;
VAL_ 154 OBJ_Has_Cut_Lane_11 1 "TRUE" 0 "FALSE" ;
VAL_ 154 OBJ_Has_Cut_Path_11 1 "TRUE" 0 "FALSE" ;
VAL_ 154 OBJ_Brake_Light_Validity_11 1 "TRUE" 0 "FALSE" ;
VAL_ 154 OBJ_Brake_Light_11 1 "TRUE" 0 "FALSE" ;
VAL_ 154 OBJ_Turn_Indicator_Right_11 1 "TRUE" 0 "FALSE" ;
VAL_ 154 OBJ_Turn_Indicator_Left_11 1 "TRUE" 0 "FALSE" ;
VAL_ 154 OBJ_Turn_Indicator_Validity_11 1 "TRUE" 0 "FALSE" ;
VAL_ 154 OBJ_Right_Out_Of_Image_11 1 "TRUE" 0 "FALSE" ;
VAL_ 154 OBJ_Left_Out_Of_Image_11 1 "TRUE" 0 "FALSE" ;
VAL_ 154 OBJ_Right_Out_Of_Image_V_11 1 "TRUE" 0 "FALSE" ;
VAL_ 154 OBJ_Left_Out_Of_Image_V_11 1 "TRUE" 0 "FALSE" ;
VAL_ 154 OBJ_Top_Out_Of_Image_11 1 "TRUE" 0 "FALSE" ;
VAL_ 154 OBJ_Bottom_Out_Of_Image_11 1 "TRUE" 0 "FALSE" ;
VAL_ 154 OBJ_Top_Out_Of_Image_V_11 1 "VALID" 0 "INVALID" ;
VAL_ 154 OBJ_Bottom_Out_Of_Image_V_11 1 "VALID" 0 "INVALID" ;
VAL_ 154 OBJ_Lane_Assignment_11 5 "RIGHT_RIGHT" 4 "RIGHT" 3 "HOST" 2 "LEFT" 1 "LEFT_LEFT" 0 "UNKNOWN" ;
VAL_ 154 OBJ_Lane_Assignment_V_11 1 "VALID" 0 "INVALID" ;
VAL_ 154 OBJ_Age_Seconds_V_11 1 "VALID" 0 "INVALID" ;
VAL_ 154 OBJ_Width_V_11 1 "VALID" 0 "INVALID" ;
VAL_ 154 OBJ_Width_STD_V_11 1 "VALID" 0 "INVALID" ;
VAL_ 154 OBJ_Length_V_11 1 "VALID" 0 "INVALID" ;
VAL_ 154 OBJ_Length_STD_V_11 1 "VALID" 0 "INVALID" ;
VAL_ 154 OBJ_Height_V_11 1 "VALID" 0 "INVALID" ;
VAL_ 154 OBJ_Height_STD_V_11 1 "VALID" 0 "INVALID" ;
VAL_ 154 OBJ_Abs_Long_Velocity_V_11 1 "VALID" 0 "INVALID" ;
VAL_ 154 OBJ_Abs_Long_Vel_STD_V_11 1 "VALID" 0 "INVALID" ;
VAL_ 154 OBJ_Abs_Lat_Velocity_V_11 1 "VALID" 0 "INVALID" ;
VAL_ 154 OBJ_Abs_Lat_Vel_STD_V_11 1 "VALID" 0 "INVALID" ;
VAL_ 154 OBJ_Abs_Long_Acc_V_11 1 "VALID" 0 "INVALID" ;
VAL_ 154 OBJ_Abs_Long_Acc_STD_V_11 1 "VALID" 0 "INVALID" ;
VAL_ 154 OBJ_Abs_Lat_Acc_V_11 1 "VALID" 0 "INVALID" ;
VAL_ 154 OBJ_Abs_Lat_Acc_STD_V_11 1 "VALID" 0 "INVALID" ;
VAL_ 154 OBJ_Abs_Acceleration_V_11 1 "VALID" 0 "INVALID" ;
VAL_ 154 OBJ_Abs_Acc_STD_V_11 1 "VALID" 0 "INVALID" ;
VAL_ 154 OBJ_Inv_TTC_V_11 1 "VALID" 0 "INVALID" ;
VAL_ 154 OBJ_Inv_TTC_STD_V_11 1 "VALID" 0 "INVALID" ;
VAL_ 154 OBJ_Relative_Long_Acc_V_11 1 "VALID" 0 "INVALID" ;
